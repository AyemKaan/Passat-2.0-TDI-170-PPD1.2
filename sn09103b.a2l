ASAP2_VERSION 1 41
/begin PROJECT SN0 "SIMOS PPD"
/begin HEADER "_default_HeaderComment" PROJECT_NO PRJ_NUM /end HEADER
/begin MODULE _default_ModuleName "_default_ModuleLongIdentifier"
/begin MOD_COMMON "_default_ModCommonComment" DEPOSIT ABSOLUTE BYTE_ORDER MSB_FIRST ALIGNMENT_BYTE 1 ALIGNMENT_WORD 2 ALIGNMENT_LONG 4 ALIGNMENT_FLOAT32_IEEE 4 ALIGNMENT_FLOAT64_IEEE 8 /end MOD_COMMON
/begin MEASUREMENT lv_err_v_tco_1_rng "Error flag of diagnosis instance V_TCO_1_RNG" UBYTE _CNV_S_2_RANGE______28_CM 1 0. 0. 1. DISPLAY_IDENTIFIER LV_ERR_V_TCO_1_RNG ECU_ADDRESS 0x7fb4e7 /end MEASUREMENT
/begin MEASUREMENT fmy_stat_v_tco_1_rng.ctr_abc "anti bounce counter for diagnosis instance V_TCO_1_RNG" UBYTE _CNV_A_R_LINEAR_____1_CM 1 0. 0. 255. DISPLAY_IDENTIFIER CTR_ABC_V_TCO_1_RNG ECU_ADDRESS 0x7f998d FORMAT "%3.0" /end MEASUREMENT
/begin MEASUREMENT fmy_stat_v_tco_1_rng.ctr_end_diag "counter for end of diagnosis for diagnosis instance V_TCO_1_RNG" UBYTE _CNV_A_R_LINEAR_____1_CM 1 0. 0. 255. DISPLAY_IDENTIFIER CTR_ABC_END_DIAG_V_TCO_1_RNG ECU_ADDRESS 0x7f998c FORMAT "%3.0" /end MEASUREMENT
/begin MEASUREMENT fmy_stat_v_tco_1_rng.err_info_stat.reserved "" UWORD _CNV_A_R_LINEAR_____0_CM 1 0. 0. 65535. DISPLAY_IDENTIFIER FMY_STAT_V_TCO_1_RNG_ERR_INFO_ST ECU_ADDRESS 0x7f998a BYTE_ORDER MSB_LAST BIT_MASK 0xF800 /end MEASUREMENT
/begin MEASUREMENT fmy_stat_v_tco_1_rng.err_info_stat.lv_cdn_diag_stc "Statistical flag for condition of diagnosis of the diagnosis instance V_TCO_1_RNG" UWORD _CNV_S_2_RANGE______380_CM 1 0. 0. 1. DISPLAY_IDENTIFIER LV_CDN_DIAG_STC_V_TCO_1_RNG ECU_ADDRESS 0x7f998a BYTE_ORDER MSB_LAST BIT_MASK 0x400 /end MEASUREMENT
/begin MEASUREMENT fmy_stat_v_tco_1_rng.err_info_stat.lv_lock_diag "lock flag (CPU load optimisation) of the diagnosis instance V_TCO_1_RNG" UWORD _CNV_S_2_RANGE______380_CM 1 0. 0. 1. DISPLAY_IDENTIFIER LV_LOCK_DIAG_V_TCO_1_RNG ECU_ADDRESS 0x7f998a BYTE_ORDER MSB_LAST BIT_MASK 0x200 /end MEASUREMENT
/begin MEASUREMENT fmy_stat_v_tco_1_rng.err_info_stat.lv_err_mem "storage in dynamic failure memory of the diagnosis instance V_TCO_1_RNG" UWORD _CNV_S_2_RANGE______380_CM 1 0. 0. 1. DISPLAY_IDENTIFIER LV_ERR_MEM_V_TCO_1_RNG ECU_ADDRESS 0x7f998a BYTE_ORDER MSB_LAST BIT_MASK 0x80 /end MEASUREMENT
/begin MEASUREMENT fmy_stat_v_tco_1_rng.err_info_stat.lv_ready "readiness status of the diagnosis instance V_TCO_1_RNG" UWORD _CNV_S_2_RANGE______380_CM 1 0. 0. 1. DISPLAY_IDENTIFIER LV_READY_V_TCO_1_RNG ECU_ADDRESS 0x7f998a BYTE_ORDER MSB_LAST BIT_MASK 0x40 /end MEASUREMENT
/begin MEASUREMENT fmy_stat_v_tco_1_rng.err_info_stat.lv_end_diag "end of diagnosis of the diagnosis instance V_TCO_1_RNG" UWORD _CNV_S_2_RANGE______380_CM 1 0. 0. 1. DISPLAY_IDENTIFIER LV_END_DIAG_V_TCO_1_RNG ECU_ADDRESS 0x7f998a BYTE_ORDER MSB_LAST BIT_MASK 0x20 /end MEASUREMENT
/begin MEASUREMENT fmy_stat_v_tco_1_rng.err_info_stat.lv_cdn_diag "diagnosis condition of the diagnosis instance V_TCO_1_RNG" UWORD _CNV_S_2_RANGE______380_CM 1 0. 0. 1. DISPLAY_IDENTIFIER LV_CDN_DIAG_V_TCO_1_RNG ECU_ADDRESS 0x7f998a BYTE_ORDER MSB_LAST BIT_MASK 0x10 /end MEASUREMENT
/begin MEASUREMENT fmy_stat_v_tco_1_rng.err_info_stat.err_sym "symptoms of the diagnosis instance V_TCO_1_RNG" UWORD _CNV_S_6_CONV_ERRM__27_CM 1 0. 0. 15. DISPLAY_IDENTIFIER ERR_SYM_V_TCO_1_RNG ECU_ADDRESS 0x7f998a BYTE_ORDER MSB_LAST BIT_MASK 0xF /end MEASUREMENT
/begin MEASUREMENT lv_err_v_tco_2_rng "Error flag of diagnosis instance V_TCO_2_RNG" UBYTE _CNV_S_2_RANGE______28_CM 1 0. 0. 1. DISPLAY_IDENTIFIER LV_ERR_V_TCO_2_RNG ECU_ADDRESS 0x7fb4e8 /end MEASUREMENT
/begin MEASUREMENT fmy_stat_v_tco_2_rng.ctr_abc "anti bounce counter for diagnosis instance V_TCO_2_RNG" UBYTE _CNV_A_R_LINEAR_____1_CM 1 0. 0. 255. DISPLAY_IDENTIFIER CTR_ABC_V_TCO_2_RNG ECU_ADDRESS 0x7f9991 FORMAT "%3.0" /end MEASUREMENT
/begin MEASUREMENT fmy_stat_v_tco_2_rng.ctr_end_diag "counter for end of diagnosis for diagnosis instance V_TCO_2_RNG" UBYTE _CNV_A_R_LINEAR_____1_CM 1 0. 0. 255. DISPLAY_IDENTIFIER CTR_ABC_END_DIAG_V_TCO_2_RNG ECU_ADDRESS 0x7f9990 FORMAT "%3.0" /end MEASUREMENT
/begin MEASUREMENT fmy_stat_v_tco_2_rng.err_info_stat.reserved "" UWORD _CNV_A_R_LINEAR_____0_CM 1 0. 0. 65535. DISPLAY_IDENTIFIER FMY_STAT_V_TCO_2_RNG_ERR_INFO_ST ECU_ADDRESS 0x7f998e BYTE_ORDER MSB_LAST BIT_MASK 0xF800 /end MEASUREMENT
/begin MEASUREMENT fmy_stat_v_tco_2_rng.err_info_stat.lv_cdn_diag_stc "Statistical flag for condition of diagnosis of the diagnosis instance V_TCO_2_RNG" UWORD _CNV_S_2_RANGE______380_CM 1 0. 0. 1. DISPLAY_IDENTIFIER LV_CDN_DIAG_STC_V_TCO_2_RNG ECU_ADDRESS 0x7f998e BYTE_ORDER MSB_LAST BIT_MASK 0x400 /end MEASUREMENT
/begin MEASUREMENT fmy_stat_v_tco_2_rng.err_info_stat.lv_lock_diag "lock flag (CPU load optimisation) of the diagnosis instance V_TCO_2_RNG" UWORD _CNV_S_2_RANGE______380_CM 1 0. 0. 1. DISPLAY_IDENTIFIER LV_LOCK_DIAG_V_TCO_2_RNG ECU_ADDRESS 0x7f998e BYTE_ORDER MSB_LAST BIT_MASK 0x200 /end MEASUREMENT
/begin MEASUREMENT fmy_stat_v_tco_2_rng.err_info_stat.lv_err_mem "storage in dynamic failure memory of the diagnosis instance V_TCO_2_RNG" UWORD _CNV_S_2_RANGE______380_CM 1 0. 0. 1. DISPLAY_IDENTIFIER LV_ERR_MEM_V_TCO_2_RNG ECU_ADDRESS 0x7f998e BYTE_ORDER MSB_LAST BIT_MASK 0x80 /end MEASUREMENT
/begin MEASUREMENT fmy_stat_v_tco_2_rng.err_info_stat.lv_ready "readiness status of the diagnosis instance V_TCO_2_RNG" UWORD _CNV_S_2_RANGE______380_CM 1 0. 0. 1. DISPLAY_IDENTIFIER LV_READY_V_TCO_2_RNG ECU_ADDRESS 0x7f998e BYTE_ORDER MSB_LAST BIT_MASK 0x40 /end MEASUREMENT
/begin MEASUREMENT fmy_stat_v_tco_2_rng.err_info_stat.lv_end_diag "end of diagnosis of the diagnosis instance V_TCO_2_RNG" UWORD _CNV_S_2_RANGE______380_CM 1 0. 0. 1. DISPLAY_IDENTIFIER LV_END_DIAG_V_TCO_2_RNG ECU_ADDRESS 0x7f998e BYTE_ORDER MSB_LAST BIT_MASK 0x20 /end MEASUREMENT
/begin MEASUREMENT fmy_stat_v_tco_2_rng.err_info_stat.lv_cdn_diag "diagnosis condition of the diagnosis instance V_TCO_2_RNG" UWORD _CNV_S_2_RANGE______380_CM 1 0. 0. 1. DISPLAY_IDENTIFIER LV_CDN_DIAG_V_TCO_2_RNG ECU_ADDRESS 0x7f998e BYTE_ORDER MSB_LAST BIT_MASK 0x10 /end MEASUREMENT
/begin MEASUREMENT fmy_stat_v_tco_2_rng.err_info_stat.err_sym "symptoms of the diagnosis instance V_TCO_2_RNG" UWORD _CNV_S_6_CONV_ERRM__27_CM 1 0. 0. 15. DISPLAY_IDENTIFIER ERR_SYM_V_TCO_2_RNG ECU_ADDRESS 0x7f998e BYTE_ORDER MSB_LAST BIT_MASK 0xF /end MEASUREMENT
/begin MEASUREMENT lv_err_tco_1_mes_grd "Error flag of diagnosis instance TCO_1_MES_GRD" UBYTE _CNV_S_2_RANGE______28_CM 1 0. 0. 1. DISPLAY_IDENTIFIER LV_ERR_TCO_1_MES_GRD ECU_ADDRESS 0x7fb4e9 /end MEASUREMENT
/begin MEASUREMENT fmy_stat_tco_1_mes_grd.ctr_abc "anti bounce counter for diagnosis instance TCO_1_MES_GRD" UBYTE _CNV_A_R_LINEAR_____1_CM 1 0. 0. 255. DISPLAY_IDENTIFIER CTR_ABC_TCO_1_MES_GRD ECU_ADDRESS 0x7f9995 FORMAT "%3.0" /end MEASUREMENT
/begin MEASUREMENT fmy_stat_tco_1_mes_grd.ctr_end_diag "counter for end of diagnosis for diagnosis instance TCO_1_MES_GRD" UBYTE _CNV_A_R_LINEAR_____1_CM 1 0. 0. 255. DISPLAY_IDENTIFIER CTR_ABC_END_DIAG_TCO_1_MES_GRD ECU_ADDRESS 0x7f9994 FORMAT "%3.0" /end MEASUREMENT
/begin MEASUREMENT fmy_stat_tco_1_mes_grd.err_info_stat.reserved "" UWORD _CNV_A_R_LINEAR_____0_CM 1 0. 0. 65535. DISPLAY_IDENTIFIER FMY_STAT_TCO_1_MES_GRD_ERR_INFO_ ECU_ADDRESS 0x7f9992 BYTE_ORDER MSB_LAST BIT_MASK 0xF800 /end MEASUREMENT
/begin MEASUREMENT fmy_stat_tco_1_mes_grd.err_info_stat.lv_cdn_diag_stc "Statistical flag for condition of diagnosis of the diagnosis instance TCO_1_MES_GRD" UWORD _CNV_S_2_RANGE______380_CM 1 0. 0. 1. DISPLAY_IDENTIFIER LV_CDN_DIAG_STC_TCO_1_MES_GRD ECU_ADDRESS 0x7f9992 BYTE_ORDER MSB_LAST BIT_MASK 0x400 /end MEASUREMENT
/begin MEASUREMENT fmy_stat_tco_1_mes_grd.err_info_stat.lv_lock_diag "lock flag (CPU load optimisation) of the diagnosis instance TCO_1_MES_GRD" UWORD _CNV_S_2_RANGE______380_CM 1 0. 0. 1. DISPLAY_IDENTIFIER LV_LOCK_DIAG_TCO_1_MES_GRD ECU_ADDRESS 0x7f9992 BYTE_ORDER MSB_LAST BIT_MASK 0x200 /end MEASUREMENT
/begin MEASUREMENT fmy_stat_tco_1_mes_grd.err_info_stat.lv_err_mem "storage in dynamic failure memory of the diagnosis instance TCO_1_MES_GRD" UWORD _CNV_S_2_RANGE______380_CM 1 0. 0. 1. DISPLAY_IDENTIFIER LV_ERR_MEM_TCO_1_MES_GRD ECU_ADDRESS 0x7f9992 BYTE_ORDER MSB_LAST BIT_MASK 0x80 /end MEASUREMENT
/begin MEASUREMENT fmy_stat_tco_1_mes_grd.err_info_stat.lv_ready "readiness status of the diagnosis instance TCO_1_MES_GRD" UWORD _CNV_S_2_RANGE______380_CM 1 0. 0. 1. DISPLAY_IDENTIFIER LV_READY_TCO_1_MES_GRD ECU_ADDRESS 0x7f9992 BYTE_ORDER MSB_LAST BIT_MASK 0x40 /end MEASUREMENT
/begin MEASUREMENT fmy_stat_tco_1_mes_grd.err_info_stat.lv_end_diag "end of diagnosis of the diagnosis instance TCO_1_MES_GRD" UWORD _CNV_S_2_RANGE______380_CM 1 0. 0. 1. DISPLAY_IDENTIFIER LV_END_DIAG_TCO_1_MES_GRD ECU_ADDRESS 0x7f9992 BYTE_ORDER MSB_LAST BIT_MASK 0x20 /end MEASUREMENT
/begin MEASUREMENT fmy_stat_tco_1_mes_grd.err_info_stat.lv_cdn_diag "diagnosis condition of the diagnosis instance TCO_1_MES_GRD" UWORD _CNV_S_2_RANGE______380_CM 1 0. 0. 1. DISPLAY_IDENTIFIER LV_CDN_DIAG_TCO_1_MES_GRD ECU_ADDRESS 0x7f9992 BYTE_ORDER MSB_LAST BIT_MASK 0x10 /end MEASUREMENT
/begin MEASUREMENT fmy_stat_tco_1_mes_grd.err_info_stat.err_sym "symptoms of the diagnosis instance TCO_1_MES_GRD" UWORD _CNV_S_6_CONV_ERRM__27_CM 1 0. 0. 15. DISPLAY_IDENTIFIER ERR_SYM_TCO_1_MES_GRD ECU_ADDRESS 0x7f9992 BYTE_ORDER MSB_LAST BIT_MASK 0xF /end MEASUREMENT
/begin MEASUREMENT lv_err_tco_2_mes_grd "Error flag of diagnosis instance TCO_2_MES_GRD" UBYTE _CNV_S_2_RANGE______28_CM 1 0. 0. 1. DISPLAY_IDENTIFIER LV_ERR_TCO_2_MES_GRD ECU_ADDRESS 0x7fb4ea /end MEASUREMENT
/begin MEASUREMENT fmy_stat_tco_2_mes_grd.ctr_abc "anti bounce counter for diagnosis instance TCO_2_MES_GRD" UBYTE _CNV_A_R_LINEAR_____1_CM 1 0. 0. 255. DISPLAY_IDENTIFIER CTR_ABC_TCO_2_MES_GRD ECU_ADDRESS 0x7f9999 FORMAT "%3.0" /end MEASUREMENT
/begin MEASUREMENT fmy_stat_tco_2_mes_grd.ctr_end_diag "counter for end of diagnosis for diagnosis instance TCO_2_MES_GRD" UBYTE _CNV_A_R_LINEAR_____1_CM 1 0. 0. 255. DISPLAY_IDENTIFIER CTR_ABC_END_DIAG_TCO_2_MES_GRD ECU_ADDRESS 0x7f9998 FORMAT "%3.0" /end MEASUREMENT
/begin MEASUREMENT fmy_stat_tco_2_mes_grd.err_info_stat.reserved "" UWORD _CNV_A_R_LINEAR_____0_CM 1 0. 0. 65535. DISPLAY_IDENTIFIER FMY_STAT_TCO_2_MES_GRD_ERR_INFO_ ECU_ADDRESS 0x7f9996 BYTE_ORDER MSB_LAST BIT_MASK 0xF800 /end MEASUREMENT
/begin MEASUREMENT fmy_stat_tco_2_mes_grd.err_info_stat.lv_cdn_diag_stc "Statistical flag for condition of diagnosis of the diagnosis instance TCO_2_MES_GRD" UWORD _CNV_S_2_RANGE______380_CM 1 0. 0. 1. DISPLAY_IDENTIFIER LV_CDN_DIAG_STC_TCO_2_MES_GRD ECU_ADDRESS 0x7f9996 BYTE_ORDER MSB_LAST BIT_MASK 0x400 /end MEASUREMENT
/begin MEASUREMENT fmy_stat_tco_2_mes_grd.err_info_stat.lv_lock_diag "lock flag (CPU load optimisation) of the diagnosis instance TCO_2_MES_GRD" UWORD _CNV_S_2_RANGE______380_CM 1 0. 0. 1. DISPLAY_IDENTIFIER LV_LOCK_DIAG_TCO_2_MES_GRD ECU_ADDRESS 0x7f9996 BYTE_ORDER MSB_LAST BIT_MASK 0x200 /end MEASUREMENT
/begin MEASUREMENT fmy_stat_tco_2_mes_grd.err_info_stat.lv_err_mem "storage in dynamic failure memory of the diagnosis instance TCO_2_MES_GRD" UWORD _CNV_S_2_RANGE______380_CM 1 0. 0. 1. DISPLAY_IDENTIFIER LV_ERR_MEM_TCO_2_MES_GRD ECU_ADDRESS 0x7f9996 BYTE_ORDER MSB_LAST BIT_MASK 0x80 /end MEASUREMENT
/begin MEASUREMENT fmy_stat_tco_2_mes_grd.err_info_stat.lv_ready "readiness status of the diagnosis instance TCO_2_MES_GRD" UWORD _CNV_S_2_RANGE______380_CM 1 0. 0. 1. DISPLAY_IDENTIFIER LV_READY_TCO_2_MES_GRD ECU_ADDRESS 0x7f9996 BYTE_ORDER MSB_LAST BIT_MASK 0x40 /end MEASUREMENT
/begin MEASUREMENT fmy_stat_tco_2_mes_grd.err_info_stat.lv_end_diag "end of diagnosis of the diagnosis instance TCO_2_MES_GRD" UWORD _CNV_S_2_RANGE______380_CM 1 0. 0. 1. DISPLAY_IDENTIFIER LV_END_DIAG_TCO_2_MES_GRD ECU_ADDRESS 0x7f9996 BYTE_ORDER MSB_LAST BIT_MASK 0x20 /end MEASUREMENT
/begin MEASUREMENT fmy_stat_tco_2_mes_grd.err_info_stat.lv_cdn_diag "diagnosis condition of the diagnosis instance TCO_2_MES_GRD" UWORD _CNV_S_2_RANGE______380_CM 1 0. 0. 1. DISPLAY_IDENTIFIER LV_CDN_DIAG_TCO_2_MES_GRD ECU_ADDRESS 0x7f9996 BYTE_ORDER MSB_LAST BIT_MASK 0x10 /end MEASUREMENT
/begin MEASUREMENT fmy_stat_tco_2_mes_grd.err_info_stat.err_sym "symptoms of the diagnosis instance TCO_2_MES_GRD" UWORD _CNV_S_6_CONV_ERRM__27_CM 1 0. 0. 15. DISPLAY_IDENTIFIER ERR_SYM_TCO_2_MES_GRD ECU_ADDRESS 0x7f9996 BYTE_ORDER MSB_LAST BIT_MASK 0xF /end MEASUREMENT
/begin MEASUREMENT lv_err_tco_mes_plaus "Error flag of diagnosis instance TCO_MES_PLAUS" UBYTE _CNV_S_2_RANGE______28_CM 1 0. 0. 1. DISPLAY_IDENTIFIER LV_ERR_TCO_MES_PLAUS ECU_ADDRESS 0x7fb4eb /end MEASUREMENT
/begin MEASUREMENT fmy_stat_tco_mes_plaus.ctr_abc "anti bounce counter for diagnosis instance TCO_MES_PLAUS" UBYTE _CNV_A_R_LINEAR_____1_CM 1 0. 0. 255. DISPLAY_IDENTIFIER CTR_ABC_TCO_MES_PLAUS ECU_ADDRESS 0x7f999d FORMAT "%3.0" /end MEASUREMENT
/begin MEASUREMENT fmy_stat_tco_mes_plaus.ctr_end_diag "counter for end of diagnosis for diagnosis instance TCO_MES_PLAUS" UBYTE _CNV_A_R_LINEAR_____1_CM 1 0. 0. 255. DISPLAY_IDENTIFIER CTR_ABC_END_DIAG_TCO_MES_PLAUS ECU_ADDRESS 0x7f999c FORMAT "%3.0" /end MEASUREMENT
/begin MEASUREMENT fmy_stat_tco_mes_plaus.err_info_stat.reserved "" UWORD _CNV_A_R_LINEAR_____0_CM 1 0. 0. 65535. DISPLAY_IDENTIFIER FMY_STAT_TCO_MES_PLAUS_ERR_INFO_ ECU_ADDRESS 0x7f999a BYTE_ORDER MSB_LAST BIT_MASK 0xF800 /end MEASUREMENT
/begin MEASUREMENT fmy_stat_tco_mes_plaus.err_info_stat.lv_cdn_diag_stc "Statistical flag for condition of diagnosis of the diagnosis instance TCO_MES_PLAUS" UWORD _CNV_S_2_RANGE______380_CM 1 0. 0. 1. DISPLAY_IDENTIFIER LV_CDN_DIAG_STC_TCO_MES_PLAUS ECU_ADDRESS 0x7f999a BYTE_ORDER MSB_LAST BIT_MASK 0x400 /end MEASUREMENT
/begin MEASUREMENT fmy_stat_tco_mes_plaus.err_info_stat.lv_lock_diag "lock flag (CPU load optimisation) of the diagnosis instance TCO_MES_PLAUS" UWORD _CNV_S_2_RANGE______380_CM 1 0. 0. 1. DISPLAY_IDENTIFIER LV_LOCK_DIAG_TCO_MES_PLAUS ECU_ADDRESS 0x7f999a BYTE_ORDER MSB_LAST BIT_MASK 0x200 /end MEASUREMENT
/begin MEASUREMENT fmy_stat_tco_mes_plaus.err_info_stat.lv_err_mem "storage in dynamic failure memory of the diagnosis instance TCO_MES_PLAUS" UWORD _CNV_S_2_RANGE______380_CM 1 0. 0. 1. DISPLAY_IDENTIFIER LV_ERR_MEM_TCO_MES_PLAUS ECU_ADDRESS 0x7f999a BYTE_ORDER MSB_LAST BIT_MASK 0x80 /end MEASUREMENT
/begin MEASUREMENT fmy_stat_tco_mes_plaus.err_info_stat.lv_ready "readiness status of the diagnosis instance TCO_MES_PLAUS" UWORD _CNV_S_2_RANGE______380_CM 1 0. 0. 1. DISPLAY_IDENTIFIER LV_READY_TCO_MES_PLAUS ECU_ADDRESS 0x7f999a BYTE_ORDER MSB_LAST BIT_MASK 0x40 /end MEASUREMENT
/begin MEASUREMENT fmy_stat_tco_mes_plaus.err_info_stat.lv_end_diag "end of diagnosis of the diagnosis instance TCO_MES_PLAUS" UWORD _CNV_S_2_RANGE______380_CM 1 0. 0. 1. DISPLAY_IDENTIFIER LV_END_DIAG_TCO_MES_PLAUS ECU_ADDRESS 0x7f999a BYTE_ORDER MSB_LAST BIT_MASK 0x20 /end MEASUREMENT
/begin MEASUREMENT fmy_stat_tco_mes_plaus.err_info_stat.lv_cdn_diag "diagnosis condition of the diagnosis instance TCO_MES_PLAUS" UWORD _CNV_S_2_RANGE______380_CM 1 0. 0. 1. DISPLAY_IDENTIFIER LV_CDN_DIAG_TCO_MES_PLAUS ECU_ADDRESS 0x7f999a BYTE_ORDER MSB_LAST BIT_MASK 0x10 /end MEASUREMENT
/begin MEASUREMENT fmy_stat_tco_mes_plaus.err_info_stat.err_sym "symptoms of the diagnosis instance TCO_MES_PLAUS" UWORD _CNV_S_6_CONV_ERRM__27_CM 1 0. 0. 15. DISPLAY_IDENTIFIER ERR_SYM_TCO_MES_PLAUS ECU_ADDRESS 0x7f999a BYTE_ORDER MSB_LAST BIT_MASK 0xF /end MEASUREMENT
/begin MEASUREMENT lv_err_egr_ctl_min "Error flag of diagnosis instance EGR_CTL_MIN" UBYTE _CNV_S_2_RANGE______28_CM 1 0. 0. 1. DISPLAY_IDENTIFIER LV_ERR_EGR_CTL_MIN ECU_ADDRESS 0x7fb4ec /end MEASUREMENT
/begin MEASUREMENT fmy_stat_egr_ctl_min.ctr_abc "anti bounce counter for diagnosis instance EGR_CTL_MIN" UBYTE _CNV_A_R_LINEAR_____1_CM 1 0. 0. 255. DISPLAY_IDENTIFIER CTR_ABC_EGR_CTL_MIN ECU_ADDRESS 0x7f99a1 FORMAT "%3.0" /end MEASUREMENT
/begin MEASUREMENT fmy_stat_egr_ctl_min.ctr_end_diag "counter for end of diagnosis for diagnosis instance EGR_CTL_MIN" UBYTE _CNV_A_R_LINEAR_____1_CM 1 0. 0. 255. DISPLAY_IDENTIFIER CTR_ABC_END_DIAG_EGR_CTL_MIN ECU_ADDRESS 0x7f99a0 FORMAT "%3.0" /end MEASUREMENT
/begin MEASUREMENT fmy_stat_egr_ctl_min.err_info_stat.reserved "" UWORD _CNV_A_R_LINEAR_____0_CM 1 0. 0. 65535. DISPLAY_IDENTIFIER FMY_STAT_EGR_CTL_MIN_ERR_INFO_ST ECU_ADDRESS 0x7f999e BYTE_ORDER MSB_LAST BIT_MASK 0xF800 /end MEASUREMENT
/begin MEASUREMENT fmy_stat_egr_ctl_min.err_info_stat.lv_cdn_diag_stc "Statistical flag for condition of diagnosis of the diagnosis instance EGR_CTL_MIN" UWORD _CNV_S_2_RANGE______380_CM 1 0. 0. 1. DISPLAY_IDENTIFIER LV_CDN_DIAG_STC_EGR_CTL_MIN ECU_ADDRESS 0x7f999e BYTE_ORDER MSB_LAST BIT_MASK 0x400 /end MEASUREMENT
/begin MEASUREMENT fmy_stat_egr_ctl_min.err_info_stat.lv_lock_diag "lock flag (CPU load optimisation) of the diagnosis instance EGR_CTL_MIN" UWORD _CNV_S_2_RANGE______380_CM 1 0. 0. 1. DISPLAY_IDENTIFIER LV_LOCK_DIAG_EGR_CTL_MIN ECU_ADDRESS 0x7f999e BYTE_ORDER MSB_LAST BIT_MASK 0x200 /end MEASUREMENT
/begin MEASUREMENT fmy_stat_egr_ctl_min.err_info_stat.lv_err_mem "storage in dynamic failure memory of the diagnosis instance EGR_CTL_MIN" UWORD _CNV_S_2_RANGE______380_CM 1 0. 0. 1. DISPLAY_IDENTIFIER LV_ERR_MEM_EGR_CTL_MIN ECU_ADDRESS 0x7f999e BYTE_ORDER MSB_LAST BIT_MASK 0x80 /end MEASUREMENT
/begin MEASUREMENT fmy_stat_egr_ctl_min.err_info_stat.lv_ready "readiness status of the diagnosis instance EGR_CTL_MIN" UWORD _CNV_S_2_RANGE______380_CM 1 0. 0. 1. DISPLAY_IDENTIFIER LV_READY_EGR_CTL_MIN ECU_ADDRESS 0x7f999e BYTE_ORDER MSB_LAST BIT_MASK 0x40 /end MEASUREMENT
/begin MEASUREMENT fmy_stat_egr_ctl_min.err_info_stat.lv_end_diag "end of diagnosis of the diagnosis instance EGR_CTL_MIN" UWORD _CNV_S_2_RANGE______380_CM 1 0. 0. 1. DISPLAY_IDENTIFIER LV_END_DIAG_EGR_CTL_MIN ECU_ADDRESS 0x7f999e BYTE_ORDER MSB_LAST BIT_MASK 0x20 /end MEASUREMENT
/begin MEASUREMENT fmy_stat_egr_ctl_min.err_info_stat.lv_cdn_diag "diagnosis condition of the diagnosis instance EGR_CTL_MIN" UWORD _CNV_S_2_RANGE______380_CM 1 0. 0. 1. DISPLAY_IDENTIFIER LV_CDN_DIAG_EGR_CTL_MIN ECU_ADDRESS 0x7f999e BYTE_ORDER MSB_LAST BIT_MASK 0x10 /end MEASUREMENT
/begin MEASUREMENT fmy_stat_egr_ctl_min.err_info_stat.err_sym "symptoms of the diagnosis instance EGR_CTL_MIN" UWORD _CNV_S_6_CONV_ERRM__27_CM 1 0. 0. 15. DISPLAY_IDENTIFIER ERR_SYM_EGR_CTL_MIN ECU_ADDRESS 0x7f999e BYTE_ORDER MSB_LAST BIT_MASK 0xF /end MEASUREMENT
/begin MEASUREMENT lv_err_egr_ctl_max "Error flag of diagnosis instance EGR_CTL_MAX" UBYTE _CNV_S_2_RANGE______28_CM 1 0. 0. 1. DISPLAY_IDENTIFIER LV_ERR_EGR_CTL_MAX ECU_ADDRESS 0x7fb4ed /end MEASUREMENT
/begin MEASUREMENT fmy_stat_egr_ctl_max.ctr_abc "anti bounce counter for diagnosis instance EGR_CTL_MAX" UBYTE _CNV_A_R_LINEAR_____1_CM 1 0. 0. 255. DISPLAY_IDENTIFIER CTR_ABC_EGR_CTL_MAX ECU_ADDRESS 0x7f99a5 FORMAT "%3.0" /end MEASUREMENT
/begin MEASUREMENT fmy_stat_egr_ctl_max.ctr_end_diag "counter for end of diagnosis for diagnosis instance EGR_CTL_MAX" UBYTE _CNV_A_R_LINEAR_____1_CM 1 0. 0. 255. DISPLAY_IDENTIFIER CTR_ABC_END_DIAG_EGR_CTL_MAX ECU_ADDRESS 0x7f99a4 FORMAT "%3.0" /end MEASUREMENT
/begin MEASUREMENT fmy_stat_egr_ctl_max.err_info_stat.reserved "" UWORD _CNV_A_R_LINEAR_____0_CM 1 0. 0. 65535. DISPLAY_IDENTIFIER FMY_STAT_EGR_CTL_MAX_ERR_INFO_ST ECU_ADDRESS 0x7f99a2 BYTE_ORDER MSB_LAST BIT_MASK 0xF800 /end MEASUREMENT
/begin MEASUREMENT fmy_stat_egr_ctl_max.err_info_stat.lv_cdn_diag_stc "Statistical flag for condition of diagnosis of the diagnosis instance EGR_CTL_MAX" UWORD _CNV_S_2_RANGE______380_CM 1 0. 0. 1. DISPLAY_IDENTIFIER LV_CDN_DIAG_STC_EGR_CTL_MAX ECU_ADDRESS 0x7f99a2 BYTE_ORDER MSB_LAST BIT_MASK 0x400 /end MEASUREMENT
/begin MEASUREMENT fmy_stat_egr_ctl_max.err_info_stat.lv_lock_diag "lock flag (CPU load optimisation) of the diagnosis instance EGR_CTL_MAX" UWORD _CNV_S_2_RANGE______380_CM 1 0. 0. 1. DISPLAY_IDENTIFIER LV_LOCK_DIAG_EGR_CTL_MAX ECU_ADDRESS 0x7f99a2 BYTE_ORDER MSB_LAST BIT_MASK 0x200 /end MEASUREMENT
/begin MEASUREMENT fmy_stat_egr_ctl_max.err_info_stat.lv_err_mem "storage in dynamic failure memory of the diagnosis instance EGR_CTL_MAX" UWORD _CNV_S_2_RANGE______380_CM 1 0. 0. 1. DISPLAY_IDENTIFIER LV_ERR_MEM_EGR_CTL_MAX ECU_ADDRESS 0x7f99a2 BYTE_ORDER MSB_LAST BIT_MASK 0x80 /end MEASUREMENT
/begin MEASUREMENT fmy_stat_egr_ctl_max.err_info_stat.lv_ready "readiness status of the diagnosis instance EGR_CTL_MAX" UWORD _CNV_S_2_RANGE______380_CM 1 0. 0. 1. DISPLAY_IDENTIFIER LV_READY_EGR_CTL_MAX ECU_ADDRESS 0x7f99a2 BYTE_ORDER MSB_LAST BIT_MASK 0x40 /end MEASUREMENT
/begin MEASUREMENT fmy_stat_egr_ctl_max.err_info_stat.lv_end_diag "end of diagnosis of the diagnosis instance EGR_CTL_MAX" UWORD _CNV_S_2_RANGE______380_CM 1 0. 0. 1. DISPLAY_IDENTIFIER LV_END_DIAG_EGR_CTL_MAX ECU_ADDRESS 0x7f99a2 BYTE_ORDER MSB_LAST BIT_MASK 0x20 /end MEASUREMENT
/begin MEASUREMENT fmy_stat_egr_ctl_max.err_info_stat.lv_cdn_diag "diagnosis condition of the diagnosis instance EGR_CTL_MAX" UWORD _CNV_S_2_RANGE______380_CM 1 0. 0. 1. DISPLAY_IDENTIFIER LV_CDN_DIAG_EGR_CTL_MAX ECU_ADDRESS 0x7f99a2 BYTE_ORDER MSB_LAST BIT_MASK 0x10 /end MEASUREMENT
/begin MEASUREMENT fmy_stat_egr_ctl_max.err_info_stat.err_sym "symptoms of the diagnosis instance EGR_CTL_MAX" UWORD _CNV_S_6_CONV_ERRM__27_CM 1 0. 0. 15. DISPLAY_IDENTIFIER ERR_SYM_EGR_CTL_MAX ECU_ADDRESS 0x7f99a2 BYTE_ORDER MSB_LAST BIT_MASK 0xF /end MEASUREMENT
/begin MEASUREMENT lv_err_v_amp_rng "Error flag of diagnosis instance V_AMP_RNG" UBYTE _CNV_S_2_RANGE______28_CM 1 0. 0. 1. DISPLAY_IDENTIFIER LV_ERR_V_AMP_RNG ECU_ADDRESS 0x7fb4ee /end MEASUREMENT
/begin MEASUREMENT fmy_stat_v_amp_rng.ctr_abc "anti bounce counter for diagnosis instance V_AMP_RNG" UBYTE _CNV_A_R_LINEAR_____1_CM 1 0. 0. 255. DISPLAY_IDENTIFIER CTR_ABC_V_AMP_RNG ECU_ADDRESS 0x7f99a9 FORMAT "%3.0" /end MEASUREMENT
/begin MEASUREMENT fmy_stat_v_amp_rng.ctr_end_diag "counter for end of diagnosis for diagnosis instance V_AMP_RNG" UBYTE _CNV_A_R_LINEAR_____1_CM 1 0. 0. 255. DISPLAY_IDENTIFIER CTR_ABC_END_DIAG_V_AMP_RNG ECU_ADDRESS 0x7f99a8 FORMAT "%3.0" /end MEASUREMENT
/begin MEASUREMENT fmy_stat_v_amp_rng.err_info_stat.reserved "" UWORD _CNV_A_R_LINEAR_____0_CM 1 0. 0. 65535. DISPLAY_IDENTIFIER FMY_STAT_V_AMP_RNG_ERR_INFO_STAT ECU_ADDRESS 0x7f99a6 BYTE_ORDER MSB_LAST BIT_MASK 0xF800 /end MEASUREMENT
/begin MEASUREMENT fmy_stat_v_amp_rng.err_info_stat.lv_cdn_diag_stc "Statistical flag for condition of diagnosis of the diagnosis instance V_AMP_RNG" UWORD _CNV_S_2_RANGE______380_CM 1 0. 0. 1. DISPLAY_IDENTIFIER LV_CDN_DIAG_STC_V_AMP_RNG ECU_ADDRESS 0x7f99a6 BYTE_ORDER MSB_LAST BIT_MASK 0x400 /end MEASUREMENT
/begin MEASUREMENT fmy_stat_v_amp_rng.err_info_stat.lv_lock_diag "lock flag (CPU load optimisation) of the diagnosis instance V_AMP_RNG" UWORD _CNV_S_2_RANGE______380_CM 1 0. 0. 1. DISPLAY_IDENTIFIER LV_LOCK_DIAG_V_AMP_RNG ECU_ADDRESS 0x7f99a6 BYTE_ORDER MSB_LAST BIT_MASK 0x200 /end MEASUREMENT
/begin MEASUREMENT fmy_stat_v_amp_rng.err_info_stat.lv_err_mem "storage in dynamic failure memory of the diagnosis instance V_AMP_RNG" UWORD _CNV_S_2_RANGE______380_CM 1 0. 0. 1. DISPLAY_IDENTIFIER LV_ERR_MEM_V_AMP_RNG ECU_ADDRESS 0x7f99a6 BYTE_ORDER MSB_LAST BIT_MASK 0x80 /end MEASUREMENT
/begin MEASUREMENT fmy_stat_v_amp_rng.err_info_stat.lv_ready "readiness status of the diagnosis instance V_AMP_RNG" UWORD _CNV_S_2_RANGE______380_CM 1 0. 0. 1. DISPLAY_IDENTIFIER LV_READY_V_AMP_RNG ECU_ADDRESS 0x7f99a6 BYTE_ORDER MSB_LAST BIT_MASK 0x40 /end MEASUREMENT
/begin MEASUREMENT fmy_stat_v_amp_rng.err_info_stat.lv_end_diag "end of diagnosis of the diagnosis instance V_AMP_RNG" UWORD _CNV_S_2_RANGE______380_CM 1 0. 0. 1. DISPLAY_IDENTIFIER LV_END_DIAG_V_AMP_RNG ECU_ADDRESS 0x7f99a6 BYTE_ORDER MSB_LAST BIT_MASK 0x20 /end MEASUREMENT
/begin MEASUREMENT fmy_stat_v_amp_rng.err_info_stat.lv_cdn_diag "diagnosis condition of the diagnosis instance V_AMP_RNG" UWORD _CNV_S_2_RANGE______380_CM 1 0. 0. 1. DISPLAY_IDENTIFIER LV_CDN_DIAG_V_AMP_RNG ECU_ADDRESS 0x7f99a6 BYTE_ORDER MSB_LAST BIT_MASK 0x10 /end MEASUREMENT
/begin MEASUREMENT fmy_stat_v_amp_rng.err_info_stat.err_sym "symptoms of the diagnosis instance V_AMP_RNG" UWORD _CNV_S_6_CONV_ERRM__27_CM 1 0. 0. 15. DISPLAY_IDENTIFIER ERR_SYM_V_AMP_RNG ECU_ADDRESS 0x7f99a6 BYTE_ORDER MSB_LAST BIT_MASK 0xF /end MEASUREMENT
/begin MEASUREMENT lv_err_amp_mes_grd "Error flag of diagnosis instance AMP_MES_GRD" UBYTE _CNV_S_2_RANGE______28_CM 1 0. 0. 1. DISPLAY_IDENTIFIER LV_ERR_AMP_MES_GRD ECU_ADDRESS 0x7fb4ef /end MEASUREMENT
/begin MEASUREMENT fmy_stat_amp_mes_grd.ctr_abc "anti bounce counter for diagnosis instance AMP_MES_GRD" UBYTE _CNV_A_R_LINEAR_____1_CM 1 0. 0. 255. DISPLAY_IDENTIFIER CTR_ABC_AMP_MES_GRD ECU_ADDRESS 0x7f99ad FORMAT "%3.0" /end MEASUREMENT
/begin MEASUREMENT fmy_stat_amp_mes_grd.ctr_end_diag "counter for end of diagnosis for diagnosis instance AMP_MES_GRD" UBYTE _CNV_A_R_LINEAR_____1_CM 1 0. 0. 255. DISPLAY_IDENTIFIER CTR_ABC_END_DIAG_AMP_MES_GRD ECU_ADDRESS 0x7f99ac FORMAT "%3.0" /end MEASUREMENT
/begin MEASUREMENT fmy_stat_amp_mes_grd.err_info_stat.reserved "" UWORD _CNV_A_R_LINEAR_____0_CM 1 0. 0. 65535. DISPLAY_IDENTIFIER FMY_STAT_AMP_MES_GRD_ERR_INFO_ST ECU_ADDRESS 0x7f99aa BYTE_ORDER MSB_LAST BIT_MASK 0xF800 /end MEASUREMENT
/begin MEASUREMENT fmy_stat_amp_mes_grd.err_info_stat.lv_cdn_diag_stc "Statistical flag for condition of diagnosis of the diagnosis instance AMP_MES_GRD" UWORD _CNV_S_2_RANGE______380_CM 1 0. 0. 1. DISPLAY_IDENTIFIER LV_CDN_DIAG_STC_AMP_MES_GRD ECU_ADDRESS 0x7f99aa BYTE_ORDER MSB_LAST BIT_MASK 0x400 /end MEASUREMENT
/begin MEASUREMENT fmy_stat_amp_mes_grd.err_info_stat.lv_lock_diag "lock flag (CPU load optimisation) of the diagnosis instance AMP_MES_GRD" UWORD _CNV_S_2_RANGE______380_CM 1 0. 0. 1. DISPLAY_IDENTIFIER LV_LOCK_DIAG_AMP_MES_GRD ECU_ADDRESS 0x7f99aa BYTE_ORDER MSB_LAST BIT_MASK 0x200 /end MEASUREMENT
/begin MEASUREMENT fmy_stat_amp_mes_grd.err_info_stat.lv_err_mem "storage in dynamic failure memory of the diagnosis instance AMP_MES_GRD" UWORD _CNV_S_2_RANGE______380_CM 1 0. 0. 1. DISPLAY_IDENTIFIER LV_ERR_MEM_AMP_MES_GRD ECU_ADDRESS 0x7f99aa BYTE_ORDER MSB_LAST BIT_MASK 0x80 /end MEASUREMENT
/begin MEASUREMENT fmy_stat_amp_mes_grd.err_info_stat.lv_ready "readiness status of the diagnosis instance AMP_MES_GRD" UWORD _CNV_S_2_RANGE______380_CM 1 0. 0. 1. DISPLAY_IDENTIFIER LV_READY_AMP_MES_GRD ECU_ADDRESS 0x7f99aa BYTE_ORDER MSB_LAST BIT_MASK 0x40 /end MEASUREMENT
/begin MEASUREMENT fmy_stat_amp_mes_grd.err_info_stat.lv_end_diag "end of diagnosis of the diagnosis instance AMP_MES_GRD" UWORD _CNV_S_2_RANGE______380_CM 1 0. 0. 1. DISPLAY_IDENTIFIER LV_END_DIAG_AMP_MES_GRD ECU_ADDRESS 0x7f99aa BYTE_ORDER MSB_LAST BIT_MASK 0x20 /end MEASUREMENT
/begin MEASUREMENT fmy_stat_amp_mes_grd.err_info_stat.lv_cdn_diag "diagnosis condition of the diagnosis instance AMP_MES_GRD" UWORD _CNV_S_2_RANGE______380_CM 1 0. 0. 1. DISPLAY_IDENTIFIER LV_CDN_DIAG_AMP_MES_GRD ECU_ADDRESS 0x7f99aa BYTE_ORDER MSB_LAST BIT_MASK 0x10 /end MEASUREMENT
/begin MEASUREMENT fmy_stat_amp_mes_grd.err_info_stat.err_sym "symptoms of the diagnosis instance AMP_MES_GRD" UWORD _CNV_S_6_CONV_ERRM__27_CM 1 0. 0. 15. DISPLAY_IDENTIFIER ERR_SYM_AMP_MES_GRD ECU_ADDRESS 0x7f99aa BYTE_ORDER MSB_LAST BIT_MASK 0xF /end MEASUREMENT
/begin MEASUREMENT lv_err_v_tfu_rng "Error flag of diagnosis instance V_TFU_RNG" UBYTE _CNV_S_2_RANGE______28_CM 1 0. 0. 1. DISPLAY_IDENTIFIER LV_ERR_V_TFU_RNG ECU_ADDRESS 0x7fb4f0 /end MEASUREMENT
/begin MEASUREMENT fmy_stat_v_tfu_rng.ctr_abc "anti bounce counter for diagnosis instance V_TFU_RNG" UBYTE _CNV_A_R_LINEAR_____1_CM 1 0. 0. 255. DISPLAY_IDENTIFIER CTR_ABC_V_TFU_RNG ECU_ADDRESS 0x7f99b1 FORMAT "%3.0" /end MEASUREMENT
/begin MEASUREMENT fmy_stat_v_tfu_rng.ctr_end_diag "counter for end of diagnosis for diagnosis instance V_TFU_RNG" UBYTE _CNV_A_R_LINEAR_____1_CM 1 0. 0. 255. DISPLAY_IDENTIFIER CTR_ABC_END_DIAG_V_TFU_RNG ECU_ADDRESS 0x7f99b0 FORMAT "%3.0" /end MEASUREMENT
/begin MEASUREMENT fmy_stat_v_tfu_rng.err_info_stat.reserved "" UWORD _CNV_A_R_LINEAR_____0_CM 1 0. 0. 65535. DISPLAY_IDENTIFIER FMY_STAT_V_TFU_RNG_ERR_INFO_STAT ECU_ADDRESS 0x7f99ae BYTE_ORDER MSB_LAST BIT_MASK 0xF800 /end MEASUREMENT
/begin MEASUREMENT fmy_stat_v_tfu_rng.err_info_stat.lv_cdn_diag_stc "Statistical flag for condition of diagnosis of the diagnosis instance V_TFU_RNG" UWORD _CNV_S_2_RANGE______380_CM 1 0. 0. 1. DISPLAY_IDENTIFIER LV_CDN_DIAG_STC_V_TFU_RNG ECU_ADDRESS 0x7f99ae BYTE_ORDER MSB_LAST BIT_MASK 0x400 /end MEASUREMENT
/begin MEASUREMENT fmy_stat_v_tfu_rng.err_info_stat.lv_lock_diag "lock flag (CPU load optimisation) of the diagnosis instance V_TFU_RNG" UWORD _CNV_S_2_RANGE______380_CM 1 0. 0. 1. DISPLAY_IDENTIFIER LV_LOCK_DIAG_V_TFU_RNG ECU_ADDRESS 0x7f99ae BYTE_ORDER MSB_LAST BIT_MASK 0x200 /end MEASUREMENT
/begin MEASUREMENT fmy_stat_v_tfu_rng.err_info_stat.lv_err_mem "storage in dynamic failure memory of the diagnosis instance V_TFU_RNG" UWORD _CNV_S_2_RANGE______380_CM 1 0. 0. 1. DISPLAY_IDENTIFIER LV_ERR_MEM_V_TFU_RNG ECU_ADDRESS 0x7f99ae BYTE_ORDER MSB_LAST BIT_MASK 0x80 /end MEASUREMENT
/begin MEASUREMENT fmy_stat_v_tfu_rng.err_info_stat.lv_ready "readiness status of the diagnosis instance V_TFU_RNG" UWORD _CNV_S_2_RANGE______380_CM 1 0. 0. 1. DISPLAY_IDENTIFIER LV_READY_V_TFU_RNG ECU_ADDRESS 0x7f99ae BYTE_ORDER MSB_LAST BIT_MASK 0x40 /end MEASUREMENT
/begin MEASUREMENT fmy_stat_v_tfu_rng.err_info_stat.lv_end_diag "end of diagnosis of the diagnosis instance V_TFU_RNG" UWORD _CNV_S_2_RANGE______380_CM 1 0. 0. 1. DISPLAY_IDENTIFIER LV_END_DIAG_V_TFU_RNG ECU_ADDRESS 0x7f99ae BYTE_ORDER MSB_LAST BIT_MASK 0x20 /end MEASUREMENT
/begin MEASUREMENT fmy_stat_v_tfu_rng.err_info_stat.lv_cdn_diag "diagnosis condition of the diagnosis instance V_TFU_RNG" UWORD _CNV_S_2_RANGE______380_CM 1 0. 0. 1. DISPLAY_IDENTIFIER LV_CDN_DIAG_V_TFU_RNG ECU_ADDRESS 0x7f99ae BYTE_ORDER MSB_LAST BIT_MASK 0x10 /end MEASUREMENT
/begin MEASUREMENT fmy_stat_v_tfu_rng.err_info_stat.err_sym "symptoms of the diagnosis instance V_TFU_RNG" UWORD _CNV_S_6_CONV_ERRM__27_CM 1 0. 0. 15. DISPLAY_IDENTIFIER ERR_SYM_V_TFU_RNG ECU_ADDRESS 0x7f99ae BYTE_ORDER MSB_LAST BIT_MASK 0xF /end MEASUREMENT
/begin MEASUREMENT lv_err_tfu_mes_grd "Error flag of diagnosis instance TFU_MES_GRD" UBYTE _CNV_S_2_RANGE______28_CM 1 0. 0. 1. DISPLAY_IDENTIFIER LV_ERR_TFU_MES_GRD ECU_ADDRESS 0x7fb4f1 /end MEASUREMENT
/begin MEASUREMENT fmy_stat_tfu_mes_grd.ctr_abc "anti bounce counter for diagnosis instance TFU_MES_GRD" UBYTE _CNV_A_R_LINEAR_____1_CM 1 0. 0. 255. DISPLAY_IDENTIFIER CTR_ABC_TFU_MES_GRD ECU_ADDRESS 0x7f99b5 FORMAT "%3.0" /end MEASUREMENT
/begin MEASUREMENT fmy_stat_tfu_mes_grd.ctr_end_diag "counter for end of diagnosis for diagnosis instance TFU_MES_GRD" UBYTE _CNV_A_R_LINEAR_____1_CM 1 0. 0. 255. DISPLAY_IDENTIFIER CTR_ABC_END_DIAG_TFU_MES_GRD ECU_ADDRESS 0x7f99b4 FORMAT "%3.0" /end MEASUREMENT
/begin MEASUREMENT fmy_stat_tfu_mes_grd.err_info_stat.reserved "" UWORD _CNV_A_R_LINEAR_____0_CM 1 0. 0. 65535. DISPLAY_IDENTIFIER FMY_STAT_TFU_MES_GRD_ERR_INFO_ST ECU_ADDRESS 0x7f99b2 BYTE_ORDER MSB_LAST BIT_MASK 0xF800 /end MEASUREMENT
/begin MEASUREMENT fmy_stat_tfu_mes_grd.err_info_stat.lv_cdn_diag_stc "Statistical flag for condition of diagnosis of the diagnosis instance TFU_MES_GRD" UWORD _CNV_S_2_RANGE______380_CM 1 0. 0. 1. DISPLAY_IDENTIFIER LV_CDN_DIAG_STC_TFU_MES_GRD ECU_ADDRESS 0x7f99b2 BYTE_ORDER MSB_LAST BIT_MASK 0x400 /end MEASUREMENT
/begin MEASUREMENT fmy_stat_tfu_mes_grd.err_info_stat.lv_lock_diag "lock flag (CPU load optimisation) of the diagnosis instance TFU_MES_GRD" UWORD _CNV_S_2_RANGE______380_CM 1 0. 0. 1. DISPLAY_IDENTIFIER LV_LOCK_DIAG_TFU_MES_GRD ECU_ADDRESS 0x7f99b2 BYTE_ORDER MSB_LAST BIT_MASK 0x200 /end MEASUREMENT
/begin MEASUREMENT fmy_stat_tfu_mes_grd.err_info_stat.lv_err_mem "storage in dynamic failure memory of the diagnosis instance TFU_MES_GRD" UWORD _CNV_S_2_RANGE______380_CM 1 0. 0. 1. DISPLAY_IDENTIFIER LV_ERR_MEM_TFU_MES_GRD ECU_ADDRESS 0x7f99b2 BYTE_ORDER MSB_LAST BIT_MASK 0x80 /end MEASUREMENT
/begin MEASUREMENT fmy_stat_tfu_mes_grd.err_info_stat.lv_ready "readiness status of the diagnosis instance TFU_MES_GRD" UWORD _CNV_S_2_RANGE______380_CM 1 0. 0. 1. DISPLAY_IDENTIFIER LV_READY_TFU_MES_GRD ECU_ADDRESS 0x7f99b2 BYTE_ORDER MSB_LAST BIT_MASK 0x40 /end MEASUREMENT
/begin MEASUREMENT fmy_stat_tfu_mes_grd.err_info_stat.lv_end_diag "end of diagnosis of the diagnosis instance TFU_MES_GRD" UWORD _CNV_S_2_RANGE______380_CM 1 0. 0. 1. DISPLAY_IDENTIFIER LV_END_DIAG_TFU_MES_GRD ECU_ADDRESS 0x7f99b2 BYTE_ORDER MSB_LAST BIT_MASK 0x20 /end MEASUREMENT
/begin MEASUREMENT fmy_stat_tfu_mes_grd.err_info_stat.lv_cdn_diag "diagnosis condition of the diagnosis instance TFU_MES_GRD" UWORD _CNV_S_2_RANGE______380_CM 1 0. 0. 1. DISPLAY_IDENTIFIER LV_CDN_DIAG_TFU_MES_GRD ECU_ADDRESS 0x7f99b2 BYTE_ORDER MSB_LAST BIT_MASK 0x10 /end MEASUREMENT
/begin MEASUREMENT fmy_stat_tfu_mes_grd.err_info_stat.err_sym "symptoms of the diagnosis instance TFU_MES_GRD" UWORD _CNV_S_6_CONV_ERRM__27_CM 1 0. 0. 15. DISPLAY_IDENTIFIER ERR_SYM_TFU_MES_GRD ECU_ADDRESS 0x7f99b2 BYTE_ORDER MSB_LAST BIT_MASK 0xF /end MEASUREMENT
/begin MEASUREMENT lv_err_v_map_rng "Error flag of diagnosis instance V_MAP_RNG" UBYTE _CNV_S_2_RANGE______28_CM 1 0. 0. 1. DISPLAY_IDENTIFIER LV_ERR_V_MAP_RNG ECU_ADDRESS 0x7fb4f2 /end MEASUREMENT
/begin MEASUREMENT fmy_stat_v_map_rng.ctr_abc "anti bounce counter for diagnosis instance V_MAP_RNG" UBYTE _CNV_A_R_LINEAR_____1_CM 1 0. 0. 255. DISPLAY_IDENTIFIER CTR_ABC_V_MAP_RNG ECU_ADDRESS 0x7f99b9 FORMAT "%3.0" /end MEASUREMENT
/begin MEASUREMENT fmy_stat_v_map_rng.ctr_end_diag "counter for end of diagnosis for diagnosis instance V_MAP_RNG" UBYTE _CNV_A_R_LINEAR_____1_CM 1 0. 0. 255. DISPLAY_IDENTIFIER CTR_ABC_END_DIAG_V_MAP_RNG ECU_ADDRESS 0x7f99b8 FORMAT "%3.0" /end MEASUREMENT
/begin MEASUREMENT fmy_stat_v_map_rng.err_info_stat.reserved "" UWORD _CNV_A_R_LINEAR_____0_CM 1 0. 0. 65535. DISPLAY_IDENTIFIER FMY_STAT_V_MAP_RNG_ERR_INFO_STAT ECU_ADDRESS 0x7f99b6 BYTE_ORDER MSB_LAST BIT_MASK 0xF800 /end MEASUREMENT
/begin MEASUREMENT fmy_stat_v_map_rng.err_info_stat.lv_cdn_diag_stc "Statistical flag for condition of diagnosis of the diagnosis instance V_MAP_RNG" UWORD _CNV_S_2_RANGE______380_CM 1 0. 0. 1. DISPLAY_IDENTIFIER LV_CDN_DIAG_STC_V_MAP_RNG ECU_ADDRESS 0x7f99b6 BYTE_ORDER MSB_LAST BIT_MASK 0x400 /end MEASUREMENT
/begin MEASUREMENT fmy_stat_v_map_rng.err_info_stat.lv_lock_diag "lock flag (CPU load optimisation) of the diagnosis instance V_MAP_RNG" UWORD _CNV_S_2_RANGE______380_CM 1 0. 0. 1. DISPLAY_IDENTIFIER LV_LOCK_DIAG_V_MAP_RNG ECU_ADDRESS 0x7f99b6 BYTE_ORDER MSB_LAST BIT_MASK 0x200 /end MEASUREMENT
/begin MEASUREMENT fmy_stat_v_map_rng.err_info_stat.lv_err_mem "storage in dynamic failure memory of the diagnosis instance V_MAP_RNG" UWORD _CNV_S_2_RANGE______380_CM 1 0. 0. 1. DISPLAY_IDENTIFIER LV_ERR_MEM_V_MAP_RNG ECU_ADDRESS 0x7f99b6 BYTE_ORDER MSB_LAST BIT_MASK 0x80 /end MEASUREMENT
/begin MEASUREMENT fmy_stat_v_map_rng.err_info_stat.lv_ready "readiness status of the diagnosis instance V_MAP_RNG" UWORD _CNV_S_2_RANGE______380_CM 1 0. 0. 1. DISPLAY_IDENTIFIER LV_READY_V_MAP_RNG ECU_ADDRESS 0x7f99b6 BYTE_ORDER MSB_LAST BIT_MASK 0x40 /end MEASUREMENT
/begin MEASUREMENT fmy_stat_v_map_rng.err_info_stat.lv_end_diag "end of diagnosis of the diagnosis instance V_MAP_RNG" UWORD _CNV_S_2_RANGE______380_CM 1 0. 0. 1. DISPLAY_IDENTIFIER LV_END_DIAG_V_MAP_RNG ECU_ADDRESS 0x7f99b6 BYTE_ORDER MSB_LAST BIT_MASK 0x20 /end MEASUREMENT
/begin MEASUREMENT fmy_stat_v_map_rng.err_info_stat.lv_cdn_diag "diagnosis condition of the diagnosis instance V_MAP_RNG" UWORD _CNV_S_2_RANGE______380_CM 1 0. 0. 1. DISPLAY_IDENTIFIER LV_CDN_DIAG_V_MAP_RNG ECU_ADDRESS 0x7f99b6 BYTE_ORDER MSB_LAST BIT_MASK 0x10 /end MEASUREMENT
/begin MEASUREMENT fmy_stat_v_map_rng.err_info_stat.err_sym "symptoms of the diagnosis instance V_MAP_RNG" UWORD _CNV_S_6_CONV_ERRM__27_CM 1 0. 0. 15. DISPLAY_IDENTIFIER ERR_SYM_V_MAP_RNG ECU_ADDRESS 0x7f99b6 BYTE_ORDER MSB_LAST BIT_MASK 0xF /end MEASUREMENT
/begin MEASUREMENT lv_err_map_amp_ofs "Error flag of diagnosis instance MAP_AMP_OFS" UBYTE _CNV_S_2_RANGE______28_CM 1 0. 0. 1. DISPLAY_IDENTIFIER LV_ERR_MAP_AMP_OFS ECU_ADDRESS 0x7fb4f3 /end MEASUREMENT
/begin MEASUREMENT fmy_stat_map_amp_ofs.ctr_abc "anti bounce counter for diagnosis instance MAP_AMP_OFS" UBYTE _CNV_A_R_LINEAR_____1_CM 1 0. 0. 255. DISPLAY_IDENTIFIER CTR_ABC_MAP_AMP_OFS ECU_ADDRESS 0x7f99bd FORMAT "%3.0" /end MEASUREMENT
/begin MEASUREMENT fmy_stat_map_amp_ofs.ctr_end_diag "counter for end of diagnosis for diagnosis instance MAP_AMP_OFS" UBYTE _CNV_A_R_LINEAR_____1_CM 1 0. 0. 255. DISPLAY_IDENTIFIER CTR_ABC_END_DIAG_MAP_AMP_OFS ECU_ADDRESS 0x7f99bc FORMAT "%3.0" /end MEASUREMENT
/begin MEASUREMENT fmy_stat_map_amp_ofs.err_info_stat.reserved "" UWORD _CNV_A_R_LINEAR_____0_CM 1 0. 0. 65535. DISPLAY_IDENTIFIER FMY_STAT_MAP_AMP_OFS_ERR_INFO_ST ECU_ADDRESS 0x7f99ba BYTE_ORDER MSB_LAST BIT_MASK 0xF800 /end MEASUREMENT
/begin MEASUREMENT fmy_stat_map_amp_ofs.err_info_stat.lv_cdn_diag_stc "Statistical flag for condition of diagnosis of the diagnosis instance MAP_AMP_OFS" UWORD _CNV_S_2_RANGE______380_CM 1 0. 0. 1. DISPLAY_IDENTIFIER LV_CDN_DIAG_STC_MAP_AMP_OFS ECU_ADDRESS 0x7f99ba BYTE_ORDER MSB_LAST BIT_MASK 0x400 /end MEASUREMENT
/begin MEASUREMENT fmy_stat_map_amp_ofs.err_info_stat.lv_lock_diag "lock flag (CPU load optimisation) of the diagnosis instance MAP_AMP_OFS" UWORD _CNV_S_2_RANGE______380_CM 1 0. 0. 1. DISPLAY_IDENTIFIER LV_LOCK_DIAG_MAP_AMP_OFS ECU_ADDRESS 0x7f99ba BYTE_ORDER MSB_LAST BIT_MASK 0x200 /end MEASUREMENT
/begin MEASUREMENT fmy_stat_map_amp_ofs.err_info_stat.lv_err_mem "storage in dynamic failure memory of the diagnosis instance MAP_AMP_OFS" UWORD _CNV_S_2_RANGE______380_CM 1 0. 0. 1. DISPLAY_IDENTIFIER LV_ERR_MEM_MAP_AMP_OFS ECU_ADDRESS 0x7f99ba BYTE_ORDER MSB_LAST BIT_MASK 0x80 /end MEASUREMENT
/begin MEASUREMENT fmy_stat_map_amp_ofs.err_info_stat.lv_ready "readiness status of the diagnosis instance MAP_AMP_OFS" UWORD _CNV_S_2_RANGE______380_CM 1 0. 0. 1. DISPLAY_IDENTIFIER LV_READY_MAP_AMP_OFS ECU_ADDRESS 0x7f99ba BYTE_ORDER MSB_LAST BIT_MASK 0x40 /end MEASUREMENT
/begin MEASUREMENT fmy_stat_map_amp_ofs.err_info_stat.lv_end_diag "end of diagnosis of the diagnosis instance MAP_AMP_OFS" UWORD _CNV_S_2_RANGE______380_CM 1 0. 0. 1. DISPLAY_IDENTIFIER LV_END_DIAG_MAP_AMP_OFS ECU_ADDRESS 0x7f99ba BYTE_ORDER MSB_LAST BIT_MASK 0x20 /end MEASUREMENT
/begin MEASUREMENT fmy_stat_map_amp_ofs.err_info_stat.lv_cdn_diag "diagnosis condition of the diagnosis instance MAP_AMP_OFS" UWORD _CNV_S_2_RANGE______380_CM 1 0. 0. 1. DISPLAY_IDENTIFIER LV_CDN_DIAG_MAP_AMP_OFS ECU_ADDRESS 0x7f99ba BYTE_ORDER MSB_LAST BIT_MASK 0x10 /end MEASUREMENT
/begin MEASUREMENT fmy_stat_map_amp_ofs.err_info_stat.err_sym "symptoms of the diagnosis instance MAP_AMP_OFS" UWORD _CNV_S_6_CONV_ERRM__27_CM 1 0. 0. 15. DISPLAY_IDENTIFIER ERR_SYM_MAP_AMP_OFS ECU_ADDRESS 0x7f99ba BYTE_ORDER MSB_LAST BIT_MASK 0xF /end MEASUREMENT
/begin MEASUREMENT lv_err_map_is_ofs "Error flag of diagnosis instance MAP_IS_OFS" UBYTE _CNV_S_2_RANGE______28_CM 1 0. 0. 1. DISPLAY_IDENTIFIER LV_ERR_MAP_IS_OFS ECU_ADDRESS 0x7fb4f4 /end MEASUREMENT
/begin MEASUREMENT fmy_stat_map_is_ofs.ctr_abc "anti bounce counter for diagnosis instance MAP_IS_OFS" UBYTE _CNV_A_R_LINEAR_____1_CM 1 0. 0. 255. DISPLAY_IDENTIFIER CTR_ABC_MAP_IS_OFS ECU_ADDRESS 0x7f99c1 FORMAT "%3.0" /end MEASUREMENT
/begin MEASUREMENT fmy_stat_map_is_ofs.ctr_end_diag "counter for end of diagnosis for diagnosis instance MAP_IS_OFS" UBYTE _CNV_A_R_LINEAR_____1_CM 1 0. 0. 255. DISPLAY_IDENTIFIER CTR_ABC_END_DIAG_MAP_IS_OFS ECU_ADDRESS 0x7f99c0 FORMAT "%3.0" /end MEASUREMENT
/begin MEASUREMENT fmy_stat_map_is_ofs.err_info_stat.reserved "" UWORD _CNV_A_R_LINEAR_____0_CM 1 0. 0. 65535. DISPLAY_IDENTIFIER FMY_STAT_MAP_IS_OFS_ERR_INFO_STA ECU_ADDRESS 0x7f99be BYTE_ORDER MSB_LAST BIT_MASK 0xF800 /end MEASUREMENT
/begin MEASUREMENT fmy_stat_map_is_ofs.err_info_stat.lv_cdn_diag_stc "Statistical flag for condition of diagnosis of the diagnosis instance MAP_IS_OFS" UWORD _CNV_S_2_RANGE______380_CM 1 0. 0. 1. DISPLAY_IDENTIFIER LV_CDN_DIAG_STC_MAP_IS_OFS ECU_ADDRESS 0x7f99be BYTE_ORDER MSB_LAST BIT_MASK 0x400 /end MEASUREMENT
/begin MEASUREMENT fmy_stat_map_is_ofs.err_info_stat.lv_lock_diag "lock flag (CPU load optimisation) of the diagnosis instance MAP_IS_OFS" UWORD _CNV_S_2_RANGE______380_CM 1 0. 0. 1. DISPLAY_IDENTIFIER LV_LOCK_DIAG_MAP_IS_OFS ECU_ADDRESS 0x7f99be BYTE_ORDER MSB_LAST BIT_MASK 0x200 /end MEASUREMENT
/begin MEASUREMENT fmy_stat_map_is_ofs.err_info_stat.lv_err_mem "storage in dynamic failure memory of the diagnosis instance MAP_IS_OFS" UWORD _CNV_S_2_RANGE______380_CM 1 0. 0. 1. DISPLAY_IDENTIFIER LV_ERR_MEM_MAP_IS_OFS ECU_ADDRESS 0x7f99be BYTE_ORDER MSB_LAST BIT_MASK 0x80 /end MEASUREMENT
/begin MEASUREMENT fmy_stat_map_is_ofs.err_info_stat.lv_ready "readiness status of the diagnosis instance MAP_IS_OFS" UWORD _CNV_S_2_RANGE______380_CM 1 0. 0. 1. DISPLAY_IDENTIFIER LV_READY_MAP_IS_OFS ECU_ADDRESS 0x7f99be BYTE_ORDER MSB_LAST BIT_MASK 0x40 /end MEASUREMENT
/begin MEASUREMENT fmy_stat_map_is_ofs.err_info_stat.lv_end_diag "end of diagnosis of the diagnosis instance MAP_IS_OFS" UWORD _CNV_S_2_RANGE______380_CM 1 0. 0. 1. DISPLAY_IDENTIFIER LV_END_DIAG_MAP_IS_OFS ECU_ADDRESS 0x7f99be BYTE_ORDER MSB_LAST BIT_MASK 0x20 /end MEASUREMENT
/begin MEASUREMENT fmy_stat_map_is_ofs.err_info_stat.lv_cdn_diag "diagnosis condition of the diagnosis instance MAP_IS_OFS" UWORD _CNV_S_2_RANGE______380_CM 1 0. 0. 1. DISPLAY_IDENTIFIER LV_CDN_DIAG_MAP_IS_OFS ECU_ADDRESS 0x7f99be BYTE_ORDER MSB_LAST BIT_MASK 0x10 /end MEASUREMENT
/begin MEASUREMENT fmy_stat_map_is_ofs.err_info_stat.err_sym "symptoms of the diagnosis instance MAP_IS_OFS" UWORD _CNV_S_6_CONV_ERRM__27_CM 1 0. 0. 15. DISPLAY_IDENTIFIER ERR_SYM_MAP_IS_OFS ECU_ADDRESS 0x7f99be BYTE_ORDER MSB_LAST BIT_MASK 0xF /end MEASUREMENT
/begin MEASUREMENT lv_err_map_mes_grd "Error flag of diagnosis instance MAP_MES_GRD" UBYTE _CNV_S_2_RANGE______28_CM 1 0. 0. 1. DISPLAY_IDENTIFIER LV_ERR_MAP_MES_GRD ECU_ADDRESS 0x7fb4f5 /end MEASUREMENT
/begin MEASUREMENT fmy_stat_map_mes_grd.ctr_abc "anti bounce counter for diagnosis instance MAP_MES_GRD" UBYTE _CNV_A_R_LINEAR_____1_CM 1 0. 0. 255. DISPLAY_IDENTIFIER CTR_ABC_MAP_MES_GRD ECU_ADDRESS 0x7f99c5 FORMAT "%3.0" /end MEASUREMENT
/begin MEASUREMENT fmy_stat_map_mes_grd.ctr_end_diag "counter for end of diagnosis for diagnosis instance MAP_MES_GRD" UBYTE _CNV_A_R_LINEAR_____1_CM 1 0. 0. 255. DISPLAY_IDENTIFIER CTR_ABC_END_DIAG_MAP_MES_GRD ECU_ADDRESS 0x7f99c4 FORMAT "%3.0" /end MEASUREMENT
/begin MEASUREMENT fmy_stat_map_mes_grd.err_info_stat.reserved "" UWORD _CNV_A_R_LINEAR_____0_CM 1 0. 0. 65535. DISPLAY_IDENTIFIER FMY_STAT_MAP_MES_GRD_ERR_INFO_ST ECU_ADDRESS 0x7f99c2 BYTE_ORDER MSB_LAST BIT_MASK 0xF800 /end MEASUREMENT
/begin MEASUREMENT fmy_stat_map_mes_grd.err_info_stat.lv_cdn_diag_stc "Statistical flag for condition of diagnosis of the diagnosis instance MAP_MES_GRD" UWORD _CNV_S_2_RANGE______380_CM 1 0. 0. 1. DISPLAY_IDENTIFIER LV_CDN_DIAG_STC_MAP_MES_GRD ECU_ADDRESS 0x7f99c2 BYTE_ORDER MSB_LAST BIT_MASK 0x400 /end MEASUREMENT
/begin MEASUREMENT fmy_stat_map_mes_grd.err_info_stat.lv_lock_diag "lock flag (CPU load optimisation) of the diagnosis instance MAP_MES_GRD" UWORD _CNV_S_2_RANGE______380_CM 1 0. 0. 1. DISPLAY_IDENTIFIER LV_LOCK_DIAG_MAP_MES_GRD ECU_ADDRESS 0x7f99c2 BYTE_ORDER MSB_LAST BIT_MASK 0x200 /end MEASUREMENT
/begin MEASUREMENT fmy_stat_map_mes_grd.err_info_stat.lv_err_mem "storage in dynamic failure memory of the diagnosis instance MAP_MES_GRD" UWORD _CNV_S_2_RANGE______380_CM 1 0. 0. 1. DISPLAY_IDENTIFIER LV_ERR_MEM_MAP_MES_GRD ECU_ADDRESS 0x7f99c2 BYTE_ORDER MSB_LAST BIT_MASK 0x80 /end MEASUREMENT
/begin MEASUREMENT fmy_stat_map_mes_grd.err_info_stat.lv_ready "readiness status of the diagnosis instance MAP_MES_GRD" UWORD _CNV_S_2_RANGE______380_CM 1 0. 0. 1. DISPLAY_IDENTIFIER LV_READY_MAP_MES_GRD ECU_ADDRESS 0x7f99c2 BYTE_ORDER MSB_LAST BIT_MASK 0x40 /end MEASUREMENT
/begin MEASUREMENT fmy_stat_map_mes_grd.err_info_stat.lv_end_diag "end of diagnosis of the diagnosis instance MAP_MES_GRD" UWORD _CNV_S_2_RANGE______380_CM 1 0. 0. 1. DISPLAY_IDENTIFIER LV_END_DIAG_MAP_MES_GRD ECU_ADDRESS 0x7f99c2 BYTE_ORDER MSB_LAST BIT_MASK 0x20 /end MEASUREMENT
/begin MEASUREMENT fmy_stat_map_mes_grd.err_info_stat.lv_cdn_diag "diagnosis condition of the diagnosis instance MAP_MES_GRD" UWORD _CNV_S_2_RANGE______380_CM 1 0. 0. 1. DISPLAY_IDENTIFIER LV_CDN_DIAG_MAP_MES_GRD ECU_ADDRESS 0x7f99c2 BYTE_ORDER MSB_LAST BIT_MASK 0x10 /end MEASUREMENT
/begin MEASUREMENT fmy_stat_map_mes_grd.err_info_stat.err_sym "symptoms of the diagnosis instance MAP_MES_GRD" UWORD _CNV_S_6_CONV_ERRM__27_CM 1 0. 0. 15. DISPLAY_IDENTIFIER ERR_SYM_MAP_MES_GRD ECU_ADDRESS 0x7f99c2 BYTE_ORDER MSB_LAST BIT_MASK 0xF /end MEASUREMENT
/begin MEASUREMENT lv_err_maf_kgh_plaus "Error flag of diagnosis instance MAF_KGH_PLAUS" UBYTE _CNV_S_2_RANGE______28_CM 1 0. 0. 1. DISPLAY_IDENTIFIER LV_ERR_MAF_KGH_PLAUS ECU_ADDRESS 0x7fb4f6 /end MEASUREMENT
/begin MEASUREMENT fmy_stat_maf_kgh_plaus.ctr_abc "anti bounce counter for diagnosis instance MAF_KGH_PLAUS" UBYTE _CNV_A_R_LINEAR_____1_CM 1 0. 0. 255. DISPLAY_IDENTIFIER CTR_ABC_MAF_KGH_PLAUS ECU_ADDRESS 0x7f99c9 FORMAT "%3.0" /end MEASUREMENT
/begin MEASUREMENT fmy_stat_maf_kgh_plaus.ctr_end_diag "counter for end of diagnosis for diagnosis instance MAF_KGH_PLAUS" UBYTE _CNV_A_R_LINEAR_____1_CM 1 0. 0. 255. DISPLAY_IDENTIFIER CTR_ABC_END_DIAG_MAF_KGH_PLAUS ECU_ADDRESS 0x7f99c8 FORMAT "%3.0" /end MEASUREMENT
/begin MEASUREMENT fmy_stat_maf_kgh_plaus.err_info_stat.reserved "" UWORD _CNV_A_R_LINEAR_____0_CM 1 0. 0. 65535. DISPLAY_IDENTIFIER FMY_STAT_MAF_KGH_PLAUS_ERR_INFO_ ECU_ADDRESS 0x7f99c6 BYTE_ORDER MSB_LAST BIT_MASK 0xF800 /end MEASUREMENT
/begin MEASUREMENT fmy_stat_maf_kgh_plaus.err_info_stat.lv_cdn_diag_stc "Statistical flag for condition of diagnosis of the diagnosis instance MAF_KGH_PLAUS" UWORD _CNV_S_2_RANGE______380_CM 1 0. 0. 1. DISPLAY_IDENTIFIER LV_CDN_DIAG_STC_MAF_KGH_PLAUS ECU_ADDRESS 0x7f99c6 BYTE_ORDER MSB_LAST BIT_MASK 0x400 /end MEASUREMENT
/begin MEASUREMENT fmy_stat_maf_kgh_plaus.err_info_stat.lv_lock_diag "lock flag (CPU load optimisation) of the diagnosis instance MAF_KGH_PLAUS" UWORD _CNV_S_2_RANGE______380_CM 1 0. 0. 1. DISPLAY_IDENTIFIER LV_LOCK_DIAG_MAF_KGH_PLAUS ECU_ADDRESS 0x7f99c6 BYTE_ORDER MSB_LAST BIT_MASK 0x200 /end MEASUREMENT
/begin MEASUREMENT fmy_stat_maf_kgh_plaus.err_info_stat.lv_err_mem "storage in dynamic failure memory of the diagnosis instance MAF_KGH_PLAUS" UWORD _CNV_S_2_RANGE______380_CM 1 0. 0. 1. DISPLAY_IDENTIFIER LV_ERR_MEM_MAF_KGH_PLAUS ECU_ADDRESS 0x7f99c6 BYTE_ORDER MSB_LAST BIT_MASK 0x80 /end MEASUREMENT
/begin MEASUREMENT fmy_stat_maf_kgh_plaus.err_info_stat.lv_ready "readiness status of the diagnosis instance MAF_KGH_PLAUS" UWORD _CNV_S_2_RANGE______380_CM 1 0. 0. 1. DISPLAY_IDENTIFIER LV_READY_MAF_KGH_PLAUS ECU_ADDRESS 0x7f99c6 BYTE_ORDER MSB_LAST BIT_MASK 0x40 /end MEASUREMENT
/begin MEASUREMENT fmy_stat_maf_kgh_plaus.err_info_stat.lv_end_diag "end of diagnosis of the diagnosis instance MAF_KGH_PLAUS" UWORD _CNV_S_2_RANGE______380_CM 1 0. 0. 1. DISPLAY_IDENTIFIER LV_END_DIAG_MAF_KGH_PLAUS ECU_ADDRESS 0x7f99c6 BYTE_ORDER MSB_LAST BIT_MASK 0x20 /end MEASUREMENT
/begin MEASUREMENT fmy_stat_maf_kgh_plaus.err_info_stat.lv_cdn_diag "diagnosis condition of the diagnosis instance MAF_KGH_PLAUS" UWORD _CNV_S_2_RANGE______380_CM 1 0. 0. 1. DISPLAY_IDENTIFIER LV_CDN_DIAG_MAF_KGH_PLAUS ECU_ADDRESS 0x7f99c6 BYTE_ORDER MSB_LAST BIT_MASK 0x10 /end MEASUREMENT
/begin MEASUREMENT fmy_stat_maf_kgh_plaus.err_info_stat.err_sym "symptoms of the diagnosis instance MAF_KGH_PLAUS" UWORD _CNV_S_6_CONV_ERRM__27_CM 1 0. 0. 15. DISPLAY_IDENTIFIER ERR_SYM_MAF_KGH_PLAUS ECU_ADDRESS 0x7f99c6 BYTE_ORDER MSB_LAST BIT_MASK 0xF /end MEASUREMENT
/begin MEASUREMENT lv_err_maf_0_rng "Error flag of diagnosis instance MAF_0_RNG" UBYTE _CNV_S_2_RANGE______28_CM 1 0. 0. 1. DISPLAY_IDENTIFIER LV_ERR_MAF_0_RNG ECU_ADDRESS 0x7fb4f7 /end MEASUREMENT
/begin MEASUREMENT fmy_stat_maf_0_rng.ctr_abc "anti bounce counter for diagnosis instance MAF_0_RNG" UBYTE _CNV_A_R_LINEAR_____1_CM 1 0. 0. 255. DISPLAY_IDENTIFIER CTR_ABC_MAF_0_RNG ECU_ADDRESS 0x7f99cd FORMAT "%3.0" /end MEASUREMENT
/begin MEASUREMENT fmy_stat_maf_0_rng.ctr_end_diag "counter for end of diagnosis for diagnosis instance MAF_0_RNG" UBYTE _CNV_A_R_LINEAR_____1_CM 1 0. 0. 255. DISPLAY_IDENTIFIER CTR_ABC_END_DIAG_MAF_0_RNG ECU_ADDRESS 0x7f99cc FORMAT "%3.0" /end MEASUREMENT
/begin MEASUREMENT fmy_stat_maf_0_rng.err_info_stat.reserved "" UWORD _CNV_A_R_LINEAR_____0_CM 1 0. 0. 65535. DISPLAY_IDENTIFIER FMY_STAT_MAF_0_RNG_ERR_INFO_STAT ECU_ADDRESS 0x7f99ca BYTE_ORDER MSB_LAST BIT_MASK 0xF800 /end MEASUREMENT
/begin MEASUREMENT fmy_stat_maf_0_rng.err_info_stat.lv_cdn_diag_stc "Statistical flag for condition of diagnosis of the diagnosis instance MAF_0_RNG" UWORD _CNV_S_2_RANGE______380_CM 1 0. 0. 1. DISPLAY_IDENTIFIER LV_CDN_DIAG_STC_MAF_0_RNG ECU_ADDRESS 0x7f99ca BYTE_ORDER MSB_LAST BIT_MASK 0x400 /end MEASUREMENT
/begin MEASUREMENT fmy_stat_maf_0_rng.err_info_stat.lv_lock_diag "lock flag (CPU load optimisation) of the diagnosis instance MAF_0_RNG" UWORD _CNV_S_2_RANGE______380_CM 1 0. 0. 1. DISPLAY_IDENTIFIER LV_LOCK_DIAG_MAF_0_RNG ECU_ADDRESS 0x7f99ca BYTE_ORDER MSB_LAST BIT_MASK 0x200 /end MEASUREMENT
/begin MEASUREMENT fmy_stat_maf_0_rng.err_info_stat.lv_err_mem "storage in dynamic failure memory of the diagnosis instance MAF_0_RNG" UWORD _CNV_S_2_RANGE______380_CM 1 0. 0. 1. DISPLAY_IDENTIFIER LV_ERR_MEM_MAF_0_RNG ECU_ADDRESS 0x7f99ca BYTE_ORDER MSB_LAST BIT_MASK 0x80 /end MEASUREMENT
/begin MEASUREMENT fmy_stat_maf_0_rng.err_info_stat.lv_ready "readiness status of the diagnosis instance MAF_0_RNG" UWORD _CNV_S_2_RANGE______380_CM 1 0. 0. 1. DISPLAY_IDENTIFIER LV_READY_MAF_0_RNG ECU_ADDRESS 0x7f99ca BYTE_ORDER MSB_LAST BIT_MASK 0x40 /end MEASUREMENT
/begin MEASUREMENT fmy_stat_maf_0_rng.err_info_stat.lv_end_diag "end of diagnosis of the diagnosis instance MAF_0_RNG" UWORD _CNV_S_2_RANGE______380_CM 1 0. 0. 1. DISPLAY_IDENTIFIER LV_END_DIAG_MAF_0_RNG ECU_ADDRESS 0x7f99ca BYTE_ORDER MSB_LAST BIT_MASK 0x20 /end MEASUREMENT
/begin MEASUREMENT fmy_stat_maf_0_rng.err_info_stat.lv_cdn_diag "diagnosis condition of the diagnosis instance MAF_0_RNG" UWORD _CNV_S_2_RANGE______380_CM 1 0. 0. 1. DISPLAY_IDENTIFIER LV_CDN_DIAG_MAF_0_RNG ECU_ADDRESS 0x7f99ca BYTE_ORDER MSB_LAST BIT_MASK 0x10 /end MEASUREMENT
/begin MEASUREMENT fmy_stat_maf_0_rng.err_info_stat.err_sym "symptoms of the diagnosis instance MAF_0_RNG" UWORD _CNV_S_6_CONV_ERRM__27_CM 1 0. 0. 15. DISPLAY_IDENTIFIER ERR_SYM_MAF_0_RNG ECU_ADDRESS 0x7f99ca BYTE_ORDER MSB_LAST BIT_MASK 0xF /end MEASUREMENT
/begin MEASUREMENT lv_err_v_tpc_rng "Error flag of diagnosis instance V_TPC_RNG" UBYTE _CNV_S_2_RANGE______28_CM 1 0. 0. 1. DISPLAY_IDENTIFIER LV_ERR_V_TPC_RNG ECU_ADDRESS 0x7fb4f8 /end MEASUREMENT
/begin MEASUREMENT fmy_stat_v_tpc_rng.ctr_abc "anti bounce counter for diagnosis instance V_TPC_RNG" UBYTE _CNV_A_R_LINEAR_____1_CM 1 0. 0. 255. DISPLAY_IDENTIFIER CTR_ABC_V_TPC_RNG ECU_ADDRESS 0x7f99d1 FORMAT "%3.0" /end MEASUREMENT
/begin MEASUREMENT fmy_stat_v_tpc_rng.ctr_end_diag "counter for end of diagnosis for diagnosis instance V_TPC_RNG" UBYTE _CNV_A_R_LINEAR_____1_CM 1 0. 0. 255. DISPLAY_IDENTIFIER CTR_ABC_END_DIAG_V_TPC_RNG ECU_ADDRESS 0x7f99d0 FORMAT "%3.0" /end MEASUREMENT
/begin MEASUREMENT fmy_stat_v_tpc_rng.err_info_stat.reserved "" UWORD _CNV_A_R_LINEAR_____0_CM 1 0. 0. 65535. DISPLAY_IDENTIFIER FMY_STAT_V_TPC_RNG_ERR_INFO_STAT ECU_ADDRESS 0x7f99ce BYTE_ORDER MSB_LAST BIT_MASK 0xF800 /end MEASUREMENT
/begin MEASUREMENT fmy_stat_v_tpc_rng.err_info_stat.lv_cdn_diag_stc "Statistical flag for condition of diagnosis of the diagnosis instance V_TPC_RNG" UWORD _CNV_S_2_RANGE______380_CM 1 0. 0. 1. DISPLAY_IDENTIFIER LV_CDN_DIAG_STC_V_TPC_RNG ECU_ADDRESS 0x7f99ce BYTE_ORDER MSB_LAST BIT_MASK 0x400 /end MEASUREMENT
/begin MEASUREMENT fmy_stat_v_tpc_rng.err_info_stat.lv_lock_diag "lock flag (CPU load optimisation) of the diagnosis instance V_TPC_RNG" UWORD _CNV_S_2_RANGE______380_CM 1 0. 0. 1. DISPLAY_IDENTIFIER LV_LOCK_DIAG_V_TPC_RNG ECU_ADDRESS 0x7f99ce BYTE_ORDER MSB_LAST BIT_MASK 0x200 /end MEASUREMENT
/begin MEASUREMENT fmy_stat_v_tpc_rng.err_info_stat.lv_err_mem "storage in dynamic failure memory of the diagnosis instance V_TPC_RNG" UWORD _CNV_S_2_RANGE______380_CM 1 0. 0. 1. DISPLAY_IDENTIFIER LV_ERR_MEM_V_TPC_RNG ECU_ADDRESS 0x7f99ce BYTE_ORDER MSB_LAST BIT_MASK 0x80 /end MEASUREMENT
/begin MEASUREMENT fmy_stat_v_tpc_rng.err_info_stat.lv_ready "readiness status of the diagnosis instance V_TPC_RNG" UWORD _CNV_S_2_RANGE______380_CM 1 0. 0. 1. DISPLAY_IDENTIFIER LV_READY_V_TPC_RNG ECU_ADDRESS 0x7f99ce BYTE_ORDER MSB_LAST BIT_MASK 0x40 /end MEASUREMENT
/begin MEASUREMENT fmy_stat_v_tpc_rng.err_info_stat.lv_end_diag "end of diagnosis of the diagnosis instance V_TPC_RNG" UWORD _CNV_S_2_RANGE______380_CM 1 0. 0. 1. DISPLAY_IDENTIFIER LV_END_DIAG_V_TPC_RNG ECU_ADDRESS 0x7f99ce BYTE_ORDER MSB_LAST BIT_MASK 0x20 /end MEASUREMENT
/begin MEASUREMENT fmy_stat_v_tpc_rng.err_info_stat.lv_cdn_diag "diagnosis condition of the diagnosis instance V_TPC_RNG" UWORD _CNV_S_2_RANGE______380_CM 1 0. 0. 1. DISPLAY_IDENTIFIER LV_CDN_DIAG_V_TPC_RNG ECU_ADDRESS 0x7f99ce BYTE_ORDER MSB_LAST BIT_MASK 0x10 /end MEASUREMENT
/begin MEASUREMENT fmy_stat_v_tpc_rng.err_info_stat.err_sym "symptoms of the diagnosis instance V_TPC_RNG" UWORD _CNV_S_6_CONV_ERRM__27_CM 1 0. 0. 15. DISPLAY_IDENTIFIER ERR_SYM_V_TPC_RNG ECU_ADDRESS 0x7f99ce BYTE_ORDER MSB_LAST BIT_MASK 0xF /end MEASUREMENT
/begin MEASUREMENT lv_err_tpc_mes_plaus "Error flag of diagnosis instance TPC_MES_PLAUS" UBYTE _CNV_S_2_RANGE______28_CM 1 0. 0. 1. DISPLAY_IDENTIFIER LV_ERR_TPC_MES_PLAUS ECU_ADDRESS 0x7fb4f9 /end MEASUREMENT
/begin MEASUREMENT fmy_stat_tpc_mes_plaus.ctr_abc "anti bounce counter for diagnosis instance TPC_MES_PLAUS" UBYTE _CNV_A_R_LINEAR_____1_CM 1 0. 0. 255. DISPLAY_IDENTIFIER CTR_ABC_TPC_MES_PLAUS ECU_ADDRESS 0x7f99d5 FORMAT "%3.0" /end MEASUREMENT
/begin MEASUREMENT fmy_stat_tpc_mes_plaus.ctr_end_diag "counter for end of diagnosis for diagnosis instance TPC_MES_PLAUS" UBYTE _CNV_A_R_LINEAR_____1_CM 1 0. 0. 255. DISPLAY_IDENTIFIER CTR_ABC_END_DIAG_TPC_MES_PLAUS ECU_ADDRESS 0x7f99d4 FORMAT "%3.0" /end MEASUREMENT
/begin MEASUREMENT fmy_stat_tpc_mes_plaus.err_info_stat.reserved "" UWORD _CNV_A_R_LINEAR_____0_CM 1 0. 0. 65535. DISPLAY_IDENTIFIER FMY_STAT_TPC_MES_PLAUS_ERR_INFO_ ECU_ADDRESS 0x7f99d2 BYTE_ORDER MSB_LAST BIT_MASK 0xF800 /end MEASUREMENT
/begin MEASUREMENT fmy_stat_tpc_mes_plaus.err_info_stat.lv_cdn_diag_stc "Statistical flag for condition of diagnosis of the diagnosis instance TPC_MES_PLAUS" UWORD _CNV_S_2_RANGE______380_CM 1 0. 0. 1. DISPLAY_IDENTIFIER LV_CDN_DIAG_STC_TPC_MES_PLAUS ECU_ADDRESS 0x7f99d2 BYTE_ORDER MSB_LAST BIT_MASK 0x400 /end MEASUREMENT
/begin MEASUREMENT fmy_stat_tpc_mes_plaus.err_info_stat.lv_lock_diag "lock flag (CPU load optimisation) of the diagnosis instance TPC_MES_PLAUS" UWORD _CNV_S_2_RANGE______380_CM 1 0. 0. 1. DISPLAY_IDENTIFIER LV_LOCK_DIAG_TPC_MES_PLAUS ECU_ADDRESS 0x7f99d2 BYTE_ORDER MSB_LAST BIT_MASK 0x200 /end MEASUREMENT
/begin MEASUREMENT fmy_stat_tpc_mes_plaus.err_info_stat.lv_err_mem "storage in dynamic failure memory of the diagnosis instance TPC_MES_PLAUS" UWORD _CNV_S_2_RANGE______380_CM 1 0. 0. 1. DISPLAY_IDENTIFIER LV_ERR_MEM_TPC_MES_PLAUS ECU_ADDRESS 0x7f99d2 BYTE_ORDER MSB_LAST BIT_MASK 0x80 /end MEASUREMENT
/begin MEASUREMENT fmy_stat_tpc_mes_plaus.err_info_stat.lv_ready "readiness status of the diagnosis instance TPC_MES_PLAUS" UWORD _CNV_S_2_RANGE______380_CM 1 0. 0. 1. DISPLAY_IDENTIFIER LV_READY_TPC_MES_PLAUS ECU_ADDRESS 0x7f99d2 BYTE_ORDER MSB_LAST BIT_MASK 0x40 /end MEASUREMENT
/begin MEASUREMENT fmy_stat_tpc_mes_plaus.err_info_stat.lv_end_diag "end of diagnosis of the diagnosis instance TPC_MES_PLAUS" UWORD _CNV_S_2_RANGE______380_CM 1 0. 0. 1. DISPLAY_IDENTIFIER LV_END_DIAG_TPC_MES_PLAUS ECU_ADDRESS 0x7f99d2 BYTE_ORDER MSB_LAST BIT_MASK 0x20 /end MEASUREMENT
/begin MEASUREMENT fmy_stat_tpc_mes_plaus.err_info_stat.lv_cdn_diag "diagnosis condition of the diagnosis instance TPC_MES_PLAUS" UWORD _CNV_S_2_RANGE______380_CM 1 0. 0. 1. DISPLAY_IDENTIFIER LV_CDN_DIAG_TPC_MES_PLAUS ECU_ADDRESS 0x7f99d2 BYTE_ORDER MSB_LAST BIT_MASK 0x10 /end MEASUREMENT
/begin MEASUREMENT fmy_stat_tpc_mes_plaus.err_info_stat.err_sym "symptoms of the diagnosis instance TPC_MES_PLAUS" UWORD _CNV_S_6_CONV_ERRM__27_CM 1 0. 0. 15. DISPLAY_IDENTIFIER ERR_SYM_TPC_MES_PLAUS ECU_ADDRESS 0x7f99d2 BYTE_ORDER MSB_LAST BIT_MASK 0xF /end MEASUREMENT
/begin MEASUREMENT lv_err_v_tac_rng "Error flag of diagnosis instance V_TAC_RNG" UBYTE _CNV_S_2_RANGE______28_CM 1 0. 0. 1. DISPLAY_IDENTIFIER LV_ERR_V_TAC_RNG ECU_ADDRESS 0x7fb4fa /end MEASUREMENT
/begin MEASUREMENT fmy_stat_v_tac_rng.ctr_abc "anti bounce counter for diagnosis instance V_TAC_RNG" UBYTE _CNV_A_R_LINEAR_____1_CM 1 0. 0. 255. DISPLAY_IDENTIFIER CTR_ABC_V_TAC_RNG ECU_ADDRESS 0x7f99d9 FORMAT "%3.0" /end MEASUREMENT
/begin MEASUREMENT fmy_stat_v_tac_rng.ctr_end_diag "counter for end of diagnosis for diagnosis instance V_TAC_RNG" UBYTE _CNV_A_R_LINEAR_____1_CM 1 0. 0. 255. DISPLAY_IDENTIFIER CTR_ABC_END_DIAG_V_TAC_RNG ECU_ADDRESS 0x7f99d8 FORMAT "%3.0" /end MEASUREMENT
/begin MEASUREMENT fmy_stat_v_tac_rng.err_info_stat.reserved "" UWORD _CNV_A_R_LINEAR_____0_CM 1 0. 0. 65535. DISPLAY_IDENTIFIER FMY_STAT_V_TAC_RNG_ERR_INFO_STAT ECU_ADDRESS 0x7f99d6 BYTE_ORDER MSB_LAST BIT_MASK 0xF800 /end MEASUREMENT
/begin MEASUREMENT fmy_stat_v_tac_rng.err_info_stat.lv_cdn_diag_stc "Statistical flag for condition of diagnosis of the diagnosis instance V_TAC_RNG" UWORD _CNV_S_2_RANGE______380_CM 1 0. 0. 1. DISPLAY_IDENTIFIER LV_CDN_DIAG_STC_V_TAC_RNG ECU_ADDRESS 0x7f99d6 BYTE_ORDER MSB_LAST BIT_MASK 0x400 /end MEASUREMENT
/begin MEASUREMENT fmy_stat_v_tac_rng.err_info_stat.lv_lock_diag "lock flag (CPU load optimisation) of the diagnosis instance V_TAC_RNG" UWORD _CNV_S_2_RANGE______380_CM 1 0. 0. 1. DISPLAY_IDENTIFIER LV_LOCK_DIAG_V_TAC_RNG ECU_ADDRESS 0x7f99d6 BYTE_ORDER MSB_LAST BIT_MASK 0x200 /end MEASUREMENT
/begin MEASUREMENT fmy_stat_v_tac_rng.err_info_stat.lv_err_mem "storage in dynamic failure memory of the diagnosis instance V_TAC_RNG" UWORD _CNV_S_2_RANGE______380_CM 1 0. 0. 1. DISPLAY_IDENTIFIER LV_ERR_MEM_V_TAC_RNG ECU_ADDRESS 0x7f99d6 BYTE_ORDER MSB_LAST BIT_MASK 0x80 /end MEASUREMENT
/begin MEASUREMENT fmy_stat_v_tac_rng.err_info_stat.lv_ready "readiness status of the diagnosis instance V_TAC_RNG" UWORD _CNV_S_2_RANGE______380_CM 1 0. 0. 1. DISPLAY_IDENTIFIER LV_READY_V_TAC_RNG ECU_ADDRESS 0x7f99d6 BYTE_ORDER MSB_LAST BIT_MASK 0x40 /end MEASUREMENT
/begin MEASUREMENT fmy_stat_v_tac_rng.err_info_stat.lv_end_diag "end of diagnosis of the diagnosis instance V_TAC_RNG" UWORD _CNV_S_2_RANGE______380_CM 1 0. 0. 1. DISPLAY_IDENTIFIER LV_END_DIAG_V_TAC_RNG ECU_ADDRESS 0x7f99d6 BYTE_ORDER MSB_LAST BIT_MASK 0x20 /end MEASUREMENT
/begin MEASUREMENT fmy_stat_v_tac_rng.err_info_stat.lv_cdn_diag "diagnosis condition of the diagnosis instance V_TAC_RNG" UWORD _CNV_S_2_RANGE______380_CM 1 0. 0. 1. DISPLAY_IDENTIFIER LV_CDN_DIAG_V_TAC_RNG ECU_ADDRESS 0x7f99d6 BYTE_ORDER MSB_LAST BIT_MASK 0x10 /end MEASUREMENT
/begin MEASUREMENT fmy_stat_v_tac_rng.err_info_stat.err_sym "symptoms of the diagnosis instance V_TAC_RNG" UWORD _CNV_S_6_CONV_ERRM__27_CM 1 0. 0. 15. DISPLAY_IDENTIFIER ERR_SYM_V_TAC_RNG ECU_ADDRESS 0x7f99d6 BYTE_ORDER MSB_LAST BIT_MASK 0xF /end MEASUREMENT
/begin MEASUREMENT lv_err_tac_mes_plaus "Error flag of diagnosis instance TAC_MES_PLAUS" UBYTE _CNV_S_2_RANGE______28_CM 1 0. 0. 1. DISPLAY_IDENTIFIER LV_ERR_TAC_MES_PLAUS ECU_ADDRESS 0x7fb4fb /end MEASUREMENT
/begin MEASUREMENT fmy_stat_tac_mes_plaus.ctr_abc "anti bounce counter for diagnosis instance TAC_MES_PLAUS" UBYTE _CNV_A_R_LINEAR_____1_CM 1 0. 0. 255. DISPLAY_IDENTIFIER CTR_ABC_TAC_MES_PLAUS ECU_ADDRESS 0x7f99dd FORMAT "%3.0" /end MEASUREMENT
/begin MEASUREMENT fmy_stat_tac_mes_plaus.ctr_end_diag "counter for end of diagnosis for diagnosis instance TAC_MES_PLAUS" UBYTE _CNV_A_R_LINEAR_____1_CM 1 0. 0. 255. DISPLAY_IDENTIFIER CTR_ABC_END_DIAG_TAC_MES_PLAUS ECU_ADDRESS 0x7f99dc FORMAT "%3.0" /end MEASUREMENT
/begin MEASUREMENT fmy_stat_tac_mes_plaus.err_info_stat.reserved "" UWORD _CNV_A_R_LINEAR_____0_CM 1 0. 0. 65535. DISPLAY_IDENTIFIER FMY_STAT_TAC_MES_PLAUS_ERR_INFO_ ECU_ADDRESS 0x7f99da BYTE_ORDER MSB_LAST BIT_MASK 0xF800 /end MEASUREMENT
/begin MEASUREMENT fmy_stat_tac_mes_plaus.err_info_stat.lv_cdn_diag_stc "Statistical flag for condition of diagnosis of the diagnosis instance TAC_MES_PLAUS" UWORD _CNV_S_2_RANGE______380_CM 1 0. 0. 1. DISPLAY_IDENTIFIER LV_CDN_DIAG_STC_TAC_MES_PLAUS ECU_ADDRESS 0x7f99da BYTE_ORDER MSB_LAST BIT_MASK 0x400 /end MEASUREMENT
/begin MEASUREMENT fmy_stat_tac_mes_plaus.err_info_stat.lv_lock_diag "lock flag (CPU load optimisation) of the diagnosis instance TAC_MES_PLAUS" UWORD _CNV_S_2_RANGE______380_CM 1 0. 0. 1. DISPLAY_IDENTIFIER LV_LOCK_DIAG_TAC_MES_PLAUS ECU_ADDRESS 0x7f99da BYTE_ORDER MSB_LAST BIT_MASK 0x200 /end MEASUREMENT
/begin MEASUREMENT fmy_stat_tac_mes_plaus.err_info_stat.lv_err_mem "storage in dynamic failure memory of the diagnosis instance TAC_MES_PLAUS" UWORD _CNV_S_2_RANGE______380_CM 1 0. 0. 1. DISPLAY_IDENTIFIER LV_ERR_MEM_TAC_MES_PLAUS ECU_ADDRESS 0x7f99da BYTE_ORDER MSB_LAST BIT_MASK 0x80 /end MEASUREMENT
/begin MEASUREMENT fmy_stat_tac_mes_plaus.err_info_stat.lv_ready "readiness status of the diagnosis instance TAC_MES_PLAUS" UWORD _CNV_S_2_RANGE______380_CM 1 0. 0. 1. DISPLAY_IDENTIFIER LV_READY_TAC_MES_PLAUS ECU_ADDRESS 0x7f99da BYTE_ORDER MSB_LAST BIT_MASK 0x40 /end MEASUREMENT
/begin MEASUREMENT fmy_stat_tac_mes_plaus.err_info_stat.lv_end_diag "end of diagnosis of the diagnosis instance TAC_MES_PLAUS" UWORD _CNV_S_2_RANGE______380_CM 1 0. 0. 1. DISPLAY_IDENTIFIER LV_END_DIAG_TAC_MES_PLAUS ECU_ADDRESS 0x7f99da BYTE_ORDER MSB_LAST BIT_MASK 0x20 /end MEASUREMENT
/begin MEASUREMENT fmy_stat_tac_mes_plaus.err_info_stat.lv_cdn_diag "diagnosis condition of the diagnosis instance TAC_MES_PLAUS" UWORD _CNV_S_2_RANGE______380_CM 1 0. 0. 1. DISPLAY_IDENTIFIER LV_CDN_DIAG_TAC_MES_PLAUS ECU_ADDRESS 0x7f99da BYTE_ORDER MSB_LAST BIT_MASK 0x10 /end MEASUREMENT
/begin MEASUREMENT fmy_stat_tac_mes_plaus.err_info_stat.err_sym "symptoms of the diagnosis instance TAC_MES_PLAUS" UWORD _CNV_S_6_CONV_ERRM__27_CM 1 0. 0. 15. DISPLAY_IDENTIFIER ERR_SYM_TAC_MES_PLAUS ECU_ADDRESS 0x7f99da BYTE_ORDER MSB_LAST BIT_MASK 0xF /end MEASUREMENT
/begin MEASUREMENT lv_err_mf_is_obd "Error flag of diagnosis instance MF_IS_OBD" UBYTE _CNV_S_2_RANGE______28_CM 1 0. 0. 1. DISPLAY_IDENTIFIER LV_ERR_MF_IS_OBD ECU_ADDRESS 0x7fb4fc /end MEASUREMENT
/begin MEASUREMENT fmy_stat_mf_is_obd.ctr_abc "anti bounce counter for diagnosis instance MF_IS_OBD" UBYTE _CNV_A_R_LINEAR_____1_CM 1 0. 0. 255. DISPLAY_IDENTIFIER CTR_ABC_MF_IS_OBD ECU_ADDRESS 0x7f99e1 FORMAT "%3.0" /end MEASUREMENT
/begin MEASUREMENT fmy_stat_mf_is_obd.ctr_end_diag "counter for end of diagnosis for diagnosis instance MF_IS_OBD" UBYTE _CNV_A_R_LINEAR_____1_CM 1 0. 0. 255. DISPLAY_IDENTIFIER CTR_ABC_END_DIAG_MF_IS_OBD ECU_ADDRESS 0x7f99e0 FORMAT "%3.0" /end MEASUREMENT
/begin MEASUREMENT fmy_stat_mf_is_obd.err_info_stat.reserved "" UWORD _CNV_A_R_LINEAR_____0_CM 1 0. 0. 65535. DISPLAY_IDENTIFIER FMY_STAT_MF_IS_OBD_ERR_INFO_STAT ECU_ADDRESS 0x7f99de BYTE_ORDER MSB_LAST BIT_MASK 0xF800 /end MEASUREMENT
/begin MEASUREMENT fmy_stat_mf_is_obd.err_info_stat.lv_cdn_diag_stc "Statistical flag for condition of diagnosis of the diagnosis instance MF_IS_OBD" UWORD _CNV_S_2_RANGE______380_CM 1 0. 0. 1. DISPLAY_IDENTIFIER LV_CDN_DIAG_STC_MF_IS_OBD ECU_ADDRESS 0x7f99de BYTE_ORDER MSB_LAST BIT_MASK 0x400 /end MEASUREMENT
/begin MEASUREMENT fmy_stat_mf_is_obd.err_info_stat.lv_lock_diag "lock flag (CPU load optimisation) of the diagnosis instance MF_IS_OBD" UWORD _CNV_S_2_RANGE______380_CM 1 0. 0. 1. DISPLAY_IDENTIFIER LV_LOCK_DIAG_MF_IS_OBD ECU_ADDRESS 0x7f99de BYTE_ORDER MSB_LAST BIT_MASK 0x200 /end MEASUREMENT
/begin MEASUREMENT fmy_stat_mf_is_obd.err_info_stat.lv_err_mem "storage in dynamic failure memory of the diagnosis instance MF_IS_OBD" UWORD _CNV_S_2_RANGE______380_CM 1 0. 0. 1. DISPLAY_IDENTIFIER LV_ERR_MEM_MF_IS_OBD ECU_ADDRESS 0x7f99de BYTE_ORDER MSB_LAST BIT_MASK 0x80 /end MEASUREMENT
/begin MEASUREMENT fmy_stat_mf_is_obd.err_info_stat.lv_ready "readiness status of the diagnosis instance MF_IS_OBD" UWORD _CNV_S_2_RANGE______380_CM 1 0. 0. 1. DISPLAY_IDENTIFIER LV_READY_MF_IS_OBD ECU_ADDRESS 0x7f99de BYTE_ORDER MSB_LAST BIT_MASK 0x40 /end MEASUREMENT
/begin MEASUREMENT fmy_stat_mf_is_obd.err_info_stat.lv_end_diag "end of diagnosis of the diagnosis instance MF_IS_OBD" UWORD _CNV_S_2_RANGE______380_CM 1 0. 0. 1. DISPLAY_IDENTIFIER LV_END_DIAG_MF_IS_OBD ECU_ADDRESS 0x7f99de BYTE_ORDER MSB_LAST BIT_MASK 0x20 /end MEASUREMENT
/begin MEASUREMENT fmy_stat_mf_is_obd.err_info_stat.lv_cdn_diag "diagnosis condition of the diagnosis instance MF_IS_OBD" UWORD _CNV_S_2_RANGE______380_CM 1 0. 0. 1. DISPLAY_IDENTIFIER LV_CDN_DIAG_MF_IS_OBD ECU_ADDRESS 0x7f99de BYTE_ORDER MSB_LAST BIT_MASK 0x10 /end MEASUREMENT
/begin MEASUREMENT fmy_stat_mf_is_obd.err_info_stat.err_sym "symptoms of the diagnosis instance MF_IS_OBD" UWORD _CNV_S_6_CONV_ERRM__27_CM 1 0. 0. 15. DISPLAY_IDENTIFIER ERR_SYM_MF_IS_OBD ECU_ADDRESS 0x7f99de BYTE_ORDER MSB_LAST BIT_MASK 0xF /end MEASUREMENT
/begin MEASUREMENT lv_err_cyl_bal_0 "Error flag of diagnosis instance CYL_BAL_0" UBYTE _CNV_S_2_RANGE______28_CM 1 0. 0. 1. DISPLAY_IDENTIFIER LV_ERR_CYL_BAL_0 ECU_ADDRESS 0x7fb4fd /end MEASUREMENT
/begin MEASUREMENT fmy_stat_cyl_bal_0.ctr_abc "anti bounce counter for diagnosis instance CYL_BAL_0" UBYTE _CNV_A_R_LINEAR_____1_CM 1 0. 0. 255. DISPLAY_IDENTIFIER CTR_ABC_CYL_BAL_0 ECU_ADDRESS 0x7f99e5 FORMAT "%3.0" /end MEASUREMENT
/begin MEASUREMENT fmy_stat_cyl_bal_0.ctr_end_diag "counter for end of diagnosis for diagnosis instance CYL_BAL_0" UBYTE _CNV_A_R_LINEAR_____1_CM 1 0. 0. 255. DISPLAY_IDENTIFIER CTR_ABC_END_DIAG_CYL_BAL_0 ECU_ADDRESS 0x7f99e4 FORMAT "%3.0" /end MEASUREMENT
/begin MEASUREMENT fmy_stat_cyl_bal_0.err_info_stat.reserved "" UWORD _CNV_A_R_LINEAR_____0_CM 1 0. 0. 65535. DISPLAY_IDENTIFIER FMY_STAT_CYL_BAL_0_ERR_INFO_STAT ECU_ADDRESS 0x7f99e2 BYTE_ORDER MSB_LAST BIT_MASK 0xF800 /end MEASUREMENT
/begin MEASUREMENT fmy_stat_cyl_bal_0.err_info_stat.lv_cdn_diag_stc "Statistical flag for condition of diagnosis of the diagnosis instance CYL_BAL_0" UWORD _CNV_S_2_RANGE______380_CM 1 0. 0. 1. DISPLAY_IDENTIFIER LV_CDN_DIAG_STC_CYL_BAL_0 ECU_ADDRESS 0x7f99e2 BYTE_ORDER MSB_LAST BIT_MASK 0x400 /end MEASUREMENT
/begin MEASUREMENT fmy_stat_cyl_bal_0.err_info_stat.lv_lock_diag "lock flag (CPU load optimisation) of the diagnosis instance CYL_BAL_0" UWORD _CNV_S_2_RANGE______380_CM 1 0. 0. 1. DISPLAY_IDENTIFIER LV_LOCK_DIAG_CYL_BAL_0 ECU_ADDRESS 0x7f99e2 BYTE_ORDER MSB_LAST BIT_MASK 0x200 /end MEASUREMENT
/begin MEASUREMENT fmy_stat_cyl_bal_0.err_info_stat.lv_err_mem "storage in dynamic failure memory of the diagnosis instance CYL_BAL_0" UWORD _CNV_S_2_RANGE______380_CM 1 0. 0. 1. DISPLAY_IDENTIFIER LV_ERR_MEM_CYL_BAL_0 ECU_ADDRESS 0x7f99e2 BYTE_ORDER MSB_LAST BIT_MASK 0x80 /end MEASUREMENT
/begin MEASUREMENT fmy_stat_cyl_bal_0.err_info_stat.lv_ready "readiness status of the diagnosis instance CYL_BAL_0" UWORD _CNV_S_2_RANGE______380_CM 1 0. 0. 1. DISPLAY_IDENTIFIER LV_READY_CYL_BAL_0 ECU_ADDRESS 0x7f99e2 BYTE_ORDER MSB_LAST BIT_MASK 0x40 /end MEASUREMENT
/begin MEASUREMENT fmy_stat_cyl_bal_0.err_info_stat.lv_end_diag "end of diagnosis of the diagnosis instance CYL_BAL_0" UWORD _CNV_S_2_RANGE______380_CM 1 0. 0. 1. DISPLAY_IDENTIFIER LV_END_DIAG_CYL_BAL_0 ECU_ADDRESS 0x7f99e2 BYTE_ORDER MSB_LAST BIT_MASK 0x20 /end MEASUREMENT
/begin MEASUREMENT fmy_stat_cyl_bal_0.err_info_stat.lv_cdn_diag "diagnosis condition of the diagnosis instance CYL_BAL_0" UWORD _CNV_S_2_RANGE______380_CM 1 0. 0. 1. DISPLAY_IDENTIFIER LV_CDN_DIAG_CYL_BAL_0 ECU_ADDRESS 0x7f99e2 BYTE_ORDER MSB_LAST BIT_MASK 0x10 /end MEASUREMENT
/begin MEASUREMENT fmy_stat_cyl_bal_0.err_info_stat.err_sym "symptoms of the diagnosis instance CYL_BAL_0" UWORD _CNV_S_6_CONV_ERRM__27_CM 1 0. 0. 15. DISPLAY_IDENTIFIER ERR_SYM_CYL_BAL_0 ECU_ADDRESS 0x7f99e2 BYTE_ORDER MSB_LAST BIT_MASK 0xF /end MEASUREMENT
/begin MEASUREMENT lv_err_cyl_bal_1 "Error flag of diagnosis instance CYL_BAL_1" UBYTE _CNV_S_2_RANGE______28_CM 1 0. 0. 1. DISPLAY_IDENTIFIER LV_ERR_CYL_BAL_1 ECU_ADDRESS 0x7fb4fe /end MEASUREMENT
/begin MEASUREMENT fmy_stat_cyl_bal_1.ctr_abc "anti bounce counter for diagnosis instance CYL_BAL_1" UBYTE _CNV_A_R_LINEAR_____1_CM 1 0. 0. 255. DISPLAY_IDENTIFIER CTR_ABC_CYL_BAL_1 ECU_ADDRESS 0x7f99e9 FORMAT "%3.0" /end MEASUREMENT
/begin MEASUREMENT fmy_stat_cyl_bal_1.ctr_end_diag "counter for end of diagnosis for diagnosis instance CYL_BAL_1" UBYTE _CNV_A_R_LINEAR_____1_CM 1 0. 0. 255. DISPLAY_IDENTIFIER CTR_ABC_END_DIAG_CYL_BAL_1 ECU_ADDRESS 0x7f99e8 FORMAT "%3.0" /end MEASUREMENT
/begin MEASUREMENT fmy_stat_cyl_bal_1.err_info_stat.reserved "" UWORD _CNV_A_R_LINEAR_____0_CM 1 0. 0. 65535. DISPLAY_IDENTIFIER FMY_STAT_CYL_BAL_1_ERR_INFO_STAT ECU_ADDRESS 0x7f99e6 BYTE_ORDER MSB_LAST BIT_MASK 0xF800 /end MEASUREMENT
/begin MEASUREMENT fmy_stat_cyl_bal_1.err_info_stat.lv_cdn_diag_stc "Statistical flag for condition of diagnosis of the diagnosis instance CYL_BAL_1" UWORD _CNV_S_2_RANGE______380_CM 1 0. 0. 1. DISPLAY_IDENTIFIER LV_CDN_DIAG_STC_CYL_BAL_1 ECU_ADDRESS 0x7f99e6 BYTE_ORDER MSB_LAST BIT_MASK 0x400 /end MEASUREMENT
/begin MEASUREMENT fmy_stat_cyl_bal_1.err_info_stat.lv_lock_diag "lock flag (CPU load optimisation) of the diagnosis instance CYL_BAL_1" UWORD _CNV_S_2_RANGE______380_CM 1 0. 0. 1. DISPLAY_IDENTIFIER LV_LOCK_DIAG_CYL_BAL_1 ECU_ADDRESS 0x7f99e6 BYTE_ORDER MSB_LAST BIT_MASK 0x200 /end MEASUREMENT
/begin MEASUREMENT fmy_stat_cyl_bal_1.err_info_stat.lv_err_mem "storage in dynamic failure memory of the diagnosis instance CYL_BAL_1" UWORD _CNV_S_2_RANGE______380_CM 1 0. 0. 1. DISPLAY_IDENTIFIER LV_ERR_MEM_CYL_BAL_1 ECU_ADDRESS 0x7f99e6 BYTE_ORDER MSB_LAST BIT_MASK 0x80 /end MEASUREMENT
/begin MEASUREMENT fmy_stat_cyl_bal_1.err_info_stat.lv_ready "readiness status of the diagnosis instance CYL_BAL_1" UWORD _CNV_S_2_RANGE______380_CM 1 0. 0. 1. DISPLAY_IDENTIFIER LV_READY_CYL_BAL_1 ECU_ADDRESS 0x7f99e6 BYTE_ORDER MSB_LAST BIT_MASK 0x40 /end MEASUREMENT
/begin MEASUREMENT fmy_stat_cyl_bal_1.err_info_stat.lv_end_diag "end of diagnosis of the diagnosis instance CYL_BAL_1" UWORD _CNV_S_2_RANGE______380_CM 1 0. 0. 1. DISPLAY_IDENTIFIER LV_END_DIAG_CYL_BAL_1 ECU_ADDRESS 0x7f99e6 BYTE_ORDER MSB_LAST BIT_MASK 0x20 /end MEASUREMENT
/begin MEASUREMENT fmy_stat_cyl_bal_1.err_info_stat.lv_cdn_diag "diagnosis condition of the diagnosis instance CYL_BAL_1" UWORD _CNV_S_2_RANGE______380_CM 1 0. 0. 1. DISPLAY_IDENTIFIER LV_CDN_DIAG_CYL_BAL_1 ECU_ADDRESS 0x7f99e6 BYTE_ORDER MSB_LAST BIT_MASK 0x10 /end MEASUREMENT
/begin MEASUREMENT fmy_stat_cyl_bal_1.err_info_stat.err_sym "symptoms of the diagnosis instance CYL_BAL_1" UWORD _CNV_S_6_CONV_ERRM__27_CM 1 0. 0. 15. DISPLAY_IDENTIFIER ERR_SYM_CYL_BAL_1 ECU_ADDRESS 0x7f99e6 BYTE_ORDER MSB_LAST BIT_MASK 0xF /end MEASUREMENT
/begin MEASUREMENT lv_err_cyl_bal_2 "Error flag of diagnosis instance CYL_BAL_2" UBYTE _CNV_S_2_RANGE______28_CM 1 0. 0. 1. DISPLAY_IDENTIFIER LV_ERR_CYL_BAL_2 ECU_ADDRESS 0x7fb4ff /end MEASUREMENT
/begin MEASUREMENT fmy_stat_cyl_bal_2.ctr_abc "anti bounce counter for diagnosis instance CYL_BAL_2" UBYTE _CNV_A_R_LINEAR_____1_CM 1 0. 0. 255. DISPLAY_IDENTIFIER CTR_ABC_CYL_BAL_2 ECU_ADDRESS 0x7f99ed FORMAT "%3.0" /end MEASUREMENT
/begin MEASUREMENT fmy_stat_cyl_bal_2.ctr_end_diag "counter for end of diagnosis for diagnosis instance CYL_BAL_2" UBYTE _CNV_A_R_LINEAR_____1_CM 1 0. 0. 255. DISPLAY_IDENTIFIER CTR_ABC_END_DIAG_CYL_BAL_2 ECU_ADDRESS 0x7f99ec FORMAT "%3.0" /end MEASUREMENT
/begin MEASUREMENT fmy_stat_cyl_bal_2.err_info_stat.reserved "" UWORD _CNV_A_R_LINEAR_____0_CM 1 0. 0. 65535. DISPLAY_IDENTIFIER FMY_STAT_CYL_BAL_2_ERR_INFO_STAT ECU_ADDRESS 0x7f99ea BYTE_ORDER MSB_LAST BIT_MASK 0xF800 /end MEASUREMENT
/begin MEASUREMENT fmy_stat_cyl_bal_2.err_info_stat.lv_cdn_diag_stc "Statistical flag for condition of diagnosis of the diagnosis instance CYL_BAL_2" UWORD _CNV_S_2_RANGE______380_CM 1 0. 0. 1. DISPLAY_IDENTIFIER LV_CDN_DIAG_STC_CYL_BAL_2 ECU_ADDRESS 0x7f99ea BYTE_ORDER MSB_LAST BIT_MASK 0x400 /end MEASUREMENT
/begin MEASUREMENT fmy_stat_cyl_bal_2.err_info_stat.lv_lock_diag "lock flag (CPU load optimisation) of the diagnosis instance CYL_BAL_2" UWORD _CNV_S_2_RANGE______380_CM 1 0. 0. 1. DISPLAY_IDENTIFIER LV_LOCK_DIAG_CYL_BAL_2 ECU_ADDRESS 0x7f99ea BYTE_ORDER MSB_LAST BIT_MASK 0x200 /end MEASUREMENT
/begin MEASUREMENT fmy_stat_cyl_bal_2.err_info_stat.lv_err_mem "storage in dynamic failure memory of the diagnosis instance CYL_BAL_2" UWORD _CNV_S_2_RANGE______380_CM 1 0. 0. 1. DISPLAY_IDENTIFIER LV_ERR_MEM_CYL_BAL_2 ECU_ADDRESS 0x7f99ea BYTE_ORDER MSB_LAST BIT_MASK 0x80 /end MEASUREMENT
/begin MEASUREMENT fmy_stat_cyl_bal_2.err_info_stat.lv_ready "readiness status of the diagnosis instance CYL_BAL_2" UWORD _CNV_S_2_RANGE______380_CM 1 0. 0. 1. DISPLAY_IDENTIFIER LV_READY_CYL_BAL_2 ECU_ADDRESS 0x7f99ea BYTE_ORDER MSB_LAST BIT_MASK 0x40 /end MEASUREMENT
/begin MEASUREMENT fmy_stat_cyl_bal_2.err_info_stat.lv_end_diag "end of diagnosis of the diagnosis instance CYL_BAL_2" UWORD _CNV_S_2_RANGE______380_CM 1 0. 0. 1. DISPLAY_IDENTIFIER LV_END_DIAG_CYL_BAL_2 ECU_ADDRESS 0x7f99ea BYTE_ORDER MSB_LAST BIT_MASK 0x20 /end MEASUREMENT
/begin MEASUREMENT fmy_stat_cyl_bal_2.err_info_stat.lv_cdn_diag "diagnosis condition of the diagnosis instance CYL_BAL_2" UWORD _CNV_S_2_RANGE______380_CM 1 0. 0. 1. DISPLAY_IDENTIFIER LV_CDN_DIAG_CYL_BAL_2 ECU_ADDRESS 0x7f99ea BYTE_ORDER MSB_LAST BIT_MASK 0x10 /end MEASUREMENT
/begin MEASUREMENT fmy_stat_cyl_bal_2.err_info_stat.err_sym "symptoms of the diagnosis instance CYL_BAL_2" UWORD _CNV_S_6_CONV_ERRM__27_CM 1 0. 0. 15. DISPLAY_IDENTIFIER ERR_SYM_CYL_BAL_2 ECU_ADDRESS 0x7f99ea BYTE_ORDER MSB_LAST BIT_MASK 0xF /end MEASUREMENT
/begin MEASUREMENT lv_err_cyl_bal_3 "Error flag of diagnosis instance CYL_BAL_3" UBYTE _CNV_S_2_RANGE______28_CM 1 0. 0. 1. DISPLAY_IDENTIFIER LV_ERR_CYL_BAL_3 ECU_ADDRESS 0x7fb500 /end MEASUREMENT
/begin MEASUREMENT fmy_stat_cyl_bal_3.ctr_abc "anti bounce counter for diagnosis instance CYL_BAL_3" UBYTE _CNV_A_R_LINEAR_____1_CM 1 0. 0. 255. DISPLAY_IDENTIFIER CTR_ABC_CYL_BAL_3 ECU_ADDRESS 0x7f99f1 FORMAT "%3.0" /end MEASUREMENT
/begin MEASUREMENT fmy_stat_cyl_bal_3.ctr_end_diag "counter for end of diagnosis for diagnosis instance CYL_BAL_3" UBYTE _CNV_A_R_LINEAR_____1_CM 1 0. 0. 255. DISPLAY_IDENTIFIER CTR_ABC_END_DIAG_CYL_BAL_3 ECU_ADDRESS 0x7f99f0 FORMAT "%3.0" /end MEASUREMENT
/begin MEASUREMENT fmy_stat_cyl_bal_3.err_info_stat.reserved "" UWORD _CNV_A_R_LINEAR_____0_CM 1 0. 0. 65535. DISPLAY_IDENTIFIER FMY_STAT_CYL_BAL_3_ERR_INFO_STAT ECU_ADDRESS 0x7f99ee BYTE_ORDER MSB_LAST BIT_MASK 0xF800 /end MEASUREMENT
/begin MEASUREMENT fmy_stat_cyl_bal_3.err_info_stat.lv_cdn_diag_stc "Statistical flag for condition of diagnosis of the diagnosis instance CYL_BAL_3" UWORD _CNV_S_2_RANGE______380_CM 1 0. 0. 1. DISPLAY_IDENTIFIER LV_CDN_DIAG_STC_CYL_BAL_3 ECU_ADDRESS 0x7f99ee BYTE_ORDER MSB_LAST BIT_MASK 0x400 /end MEASUREMENT
/begin MEASUREMENT fmy_stat_cyl_bal_3.err_info_stat.lv_lock_diag "lock flag (CPU load optimisation) of the diagnosis instance CYL_BAL_3" UWORD _CNV_S_2_RANGE______380_CM 1 0. 0. 1. DISPLAY_IDENTIFIER LV_LOCK_DIAG_CYL_BAL_3 ECU_ADDRESS 0x7f99ee BYTE_ORDER MSB_LAST BIT_MASK 0x200 /end MEASUREMENT
/begin MEASUREMENT fmy_stat_cyl_bal_3.err_info_stat.lv_err_mem "storage in dynamic failure memory of the diagnosis instance CYL_BAL_3" UWORD _CNV_S_2_RANGE______380_CM 1 0. 0. 1. DISPLAY_IDENTIFIER LV_ERR_MEM_CYL_BAL_3 ECU_ADDRESS 0x7f99ee BYTE_ORDER MSB_LAST BIT_MASK 0x80 /end MEASUREMENT
/begin MEASUREMENT fmy_stat_cyl_bal_3.err_info_stat.lv_ready "readiness status of the diagnosis instance CYL_BAL_3" UWORD _CNV_S_2_RANGE______380_CM 1 0. 0. 1. DISPLAY_IDENTIFIER LV_READY_CYL_BAL_3 ECU_ADDRESS 0x7f99ee BYTE_ORDER MSB_LAST BIT_MASK 0x40 /end MEASUREMENT
/begin MEASUREMENT fmy_stat_cyl_bal_3.err_info_stat.lv_end_diag "end of diagnosis of the diagnosis instance CYL_BAL_3" UWORD _CNV_S_2_RANGE______380_CM 1 0. 0. 1. DISPLAY_IDENTIFIER LV_END_DIAG_CYL_BAL_3 ECU_ADDRESS 0x7f99ee BYTE_ORDER MSB_LAST BIT_MASK 0x20 /end MEASUREMENT
/begin MEASUREMENT fmy_stat_cyl_bal_3.err_info_stat.lv_cdn_diag "diagnosis condition of the diagnosis instance CYL_BAL_3" UWORD _CNV_S_2_RANGE______380_CM 1 0. 0. 1. DISPLAY_IDENTIFIER LV_CDN_DIAG_CYL_BAL_3 ECU_ADDRESS 0x7f99ee BYTE_ORDER MSB_LAST BIT_MASK 0x10 /end MEASUREMENT
/begin MEASUREMENT fmy_stat_cyl_bal_3.err_info_stat.err_sym "symptoms of the diagnosis instance CYL_BAL_3" UWORD _CNV_S_6_CONV_ERRM__27_CM 1 0. 0. 15. DISPLAY_IDENTIFIER ERR_SYM_CYL_BAL_3 ECU_ADDRESS 0x7f99ee BYTE_ORDER MSB_LAST BIT_MASK 0xF /end MEASUREMENT
/begin MEASUREMENT lv_err_egrv_0_ctl "Error flag of diagnosis instance EGRV_0_CTL" UBYTE _CNV_S_2_RANGE______28_CM 1 0. 0. 1. DISPLAY_IDENTIFIER LV_ERR_EGRV_0_CTL ECU_ADDRESS 0x7fb501 /end MEASUREMENT
/begin MEASUREMENT fmy_stat_egrv_0_ctl.ctr_abc "anti bounce counter for diagnosis instance EGRV_0_CTL" UBYTE _CNV_A_R_LINEAR_____1_CM 1 0. 0. 255. DISPLAY_IDENTIFIER CTR_ABC_EGRV_0_CTL ECU_ADDRESS 0x7f99f5 FORMAT "%3.0" /end MEASUREMENT
/begin MEASUREMENT fmy_stat_egrv_0_ctl.ctr_end_diag "counter for end of diagnosis for diagnosis instance EGRV_0_CTL" UBYTE _CNV_A_R_LINEAR_____1_CM 1 0. 0. 255. DISPLAY_IDENTIFIER CTR_ABC_END_DIAG_EGRV_0_CTL ECU_ADDRESS 0x7f99f4 FORMAT "%3.0" /end MEASUREMENT
/begin MEASUREMENT fmy_stat_egrv_0_ctl.err_info_stat.reserved "" UWORD _CNV_A_R_LINEAR_____0_CM 1 0. 0. 65535. DISPLAY_IDENTIFIER FMY_STAT_EGRV_0_CTL_ERR_INFO_STA ECU_ADDRESS 0x7f99f2 BYTE_ORDER MSB_LAST BIT_MASK 0xF800 /end MEASUREMENT
/begin MEASUREMENT fmy_stat_egrv_0_ctl.err_info_stat.lv_cdn_diag_stc "Statistical flag for condition of diagnosis of the diagnosis instance EGRV_0_CTL" UWORD _CNV_S_2_RANGE______380_CM 1 0. 0. 1. DISPLAY_IDENTIFIER LV_CDN_DIAG_STC_EGRV_0_CTL ECU_ADDRESS 0x7f99f2 BYTE_ORDER MSB_LAST BIT_MASK 0x400 /end MEASUREMENT
/begin MEASUREMENT fmy_stat_egrv_0_ctl.err_info_stat.lv_lock_diag "lock flag (CPU load optimisation) of the diagnosis instance EGRV_0_CTL" UWORD _CNV_S_2_RANGE______380_CM 1 0. 0. 1. DISPLAY_IDENTIFIER LV_LOCK_DIAG_EGRV_0_CTL ECU_ADDRESS 0x7f99f2 BYTE_ORDER MSB_LAST BIT_MASK 0x200 /end MEASUREMENT
/begin MEASUREMENT fmy_stat_egrv_0_ctl.err_info_stat.lv_err_mem "storage in dynamic failure memory of the diagnosis instance EGRV_0_CTL" UWORD _CNV_S_2_RANGE______380_CM 1 0. 0. 1. DISPLAY_IDENTIFIER LV_ERR_MEM_EGRV_0_CTL ECU_ADDRESS 0x7f99f2 BYTE_ORDER MSB_LAST BIT_MASK 0x80 /end MEASUREMENT
/begin MEASUREMENT fmy_stat_egrv_0_ctl.err_info_stat.lv_ready "readiness status of the diagnosis instance EGRV_0_CTL" UWORD _CNV_S_2_RANGE______380_CM 1 0. 0. 1. DISPLAY_IDENTIFIER LV_READY_EGRV_0_CTL ECU_ADDRESS 0x7f99f2 BYTE_ORDER MSB_LAST BIT_MASK 0x40 /end MEASUREMENT
/begin MEASUREMENT fmy_stat_egrv_0_ctl.err_info_stat.lv_end_diag "end of diagnosis of the diagnosis instance EGRV_0_CTL" UWORD _CNV_S_2_RANGE______380_CM 1 0. 0. 1. DISPLAY_IDENTIFIER LV_END_DIAG_EGRV_0_CTL ECU_ADDRESS 0x7f99f2 BYTE_ORDER MSB_LAST BIT_MASK 0x20 /end MEASUREMENT
/begin MEASUREMENT fmy_stat_egrv_0_ctl.err_info_stat.lv_cdn_diag "diagnosis condition of the diagnosis instance EGRV_0_CTL" UWORD _CNV_S_2_RANGE______380_CM 1 0. 0. 1. DISPLAY_IDENTIFIER LV_CDN_DIAG_EGRV_0_CTL ECU_ADDRESS 0x7f99f2 BYTE_ORDER MSB_LAST BIT_MASK 0x10 /end MEASUREMENT
/begin MEASUREMENT fmy_stat_egrv_0_ctl.err_info_stat.err_sym "symptoms of the diagnosis instance EGRV_0_CTL" UWORD _CNV_S_6_CONV_ERRM__27_CM 1 0. 0. 15. DISPLAY_IDENTIFIER ERR_SYM_EGRV_0_CTL ECU_ADDRESS 0x7f99f2 BYTE_ORDER MSB_LAST BIT_MASK 0xF /end MEASUREMENT
/begin MEASUREMENT lv_err_v_egrv_0_bol_ad "Error flag of diagnosis instance V_EGRV_0_BOL_AD" UBYTE _CNV_S_2_RANGE______28_CM 1 0. 0. 1. DISPLAY_IDENTIFIER LV_ERR_V_EGRV_0_BOL_AD ECU_ADDRESS 0x7fb502 /end MEASUREMENT
/begin MEASUREMENT fmy_stat_v_egrv_0_bol_ad.ctr_abc "anti bounce counter for diagnosis instance V_EGRV_0_BOL_AD" UBYTE _CNV_A_R_LINEAR_____1_CM 1 0. 0. 255. DISPLAY_IDENTIFIER CTR_ABC_V_EGRV_0_BOL_AD ECU_ADDRESS 0x7f99f9 FORMAT "%3.0" /end MEASUREMENT
/begin MEASUREMENT fmy_stat_v_egrv_0_bol_ad.ctr_end_diag "counter for end of diagnosis for diagnosis instance V_EGRV_0_BOL_AD" UBYTE _CNV_A_R_LINEAR_____1_CM 1 0. 0. 255. DISPLAY_IDENTIFIER CTR_ABC_END_DIAG_V_EGRV_0_BOL_AD ECU_ADDRESS 0x7f99f8 FORMAT "%3.0" /end MEASUREMENT
/begin MEASUREMENT fmy_stat_v_egrv_0_bol_ad.err_info_stat.reserved "" UWORD _CNV_A_R_LINEAR_____0_CM 1 0. 0. 65535. DISPLAY_IDENTIFIER FMY_STAT_V_EGRV_0_BOL_AD_ERR_INF ECU_ADDRESS 0x7f99f6 BYTE_ORDER MSB_LAST BIT_MASK 0xF800 /end MEASUREMENT
/begin MEASUREMENT fmy_stat_v_egrv_0_bol_ad.err_info_stat.lv_cdn_diag_stc "Statistical flag for condition of diagnosis of the diagnosis instance V_EGRV_0_BOL_AD" UWORD _CNV_S_2_RANGE______380_CM 1 0. 0. 1. DISPLAY_IDENTIFIER LV_CDN_DIAG_STC_V_EGRV_0_BOL_AD ECU_ADDRESS 0x7f99f6 BYTE_ORDER MSB_LAST BIT_MASK 0x400 /end MEASUREMENT
/begin MEASUREMENT fmy_stat_v_egrv_0_bol_ad.err_info_stat.lv_lock_diag "lock flag (CPU load optimisation) of the diagnosis instance V_EGRV_0_BOL_AD" UWORD _CNV_S_2_RANGE______380_CM 1 0. 0. 1. DISPLAY_IDENTIFIER LV_LOCK_DIAG_V_EGRV_0_BOL_AD ECU_ADDRESS 0x7f99f6 BYTE_ORDER MSB_LAST BIT_MASK 0x200 /end MEASUREMENT
/begin MEASUREMENT fmy_stat_v_egrv_0_bol_ad.err_info_stat.lv_err_mem "storage in dynamic failure memory of the diagnosis instance V_EGRV_0_BOL_AD" UWORD _CNV_S_2_RANGE______380_CM 1 0. 0. 1. DISPLAY_IDENTIFIER LV_ERR_MEM_V_EGRV_0_BOL_AD ECU_ADDRESS 0x7f99f6 BYTE_ORDER MSB_LAST BIT_MASK 0x80 /end MEASUREMENT
/begin MEASUREMENT fmy_stat_v_egrv_0_bol_ad.err_info_stat.lv_ready "readiness status of the diagnosis instance V_EGRV_0_BOL_AD" UWORD _CNV_S_2_RANGE______380_CM 1 0. 0. 1. DISPLAY_IDENTIFIER LV_READY_V_EGRV_0_BOL_AD ECU_ADDRESS 0x7f99f6 BYTE_ORDER MSB_LAST BIT_MASK 0x40 /end MEASUREMENT
/begin MEASUREMENT fmy_stat_v_egrv_0_bol_ad.err_info_stat.lv_end_diag "end of diagnosis of the diagnosis instance V_EGRV_0_BOL_AD" UWORD _CNV_S_2_RANGE______380_CM 1 0. 0. 1. DISPLAY_IDENTIFIER LV_END_DIAG_V_EGRV_0_BOL_AD ECU_ADDRESS 0x7f99f6 BYTE_ORDER MSB_LAST BIT_MASK 0x20 /end MEASUREMENT
/begin MEASUREMENT fmy_stat_v_egrv_0_bol_ad.err_info_stat.lv_cdn_diag "diagnosis condition of the diagnosis instance V_EGRV_0_BOL_AD" UWORD _CNV_S_2_RANGE______380_CM 1 0. 0. 1. DISPLAY_IDENTIFIER LV_CDN_DIAG_V_EGRV_0_BOL_AD ECU_ADDRESS 0x7f99f6 BYTE_ORDER MSB_LAST BIT_MASK 0x10 /end MEASUREMENT
/begin MEASUREMENT fmy_stat_v_egrv_0_bol_ad.err_info_stat.err_sym "symptoms of the diagnosis instance V_EGRV_0_BOL_AD" UWORD _CNV_S_6_CONV_ERRM__27_CM 1 0. 0. 15. DISPLAY_IDENTIFIER ERR_SYM_V_EGRV_0_BOL_AD ECU_ADDRESS 0x7f99f6 BYTE_ORDER MSB_LAST BIT_MASK 0xF /end MEASUREMENT
/begin MEASUREMENT lv_err_thr_0_ctl "Error flag of diagnosis instance THR_0_CTL" UBYTE _CNV_S_2_RANGE______28_CM 1 0. 0. 1. DISPLAY_IDENTIFIER LV_ERR_THR_0_CTL ECU_ADDRESS 0x7fb503 /end MEASUREMENT
/begin MEASUREMENT fmy_stat_thr_0_ctl.ctr_abc "anti bounce counter for diagnosis instance THR_0_CTL" UBYTE _CNV_A_R_LINEAR_____1_CM 1 0. 0. 255. DISPLAY_IDENTIFIER CTR_ABC_THR_0_CTL ECU_ADDRESS 0x7f99fd FORMAT "%3.0" /end MEASUREMENT
/begin MEASUREMENT fmy_stat_thr_0_ctl.ctr_end_diag "counter for end of diagnosis for diagnosis instance THR_0_CTL" UBYTE _CNV_A_R_LINEAR_____1_CM 1 0. 0. 255. DISPLAY_IDENTIFIER CTR_ABC_END_DIAG_THR_0_CTL ECU_ADDRESS 0x7f99fc FORMAT "%3.0" /end MEASUREMENT
/begin MEASUREMENT fmy_stat_thr_0_ctl.err_info_stat.reserved "" UWORD _CNV_A_R_LINEAR_____0_CM 1 0. 0. 65535. DISPLAY_IDENTIFIER FMY_STAT_THR_0_CTL_ERR_INFO_STAT ECU_ADDRESS 0x7f99fa BYTE_ORDER MSB_LAST BIT_MASK 0xF800 /end MEASUREMENT
/begin MEASUREMENT fmy_stat_thr_0_ctl.err_info_stat.lv_cdn_diag_stc "Statistical flag for condition of diagnosis of the diagnosis instance THR_0_CTL" UWORD _CNV_S_2_RANGE______380_CM 1 0. 0. 1. DISPLAY_IDENTIFIER LV_CDN_DIAG_STC_THR_0_CTL ECU_ADDRESS 0x7f99fa BYTE_ORDER MSB_LAST BIT_MASK 0x400 /end MEASUREMENT
/begin MEASUREMENT fmy_stat_thr_0_ctl.err_info_stat.lv_lock_diag "lock flag (CPU load optimisation) of the diagnosis instance THR_0_CTL" UWORD _CNV_S_2_RANGE______380_CM 1 0. 0. 1. DISPLAY_IDENTIFIER LV_LOCK_DIAG_THR_0_CTL ECU_ADDRESS 0x7f99fa BYTE_ORDER MSB_LAST BIT_MASK 0x200 /end MEASUREMENT
/begin MEASUREMENT fmy_stat_thr_0_ctl.err_info_stat.lv_err_mem "storage in dynamic failure memory of the diagnosis instance THR_0_CTL" UWORD _CNV_S_2_RANGE______380_CM 1 0. 0. 1. DISPLAY_IDENTIFIER LV_ERR_MEM_THR_0_CTL ECU_ADDRESS 0x7f99fa BYTE_ORDER MSB_LAST BIT_MASK 0x80 /end MEASUREMENT
/begin MEASUREMENT fmy_stat_thr_0_ctl.err_info_stat.lv_ready "readiness status of the diagnosis instance THR_0_CTL" UWORD _CNV_S_2_RANGE______380_CM 1 0. 0. 1. DISPLAY_IDENTIFIER LV_READY_THR_0_CTL ECU_ADDRESS 0x7f99fa BYTE_ORDER MSB_LAST BIT_MASK 0x40 /end MEASUREMENT
/begin MEASUREMENT fmy_stat_thr_0_ctl.err_info_stat.lv_end_diag "end of diagnosis of the diagnosis instance THR_0_CTL" UWORD _CNV_S_2_RANGE______380_CM 1 0. 0. 1. DISPLAY_IDENTIFIER LV_END_DIAG_THR_0_CTL ECU_ADDRESS 0x7f99fa BYTE_ORDER MSB_LAST BIT_MASK 0x20 /end MEASUREMENT
/begin MEASUREMENT fmy_stat_thr_0_ctl.err_info_stat.lv_cdn_diag "diagnosis condition of the diagnosis instance THR_0_CTL" UWORD _CNV_S_2_RANGE______380_CM 1 0. 0. 1. DISPLAY_IDENTIFIER LV_CDN_DIAG_THR_0_CTL ECU_ADDRESS 0x7f99fa BYTE_ORDER MSB_LAST BIT_MASK 0x10 /end MEASUREMENT
/begin MEASUREMENT fmy_stat_thr_0_ctl.err_info_stat.err_sym "symptoms of the diagnosis instance THR_0_CTL" UWORD _CNV_S_6_CONV_ERRM__27_CM 1 0. 0. 15. DISPLAY_IDENTIFIER ERR_SYM_THR_0_CTL ECU_ADDRESS 0x7f99fa BYTE_ORDER MSB_LAST BIT_MASK 0xF /end MEASUREMENT
/begin MEASUREMENT lv_err_v_thr_0_bol_ad "Error flag of diagnosis instance V_THR_0_BOL_AD" UBYTE _CNV_S_2_RANGE______28_CM 1 0. 0. 1. DISPLAY_IDENTIFIER LV_ERR_V_THR_0_BOL_AD ECU_ADDRESS 0x7fb504 /end MEASUREMENT
/begin MEASUREMENT fmy_stat_v_thr_0_bol_ad.ctr_abc "anti bounce counter for diagnosis instance V_THR_0_BOL_AD" UBYTE _CNV_A_R_LINEAR_____1_CM 1 0. 0. 255. DISPLAY_IDENTIFIER CTR_ABC_V_THR_0_BOL_AD ECU_ADDRESS 0x7f9a01 FORMAT "%3.0" /end MEASUREMENT
/begin MEASUREMENT fmy_stat_v_thr_0_bol_ad.ctr_end_diag "counter for end of diagnosis for diagnosis instance V_THR_0_BOL_AD" UBYTE _CNV_A_R_LINEAR_____1_CM 1 0. 0. 255. DISPLAY_IDENTIFIER CTR_ABC_END_DIAG_V_THR_0_BOL_AD ECU_ADDRESS 0x7f9a00 FORMAT "%3.0" /end MEASUREMENT
/begin MEASUREMENT fmy_stat_v_thr_0_bol_ad.err_info_stat.reserved "" UWORD _CNV_A_R_LINEAR_____0_CM 1 0. 0. 65535. DISPLAY_IDENTIFIER FMY_STAT_V_THR_0_BOL_AD_ERR_INFO ECU_ADDRESS 0x7f99fe BYTE_ORDER MSB_LAST BIT_MASK 0xF800 /end MEASUREMENT
/begin MEASUREMENT fmy_stat_v_thr_0_bol_ad.err_info_stat.lv_cdn_diag_stc "Statistical flag for condition of diagnosis of the diagnosis instance V_THR_0_BOL_AD" UWORD _CNV_S_2_RANGE______380_CM 1 0. 0. 1. DISPLAY_IDENTIFIER LV_CDN_DIAG_STC_V_THR_0_BOL_AD ECU_ADDRESS 0x7f99fe BYTE_ORDER MSB_LAST BIT_MASK 0x400 /end MEASUREMENT
/begin MEASUREMENT fmy_stat_v_thr_0_bol_ad.err_info_stat.lv_lock_diag "lock flag (CPU load optimisation) of the diagnosis instance V_THR_0_BOL_AD" UWORD _CNV_S_2_RANGE______380_CM 1 0. 0. 1. DISPLAY_IDENTIFIER LV_LOCK_DIAG_V_THR_0_BOL_AD ECU_ADDRESS 0x7f99fe BYTE_ORDER MSB_LAST BIT_MASK 0x200 /end MEASUREMENT
/begin MEASUREMENT fmy_stat_v_thr_0_bol_ad.err_info_stat.lv_err_mem "storage in dynamic failure memory of the diagnosis instance V_THR_0_BOL_AD" UWORD _CNV_S_2_RANGE______380_CM 1 0. 0. 1. DISPLAY_IDENTIFIER LV_ERR_MEM_V_THR_0_BOL_AD ECU_ADDRESS 0x7f99fe BYTE_ORDER MSB_LAST BIT_MASK 0x80 /end MEASUREMENT
/begin MEASUREMENT fmy_stat_v_thr_0_bol_ad.err_info_stat.lv_ready "readiness status of the diagnosis instance V_THR_0_BOL_AD" UWORD _CNV_S_2_RANGE______380_CM 1 0. 0. 1. DISPLAY_IDENTIFIER LV_READY_V_THR_0_BOL_AD ECU_ADDRESS 0x7f99fe BYTE_ORDER MSB_LAST BIT_MASK 0x40 /end MEASUREMENT
/begin MEASUREMENT fmy_stat_v_thr_0_bol_ad.err_info_stat.lv_end_diag "end of diagnosis of the diagnosis instance V_THR_0_BOL_AD" UWORD _CNV_S_2_RANGE______380_CM 1 0. 0. 1. DISPLAY_IDENTIFIER LV_END_DIAG_V_THR_0_BOL_AD ECU_ADDRESS 0x7f99fe BYTE_ORDER MSB_LAST BIT_MASK 0x20 /end MEASUREMENT
/begin MEASUREMENT fmy_stat_v_thr_0_bol_ad.err_info_stat.lv_cdn_diag "diagnosis condition of the diagnosis instance V_THR_0_BOL_AD" UWORD _CNV_S_2_RANGE______380_CM 1 0. 0. 1. DISPLAY_IDENTIFIER LV_CDN_DIAG_V_THR_0_BOL_AD ECU_ADDRESS 0x7f99fe BYTE_ORDER MSB_LAST BIT_MASK 0x10 /end MEASUREMENT
/begin MEASUREMENT fmy_stat_v_thr_0_bol_ad.err_info_stat.err_sym "symptoms of the diagnosis instance V_THR_0_BOL_AD" UWORD _CNV_S_6_CONV_ERRM__27_CM 1 0. 0. 15. DISPLAY_IDENTIFIER ERR_SYM_V_THR_0_BOL_AD ECU_ADDRESS 0x7f99fe BYTE_ORDER MSB_LAST BIT_MASK 0xF /end MEASUREMENT
/begin MEASUREMENT lv_err_bpa_0_ctl "Error flag of diagnosis instance BPA_0_CTL" UBYTE _CNV_S_2_RANGE______28_CM 1 0. 0. 1. DISPLAY_IDENTIFIER LV_ERR_BPA_0_CTL ECU_ADDRESS 0x7fb505 /end MEASUREMENT
/begin MEASUREMENT fmy_stat_bpa_0_ctl.ctr_abc "anti bounce counter for diagnosis instance BPA_0_CTL" UBYTE _CNV_A_R_LINEAR_____1_CM 1 0. 0. 255. DISPLAY_IDENTIFIER CTR_ABC_BPA_0_CTL ECU_ADDRESS 0x7f9a05 FORMAT "%3.0" /end MEASUREMENT
/begin MEASUREMENT fmy_stat_bpa_0_ctl.ctr_end_diag "counter for end of diagnosis for diagnosis instance BPA_0_CTL" UBYTE _CNV_A_R_LINEAR_____1_CM 1 0. 0. 255. DISPLAY_IDENTIFIER CTR_ABC_END_DIAG_BPA_0_CTL ECU_ADDRESS 0x7f9a04 FORMAT "%3.0" /end MEASUREMENT
/begin MEASUREMENT fmy_stat_bpa_0_ctl.err_info_stat.reserved "" UWORD _CNV_A_R_LINEAR_____0_CM 1 0. 0. 65535. DISPLAY_IDENTIFIER FMY_STAT_BPA_0_CTL_ERR_INFO_STAT ECU_ADDRESS 0x7f9a02 BYTE_ORDER MSB_LAST BIT_MASK 0xF800 /end MEASUREMENT
/begin MEASUREMENT fmy_stat_bpa_0_ctl.err_info_stat.lv_cdn_diag_stc "Statistical flag for condition of diagnosis of the diagnosis instance BPA_0_CTL" UWORD _CNV_S_2_RANGE______380_CM 1 0. 0. 1. DISPLAY_IDENTIFIER LV_CDN_DIAG_STC_BPA_0_CTL ECU_ADDRESS 0x7f9a02 BYTE_ORDER MSB_LAST BIT_MASK 0x400 /end MEASUREMENT
/begin MEASUREMENT fmy_stat_bpa_0_ctl.err_info_stat.lv_lock_diag "lock flag (CPU load optimisation) of the diagnosis instance BPA_0_CTL" UWORD _CNV_S_2_RANGE______380_CM 1 0. 0. 1. DISPLAY_IDENTIFIER LV_LOCK_DIAG_BPA_0_CTL ECU_ADDRESS 0x7f9a02 BYTE_ORDER MSB_LAST BIT_MASK 0x200 /end MEASUREMENT
/begin MEASUREMENT fmy_stat_bpa_0_ctl.err_info_stat.lv_err_mem "storage in dynamic failure memory of the diagnosis instance BPA_0_CTL" UWORD _CNV_S_2_RANGE______380_CM 1 0. 0. 1. DISPLAY_IDENTIFIER LV_ERR_MEM_BPA_0_CTL ECU_ADDRESS 0x7f9a02 BYTE_ORDER MSB_LAST BIT_MASK 0x80 /end MEASUREMENT
/begin MEASUREMENT fmy_stat_bpa_0_ctl.err_info_stat.lv_ready "readiness status of the diagnosis instance BPA_0_CTL" UWORD _CNV_S_2_RANGE______380_CM 1 0. 0. 1. DISPLAY_IDENTIFIER LV_READY_BPA_0_CTL ECU_ADDRESS 0x7f9a02 BYTE_ORDER MSB_LAST BIT_MASK 0x40 /end MEASUREMENT
/begin MEASUREMENT fmy_stat_bpa_0_ctl.err_info_stat.lv_end_diag "end of diagnosis of the diagnosis instance BPA_0_CTL" UWORD _CNV_S_2_RANGE______380_CM 1 0. 0. 1. DISPLAY_IDENTIFIER LV_END_DIAG_BPA_0_CTL ECU_ADDRESS 0x7f9a02 BYTE_ORDER MSB_LAST BIT_MASK 0x20 /end MEASUREMENT
/begin MEASUREMENT fmy_stat_bpa_0_ctl.err_info_stat.lv_cdn_diag "diagnosis condition of the diagnosis instance BPA_0_CTL" UWORD _CNV_S_2_RANGE______380_CM 1 0. 0. 1. DISPLAY_IDENTIFIER LV_CDN_DIAG_BPA_0_CTL ECU_ADDRESS 0x7f9a02 BYTE_ORDER MSB_LAST BIT_MASK 0x10 /end MEASUREMENT
/begin MEASUREMENT fmy_stat_bpa_0_ctl.err_info_stat.err_sym "symptoms of the diagnosis instance BPA_0_CTL" UWORD _CNV_S_6_CONV_ERRM__27_CM 1 0. 0. 15. DISPLAY_IDENTIFIER ERR_SYM_BPA_0_CTL ECU_ADDRESS 0x7f9a02 BYTE_ORDER MSB_LAST BIT_MASK 0xF /end MEASUREMENT
/begin MEASUREMENT lv_err_v_bpa_0_bol_ad "Error flag of diagnosis instance V_BPA_0_BOL_AD" UBYTE _CNV_S_2_RANGE______28_CM 1 0. 0. 1. DISPLAY_IDENTIFIER LV_ERR_V_BPA_0_BOL_AD ECU_ADDRESS 0x7fb506 /end MEASUREMENT
/begin MEASUREMENT fmy_stat_v_bpa_0_bol_ad.ctr_abc "anti bounce counter for diagnosis instance V_BPA_0_BOL_AD" UBYTE _CNV_A_R_LINEAR_____1_CM 1 0. 0. 255. DISPLAY_IDENTIFIER CTR_ABC_V_BPA_0_BOL_AD ECU_ADDRESS 0x7f9a09 FORMAT "%3.0" /end MEASUREMENT
/begin MEASUREMENT fmy_stat_v_bpa_0_bol_ad.ctr_end_diag "counter for end of diagnosis for diagnosis instance V_BPA_0_BOL_AD" UBYTE _CNV_A_R_LINEAR_____1_CM 1 0. 0. 255. DISPLAY_IDENTIFIER CTR_ABC_END_DIAG_V_BPA_0_BOL_AD ECU_ADDRESS 0x7f9a08 FORMAT "%3.0" /end MEASUREMENT
/begin MEASUREMENT fmy_stat_v_bpa_0_bol_ad.err_info_stat.reserved "" UWORD _CNV_A_R_LINEAR_____0_CM 1 0. 0. 65535. DISPLAY_IDENTIFIER FMY_STAT_V_BPA_0_BOL_AD_ERR_INFO ECU_ADDRESS 0x7f9a06 BYTE_ORDER MSB_LAST BIT_MASK 0xF800 /end MEASUREMENT
/begin MEASUREMENT fmy_stat_v_bpa_0_bol_ad.err_info_stat.lv_cdn_diag_stc "Statistical flag for condition of diagnosis of the diagnosis instance V_BPA_0_BOL_AD" UWORD _CNV_S_2_RANGE______380_CM 1 0. 0. 1. DISPLAY_IDENTIFIER LV_CDN_DIAG_STC_V_BPA_0_BOL_AD ECU_ADDRESS 0x7f9a06 BYTE_ORDER MSB_LAST BIT_MASK 0x400 /end MEASUREMENT
/begin MEASUREMENT fmy_stat_v_bpa_0_bol_ad.err_info_stat.lv_lock_diag "lock flag (CPU load optimisation) of the diagnosis instance V_BPA_0_BOL_AD" UWORD _CNV_S_2_RANGE______380_CM 1 0. 0. 1. DISPLAY_IDENTIFIER LV_LOCK_DIAG_V_BPA_0_BOL_AD ECU_ADDRESS 0x7f9a06 BYTE_ORDER MSB_LAST BIT_MASK 0x200 /end MEASUREMENT
/begin MEASUREMENT fmy_stat_v_bpa_0_bol_ad.err_info_stat.lv_err_mem "storage in dynamic failure memory of the diagnosis instance V_BPA_0_BOL_AD" UWORD _CNV_S_2_RANGE______380_CM 1 0. 0. 1. DISPLAY_IDENTIFIER LV_ERR_MEM_V_BPA_0_BOL_AD ECU_ADDRESS 0x7f9a06 BYTE_ORDER MSB_LAST BIT_MASK 0x80 /end MEASUREMENT
/begin MEASUREMENT fmy_stat_v_bpa_0_bol_ad.err_info_stat.lv_ready "readiness status of the diagnosis instance V_BPA_0_BOL_AD" UWORD _CNV_S_2_RANGE______380_CM 1 0. 0. 1. DISPLAY_IDENTIFIER LV_READY_V_BPA_0_BOL_AD ECU_ADDRESS 0x7f9a06 BYTE_ORDER MSB_LAST BIT_MASK 0x40 /end MEASUREMENT
/begin MEASUREMENT fmy_stat_v_bpa_0_bol_ad.err_info_stat.lv_end_diag "end of diagnosis of the diagnosis instance V_BPA_0_BOL_AD" UWORD _CNV_S_2_RANGE______380_CM 1 0. 0. 1. DISPLAY_IDENTIFIER LV_END_DIAG_V_BPA_0_BOL_AD ECU_ADDRESS 0x7f9a06 BYTE_ORDER MSB_LAST BIT_MASK 0x20 /end MEASUREMENT
/begin MEASUREMENT fmy_stat_v_bpa_0_bol_ad.err_info_stat.lv_cdn_diag "diagnosis condition of the diagnosis instance V_BPA_0_BOL_AD" UWORD _CNV_S_2_RANGE______380_CM 1 0. 0. 1. DISPLAY_IDENTIFIER LV_CDN_DIAG_V_BPA_0_BOL_AD ECU_ADDRESS 0x7f9a06 BYTE_ORDER MSB_LAST BIT_MASK 0x10 /end MEASUREMENT
/begin MEASUREMENT fmy_stat_v_bpa_0_bol_ad.err_info_stat.err_sym "symptoms of the diagnosis instance V_BPA_0_BOL_AD" UWORD _CNV_S_6_CONV_ERRM__27_CM 1 0. 0. 15. DISPLAY_IDENTIFIER ERR_SYM_V_BPA_0_BOL_AD ECU_ADDRESS 0x7f9a06 BYTE_ORDER MSB_LAST BIT_MASK 0xF /end MEASUREMENT
/begin MEASUREMENT lv_err_byp_0_ctl "Error flag of diagnosis instance BYP_0_CTL" UBYTE _CNV_S_2_RANGE______28_CM 1 0. 0. 1. DISPLAY_IDENTIFIER LV_ERR_BYP_0_CTL ECU_ADDRESS 0x7fb507 /end MEASUREMENT
/begin MEASUREMENT fmy_stat_byp_0_ctl.ctr_abc "anti bounce counter for diagnosis instance BYP_0_CTL" UBYTE _CNV_A_R_LINEAR_____1_CM 1 0. 0. 255. DISPLAY_IDENTIFIER CTR_ABC_BYP_0_CTL ECU_ADDRESS 0x7f9a0d FORMAT "%3.0" /end MEASUREMENT
/begin MEASUREMENT fmy_stat_byp_0_ctl.ctr_end_diag "counter for end of diagnosis for diagnosis instance BYP_0_CTL" UBYTE _CNV_A_R_LINEAR_____1_CM 1 0. 0. 255. DISPLAY_IDENTIFIER CTR_ABC_END_DIAG_BYP_0_CTL ECU_ADDRESS 0x7f9a0c FORMAT "%3.0" /end MEASUREMENT
/begin MEASUREMENT fmy_stat_byp_0_ctl.err_info_stat.reserved "" UWORD _CNV_A_R_LINEAR_____0_CM 1 0. 0. 65535. DISPLAY_IDENTIFIER FMY_STAT_BYP_0_CTL_ERR_INFO_STAT ECU_ADDRESS 0x7f9a0a BYTE_ORDER MSB_LAST BIT_MASK 0xF800 /end MEASUREMENT
/begin MEASUREMENT fmy_stat_byp_0_ctl.err_info_stat.lv_cdn_diag_stc "Statistical flag for condition of diagnosis of the diagnosis instance BYP_0_CTL" UWORD _CNV_S_2_RANGE______380_CM 1 0. 0. 1. DISPLAY_IDENTIFIER LV_CDN_DIAG_STC_BYP_0_CTL ECU_ADDRESS 0x7f9a0a BYTE_ORDER MSB_LAST BIT_MASK 0x400 /end MEASUREMENT
/begin MEASUREMENT fmy_stat_byp_0_ctl.err_info_stat.lv_lock_diag "lock flag (CPU load optimisation) of the diagnosis instance BYP_0_CTL" UWORD _CNV_S_2_RANGE______380_CM 1 0. 0. 1. DISPLAY_IDENTIFIER LV_LOCK_DIAG_BYP_0_CTL ECU_ADDRESS 0x7f9a0a BYTE_ORDER MSB_LAST BIT_MASK 0x200 /end MEASUREMENT
/begin MEASUREMENT fmy_stat_byp_0_ctl.err_info_stat.lv_err_mem "storage in dynamic failure memory of the diagnosis instance BYP_0_CTL" UWORD _CNV_S_2_RANGE______380_CM 1 0. 0. 1. DISPLAY_IDENTIFIER LV_ERR_MEM_BYP_0_CTL ECU_ADDRESS 0x7f9a0a BYTE_ORDER MSB_LAST BIT_MASK 0x80 /end MEASUREMENT
/begin MEASUREMENT fmy_stat_byp_0_ctl.err_info_stat.lv_ready "readiness status of the diagnosis instance BYP_0_CTL" UWORD _CNV_S_2_RANGE______380_CM 1 0. 0. 1. DISPLAY_IDENTIFIER LV_READY_BYP_0_CTL ECU_ADDRESS 0x7f9a0a BYTE_ORDER MSB_LAST BIT_MASK 0x40 /end MEASUREMENT
/begin MEASUREMENT fmy_stat_byp_0_ctl.err_info_stat.lv_end_diag "end of diagnosis of the diagnosis instance BYP_0_CTL" UWORD _CNV_S_2_RANGE______380_CM 1 0. 0. 1. DISPLAY_IDENTIFIER LV_END_DIAG_BYP_0_CTL ECU_ADDRESS 0x7f9a0a BYTE_ORDER MSB_LAST BIT_MASK 0x20 /end MEASUREMENT
/begin MEASUREMENT fmy_stat_byp_0_ctl.err_info_stat.lv_cdn_diag "diagnosis condition of the diagnosis instance BYP_0_CTL" UWORD _CNV_S_2_RANGE______380_CM 1 0. 0. 1. DISPLAY_IDENTIFIER LV_CDN_DIAG_BYP_0_CTL ECU_ADDRESS 0x7f9a0a BYTE_ORDER MSB_LAST BIT_MASK 0x10 /end MEASUREMENT
/begin MEASUREMENT fmy_stat_byp_0_ctl.err_info_stat.err_sym "symptoms of the diagnosis instance BYP_0_CTL" UWORD _CNV_S_6_CONV_ERRM__27_CM 1 0. 0. 15. DISPLAY_IDENTIFIER ERR_SYM_BYP_0_CTL ECU_ADDRESS 0x7f9a0a BYTE_ORDER MSB_LAST BIT_MASK 0xF /end MEASUREMENT
/begin MEASUREMENT lv_err_v_byp_0_bol_ad "Error flag of diagnosis instance V_BYP_0_BOL_AD" UBYTE _CNV_S_2_RANGE______28_CM 1 0. 0. 1. DISPLAY_IDENTIFIER LV_ERR_V_BYP_0_BOL_AD ECU_ADDRESS 0x7fb508 /end MEASUREMENT
/begin MEASUREMENT fmy_stat_v_byp_0_bol_ad.ctr_abc "anti bounce counter for diagnosis instance V_BYP_0_BOL_AD" UBYTE _CNV_A_R_LINEAR_____1_CM 1 0. 0. 255. DISPLAY_IDENTIFIER CTR_ABC_V_BYP_0_BOL_AD ECU_ADDRESS 0x7f9a11 FORMAT "%3.0" /end MEASUREMENT
/begin MEASUREMENT fmy_stat_v_byp_0_bol_ad.ctr_end_diag "counter for end of diagnosis for diagnosis instance V_BYP_0_BOL_AD" UBYTE _CNV_A_R_LINEAR_____1_CM 1 0. 0. 255. DISPLAY_IDENTIFIER CTR_ABC_END_DIAG_V_BYP_0_BOL_AD ECU_ADDRESS 0x7f9a10 FORMAT "%3.0" /end MEASUREMENT
/begin MEASUREMENT fmy_stat_v_byp_0_bol_ad.err_info_stat.reserved "" UWORD _CNV_A_R_LINEAR_____0_CM 1 0. 0. 65535. DISPLAY_IDENTIFIER FMY_STAT_V_BYP_0_BOL_AD_ERR_INFO ECU_ADDRESS 0x7f9a0e BYTE_ORDER MSB_LAST BIT_MASK 0xF800 /end MEASUREMENT
/begin MEASUREMENT fmy_stat_v_byp_0_bol_ad.err_info_stat.lv_cdn_diag_stc "Statistical flag for condition of diagnosis of the diagnosis instance V_BYP_0_BOL_AD" UWORD _CNV_S_2_RANGE______380_CM 1 0. 0. 1. DISPLAY_IDENTIFIER LV_CDN_DIAG_STC_V_BYP_0_BOL_AD ECU_ADDRESS 0x7f9a0e BYTE_ORDER MSB_LAST BIT_MASK 0x400 /end MEASUREMENT
/begin MEASUREMENT fmy_stat_v_byp_0_bol_ad.err_info_stat.lv_lock_diag "lock flag (CPU load optimisation) of the diagnosis instance V_BYP_0_BOL_AD" UWORD _CNV_S_2_RANGE______380_CM 1 0. 0. 1. DISPLAY_IDENTIFIER LV_LOCK_DIAG_V_BYP_0_BOL_AD ECU_ADDRESS 0x7f9a0e BYTE_ORDER MSB_LAST BIT_MASK 0x200 /end MEASUREMENT
/begin MEASUREMENT fmy_stat_v_byp_0_bol_ad.err_info_stat.lv_err_mem "storage in dynamic failure memory of the diagnosis instance V_BYP_0_BOL_AD" UWORD _CNV_S_2_RANGE______380_CM 1 0. 0. 1. DISPLAY_IDENTIFIER LV_ERR_MEM_V_BYP_0_BOL_AD ECU_ADDRESS 0x7f9a0e BYTE_ORDER MSB_LAST BIT_MASK 0x80 /end MEASUREMENT
/begin MEASUREMENT fmy_stat_v_byp_0_bol_ad.err_info_stat.lv_ready "readiness status of the diagnosis instance V_BYP_0_BOL_AD" UWORD _CNV_S_2_RANGE______380_CM 1 0. 0. 1. DISPLAY_IDENTIFIER LV_READY_V_BYP_0_BOL_AD ECU_ADDRESS 0x7f9a0e BYTE_ORDER MSB_LAST BIT_MASK 0x40 /end MEASUREMENT
/begin MEASUREMENT fmy_stat_v_byp_0_bol_ad.err_info_stat.lv_end_diag "end of diagnosis of the diagnosis instance V_BYP_0_BOL_AD" UWORD _CNV_S_2_RANGE______380_CM 1 0. 0. 1. DISPLAY_IDENTIFIER LV_END_DIAG_V_BYP_0_BOL_AD ECU_ADDRESS 0x7f9a0e BYTE_ORDER MSB_LAST BIT_MASK 0x20 /end MEASUREMENT
/begin MEASUREMENT fmy_stat_v_byp_0_bol_ad.err_info_stat.lv_cdn_diag "diagnosis condition of the diagnosis instance V_BYP_0_BOL_AD" UWORD _CNV_S_2_RANGE______380_CM 1 0. 0. 1. DISPLAY_IDENTIFIER LV_CDN_DIAG_V_BYP_0_BOL_AD ECU_ADDRESS 0x7f9a0e BYTE_ORDER MSB_LAST BIT_MASK 0x10 /end MEASUREMENT
/begin MEASUREMENT fmy_stat_v_byp_0_bol_ad.err_info_stat.err_sym "symptoms of the diagnosis instance V_BYP_0_BOL_AD" UWORD _CNV_S_6_CONV_ERRM__27_CM 1 0. 0. 15. DISPLAY_IDENTIFIER ERR_SYM_V_BYP_0_BOL_AD ECU_ADDRESS 0x7f9a0e BYTE_ORDER MSB_LAST BIT_MASK 0xF /end MEASUREMENT
/begin MEASUREMENT lv_err_map_ctl_min "Error flag of diagnosis instance MAP_CTL_MIN" UBYTE _CNV_S_2_RANGE______28_CM 1 0. 0. 1. DISPLAY_IDENTIFIER LV_ERR_MAP_CTL_MIN ECU_ADDRESS 0x7fb509 /end MEASUREMENT
/begin MEASUREMENT fmy_stat_map_ctl_min.ctr_abc "anti bounce counter for diagnosis instance MAP_CTL_MIN" UBYTE _CNV_A_R_LINEAR_____1_CM 1 0. 0. 255. DISPLAY_IDENTIFIER CTR_ABC_MAP_CTL_MIN ECU_ADDRESS 0x7f9a15 FORMAT "%3.0" /end MEASUREMENT
/begin MEASUREMENT fmy_stat_map_ctl_min.ctr_end_diag "counter for end of diagnosis for diagnosis instance MAP_CTL_MIN" UBYTE _CNV_A_R_LINEAR_____1_CM 1 0. 0. 255. DISPLAY_IDENTIFIER CTR_ABC_END_DIAG_MAP_CTL_MIN ECU_ADDRESS 0x7f9a14 FORMAT "%3.0" /end MEASUREMENT
/begin MEASUREMENT fmy_stat_map_ctl_min.err_info_stat.reserved "" UWORD _CNV_A_R_LINEAR_____0_CM 1 0. 0. 65535. DISPLAY_IDENTIFIER FMY_STAT_MAP_CTL_MIN_ERR_INFO_ST ECU_ADDRESS 0x7f9a12 BYTE_ORDER MSB_LAST BIT_MASK 0xF800 /end MEASUREMENT
/begin MEASUREMENT fmy_stat_map_ctl_min.err_info_stat.lv_cdn_diag_stc "Statistical flag for condition of diagnosis of the diagnosis instance MAP_CTL_MIN" UWORD _CNV_S_2_RANGE______380_CM 1 0. 0. 1. DISPLAY_IDENTIFIER LV_CDN_DIAG_STC_MAP_CTL_MIN ECU_ADDRESS 0x7f9a12 BYTE_ORDER MSB_LAST BIT_MASK 0x400 /end MEASUREMENT
/begin MEASUREMENT fmy_stat_map_ctl_min.err_info_stat.lv_lock_diag "lock flag (CPU load optimisation) of the diagnosis instance MAP_CTL_MIN" UWORD _CNV_S_2_RANGE______380_CM 1 0. 0. 1. DISPLAY_IDENTIFIER LV_LOCK_DIAG_MAP_CTL_MIN ECU_ADDRESS 0x7f9a12 BYTE_ORDER MSB_LAST BIT_MASK 0x200 /end MEASUREMENT
/begin MEASUREMENT fmy_stat_map_ctl_min.err_info_stat.lv_err_mem "storage in dynamic failure memory of the diagnosis instance MAP_CTL_MIN" UWORD _CNV_S_2_RANGE______380_CM 1 0. 0. 1. DISPLAY_IDENTIFIER LV_ERR_MEM_MAP_CTL_MIN ECU_ADDRESS 0x7f9a12 BYTE_ORDER MSB_LAST BIT_MASK 0x80 /end MEASUREMENT
/begin MEASUREMENT fmy_stat_map_ctl_min.err_info_stat.lv_ready "readiness status of the diagnosis instance MAP_CTL_MIN" UWORD _CNV_S_2_RANGE______380_CM 1 0. 0. 1. DISPLAY_IDENTIFIER LV_READY_MAP_CTL_MIN ECU_ADDRESS 0x7f9a12 BYTE_ORDER MSB_LAST BIT_MASK 0x40 /end MEASUREMENT
/begin MEASUREMENT fmy_stat_map_ctl_min.err_info_stat.lv_end_diag "end of diagnosis of the diagnosis instance MAP_CTL_MIN" UWORD _CNV_S_2_RANGE______380_CM 1 0. 0. 1. DISPLAY_IDENTIFIER LV_END_DIAG_MAP_CTL_MIN ECU_ADDRESS 0x7f9a12 BYTE_ORDER MSB_LAST BIT_MASK 0x20 /end MEASUREMENT
/begin MEASUREMENT fmy_stat_map_ctl_min.err_info_stat.lv_cdn_diag "diagnosis condition of the diagnosis instance MAP_CTL_MIN" UWORD _CNV_S_2_RANGE______380_CM 1 0. 0. 1. DISPLAY_IDENTIFIER LV_CDN_DIAG_MAP_CTL_MIN ECU_ADDRESS 0x7f9a12 BYTE_ORDER MSB_LAST BIT_MASK 0x10 /end MEASUREMENT
/begin MEASUREMENT fmy_stat_map_ctl_min.err_info_stat.err_sym "symptoms of the diagnosis instance MAP_CTL_MIN" UWORD _CNV_S_6_CONV_ERRM__27_CM 1 0. 0. 15. DISPLAY_IDENTIFIER ERR_SYM_MAP_CTL_MIN ECU_ADDRESS 0x7f9a12 BYTE_ORDER MSB_LAST BIT_MASK 0xF /end MEASUREMENT
/begin MEASUREMENT lv_err_map_ctl_max "Error flag of diagnosis instance MAP_CTL_MAX" UBYTE _CNV_S_2_RANGE______28_CM 1 0. 0. 1. DISPLAY_IDENTIFIER LV_ERR_MAP_CTL_MAX ECU_ADDRESS 0x7fb50a /end MEASUREMENT
/begin MEASUREMENT fmy_stat_map_ctl_max.ctr_abc "anti bounce counter for diagnosis instance MAP_CTL_MAX" UBYTE _CNV_A_R_LINEAR_____1_CM 1 0. 0. 255. DISPLAY_IDENTIFIER CTR_ABC_MAP_CTL_MAX ECU_ADDRESS 0x7f9a19 FORMAT "%3.0" /end MEASUREMENT
/begin MEASUREMENT fmy_stat_map_ctl_max.ctr_end_diag "counter for end of diagnosis for diagnosis instance MAP_CTL_MAX" UBYTE _CNV_A_R_LINEAR_____1_CM 1 0. 0. 255. DISPLAY_IDENTIFIER CTR_ABC_END_DIAG_MAP_CTL_MAX ECU_ADDRESS 0x7f9a18 FORMAT "%3.0" /end MEASUREMENT
/begin MEASUREMENT fmy_stat_map_ctl_max.err_info_stat.reserved "" UWORD _CNV_A_R_LINEAR_____0_CM 1 0. 0. 65535. DISPLAY_IDENTIFIER FMY_STAT_MAP_CTL_MAX_ERR_INFO_ST ECU_ADDRESS 0x7f9a16 BYTE_ORDER MSB_LAST BIT_MASK 0xF800 /end MEASUREMENT
/begin MEASUREMENT fmy_stat_map_ctl_max.err_info_stat.lv_cdn_diag_stc "Statistical flag for condition of diagnosis of the diagnosis instance MAP_CTL_MAX" UWORD _CNV_S_2_RANGE______380_CM 1 0. 0. 1. DISPLAY_IDENTIFIER LV_CDN_DIAG_STC_MAP_CTL_MAX ECU_ADDRESS 0x7f9a16 BYTE_ORDER MSB_LAST BIT_MASK 0x400 /end MEASUREMENT
/begin MEASUREMENT fmy_stat_map_ctl_max.err_info_stat.lv_lock_diag "lock flag (CPU load optimisation) of the diagnosis instance MAP_CTL_MAX" UWORD _CNV_S_2_RANGE______380_CM 1 0. 0. 1. DISPLAY_IDENTIFIER LV_LOCK_DIAG_MAP_CTL_MAX ECU_ADDRESS 0x7f9a16 BYTE_ORDER MSB_LAST BIT_MASK 0x200 /end MEASUREMENT
/begin MEASUREMENT fmy_stat_map_ctl_max.err_info_stat.lv_err_mem "storage in dynamic failure memory of the diagnosis instance MAP_CTL_MAX" UWORD _CNV_S_2_RANGE______380_CM 1 0. 0. 1. DISPLAY_IDENTIFIER LV_ERR_MEM_MAP_CTL_MAX ECU_ADDRESS 0x7f9a16 BYTE_ORDER MSB_LAST BIT_MASK 0x80 /end MEASUREMENT
/begin MEASUREMENT fmy_stat_map_ctl_max.err_info_stat.lv_ready "readiness status of the diagnosis instance MAP_CTL_MAX" UWORD _CNV_S_2_RANGE______380_CM 1 0. 0. 1. DISPLAY_IDENTIFIER LV_READY_MAP_CTL_MAX ECU_ADDRESS 0x7f9a16 BYTE_ORDER MSB_LAST BIT_MASK 0x40 /end MEASUREMENT
/begin MEASUREMENT fmy_stat_map_ctl_max.err_info_stat.lv_end_diag "end of diagnosis of the diagnosis instance MAP_CTL_MAX" UWORD _CNV_S_2_RANGE______380_CM 1 0. 0. 1. DISPLAY_IDENTIFIER LV_END_DIAG_MAP_CTL_MAX ECU_ADDRESS 0x7f9a16 BYTE_ORDER MSB_LAST BIT_MASK 0x20 /end MEASUREMENT
/begin MEASUREMENT fmy_stat_map_ctl_max.err_info_stat.lv_cdn_diag "diagnosis condition of the diagnosis instance MAP_CTL_MAX" UWORD _CNV_S_2_RANGE______380_CM 1 0. 0. 1. DISPLAY_IDENTIFIER LV_CDN_DIAG_MAP_CTL_MAX ECU_ADDRESS 0x7f9a16 BYTE_ORDER MSB_LAST BIT_MASK 0x10 /end MEASUREMENT
/begin MEASUREMENT fmy_stat_map_ctl_max.err_info_stat.err_sym "symptoms of the diagnosis instance MAP_CTL_MAX" UWORD _CNV_S_6_CONV_ERRM__27_CM 1 0. 0. 15. DISPLAY_IDENTIFIER ERR_SYM_MAP_CTL_MAX ECU_ADDRESS 0x7f9a16 BYTE_ORDER MSB_LAST BIT_MASK 0xF /end MEASUREMENT
/begin MEASUREMENT lv_err_maf_egr_thr_obd "Error flag of diagnosis instance MAF_EGR_THR_OBD" UBYTE _CNV_S_2_RANGE______28_CM 1 0. 0. 1. DISPLAY_IDENTIFIER LV_ERR_MAF_EGR_THR_OBD ECU_ADDRESS 0x7fb50c /end MEASUREMENT
/begin MEASUREMENT fmy_stat_maf_egr_thr_obd.ctr_abc "anti bounce counter for diagnosis instance MAF_EGR_THR_OBD" UBYTE _CNV_A_R_LINEAR_____1_CM 1 0. 0. 255. DISPLAY_IDENTIFIER CTR_ABC_MAF_EGR_THR_OBD ECU_ADDRESS 0x7f9a21 FORMAT "%3.0" /end MEASUREMENT
/begin MEASUREMENT fmy_stat_maf_egr_thr_obd.ctr_end_diag "counter for end of diagnosis for diagnosis instance MAF_EGR_THR_OBD" UBYTE _CNV_A_R_LINEAR_____1_CM 1 0. 0. 255. DISPLAY_IDENTIFIER CTR_ABC_END_DIAG_MAF_EGR_THR_OBD ECU_ADDRESS 0x7f9a20 FORMAT "%3.0" /end MEASUREMENT
/begin MEASUREMENT fmy_stat_maf_egr_thr_obd.err_info_stat.reserved "" UWORD _CNV_A_R_LINEAR_____0_CM 1 0. 0. 65535. DISPLAY_IDENTIFIER FMY_STAT_MAF_EGR_THR_OBD_ERR_INF ECU_ADDRESS 0x7f9a1e BYTE_ORDER MSB_LAST BIT_MASK 0xF800 /end MEASUREMENT
/begin MEASUREMENT fmy_stat_maf_egr_thr_obd.err_info_stat.lv_cdn_diag_stc "Statistical flag for condition of diagnosis of the diagnosis instance MAF_EGR_THR_OBD" UWORD _CNV_S_2_RANGE______380_CM 1 0. 0. 1. DISPLAY_IDENTIFIER LV_CDN_DIAG_STC_MAF_EGR_THR_OBD ECU_ADDRESS 0x7f9a1e BYTE_ORDER MSB_LAST BIT_MASK 0x400 /end MEASUREMENT
/begin MEASUREMENT fmy_stat_maf_egr_thr_obd.err_info_stat.lv_lock_diag "lock flag (CPU load optimisation) of the diagnosis instance MAF_EGR_THR_OBD" UWORD _CNV_S_2_RANGE______380_CM 1 0. 0. 1. DISPLAY_IDENTIFIER LV_LOCK_DIAG_MAF_EGR_THR_OBD ECU_ADDRESS 0x7f9a1e BYTE_ORDER MSB_LAST BIT_MASK 0x200 /end MEASUREMENT
/begin MEASUREMENT fmy_stat_maf_egr_thr_obd.err_info_stat.lv_err_mem "storage in dynamic failure memory of the diagnosis instance MAF_EGR_THR_OBD" UWORD _CNV_S_2_RANGE______380_CM 1 0. 0. 1. DISPLAY_IDENTIFIER LV_ERR_MEM_MAF_EGR_THR_OBD ECU_ADDRESS 0x7f9a1e BYTE_ORDER MSB_LAST BIT_MASK 0x80 /end MEASUREMENT
/begin MEASUREMENT fmy_stat_maf_egr_thr_obd.err_info_stat.lv_ready "readiness status of the diagnosis instance MAF_EGR_THR_OBD" UWORD _CNV_S_2_RANGE______380_CM 1 0. 0. 1. DISPLAY_IDENTIFIER LV_READY_MAF_EGR_THR_OBD ECU_ADDRESS 0x7f9a1e BYTE_ORDER MSB_LAST BIT_MASK 0x40 /end MEASUREMENT
/begin MEASUREMENT fmy_stat_maf_egr_thr_obd.err_info_stat.lv_end_diag "end of diagnosis of the diagnosis instance MAF_EGR_THR_OBD" UWORD _CNV_S_2_RANGE______380_CM 1 0. 0. 1. DISPLAY_IDENTIFIER LV_END_DIAG_MAF_EGR_THR_OBD ECU_ADDRESS 0x7f9a1e BYTE_ORDER MSB_LAST BIT_MASK 0x20 /end MEASUREMENT
/begin MEASUREMENT fmy_stat_maf_egr_thr_obd.err_info_stat.lv_cdn_diag "diagnosis condition of the diagnosis instance MAF_EGR_THR_OBD" UWORD _CNV_S_2_RANGE______380_CM 1 0. 0. 1. DISPLAY_IDENTIFIER LV_CDN_DIAG_MAF_EGR_THR_OBD ECU_ADDRESS 0x7f9a1e BYTE_ORDER MSB_LAST BIT_MASK 0x10 /end MEASUREMENT
/begin MEASUREMENT fmy_stat_maf_egr_thr_obd.err_info_stat.err_sym "symptoms of the diagnosis instance MAF_EGR_THR_OBD" UWORD _CNV_S_6_CONV_ERRM__27_CM 1 0. 0. 15. DISPLAY_IDENTIFIER ERR_SYM_MAF_EGR_THR_OBD ECU_ADDRESS 0x7f9a1e BYTE_ORDER MSB_LAST BIT_MASK 0xF /end MEASUREMENT
/begin MEASUREMENT lv_err_maf_dif_egr_thr_obd "Error flag of diagnosis instance MAF_DIF_EGR_THR_OBD" UBYTE _CNV_S_2_RANGE______28_CM 1 0. 0. 1. DISPLAY_IDENTIFIER LV_ERR_MAF_DIF_EGR_THR_OBD ECU_ADDRESS 0x7fb50d /end MEASUREMENT
/begin MEASUREMENT fmy_stat_maf_dif_egr_thr_obd.ctr_abc "anti bounce counter for diagnosis instance MAF_DIF_EGR_THR_OBD" UBYTE _CNV_A_R_LINEAR_____1_CM 1 0. 0. 255. DISPLAY_IDENTIFIER CTR_ABC_MAF_DIF_EGR_THR_OBD ECU_ADDRESS 0x7f9a25 FORMAT "%3.0" /end MEASUREMENT
/begin MEASUREMENT fmy_stat_maf_dif_egr_thr_obd.ctr_end_diag "counter for end of diagnosis for diagnosis instance MAF_DIF_EGR_THR_OBD" UBYTE _CNV_A_R_LINEAR_____1_CM 1 0. 0. 255. DISPLAY_IDENTIFIER CTR_ABC_END_DIAG_MAF_DIF_EGR_THR ECU_ADDRESS 0x7f9a24 FORMAT "%3.0" /end MEASUREMENT
/begin MEASUREMENT fmy_stat_maf_dif_egr_thr_obd.err_info_stat.reserved "" UWORD _CNV_A_R_LINEAR_____0_CM 1 0. 0. 65535. DISPLAY_IDENTIFIER FMY_STAT_MAF_DIF_EGR_THR_OBD_ERR ECU_ADDRESS 0x7f9a22 BYTE_ORDER MSB_LAST BIT_MASK 0xF800 /end MEASUREMENT
/begin MEASUREMENT fmy_stat_maf_dif_egr_thr_obd.err_info_stat.lv_cdn_diag_stc "Statistical flag for condition of diagnosis of the diagnosis instance MAF_DIF_EGR_THR_OBD" UWORD _CNV_S_2_RANGE______380_CM 1 0. 0. 1. DISPLAY_IDENTIFIER LV_CDN_DIAG_STC_MAF_DIF_EGR_THR_ ECU_ADDRESS 0x7f9a22 BYTE_ORDER MSB_LAST BIT_MASK 0x400 /end MEASUREMENT
/begin MEASUREMENT fmy_stat_maf_dif_egr_thr_obd.err_info_stat.lv_lock_diag "lock flag (CPU load optimisation) of the diagnosis instance MAF_DIF_EGR_THR_OBD" UWORD _CNV_S_2_RANGE______380_CM 1 0. 0. 1. DISPLAY_IDENTIFIER LV_LOCK_DIAG_MAF_DIF_EGR_THR_OBD ECU_ADDRESS 0x7f9a22 BYTE_ORDER MSB_LAST BIT_MASK 0x200 /end MEASUREMENT
/begin MEASUREMENT fmy_stat_maf_dif_egr_thr_obd.err_info_stat.lv_err_mem "storage in dynamic failure memory of the diagnosis instance MAF_DIF_EGR_THR_OBD" UWORD _CNV_S_2_RANGE______380_CM 1 0. 0. 1. DISPLAY_IDENTIFIER LV_ERR_MEM_MAF_DIF_EGR_THR_OBD ECU_ADDRESS 0x7f9a22 BYTE_ORDER MSB_LAST BIT_MASK 0x80 /end MEASUREMENT
/begin MEASUREMENT fmy_stat_maf_dif_egr_thr_obd.err_info_stat.lv_ready "readiness status of the diagnosis instance MAF_DIF_EGR_THR_OBD" UWORD _CNV_S_2_RANGE______380_CM 1 0. 0. 1. DISPLAY_IDENTIFIER LV_READY_MAF_DIF_EGR_THR_OBD ECU_ADDRESS 0x7f9a22 BYTE_ORDER MSB_LAST BIT_MASK 0x40 /end MEASUREMENT
/begin MEASUREMENT fmy_stat_maf_dif_egr_thr_obd.err_info_stat.lv_end_diag "end of diagnosis of the diagnosis instance MAF_DIF_EGR_THR_OBD" UWORD _CNV_S_2_RANGE______380_CM 1 0. 0. 1. DISPLAY_IDENTIFIER LV_END_DIAG_MAF_DIF_EGR_THR_OBD ECU_ADDRESS 0x7f9a22 BYTE_ORDER MSB_LAST BIT_MASK 0x20 /end MEASUREMENT
/begin MEASUREMENT fmy_stat_maf_dif_egr_thr_obd.err_info_stat.lv_cdn_diag "diagnosis condition of the diagnosis instance MAF_DIF_EGR_THR_OBD" UWORD _CNV_S_2_RANGE______380_CM 1 0. 0. 1. DISPLAY_IDENTIFIER LV_CDN_DIAG_MAF_DIF_EGR_THR_OBD ECU_ADDRESS 0x7f9a22 BYTE_ORDER MSB_LAST BIT_MASK 0x10 /end MEASUREMENT
/begin MEASUREMENT fmy_stat_maf_dif_egr_thr_obd.err_info_stat.err_sym "symptoms of the diagnosis instance MAF_DIF_EGR_THR_OBD" UWORD _CNV_S_6_CONV_ERRM__27_CM 1 0. 0. 15. DISPLAY_IDENTIFIER ERR_SYM_MAF_DIF_EGR_THR_OBD ECU_ADDRESS 0x7f9a22 BYTE_ORDER MSB_LAST BIT_MASK 0xF /end MEASUREMENT
/begin MEASUREMENT lv_err_map_dif_egr_thr_obd "Error flag of diagnosis instance MAP_DIF_EGR_THR_OBD" UBYTE _CNV_S_2_RANGE______28_CM 1 0. 0. 1. DISPLAY_IDENTIFIER LV_ERR_MAP_DIF_EGR_THR_OBD ECU_ADDRESS 0x7fb50e /end MEASUREMENT
/begin MEASUREMENT fmy_stat_map_dif_egr_thr_obd.ctr_abc "anti bounce counter for diagnosis instance MAP_DIF_EGR_THR_OBD" UBYTE _CNV_A_R_LINEAR_____1_CM 1 0. 0. 255. DISPLAY_IDENTIFIER CTR_ABC_MAP_DIF_EGR_THR_OBD ECU_ADDRESS 0x7f9a29 FORMAT "%3.0" /end MEASUREMENT
/begin MEASUREMENT fmy_stat_map_dif_egr_thr_obd.ctr_end_diag "counter for end of diagnosis for diagnosis instance MAP_DIF_EGR_THR_OBD" UBYTE _CNV_A_R_LINEAR_____1_CM 1 0. 0. 255. DISPLAY_IDENTIFIER CTR_ABC_END_DIAG_MAP_DIF_EGR_THR ECU_ADDRESS 0x7f9a28 FORMAT "%3.0" /end MEASUREMENT
/begin MEASUREMENT fmy_stat_map_dif_egr_thr_obd.err_info_stat.reserved "" UWORD _CNV_A_R_LINEAR_____0_CM 1 0. 0. 65535. DISPLAY_IDENTIFIER FMY_STAT_MAP_DIF_EGR_THR_OBD_ERR ECU_ADDRESS 0x7f9a26 BYTE_ORDER MSB_LAST BIT_MASK 0xF800 /end MEASUREMENT
/begin MEASUREMENT fmy_stat_map_dif_egr_thr_obd.err_info_stat.lv_cdn_diag_stc "Statistical flag for condition of diagnosis of the diagnosis instance MAP_DIF_EGR_THR_OBD" UWORD _CNV_S_2_RANGE______380_CM 1 0. 0. 1. DISPLAY_IDENTIFIER LV_CDN_DIAG_STC_MAP_DIF_EGR_THR_ ECU_ADDRESS 0x7f9a26 BYTE_ORDER MSB_LAST BIT_MASK 0x400 /end MEASUREMENT
/begin MEASUREMENT fmy_stat_map_dif_egr_thr_obd.err_info_stat.lv_lock_diag "lock flag (CPU load optimisation) of the diagnosis instance MAP_DIF_EGR_THR_OBD" UWORD _CNV_S_2_RANGE______380_CM 1 0. 0. 1. DISPLAY_IDENTIFIER LV_LOCK_DIAG_MAP_DIF_EGR_THR_OBD ECU_ADDRESS 0x7f9a26 BYTE_ORDER MSB_LAST BIT_MASK 0x200 /end MEASUREMENT
/begin MEASUREMENT fmy_stat_map_dif_egr_thr_obd.err_info_stat.lv_err_mem "storage in dynamic failure memory of the diagnosis instance MAP_DIF_EGR_THR_OBD" UWORD _CNV_S_2_RANGE______380_CM 1 0. 0. 1. DISPLAY_IDENTIFIER LV_ERR_MEM_MAP_DIF_EGR_THR_OBD ECU_ADDRESS 0x7f9a26 BYTE_ORDER MSB_LAST BIT_MASK 0x80 /end MEASUREMENT
/begin MEASUREMENT fmy_stat_map_dif_egr_thr_obd.err_info_stat.lv_ready "readiness status of the diagnosis instance MAP_DIF_EGR_THR_OBD" UWORD _CNV_S_2_RANGE______380_CM 1 0. 0. 1. DISPLAY_IDENTIFIER LV_READY_MAP_DIF_EGR_THR_OBD ECU_ADDRESS 0x7f9a26 BYTE_ORDER MSB_LAST BIT_MASK 0x40 /end MEASUREMENT
/begin MEASUREMENT fmy_stat_map_dif_egr_thr_obd.err_info_stat.lv_end_diag "end of diagnosis of the diagnosis instance MAP_DIF_EGR_THR_OBD" UWORD _CNV_S_2_RANGE______380_CM 1 0. 0. 1. DISPLAY_IDENTIFIER LV_END_DIAG_MAP_DIF_EGR_THR_OBD ECU_ADDRESS 0x7f9a26 BYTE_ORDER MSB_LAST BIT_MASK 0x20 /end MEASUREMENT
/begin MEASUREMENT fmy_stat_map_dif_egr_thr_obd.err_info_stat.lv_cdn_diag "diagnosis condition of the diagnosis instance MAP_DIF_EGR_THR_OBD" UWORD _CNV_S_2_RANGE______380_CM 1 0. 0. 1. DISPLAY_IDENTIFIER LV_CDN_DIAG_MAP_DIF_EGR_THR_OBD ECU_ADDRESS 0x7f9a26 BYTE_ORDER MSB_LAST BIT_MASK 0x10 /end MEASUREMENT
/begin MEASUREMENT fmy_stat_map_dif_egr_thr_obd.err_info_stat.err_sym "symptoms of the diagnosis instance MAP_DIF_EGR_THR_OBD" UWORD _CNV_S_6_CONV_ERRM__27_CM 1 0. 0. 15. DISPLAY_IDENTIFIER ERR_SYM_MAP_DIF_EGR_THR_OBD ECU_ADDRESS 0x7f9a26 BYTE_ORDER MSB_LAST BIT_MASK 0xF /end MEASUREMENT
/begin MEASUREMENT lv_err_vs "Error flag of diagnosis instance VS" UBYTE _CNV_S_2_RANGE______28_CM 1 0. 0. 1. DISPLAY_IDENTIFIER LV_ERR_VS ECU_ADDRESS 0x7fb50f /end MEASUREMENT
/begin MEASUREMENT fmy_stat_vs.ctr_abc "anti bounce counter for diagnosis instance VS" UBYTE _CNV_A_R_LINEAR_____1_CM 1 0. 0. 255. DISPLAY_IDENTIFIER CTR_ABC_VS ECU_ADDRESS 0x7f9a2d FORMAT "%3.0" /end MEASUREMENT
/begin MEASUREMENT fmy_stat_vs.ctr_end_diag "counter for end of diagnosis for diagnosis instance VS" UBYTE _CNV_A_R_LINEAR_____1_CM 1 0. 0. 255. DISPLAY_IDENTIFIER CTR_ABC_END_DIAG_VS ECU_ADDRESS 0x7f9a2c FORMAT "%3.0" /end MEASUREMENT
/begin MEASUREMENT fmy_stat_vs.err_info_stat.reserved "" UWORD _CNV_A_R_LINEAR_____0_CM 1 0. 0. 65535. DISPLAY_IDENTIFIER FMY_STAT_VS_ERR_INFO_STAT_RESERV ECU_ADDRESS 0x7f9a2a BYTE_ORDER MSB_LAST BIT_MASK 0xF800 /end MEASUREMENT
/begin MEASUREMENT fmy_stat_vs.err_info_stat.lv_cdn_diag_stc "Statistical flag for condition of diagnosis of the diagnosis instance VS" UWORD _CNV_S_2_RANGE______380_CM 1 0. 0. 1. DISPLAY_IDENTIFIER LV_CDN_DIAG_STC_VS ECU_ADDRESS 0x7f9a2a BYTE_ORDER MSB_LAST BIT_MASK 0x400 /end MEASUREMENT
/begin MEASUREMENT fmy_stat_vs.err_info_stat.lv_lock_diag "lock flag (CPU load optimisation) of the diagnosis instance VS" UWORD _CNV_S_2_RANGE______380_CM 1 0. 0. 1. DISPLAY_IDENTIFIER LV_LOCK_DIAG_VS ECU_ADDRESS 0x7f9a2a BYTE_ORDER MSB_LAST BIT_MASK 0x200 /end MEASUREMENT
/begin MEASUREMENT fmy_stat_vs.err_info_stat.lv_err_mem "storage in dynamic failure memory of the diagnosis instance VS" UWORD _CNV_S_2_RANGE______380_CM 1 0. 0. 1. DISPLAY_IDENTIFIER LV_ERR_MEM_VS ECU_ADDRESS 0x7f9a2a BYTE_ORDER MSB_LAST BIT_MASK 0x80 /end MEASUREMENT
/begin MEASUREMENT fmy_stat_vs.err_info_stat.lv_ready "readiness status of the diagnosis instance VS" UWORD _CNV_S_2_RANGE______380_CM 1 0. 0. 1. DISPLAY_IDENTIFIER LV_READY_VS ECU_ADDRESS 0x7f9a2a BYTE_ORDER MSB_LAST BIT_MASK 0x40 /end MEASUREMENT
/begin MEASUREMENT fmy_stat_vs.err_info_stat.lv_end_diag "end of diagnosis of the diagnosis instance VS" UWORD _CNV_S_2_RANGE______380_CM 1 0. 0. 1. DISPLAY_IDENTIFIER LV_END_DIAG_VS ECU_ADDRESS 0x7f9a2a BYTE_ORDER MSB_LAST BIT_MASK 0x20 /end MEASUREMENT
/begin MEASUREMENT fmy_stat_vs.err_info_stat.lv_cdn_diag "diagnosis condition of the diagnosis instance VS" UWORD _CNV_S_2_RANGE______380_CM 1 0. 0. 1. DISPLAY_IDENTIFIER LV_CDN_DIAG_VS ECU_ADDRESS 0x7f9a2a BYTE_ORDER MSB_LAST BIT_MASK 0x10 /end MEASUREMENT
/begin MEASUREMENT fmy_stat_vs.err_info_stat.err_sym "symptoms of the diagnosis instance VS" UWORD _CNV_S_6_CONV_ERRM__27_CM 1 0. 0. 15. DISPLAY_IDENTIFIER ERR_SYM_VS ECU_ADDRESS 0x7f9a2a BYTE_ORDER MSB_LAST BIT_MASK 0xF /end MEASUREMENT
/begin MEASUREMENT lv_err_cs "Error flag of diagnosis instance CS" UBYTE _CNV_S_2_RANGE______28_CM 1 0. 0. 1. DISPLAY_IDENTIFIER LV_ERR_CS ECU_ADDRESS 0x7fb510 /end MEASUREMENT
/begin MEASUREMENT fmy_stat_cs.ctr_abc "anti bounce counter for diagnosis instance CS" UBYTE _CNV_A_R_LINEAR_____1_CM 1 0. 0. 255. DISPLAY_IDENTIFIER CTR_ABC_CS ECU_ADDRESS 0x7f9a31 FORMAT "%3.0" /end MEASUREMENT
/begin MEASUREMENT fmy_stat_cs.ctr_end_diag "counter for end of diagnosis for diagnosis instance CS" UBYTE _CNV_A_R_LINEAR_____1_CM 1 0. 0. 255. DISPLAY_IDENTIFIER CTR_ABC_END_DIAG_CS ECU_ADDRESS 0x7f9a30 FORMAT "%3.0" /end MEASUREMENT
/begin MEASUREMENT fmy_stat_cs.err_info_stat.reserved "" UWORD _CNV_A_R_LINEAR_____0_CM 1 0. 0. 65535. DISPLAY_IDENTIFIER FMY_STAT_CS_ERR_INFO_STAT_RESERV ECU_ADDRESS 0x7f9a2e BYTE_ORDER MSB_LAST BIT_MASK 0xF800 /end MEASUREMENT
/begin MEASUREMENT fmy_stat_cs.err_info_stat.lv_cdn_diag_stc "Statistical flag for condition of diagnosis of the diagnosis instance CS" UWORD _CNV_S_2_RANGE______380_CM 1 0. 0. 1. DISPLAY_IDENTIFIER LV_CDN_DIAG_STC_CS ECU_ADDRESS 0x7f9a2e BYTE_ORDER MSB_LAST BIT_MASK 0x400 /end MEASUREMENT
/begin MEASUREMENT fmy_stat_cs.err_info_stat.lv_lock_diag "lock flag (CPU load optimisation) of the diagnosis instance CS" UWORD _CNV_S_2_RANGE______380_CM 1 0. 0. 1. DISPLAY_IDENTIFIER LV_LOCK_DIAG_CS ECU_ADDRESS 0x7f9a2e BYTE_ORDER MSB_LAST BIT_MASK 0x200 /end MEASUREMENT
/begin MEASUREMENT fmy_stat_cs.err_info_stat.lv_err_mem "storage in dynamic failure memory of the diagnosis instance CS" UWORD _CNV_S_2_RANGE______380_CM 1 0. 0. 1. DISPLAY_IDENTIFIER LV_ERR_MEM_CS ECU_ADDRESS 0x7f9a2e BYTE_ORDER MSB_LAST BIT_MASK 0x80 /end MEASUREMENT
/begin MEASUREMENT fmy_stat_cs.err_info_stat.lv_ready "readiness status of the diagnosis instance CS" UWORD _CNV_S_2_RANGE______380_CM 1 0. 0. 1. DISPLAY_IDENTIFIER LV_READY_CS ECU_ADDRESS 0x7f9a2e BYTE_ORDER MSB_LAST BIT_MASK 0x40 /end MEASUREMENT
/begin MEASUREMENT fmy_stat_cs.err_info_stat.lv_end_diag "end of diagnosis of the diagnosis instance CS" UWORD _CNV_S_2_RANGE______380_CM 1 0. 0. 1. DISPLAY_IDENTIFIER LV_END_DIAG_CS ECU_ADDRESS 0x7f9a2e BYTE_ORDER MSB_LAST BIT_MASK 0x20 /end MEASUREMENT
/begin MEASUREMENT fmy_stat_cs.err_info_stat.lv_cdn_diag "diagnosis condition of the diagnosis instance CS" UWORD _CNV_S_2_RANGE______380_CM 1 0. 0. 1. DISPLAY_IDENTIFIER LV_CDN_DIAG_CS ECU_ADDRESS 0x7f9a2e BYTE_ORDER MSB_LAST BIT_MASK 0x10 /end MEASUREMENT
/begin MEASUREMENT fmy_stat_cs.err_info_stat.err_sym "symptoms of the diagnosis instance CS" UWORD _CNV_S_6_CONV_ERRM__27_CM 1 0. 0. 15. DISPLAY_IDENTIFIER ERR_SYM_CS ECU_ADDRESS 0x7f9a2e BYTE_ORDER MSB_LAST BIT_MASK 0xF /end MEASUREMENT
/begin MEASUREMENT lv_err_bls "Error flag of diagnosis instance BLS" UBYTE _CNV_S_2_RANGE______28_CM 1 0. 0. 1. DISPLAY_IDENTIFIER LV_ERR_BLS ECU_ADDRESS 0x7fb511 /end MEASUREMENT
/begin MEASUREMENT fmy_stat_bls.ctr_abc "anti bounce counter for diagnosis instance BLS" UBYTE _CNV_A_R_LINEAR_____1_CM 1 0. 0. 255. DISPLAY_IDENTIFIER CTR_ABC_BLS ECU_ADDRESS 0x7f9a35 FORMAT "%3.0" /end MEASUREMENT
/begin MEASUREMENT fmy_stat_bls.ctr_end_diag "counter for end of diagnosis for diagnosis instance BLS" UBYTE _CNV_A_R_LINEAR_____1_CM 1 0. 0. 255. DISPLAY_IDENTIFIER CTR_ABC_END_DIAG_BLS ECU_ADDRESS 0x7f9a34 FORMAT "%3.0" /end MEASUREMENT
/begin MEASUREMENT fmy_stat_bls.err_info_stat.reserved "" UWORD _CNV_A_R_LINEAR_____0_CM 1 0. 0. 65535. DISPLAY_IDENTIFIER FMY_STAT_BLS_ERR_INFO_STAT_RESER ECU_ADDRESS 0x7f9a32 BYTE_ORDER MSB_LAST BIT_MASK 0xF800 /end MEASUREMENT
/begin MEASUREMENT fmy_stat_bls.err_info_stat.lv_cdn_diag_stc "Statistical flag for condition of diagnosis of the diagnosis instance BLS" UWORD _CNV_S_2_RANGE______380_CM 1 0. 0. 1. DISPLAY_IDENTIFIER LV_CDN_DIAG_STC_BLS ECU_ADDRESS 0x7f9a32 BYTE_ORDER MSB_LAST BIT_MASK 0x400 /end MEASUREMENT
/begin MEASUREMENT fmy_stat_bls.err_info_stat.lv_lock_diag "lock flag (CPU load optimisation) of the diagnosis instance BLS" UWORD _CNV_S_2_RANGE______380_CM 1 0. 0. 1. DISPLAY_IDENTIFIER LV_LOCK_DIAG_BLS ECU_ADDRESS 0x7f9a32 BYTE_ORDER MSB_LAST BIT_MASK 0x200 /end MEASUREMENT
/begin MEASUREMENT fmy_stat_bls.err_info_stat.lv_err_mem "storage in dynamic failure memory of the diagnosis instance BLS" UWORD _CNV_S_2_RANGE______380_CM 1 0. 0. 1. DISPLAY_IDENTIFIER LV_ERR_MEM_BLS ECU_ADDRESS 0x7f9a32 BYTE_ORDER MSB_LAST BIT_MASK 0x80 /end MEASUREMENT
/begin MEASUREMENT fmy_stat_bls.err_info_stat.lv_ready "readiness status of the diagnosis instance BLS" UWORD _CNV_S_2_RANGE______380_CM 1 0. 0. 1. DISPLAY_IDENTIFIER LV_READY_BLS ECU_ADDRESS 0x7f9a32 BYTE_ORDER MSB_LAST BIT_MASK 0x40 /end MEASUREMENT
/begin MEASUREMENT fmy_stat_bls.err_info_stat.lv_end_diag "end of diagnosis of the diagnosis instance BLS" UWORD _CNV_S_2_RANGE______380_CM 1 0. 0. 1. DISPLAY_IDENTIFIER LV_END_DIAG_BLS ECU_ADDRESS 0x7f9a32 BYTE_ORDER MSB_LAST BIT_MASK 0x20 /end MEASUREMENT
/begin MEASUREMENT fmy_stat_bls.err_info_stat.lv_cdn_diag "diagnosis condition of the diagnosis instance BLS" UWORD _CNV_S_2_RANGE______380_CM 1 0. 0. 1. DISPLAY_IDENTIFIER LV_CDN_DIAG_BLS ECU_ADDRESS 0x7f9a32 BYTE_ORDER MSB_LAST BIT_MASK 0x10 /end MEASUREMENT
/begin MEASUREMENT fmy_stat_bls.err_info_stat.err_sym "symptoms of the diagnosis instance BLS" UWORD _CNV_S_6_CONV_ERRM__27_CM 1 0. 0. 15. DISPLAY_IDENTIFIER ERR_SYM_BLS ECU_ADDRESS 0x7f9a32 BYTE_ORDER MSB_LAST BIT_MASK 0xF /end MEASUREMENT
/begin MEASUREMENT lv_err_bls_bts_dece "Error flag of diagnosis instance BLS_BTS_DECE" UBYTE _CNV_S_2_RANGE______28_CM 1 0. 0. 1. DISPLAY_IDENTIFIER LV_ERR_BLS_BTS_DECE ECU_ADDRESS 0x7fb512 /end MEASUREMENT
/begin MEASUREMENT fmy_stat_bls_bts_dece.ctr_abc "anti bounce counter for diagnosis instance BLS_BTS_DECE" UBYTE _CNV_A_R_LINEAR_____1_CM 1 0. 0. 255. DISPLAY_IDENTIFIER CTR_ABC_BLS_BTS_DECE ECU_ADDRESS 0x7f9a39 FORMAT "%3.0" /end MEASUREMENT
/begin MEASUREMENT fmy_stat_bls_bts_dece.ctr_end_diag "counter for end of diagnosis for diagnosis instance BLS_BTS_DECE" UBYTE _CNV_A_R_LINEAR_____1_CM 1 0. 0. 255. DISPLAY_IDENTIFIER CTR_ABC_END_DIAG_BLS_BTS_DECE ECU_ADDRESS 0x7f9a38 FORMAT "%3.0" /end MEASUREMENT
/begin MEASUREMENT fmy_stat_bls_bts_dece.err_info_stat.reserved "" UWORD _CNV_A_R_LINEAR_____0_CM 1 0. 0. 65535. DISPLAY_IDENTIFIER FMY_STAT_BLS_BTS_DECE_ERR_INFO_S ECU_ADDRESS 0x7f9a36 BYTE_ORDER MSB_LAST BIT_MASK 0xF800 /end MEASUREMENT
/begin MEASUREMENT fmy_stat_bls_bts_dece.err_info_stat.lv_cdn_diag_stc "Statistical flag for condition of diagnosis of the diagnosis instance BLS_BTS_DECE" UWORD _CNV_S_2_RANGE______380_CM 1 0. 0. 1. DISPLAY_IDENTIFIER LV_CDN_DIAG_STC_BLS_BTS_DECE ECU_ADDRESS 0x7f9a36 BYTE_ORDER MSB_LAST BIT_MASK 0x400 /end MEASUREMENT
/begin MEASUREMENT fmy_stat_bls_bts_dece.err_info_stat.lv_lock_diag "lock flag (CPU load optimisation) of the diagnosis instance BLS_BTS_DECE" UWORD _CNV_S_2_RANGE______380_CM 1 0. 0. 1. DISPLAY_IDENTIFIER LV_LOCK_DIAG_BLS_BTS_DECE ECU_ADDRESS 0x7f9a36 BYTE_ORDER MSB_LAST BIT_MASK 0x200 /end MEASUREMENT
/begin MEASUREMENT fmy_stat_bls_bts_dece.err_info_stat.lv_err_mem "storage in dynamic failure memory of the diagnosis instance BLS_BTS_DECE" UWORD _CNV_S_2_RANGE______380_CM 1 0. 0. 1. DISPLAY_IDENTIFIER LV_ERR_MEM_BLS_BTS_DECE ECU_ADDRESS 0x7f9a36 BYTE_ORDER MSB_LAST BIT_MASK 0x80 /end MEASUREMENT
/begin MEASUREMENT fmy_stat_bls_bts_dece.err_info_stat.lv_ready "readiness status of the diagnosis instance BLS_BTS_DECE" UWORD _CNV_S_2_RANGE______380_CM 1 0. 0. 1. DISPLAY_IDENTIFIER LV_READY_BLS_BTS_DECE ECU_ADDRESS 0x7f9a36 BYTE_ORDER MSB_LAST BIT_MASK 0x40 /end MEASUREMENT
/begin MEASUREMENT fmy_stat_bls_bts_dece.err_info_stat.lv_end_diag "end of diagnosis of the diagnosis instance BLS_BTS_DECE" UWORD _CNV_S_2_RANGE______380_CM 1 0. 0. 1. DISPLAY_IDENTIFIER LV_END_DIAG_BLS_BTS_DECE ECU_ADDRESS 0x7f9a36 BYTE_ORDER MSB_LAST BIT_MASK 0x20 /end MEASUREMENT
/begin MEASUREMENT fmy_stat_bls_bts_dece.err_info_stat.lv_cdn_diag "diagnosis condition of the diagnosis instance BLS_BTS_DECE" UWORD _CNV_S_2_RANGE______380_CM 1 0. 0. 1. DISPLAY_IDENTIFIER LV_CDN_DIAG_BLS_BTS_DECE ECU_ADDRESS 0x7f9a36 BYTE_ORDER MSB_LAST BIT_MASK 0x10 /end MEASUREMENT
/begin MEASUREMENT fmy_stat_bls_bts_dece.err_info_stat.err_sym "symptoms of the diagnosis instance BLS_BTS_DECE" UWORD _CNV_S_6_CONV_ERRM__27_CM 1 0. 0. 15. DISPLAY_IDENTIFIER ERR_SYM_BLS_BTS_DECE ECU_ADDRESS 0x7f9a36 BYTE_ORDER MSB_LAST BIT_MASK 0xF /end MEASUREMENT
/begin MEASUREMENT lv_err_bls_bts_plaus "Error flag of diagnosis instance BLS_BTS_PLAUS" UBYTE _CNV_S_2_RANGE______28_CM 1 0. 0. 1. DISPLAY_IDENTIFIER LV_ERR_BLS_BTS_PLAUS ECU_ADDRESS 0x7fb513 /end MEASUREMENT
/begin MEASUREMENT fmy_stat_bls_bts_plaus.ctr_abc "anti bounce counter for diagnosis instance BLS_BTS_PLAUS" UBYTE _CNV_A_R_LINEAR_____1_CM 1 0. 0. 255. DISPLAY_IDENTIFIER CTR_ABC_BLS_BTS_PLAUS ECU_ADDRESS 0x7f9a3d FORMAT "%3.0" /end MEASUREMENT
/begin MEASUREMENT fmy_stat_bls_bts_plaus.ctr_end_diag "counter for end of diagnosis for diagnosis instance BLS_BTS_PLAUS" UBYTE _CNV_A_R_LINEAR_____1_CM 1 0. 0. 255. DISPLAY_IDENTIFIER CTR_ABC_END_DIAG_BLS_BTS_PLAUS ECU_ADDRESS 0x7f9a3c FORMAT "%3.0" /end MEASUREMENT
/begin MEASUREMENT fmy_stat_bls_bts_plaus.err_info_stat.reserved "" UWORD _CNV_A_R_LINEAR_____0_CM 1 0. 0. 65535. DISPLAY_IDENTIFIER FMY_STAT_BLS_BTS_PLAUS_ERR_INFO_ ECU_ADDRESS 0x7f9a3a BYTE_ORDER MSB_LAST BIT_MASK 0xF800 /end MEASUREMENT
/begin MEASUREMENT fmy_stat_bls_bts_plaus.err_info_stat.lv_cdn_diag_stc "Statistical flag for condition of diagnosis of the diagnosis instance BLS_BTS_PLAUS" UWORD _CNV_S_2_RANGE______380_CM 1 0. 0. 1. DISPLAY_IDENTIFIER LV_CDN_DIAG_STC_BLS_BTS_PLAUS ECU_ADDRESS 0x7f9a3a BYTE_ORDER MSB_LAST BIT_MASK 0x400 /end MEASUREMENT
/begin MEASUREMENT fmy_stat_bls_bts_plaus.err_info_stat.lv_lock_diag "lock flag (CPU load optimisation) of the diagnosis instance BLS_BTS_PLAUS" UWORD _CNV_S_2_RANGE______380_CM 1 0. 0. 1. DISPLAY_IDENTIFIER LV_LOCK_DIAG_BLS_BTS_PLAUS ECU_ADDRESS 0x7f9a3a BYTE_ORDER MSB_LAST BIT_MASK 0x200 /end MEASUREMENT
/begin MEASUREMENT fmy_stat_bls_bts_plaus.err_info_stat.lv_err_mem "storage in dynamic failure memory of the diagnosis instance BLS_BTS_PLAUS" UWORD _CNV_S_2_RANGE______380_CM 1 0. 0. 1. DISPLAY_IDENTIFIER LV_ERR_MEM_BLS_BTS_PLAUS ECU_ADDRESS 0x7f9a3a BYTE_ORDER MSB_LAST BIT_MASK 0x80 /end MEASUREMENT
/begin MEASUREMENT fmy_stat_bls_bts_plaus.err_info_stat.lv_ready "readiness status of the diagnosis instance BLS_BTS_PLAUS" UWORD _CNV_S_2_RANGE______380_CM 1 0. 0. 1. DISPLAY_IDENTIFIER LV_READY_BLS_BTS_PLAUS ECU_ADDRESS 0x7f9a3a BYTE_ORDER MSB_LAST BIT_MASK 0x40 /end MEASUREMENT
/begin MEASUREMENT fmy_stat_bls_bts_plaus.err_info_stat.lv_end_diag "end of diagnosis of the diagnosis instance BLS_BTS_PLAUS" UWORD _CNV_S_2_RANGE______380_CM 1 0. 0. 1. DISPLAY_IDENTIFIER LV_END_DIAG_BLS_BTS_PLAUS ECU_ADDRESS 0x7f9a3a BYTE_ORDER MSB_LAST BIT_MASK 0x20 /end MEASUREMENT
/begin MEASUREMENT fmy_stat_bls_bts_plaus.err_info_stat.lv_cdn_diag "diagnosis condition of the diagnosis instance BLS_BTS_PLAUS" UWORD _CNV_S_2_RANGE______380_CM 1 0. 0. 1. DISPLAY_IDENTIFIER LV_CDN_DIAG_BLS_BTS_PLAUS ECU_ADDRESS 0x7f9a3a BYTE_ORDER MSB_LAST BIT_MASK 0x10 /end MEASUREMENT
/begin MEASUREMENT fmy_stat_bls_bts_plaus.err_info_stat.err_sym "symptoms of the diagnosis instance BLS_BTS_PLAUS" UWORD _CNV_S_6_CONV_ERRM__27_CM 1 0. 0. 15. DISPLAY_IDENTIFIER ERR_SYM_BLS_BTS_PLAUS ECU_ADDRESS 0x7f9a3a BYTE_ORDER MSB_LAST BIT_MASK 0xF /end MEASUREMENT
/begin COMPU_METHOD _CNV_A_R_LINEAR_____0_CM "" RAT_FUNC "%6.3" "[-]" COEFFS 0 1. 0. 0 0 1 /end COMPU_METHOD
/begin COMPU_METHOD _CNV_A_R_LINEAR_____1_CM "" RAT_FUNC "%6.3" "-" COEFFS 0 1. 0. 0 0 1 /end COMPU_METHOD
/begin COMPU_METHOD _CNV_S_6_CONV_ERRM__27_CM "" TAB_VERB "%6.3" "[-]" COMPU_TAB_REF _CNV_S_6_CONV_ERRM__27 /end COMPU_METHOD
/begin COMPU_VTAB _CNV_S_6_CONV_ERRM__27 "" TAB_VERB 6 0 "NO_SYM" 1 "SYM_0" 2 "SYM_1" 4 "SYM_2" 8 "SYM_3" 15 "BENCH_MODE" /end COMPU_VTAB
/begin COMPU_METHOD _CNV_S_2_RANGE______28_CM "" TAB_VERB "%6.3" "[-]" COMPU_TAB_REF _CNV_S_2_RANGE______28 /end COMPU_METHOD
/begin COMPU_VTAB _CNV_S_2_RANGE______28 "" TAB_VERB 2 0 "passive" 1 "active" /end COMPU_VTAB
/begin COMPU_METHOD _CNV_S_2_RANGE______380_CM "" TAB_VERB "%6.3" "-" COMPU_TAB_REF _CNV_S_2_RANGE______380 /end COMPU_METHOD
/begin COMPU_VTAB _CNV_S_2_RANGE______380 "" TAB_VERB 2 0 "passive" 1 "active" /end COMPU_VTAB
/begin FUNCTION ERRM_ATCODIAG "Error Management data for diagnosis ATCODIAG"
 /begin OUT_MEASUREMENT lv_err_v_tco_1_rng fmy_stat_v_tco_1_rng.ctr_abc fmy_stat_v_tco_1_rng.ctr_end_diag fmy_stat_v_tco_1_rng.err_info_stat.reserved fmy_stat_v_tco_1_rng.err_info_stat.lv_cdn_diag_stc fmy_stat_v_tco_1_rng.err_info_stat.lv_lock_diag fmy_stat_v_tco_1_rng.err_info_stat.lv_err_mem fmy_stat_v_tco_1_rng.err_info_stat.lv_ready fmy_stat_v_tco_1_rng.err_info_stat.lv_end_diag fmy_stat_v_tco_1_rng.err_info_stat.lv_cdn_diag fmy_stat_v_tco_1_rng.err_info_stat.err_sym lv_err_v_tco_2_rng fmy_stat_v_tco_2_rng.ctr_abc fmy_stat_v_tco_2_rng.ctr_end_diag fmy_stat_v_tco_2_rng.err_info_stat.reserved fmy_stat_v_tco_2_rng.err_info_stat.lv_cdn_diag_stc fmy_stat_v_tco_2_rng.err_info_stat.lv_lock_diag fmy_stat_v_tco_2_rng.err_info_stat.lv_err_mem fmy_stat_v_tco_2_rng.err_info_stat.lv_ready fmy_stat_v_tco_2_rng.err_info_stat.lv_end_diag fmy_stat_v_tco_2_rng.err_info_stat.lv_cdn_diag fmy_stat_v_tco_2_rng.err_info_stat.err_sym lv_err_tco_1_mes_grd fmy_stat_tco_1_mes_grd.ctr_abc fmy_stat_tco_1_mes_grd.ctr_end_diag fmy_stat_tco_1_mes_grd.err_info_stat.reserved fmy_stat_tco_1_mes_grd.err_info_stat.lv_cdn_diag_stc fmy_stat_tco_1_mes_grd.err_info_stat.lv_lock_diag fmy_stat_tco_1_mes_grd.err_info_stat.lv_err_mem fmy_stat_tco_1_mes_grd.err_info_stat.lv_ready fmy_stat_tco_1_mes_grd.err_info_stat.lv_end_diag fmy_stat_tco_1_mes_grd.err_info_stat.lv_cdn_diag fmy_stat_tco_1_mes_grd.err_info_stat.err_sym lv_err_tco_2_mes_grd fmy_stat_tco_2_mes_grd.ctr_abc fmy_stat_tco_2_mes_grd.ctr_end_diag fmy_stat_tco_2_mes_grd.err_info_stat.reserved fmy_stat_tco_2_mes_grd.err_info_stat.lv_cdn_diag_stc fmy_stat_tco_2_mes_grd.err_info_stat.lv_lock_diag fmy_stat_tco_2_mes_grd.err_info_stat.lv_err_mem fmy_stat_tco_2_mes_grd.err_info_stat.lv_ready fmy_stat_tco_2_mes_grd.err_info_stat.lv_end_diag fmy_stat_tco_2_mes_grd.err_info_stat.lv_cdn_diag fmy_stat_tco_2_mes_grd.err_info_stat.err_sym lv_err_tco_mes_plaus fmy_stat_tco_mes_plaus.ctr_abc fmy_stat_tco_mes_plaus.ctr_end_diag fmy_stat_tco_mes_plaus.err_info_stat.reserved fmy_stat_tco_mes_plaus.err_info_stat.lv_cdn_diag_stc fmy_stat_tco_mes_plaus.err_info_stat.lv_lock_diag fmy_stat_tco_mes_plaus.err_info_stat.lv_err_mem fmy_stat_tco_mes_plaus.err_info_stat.lv_ready fmy_stat_tco_mes_plaus.err_info_stat.lv_end_diag fmy_stat_tco_mes_plaus.err_info_stat.lv_cdn_diag fmy_stat_tco_mes_plaus.err_info_stat.err_sym /end OUT_MEASUREMENT
/end FUNCTION
/begin FUNCTION ERRM_AEGRCTLD "Error Management data for diagnosis AEGRCTLD"
 /begin OUT_MEASUREMENT lv_err_egr_ctl_min fmy_stat_egr_ctl_min.ctr_abc fmy_stat_egr_ctl_min.ctr_end_diag fmy_stat_egr_ctl_min.err_info_stat.reserved fmy_stat_egr_ctl_min.err_info_stat.lv_cdn_diag_stc fmy_stat_egr_ctl_min.err_info_stat.lv_lock_diag fmy_stat_egr_ctl_min.err_info_stat.lv_err_mem fmy_stat_egr_ctl_min.err_info_stat.lv_ready fmy_stat_egr_ctl_min.err_info_stat.lv_end_diag fmy_stat_egr_ctl_min.err_info_stat.lv_cdn_diag fmy_stat_egr_ctl_min.err_info_stat.err_sym lv_err_egr_ctl_max fmy_stat_egr_ctl_max.ctr_abc fmy_stat_egr_ctl_max.ctr_end_diag fmy_stat_egr_ctl_max.err_info_stat.reserved fmy_stat_egr_ctl_max.err_info_stat.lv_cdn_diag_stc fmy_stat_egr_ctl_max.err_info_stat.lv_lock_diag fmy_stat_egr_ctl_max.err_info_stat.lv_err_mem fmy_stat_egr_ctl_max.err_info_stat.lv_ready fmy_stat_egr_ctl_max.err_info_stat.lv_end_diag fmy_stat_egr_ctl_max.err_info_stat.lv_cdn_diag fmy_stat_egr_ctl_max.err_info_stat.err_sym /end OUT_MEASUREMENT
/end FUNCTION
/begin FUNCTION ERRM_AAMPDIAG "Error Management data for diagnosis AAMPDIAG"
 /begin OUT_MEASUREMENT lv_err_v_amp_rng fmy_stat_v_amp_rng.ctr_abc fmy_stat_v_amp_rng.ctr_end_diag fmy_stat_v_amp_rng.err_info_stat.reserved fmy_stat_v_amp_rng.err_info_stat.lv_cdn_diag_stc fmy_stat_v_amp_rng.err_info_stat.lv_lock_diag fmy_stat_v_amp_rng.err_info_stat.lv_err_mem fmy_stat_v_amp_rng.err_info_stat.lv_ready fmy_stat_v_amp_rng.err_info_stat.lv_end_diag fmy_stat_v_amp_rng.err_info_stat.lv_cdn_diag fmy_stat_v_amp_rng.err_info_stat.err_sym lv_err_amp_mes_grd fmy_stat_amp_mes_grd.ctr_abc fmy_stat_amp_mes_grd.ctr_end_diag fmy_stat_amp_mes_grd.err_info_stat.reserved fmy_stat_amp_mes_grd.err_info_stat.lv_cdn_diag_stc fmy_stat_amp_mes_grd.err_info_stat.lv_lock_diag fmy_stat_amp_mes_grd.err_info_stat.lv_err_mem fmy_stat_amp_mes_grd.err_info_stat.lv_ready fmy_stat_amp_mes_grd.err_info_stat.lv_end_diag fmy_stat_amp_mes_grd.err_info_stat.lv_cdn_diag fmy_stat_amp_mes_grd.err_info_stat.err_sym /end OUT_MEASUREMENT
/end FUNCTION
/begin FUNCTION ERRM_ATFU "Error Management data for diagnosis ATFU"
 /begin OUT_MEASUREMENT lv_err_v_tfu_rng fmy_stat_v_tfu_rng.ctr_abc fmy_stat_v_tfu_rng.ctr_end_diag fmy_stat_v_tfu_rng.err_info_stat.reserved fmy_stat_v_tfu_rng.err_info_stat.lv_cdn_diag_stc fmy_stat_v_tfu_rng.err_info_stat.lv_lock_diag fmy_stat_v_tfu_rng.err_info_stat.lv_err_mem fmy_stat_v_tfu_rng.err_info_stat.lv_ready fmy_stat_v_tfu_rng.err_info_stat.lv_end_diag fmy_stat_v_tfu_rng.err_info_stat.lv_cdn_diag fmy_stat_v_tfu_rng.err_info_stat.err_sym lv_err_tfu_mes_grd fmy_stat_tfu_mes_grd.ctr_abc fmy_stat_tfu_mes_grd.ctr_end_diag fmy_stat_tfu_mes_grd.err_info_stat.reserved fmy_stat_tfu_mes_grd.err_info_stat.lv_cdn_diag_stc fmy_stat_tfu_mes_grd.err_info_stat.lv_lock_diag fmy_stat_tfu_mes_grd.err_info_stat.lv_err_mem fmy_stat_tfu_mes_grd.err_info_stat.lv_ready fmy_stat_tfu_mes_grd.err_info_stat.lv_end_diag fmy_stat_tfu_mes_grd.err_info_stat.lv_cdn_diag fmy_stat_tfu_mes_grd.err_info_stat.err_sym /end OUT_MEASUREMENT
/end FUNCTION
/begin FUNCTION ERRM_AMAPDIAG "Error Management data for diagnosis AMAPDIAG"
 /begin OUT_MEASUREMENT lv_err_v_map_rng fmy_stat_v_map_rng.ctr_abc fmy_stat_v_map_rng.ctr_end_diag fmy_stat_v_map_rng.err_info_stat.reserved fmy_stat_v_map_rng.err_info_stat.lv_cdn_diag_stc fmy_stat_v_map_rng.err_info_stat.lv_lock_diag fmy_stat_v_map_rng.err_info_stat.lv_err_mem fmy_stat_v_map_rng.err_info_stat.lv_ready fmy_stat_v_map_rng.err_info_stat.lv_end_diag fmy_stat_v_map_rng.err_info_stat.lv_cdn_diag fmy_stat_v_map_rng.err_info_stat.err_sym lv_err_map_amp_ofs fmy_stat_map_amp_ofs.ctr_abc fmy_stat_map_amp_ofs.ctr_end_diag fmy_stat_map_amp_ofs.err_info_stat.reserved fmy_stat_map_amp_ofs.err_info_stat.lv_cdn_diag_stc fmy_stat_map_amp_ofs.err_info_stat.lv_lock_diag fmy_stat_map_amp_ofs.err_info_stat.lv_err_mem fmy_stat_map_amp_ofs.err_info_stat.lv_ready fmy_stat_map_amp_ofs.err_info_stat.lv_end_diag fmy_stat_map_amp_ofs.err_info_stat.lv_cdn_diag fmy_stat_map_amp_ofs.err_info_stat.err_sym lv_err_map_is_ofs fmy_stat_map_is_ofs.ctr_abc fmy_stat_map_is_ofs.ctr_end_diag fmy_stat_map_is_ofs.err_info_stat.reserved fmy_stat_map_is_ofs.err_info_stat.lv_cdn_diag_stc fmy_stat_map_is_ofs.err_info_stat.lv_lock_diag fmy_stat_map_is_ofs.err_info_stat.lv_err_mem fmy_stat_map_is_ofs.err_info_stat.lv_ready fmy_stat_map_is_ofs.err_info_stat.lv_end_diag fmy_stat_map_is_ofs.err_info_stat.lv_cdn_diag fmy_stat_map_is_ofs.err_info_stat.err_sym lv_err_map_mes_grd fmy_stat_map_mes_grd.ctr_abc fmy_stat_map_mes_grd.ctr_end_diag fmy_stat_map_mes_grd.err_info_stat.reserved fmy_stat_map_mes_grd.err_info_stat.lv_cdn_diag_stc fmy_stat_map_mes_grd.err_info_stat.lv_lock_diag fmy_stat_map_mes_grd.err_info_stat.lv_err_mem fmy_stat_map_mes_grd.err_info_stat.lv_ready fmy_stat_map_mes_grd.err_info_stat.lv_end_diag fmy_stat_map_mes_grd.err_info_stat.lv_cdn_diag fmy_stat_map_mes_grd.err_info_stat.err_sym /end OUT_MEASUREMENT
/end FUNCTION
/begin FUNCTION ERRM_AMAFPLAD "Error Management data for diagnosis AMAFPLAD"
 /begin OUT_MEASUREMENT lv_err_maf_kgh_plaus fmy_stat_maf_kgh_plaus.ctr_abc fmy_stat_maf_kgh_plaus.ctr_end_diag fmy_stat_maf_kgh_plaus.err_info_stat.reserved fmy_stat_maf_kgh_plaus.err_info_stat.lv_cdn_diag_stc fmy_stat_maf_kgh_plaus.err_info_stat.lv_lock_diag fmy_stat_maf_kgh_plaus.err_info_stat.lv_err_mem fmy_stat_maf_kgh_plaus.err_info_stat.lv_ready fmy_stat_maf_kgh_plaus.err_info_stat.lv_end_diag fmy_stat_maf_kgh_plaus.err_info_stat.lv_cdn_diag fmy_stat_maf_kgh_plaus.err_info_stat.err_sym /end OUT_MEASUREMENT
/end FUNCTION
/begin FUNCTION ERRM_AMAFANAD "Error Management data for diagnosis AMAFANAD"
 /begin OUT_MEASUREMENT lv_err_maf_0_rng fmy_stat_maf_0_rng.ctr_abc fmy_stat_maf_0_rng.ctr_end_diag fmy_stat_maf_0_rng.err_info_stat.reserved fmy_stat_maf_0_rng.err_info_stat.lv_cdn_diag_stc fmy_stat_maf_0_rng.err_info_stat.lv_lock_diag fmy_stat_maf_0_rng.err_info_stat.lv_err_mem fmy_stat_maf_0_rng.err_info_stat.lv_ready fmy_stat_maf_0_rng.err_info_stat.lv_end_diag fmy_stat_maf_0_rng.err_info_stat.lv_cdn_diag fmy_stat_maf_0_rng.err_info_stat.err_sym /end OUT_MEASUREMENT
/end FUNCTION
/begin FUNCTION ERRM_ATPCDIAG "Error Management data for diagnosis ATPCDIAG"
 /begin OUT_MEASUREMENT lv_err_v_tpc_rng fmy_stat_v_tpc_rng.ctr_abc fmy_stat_v_tpc_rng.ctr_end_diag fmy_stat_v_tpc_rng.err_info_stat.reserved fmy_stat_v_tpc_rng.err_info_stat.lv_cdn_diag_stc fmy_stat_v_tpc_rng.err_info_stat.lv_lock_diag fmy_stat_v_tpc_rng.err_info_stat.lv_err_mem fmy_stat_v_tpc_rng.err_info_stat.lv_ready fmy_stat_v_tpc_rng.err_info_stat.lv_end_diag fmy_stat_v_tpc_rng.err_info_stat.lv_cdn_diag fmy_stat_v_tpc_rng.err_info_stat.err_sym lv_err_tpc_mes_plaus fmy_stat_tpc_mes_plaus.ctr_abc fmy_stat_tpc_mes_plaus.ctr_end_diag fmy_stat_tpc_mes_plaus.err_info_stat.reserved fmy_stat_tpc_mes_plaus.err_info_stat.lv_cdn_diag_stc fmy_stat_tpc_mes_plaus.err_info_stat.lv_lock_diag fmy_stat_tpc_mes_plaus.err_info_stat.lv_err_mem fmy_stat_tpc_mes_plaus.err_info_stat.lv_ready fmy_stat_tpc_mes_plaus.err_info_stat.lv_end_diag fmy_stat_tpc_mes_plaus.err_info_stat.lv_cdn_diag fmy_stat_tpc_mes_plaus.err_info_stat.err_sym /end OUT_MEASUREMENT
/end FUNCTION
/begin FUNCTION ERRM_ATACDIAG "Error Management data for diagnosis ATACDIAG"
 /begin OUT_MEASUREMENT lv_err_v_tac_rng fmy_stat_v_tac_rng.ctr_abc fmy_stat_v_tac_rng.ctr_end_diag fmy_stat_v_tac_rng.err_info_stat.reserved fmy_stat_v_tac_rng.err_info_stat.lv_cdn_diag_stc fmy_stat_v_tac_rng.err_info_stat.lv_lock_diag fmy_stat_v_tac_rng.err_info_stat.lv_err_mem fmy_stat_v_tac_rng.err_info_stat.lv_ready fmy_stat_v_tac_rng.err_info_stat.lv_end_diag fmy_stat_v_tac_rng.err_info_stat.lv_cdn_diag fmy_stat_v_tac_rng.err_info_stat.err_sym lv_err_tac_mes_plaus fmy_stat_tac_mes_plaus.ctr_abc fmy_stat_tac_mes_plaus.ctr_end_diag fmy_stat_tac_mes_plaus.err_info_stat.reserved fmy_stat_tac_mes_plaus.err_info_stat.lv_cdn_diag_stc fmy_stat_tac_mes_plaus.err_info_stat.lv_lock_diag fmy_stat_tac_mes_plaus.err_info_stat.lv_err_mem fmy_stat_tac_mes_plaus.err_info_stat.lv_ready fmy_stat_tac_mes_plaus.err_info_stat.lv_end_diag fmy_stat_tac_mes_plaus.err_info_stat.lv_cdn_diag fmy_stat_tac_mes_plaus.err_info_stat.err_sym /end OUT_MEASUREMENT
/end FUNCTION
/begin FUNCTION ERRM_AOBDFSD "Error Management data for diagnosis AOBDFSD"
 /begin OUT_MEASUREMENT lv_err_mf_is_obd fmy_stat_mf_is_obd.ctr_abc fmy_stat_mf_is_obd.ctr_end_diag fmy_stat_mf_is_obd.err_info_stat.reserved fmy_stat_mf_is_obd.err_info_stat.lv_cdn_diag_stc fmy_stat_mf_is_obd.err_info_stat.lv_lock_diag fmy_stat_mf_is_obd.err_info_stat.lv_err_mem fmy_stat_mf_is_obd.err_info_stat.lv_ready fmy_stat_mf_is_obd.err_info_stat.lv_end_diag fmy_stat_mf_is_obd.err_info_stat.lv_cdn_diag fmy_stat_mf_is_obd.err_info_stat.err_sym /end OUT_MEASUREMENT
/end FUNCTION
/begin FUNCTION ERRM_ACYBDIAG "Error Management data for diagnosis ACYBDIAG"
 /begin OUT_MEASUREMENT lv_err_cyl_bal_0 fmy_stat_cyl_bal_0.ctr_abc fmy_stat_cyl_bal_0.ctr_end_diag fmy_stat_cyl_bal_0.err_info_stat.reserved fmy_stat_cyl_bal_0.err_info_stat.lv_cdn_diag_stc fmy_stat_cyl_bal_0.err_info_stat.lv_lock_diag fmy_stat_cyl_bal_0.err_info_stat.lv_err_mem fmy_stat_cyl_bal_0.err_info_stat.lv_ready fmy_stat_cyl_bal_0.err_info_stat.lv_end_diag fmy_stat_cyl_bal_0.err_info_stat.lv_cdn_diag fmy_stat_cyl_bal_0.err_info_stat.err_sym lv_err_cyl_bal_1 fmy_stat_cyl_bal_1.ctr_abc fmy_stat_cyl_bal_1.ctr_end_diag fmy_stat_cyl_bal_1.err_info_stat.reserved fmy_stat_cyl_bal_1.err_info_stat.lv_cdn_diag_stc fmy_stat_cyl_bal_1.err_info_stat.lv_lock_diag fmy_stat_cyl_bal_1.err_info_stat.lv_err_mem fmy_stat_cyl_bal_1.err_info_stat.lv_ready fmy_stat_cyl_bal_1.err_info_stat.lv_end_diag fmy_stat_cyl_bal_1.err_info_stat.lv_cdn_diag fmy_stat_cyl_bal_1.err_info_stat.err_sym lv_err_cyl_bal_2 fmy_stat_cyl_bal_2.ctr_abc fmy_stat_cyl_bal_2.ctr_end_diag fmy_stat_cyl_bal_2.err_info_stat.reserved fmy_stat_cyl_bal_2.err_info_stat.lv_cdn_diag_stc fmy_stat_cyl_bal_2.err_info_stat.lv_lock_diag fmy_stat_cyl_bal_2.err_info_stat.lv_err_mem fmy_stat_cyl_bal_2.err_info_stat.lv_ready fmy_stat_cyl_bal_2.err_info_stat.lv_end_diag fmy_stat_cyl_bal_2.err_info_stat.lv_cdn_diag fmy_stat_cyl_bal_2.err_info_stat.err_sym lv_err_cyl_bal_3 fmy_stat_cyl_bal_3.ctr_abc fmy_stat_cyl_bal_3.ctr_end_diag fmy_stat_cyl_bal_3.err_info_stat.reserved fmy_stat_cyl_bal_3.err_info_stat.lv_cdn_diag_stc fmy_stat_cyl_bal_3.err_info_stat.lv_lock_diag fmy_stat_cyl_bal_3.err_info_stat.lv_err_mem fmy_stat_cyl_bal_3.err_info_stat.lv_ready fmy_stat_cyl_bal_3.err_info_stat.lv_end_diag fmy_stat_cyl_bal_3.err_info_stat.lv_cdn_diag fmy_stat_cyl_bal_3.err_info_stat.err_sym /end OUT_MEASUREMENT
/end FUNCTION
/begin FUNCTION ERRM_AEGRVCAD "Error Management data for diagnosis AEGRVCAD"
 /begin OUT_MEASUREMENT lv_err_egrv_0_ctl fmy_stat_egrv_0_ctl.ctr_abc fmy_stat_egrv_0_ctl.ctr_end_diag fmy_stat_egrv_0_ctl.err_info_stat.reserved fmy_stat_egrv_0_ctl.err_info_stat.lv_cdn_diag_stc fmy_stat_egrv_0_ctl.err_info_stat.lv_lock_diag fmy_stat_egrv_0_ctl.err_info_stat.lv_err_mem fmy_stat_egrv_0_ctl.err_info_stat.lv_ready fmy_stat_egrv_0_ctl.err_info_stat.lv_end_diag fmy_stat_egrv_0_ctl.err_info_stat.lv_cdn_diag fmy_stat_egrv_0_ctl.err_info_stat.err_sym lv_err_v_egrv_0_bol_ad fmy_stat_v_egrv_0_bol_ad.ctr_abc fmy_stat_v_egrv_0_bol_ad.ctr_end_diag fmy_stat_v_egrv_0_bol_ad.err_info_stat.reserved fmy_stat_v_egrv_0_bol_ad.err_info_stat.lv_cdn_diag_stc fmy_stat_v_egrv_0_bol_ad.err_info_stat.lv_lock_diag fmy_stat_v_egrv_0_bol_ad.err_info_stat.lv_err_mem fmy_stat_v_egrv_0_bol_ad.err_info_stat.lv_ready fmy_stat_v_egrv_0_bol_ad.err_info_stat.lv_end_diag fmy_stat_v_egrv_0_bol_ad.err_info_stat.lv_cdn_diag fmy_stat_v_egrv_0_bol_ad.err_info_stat.err_sym /end OUT_MEASUREMENT
/end FUNCTION
/begin FUNCTION ERRM_ATHRCAD "Error Management data for diagnosis ATHRCAD"
 /begin OUT_MEASUREMENT lv_err_thr_0_ctl fmy_stat_thr_0_ctl.ctr_abc fmy_stat_thr_0_ctl.ctr_end_diag fmy_stat_thr_0_ctl.err_info_stat.reserved fmy_stat_thr_0_ctl.err_info_stat.lv_cdn_diag_stc fmy_stat_thr_0_ctl.err_info_stat.lv_lock_diag fmy_stat_thr_0_ctl.err_info_stat.lv_err_mem fmy_stat_thr_0_ctl.err_info_stat.lv_ready fmy_stat_thr_0_ctl.err_info_stat.lv_end_diag fmy_stat_thr_0_ctl.err_info_stat.lv_cdn_diag fmy_stat_thr_0_ctl.err_info_stat.err_sym lv_err_v_thr_0_bol_ad fmy_stat_v_thr_0_bol_ad.ctr_abc fmy_stat_v_thr_0_bol_ad.ctr_end_diag fmy_stat_v_thr_0_bol_ad.err_info_stat.reserved fmy_stat_v_thr_0_bol_ad.err_info_stat.lv_cdn_diag_stc fmy_stat_v_thr_0_bol_ad.err_info_stat.lv_lock_diag fmy_stat_v_thr_0_bol_ad.err_info_stat.lv_err_mem fmy_stat_v_thr_0_bol_ad.err_info_stat.lv_ready fmy_stat_v_thr_0_bol_ad.err_info_stat.lv_end_diag fmy_stat_v_thr_0_bol_ad.err_info_stat.lv_cdn_diag fmy_stat_v_thr_0_bol_ad.err_info_stat.err_sym /end OUT_MEASUREMENT
/end FUNCTION
/begin FUNCTION ERRM_ABPACAD "Error Management data for diagnosis ABPACAD"
 /begin OUT_MEASUREMENT lv_err_bpa_0_ctl fmy_stat_bpa_0_ctl.ctr_abc fmy_stat_bpa_0_ctl.ctr_end_diag fmy_stat_bpa_0_ctl.err_info_stat.reserved fmy_stat_bpa_0_ctl.err_info_stat.lv_cdn_diag_stc fmy_stat_bpa_0_ctl.err_info_stat.lv_lock_diag fmy_stat_bpa_0_ctl.err_info_stat.lv_err_mem fmy_stat_bpa_0_ctl.err_info_stat.lv_ready fmy_stat_bpa_0_ctl.err_info_stat.lv_end_diag fmy_stat_bpa_0_ctl.err_info_stat.lv_cdn_diag fmy_stat_bpa_0_ctl.err_info_stat.err_sym lv_err_v_bpa_0_bol_ad fmy_stat_v_bpa_0_bol_ad.ctr_abc fmy_stat_v_bpa_0_bol_ad.ctr_end_diag fmy_stat_v_bpa_0_bol_ad.err_info_stat.reserved fmy_stat_v_bpa_0_bol_ad.err_info_stat.lv_cdn_diag_stc fmy_stat_v_bpa_0_bol_ad.err_info_stat.lv_lock_diag fmy_stat_v_bpa_0_bol_ad.err_info_stat.lv_err_mem fmy_stat_v_bpa_0_bol_ad.err_info_stat.lv_ready fmy_stat_v_bpa_0_bol_ad.err_info_stat.lv_end_diag fmy_stat_v_bpa_0_bol_ad.err_info_stat.lv_cdn_diag fmy_stat_v_bpa_0_bol_ad.err_info_stat.err_sym /end OUT_MEASUREMENT
/end FUNCTION
/begin FUNCTION ERRM_ABYPCAD "Error Management data for diagnosis ABYPCAD"
 /begin OUT_MEASUREMENT lv_err_byp_0_ctl fmy_stat_byp_0_ctl.ctr_abc fmy_stat_byp_0_ctl.ctr_end_diag fmy_stat_byp_0_ctl.err_info_stat.reserved fmy_stat_byp_0_ctl.err_info_stat.lv_cdn_diag_stc fmy_stat_byp_0_ctl.err_info_stat.lv_lock_diag fmy_stat_byp_0_ctl.err_info_stat.lv_err_mem fmy_stat_byp_0_ctl.err_info_stat.lv_ready fmy_stat_byp_0_ctl.err_info_stat.lv_end_diag fmy_stat_byp_0_ctl.err_info_stat.lv_cdn_diag fmy_stat_byp_0_ctl.err_info_stat.err_sym lv_err_v_byp_0_bol_ad fmy_stat_v_byp_0_bol_ad.ctr_abc fmy_stat_v_byp_0_bol_ad.ctr_end_diag fmy_stat_v_byp_0_bol_ad.err_info_stat.reserved fmy_stat_v_byp_0_bol_ad.err_info_stat.lv_cdn_diag_stc fmy_stat_v_byp_0_bol_ad.err_info_stat.lv_lock_diag fmy_stat_v_byp_0_bol_ad.err_info_stat.lv_err_mem fmy_stat_v_byp_0_bol_ad.err_info_stat.lv_ready fmy_stat_v_byp_0_bol_ad.err_info_stat.lv_end_diag fmy_stat_v_byp_0_bol_ad.err_info_stat.lv_cdn_diag fmy_stat_v_byp_0_bol_ad.err_info_stat.err_sym /end OUT_MEASUREMENT
/end FUNCTION
/begin FUNCTION ERRM_AMAPCTLD "Error Management data for diagnosis AMAPCTLD"
 /begin OUT_MEASUREMENT lv_err_map_ctl_min fmy_stat_map_ctl_min.ctr_abc fmy_stat_map_ctl_min.ctr_end_diag fmy_stat_map_ctl_min.err_info_stat.reserved fmy_stat_map_ctl_min.err_info_stat.lv_cdn_diag_stc fmy_stat_map_ctl_min.err_info_stat.lv_lock_diag fmy_stat_map_ctl_min.err_info_stat.lv_err_mem fmy_stat_map_ctl_min.err_info_stat.lv_ready fmy_stat_map_ctl_min.err_info_stat.lv_end_diag fmy_stat_map_ctl_min.err_info_stat.lv_cdn_diag fmy_stat_map_ctl_min.err_info_stat.err_sym lv_err_map_ctl_max fmy_stat_map_ctl_max.ctr_abc fmy_stat_map_ctl_max.ctr_end_diag fmy_stat_map_ctl_max.err_info_stat.reserved fmy_stat_map_ctl_max.err_info_stat.lv_cdn_diag_stc fmy_stat_map_ctl_max.err_info_stat.lv_lock_diag fmy_stat_map_ctl_max.err_info_stat.lv_err_mem fmy_stat_map_ctl_max.err_info_stat.lv_ready fmy_stat_map_ctl_max.err_info_stat.lv_end_diag fmy_stat_map_ctl_max.err_info_stat.lv_cdn_diag fmy_stat_map_ctl_max.err_info_stat.err_sym /end OUT_MEASUREMENT
/end FUNCTION
/begin FUNCTION ERRM_AOBDEGR "Error Management data for diagnosis AOBDEGR"
 /begin OUT_MEASUREMENT lv_err_maf_egr_thr_obd fmy_stat_maf_egr_thr_obd.ctr_abc fmy_stat_maf_egr_thr_obd.ctr_end_diag fmy_stat_maf_egr_thr_obd.err_info_stat.reserved fmy_stat_maf_egr_thr_obd.err_info_stat.lv_cdn_diag_stc fmy_stat_maf_egr_thr_obd.err_info_stat.lv_lock_diag fmy_stat_maf_egr_thr_obd.err_info_stat.lv_err_mem fmy_stat_maf_egr_thr_obd.err_info_stat.lv_ready fmy_stat_maf_egr_thr_obd.err_info_stat.lv_end_diag fmy_stat_maf_egr_thr_obd.err_info_stat.lv_cdn_diag fmy_stat_maf_egr_thr_obd.err_info_stat.err_sym lv_err_maf_dif_egr_thr_obd fmy_stat_maf_dif_egr_thr_obd.ctr_abc fmy_stat_maf_dif_egr_thr_obd.ctr_end_diag fmy_stat_maf_dif_egr_thr_obd.err_info_stat.reserved fmy_stat_maf_dif_egr_thr_obd.err_info_stat.lv_cdn_diag_stc fmy_stat_maf_dif_egr_thr_obd.err_info_stat.lv_lock_diag fmy_stat_maf_dif_egr_thr_obd.err_info_stat.lv_err_mem fmy_stat_maf_dif_egr_thr_obd.err_info_stat.lv_ready fmy_stat_maf_dif_egr_thr_obd.err_info_stat.lv_end_diag fmy_stat_maf_dif_egr_thr_obd.err_info_stat.lv_cdn_diag fmy_stat_maf_dif_egr_thr_obd.err_info_stat.err_sym lv_err_map_dif_egr_thr_obd fmy_stat_map_dif_egr_thr_obd.ctr_abc fmy_stat_map_dif_egr_thr_obd.ctr_end_diag fmy_stat_map_dif_egr_thr_obd.err_info_stat.reserved fmy_stat_map_dif_egr_thr_obd.err_info_stat.lv_cdn_diag_stc fmy_stat_map_dif_egr_thr_obd.err_info_stat.lv_lock_diag fmy_stat_map_dif_egr_thr_obd.err_info_stat.lv_err_mem fmy_stat_map_dif_egr_thr_obd.err_info_stat.lv_ready fmy_stat_map_dif_egr_thr_obd.err_info_stat.lv_end_diag fmy_stat_map_dif_egr_thr_obd.err_info_stat.lv_cdn_diag fmy_stat_map_dif_egr_thr_obd.err_info_stat.err_sym /end OUT_MEASUREMENT
/end FUNCTION
/begin FUNCTION ERRM_AVSDIAG "Error Management data for diagnosis AVSDIAG"
 /begin OUT_MEASUREMENT lv_err_vs fmy_stat_vs.ctr_abc fmy_stat_vs.ctr_end_diag fmy_stat_vs.err_info_stat.reserved fmy_stat_vs.err_info_stat.lv_cdn_diag_stc fmy_stat_vs.err_info_stat.lv_lock_diag fmy_stat_vs.err_info_stat.lv_err_mem fmy_stat_vs.err_info_stat.lv_ready fmy_stat_vs.err_info_stat.lv_end_diag fmy_stat_vs.err_info_stat.lv_cdn_diag fmy_stat_vs.err_info_stat.err_sym /end OUT_MEASUREMENT
/end FUNCTION
/begin FUNCTION ERRM_ACSDIAG "Error Management data for diagnosis ACSDIAG"
 /begin OUT_MEASUREMENT lv_err_cs fmy_stat_cs.ctr_abc fmy_stat_cs.ctr_end_diag fmy_stat_cs.err_info_stat.reserved fmy_stat_cs.err_info_stat.lv_cdn_diag_stc fmy_stat_cs.err_info_stat.lv_lock_diag fmy_stat_cs.err_info_stat.lv_err_mem fmy_stat_cs.err_info_stat.lv_ready fmy_stat_cs.err_info_stat.lv_end_diag fmy_stat_cs.err_info_stat.lv_cdn_diag fmy_stat_cs.err_info_stat.err_sym /end OUT_MEASUREMENT
/end FUNCTION
/begin FUNCTION ERRM_ABRAKE_D "Error Management data for diagnosis ABRAKE_D"
 /begin OUT_MEASUREMENT lv_err_bls fmy_stat_bls.ctr_abc fmy_stat_bls.ctr_end_diag fmy_stat_bls.err_info_stat.reserved fmy_stat_bls.err_info_stat.lv_cdn_diag_stc fmy_stat_bls.err_info_stat.lv_lock_diag fmy_stat_bls.err_info_stat.lv_err_mem fmy_stat_bls.err_info_stat.lv_ready fmy_stat_bls.err_info_stat.lv_end_diag fmy_stat_bls.err_info_stat.lv_cdn_diag fmy_stat_bls.err_info_stat.err_sym lv_err_bls_bts_dece fmy_stat_bls_bts_dece.ctr_abc fmy_stat_bls_bts_dece.ctr_end_diag fmy_stat_bls_bts_dece.err_info_stat.reserved fmy_stat_bls_bts_dece.err_info_stat.lv_cdn_diag_stc fmy_stat_bls_bts_dece.err_info_stat.lv_lock_diag fmy_stat_bls_bts_dece.err_info_stat.lv_err_mem fmy_stat_bls_bts_dece.err_info_stat.lv_ready fmy_stat_bls_bts_dece.err_info_stat.lv_end_diag fmy_stat_bls_bts_dece.err_info_stat.lv_cdn_diag fmy_stat_bls_bts_dece.err_info_stat.err_sym lv_err_bls_bts_plaus fmy_stat_bls_bts_plaus.ctr_abc fmy_stat_bls_bts_plaus.ctr_end_diag fmy_stat_bls_bts_plaus.err_info_stat.reserved fmy_stat_bls_bts_plaus.err_info_stat.lv_cdn_diag_stc fmy_stat_bls_bts_plaus.err_info_stat.lv_lock_diag fmy_stat_bls_bts_plaus.err_info_stat.lv_err_mem fmy_stat_bls_bts_plaus.err_info_stat.lv_ready fmy_stat_bls_bts_plaus.err_info_stat.lv_end_diag fmy_stat_bls_bts_plaus.err_info_stat.lv_cdn_diag fmy_stat_bls_bts_plaus.err_info_stat.err_sym /end OUT_MEASUREMENT
/end FUNCTION
/end MODULE
/end PROJECT
