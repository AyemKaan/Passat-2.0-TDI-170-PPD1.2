ASAP2_VERSION 1 41
/begin PROJECT SN0 "SIMOS PPD"
/begin HEADER "_default_HeaderComment" PROJECT_NO PRJ_NUM /end HEADER
/begin MODULE _default_ModuleName "_default_ModuleLongIdentifier"
/begin MOD_COMMON "_default_ModCommonComment" DEPOSIT ABSOLUTE BYTE_ORDER MSB_FIRST ALIGNMENT_BYTE 1 ALIGNMENT_WORD 2 ALIGNMENT_LONG 4 ALIGNMENT_FLOAT32_IEEE 4 ALIGNMENT_FLOAT64_IEEE 8 /end MOD_COMMON
/begin CHARACTERISTIC c_abc_inc_mon_3 "anti bounce counter increment for diagnosis instance MON_3" VALUE 0x848222 _REC_VAL_20_u1 255. _CNV_A_R_LINEAR_____0_CM 0. 255. DISPLAY_IDENTIFIER C_ABC_INC_MON_3 FORMAT "%3.0" /end CHARACTERISTIC
/begin CHARACTERISTIC c_abc_max_mon_3 "maximum value of anti bounce counter for diagnosis instance MON_3" VALUE 0x8482a4 _REC_VAL_20_u1 255. _CNV_A_R_LINEAR_____0_CM 0. 255. DISPLAY_IDENTIFIER C_ABC_MAX_MON_3 FORMAT "%3.0" /end CHARACTERISTIC
/begin CHARACTERISTIC c_abc_inc_v_tco_1_rng "" VALUE 0x84825f _REC_VAL_20_u1 255. _CNV_A_R_LINEAR_____0_CM 0. 255. DISPLAY_IDENTIFIER C_ABC_INC_V_TCO_1_RNG FORMAT "%3.0" /end CHARACTERISTIC
/begin CHARACTERISTIC c_abc_max_v_tco_1_rng "" VALUE 0x8482e1 _REC_VAL_20_u1 255. _CNV_A_R_LINEAR_____0_CM 0. 255. DISPLAY_IDENTIFIER C_ABC_MAX_V_TCO_1_RNG FORMAT "%3.0" /end CHARACTERISTIC
/begin CHARACTERISTIC c_abc_inc_v_tco_2_rng "" VALUE 0x848260 _REC_VAL_20_u1 255. _CNV_A_R_LINEAR_____0_CM 0. 255. DISPLAY_IDENTIFIER C_ABC_INC_V_TCO_2_RNG FORMAT "%3.0" /end CHARACTERISTIC
/begin CHARACTERISTIC c_abc_max_v_tco_2_rng "" VALUE 0x8482e2 _REC_VAL_20_u1 255. _CNV_A_R_LINEAR_____0_CM 0. 255. DISPLAY_IDENTIFIER C_ABC_MAX_V_TCO_2_RNG FORMAT "%3.0" /end CHARACTERISTIC
/begin CHARACTERISTIC c_abc_inc_tco_1_mes_grd "" VALUE 0x848247 _REC_VAL_20_u1 255. _CNV_A_R_LINEAR_____0_CM 0. 255. DISPLAY_IDENTIFIER C_ABC_INC_TCO_1_MES_GRD FORMAT "%3.0" /end CHARACTERISTIC
/begin CHARACTERISTIC c_abc_max_tco_1_mes_grd "" VALUE 0x8482c9 _REC_VAL_20_u1 255. _CNV_A_R_LINEAR_____0_CM 0. 255. DISPLAY_IDENTIFIER C_ABC_MAX_TCO_1_MES_GRD FORMAT "%3.0" /end CHARACTERISTIC
/begin CHARACTERISTIC c_abc_inc_tco_2_mes_grd "" VALUE 0x848248 _REC_VAL_20_u1 255. _CNV_A_R_LINEAR_____0_CM 0. 255. DISPLAY_IDENTIFIER C_ABC_INC_TCO_2_MES_GRD FORMAT "%3.0" /end CHARACTERISTIC
/begin CHARACTERISTIC c_abc_max_tco_2_mes_grd "" VALUE 0x8482ca _REC_VAL_20_u1 255. _CNV_A_R_LINEAR_____0_CM 0. 255. DISPLAY_IDENTIFIER C_ABC_MAX_TCO_2_MES_GRD FORMAT "%3.0" /end CHARACTERISTIC
/begin CHARACTERISTIC c_abc_inc_tco_mes_plaus "" VALUE 0x848249 _REC_VAL_20_u1 255. _CNV_A_R_LINEAR_____0_CM 0. 255. DISPLAY_IDENTIFIER C_ABC_INC_TCO_MES_PLAUS FORMAT "%3.0" /end CHARACTERISTIC
/begin CHARACTERISTIC c_abc_max_tco_mes_plaus "" VALUE 0x8482cb _REC_VAL_20_u1 255. _CNV_A_R_LINEAR_____0_CM 0. 255. DISPLAY_IDENTIFIER C_ABC_MAX_TCO_MES_PLAUS FORMAT "%3.0" /end CHARACTERISTIC
/begin CHARACTERISTIC c_v_tco_max_diag "" VALUE 0x85c27c _REC_VAL_20_u2 4.9951171875 _CNV_A_R_LINEAR_____33_CM 0. 4.9951171875 DISPLAY_IDENTIFIER C_V_TCO_MAX_DIAG FORMAT "%3.2" /end CHARACTERISTIC
/begin CHARACTERISTIC c_v_tco_min_diag "" VALUE 0x85c27e _REC_VAL_20_u2 4.9951171875 _CNV_A_R_LINEAR_____33_CM 0. 4.9951171875 DISPLAY_IDENTIFIER C_V_TCO_MIN_DIAG FORMAT "%3.2" /end CHARACTERISTIC
/begin MEASUREMENT lv_err_tco_mes "" UBYTE _CNV_S_2_RANGE______28_CM 1 0. 0. 1. DISPLAY_IDENTIFIER LV_ERR_TCO_MES ECU_ADDRESS 0x7fb44b /end MEASUREMENT
/begin MEASUREMENT lv_err_tco_1_mes "" UBYTE _CNV_S_2_RANGE______28_CM 1 0. 0. 1. DISPLAY_IDENTIFIER LV_ERR_TCO_1_MES ECU_ADDRESS 0x7fb44c /end MEASUREMENT
/begin MEASUREMENT lv_err_tco_2_mes "" UBYTE _CNV_S_2_RANGE______28_CM 1 0. 0. 1. DISPLAY_IDENTIFIER LV_ERR_TCO_2_MES ECU_ADDRESS 0x7fb44d /end MEASUREMENT
/begin CHARACTERISTIC c_tfu_min_tco_diag "" VALUE 0x85c191 _REC_VAL_20_u1 255. _CNV_A_R_LINEAR_____18_CM -50. 205. DISPLAY_IDENTIFIER C_TFU_MIN_TCO_DIAG FORMAT "%4.3" /end CHARACTERISTIC
/begin MEASUREMENT lv_rst_diag_tco_mes_plaus "" UBYTE _CNV_S_2_RANGE______11_CM 1 0. 0. 1. DISPLAY_IDENTIFIER LV_RST_DIAG_TCO_MES_PLAUS ECU_ADDRESS 0x7fb9f0 /end MEASUREMENT
/begin MEASUREMENT tco_mes_st_diag "" UBYTE _CNV_A_R_LINEAR_____18_CM 1 0. -50. 205. DISPLAY_IDENTIFIER TCO_MES_ST_DIAG ECU_ADDRESS 0x7fb9ef FORMAT "%3.0" /end MEASUREMENT
/begin MEASUREMENT ctr_inh_temp_diag "" UWORD _CNV_A_R_LINEAR_____16_CM 1 0. 0. 65535. DISPLAY_IDENTIFIER CTR_INH_TEMP_DIAG ECU_ADDRESS 0x7fa598 BYTE_ORDER MSB_LAST FORMAT "%5.0" /end MEASUREMENT
/begin CHARACTERISTIC c_abc_inc_v_map_rng "" VALUE 0x84825c _REC_VAL_20_u1 255. _CNV_A_R_LINEAR_____0_CM 0. 255. DISPLAY_IDENTIFIER C_ABC_INC_V_MAP_RNG FORMAT "%3.0" /end CHARACTERISTIC
/begin CHARACTERISTIC c_abc_max_v_map_rng "" VALUE 0x8482de _REC_VAL_20_u1 255. _CNV_A_R_LINEAR_____0_CM 0. 255. DISPLAY_IDENTIFIER C_ABC_MAX_V_MAP_RNG FORMAT "%3.0" /end CHARACTERISTIC
/begin CHARACTERISTIC c_abc_inc_map_amp_ofs "" VALUE 0x84821b _REC_VAL_20_u1 255. _CNV_A_R_LINEAR_____0_CM 0. 255. DISPLAY_IDENTIFIER C_ABC_INC_MAP_AMP_OFS FORMAT "%3.0" /end CHARACTERISTIC
/begin CHARACTERISTIC c_abc_max_map_amp_ofs "" VALUE 0x84829d _REC_VAL_20_u1 255. _CNV_A_R_LINEAR_____0_CM 0. 255. DISPLAY_IDENTIFIER C_ABC_MAX_MAP_AMP_OFS FORMAT "%3.0" /end CHARACTERISTIC
/begin CHARACTERISTIC c_abc_inc_map_is_ofs "" VALUE 0x84821f _REC_VAL_20_u1 255. _CNV_A_R_LINEAR_____0_CM 0. 255. DISPLAY_IDENTIFIER C_ABC_INC_MAP_IS_OFS FORMAT "%3.0" /end CHARACTERISTIC
/begin CHARACTERISTIC c_abc_max_map_is_ofs "" VALUE 0x8482a1 _REC_VAL_20_u1 255. _CNV_A_R_LINEAR_____0_CM 0. 255. DISPLAY_IDENTIFIER C_ABC_MAX_MAP_IS_OFS FORMAT "%3.0" /end CHARACTERISTIC
/begin CHARACTERISTIC c_v_map_min_diag "" VALUE 0x85c234 _REC_VAL_20_u2 4.9999237 _CNV_A_R_LINEAR_____52_CM 0. 4.9999237 DISPLAY_IDENTIFIER C_V_MAP_MIN_DIAG FORMAT "%6.5" /end CHARACTERISTIC
/begin CHARACTERISTIC c_v_map_max_diag "" VALUE 0x85c232 _REC_VAL_20_u2 4.9999237 _CNV_A_R_LINEAR_____52_CM 0. 4.9999237 DISPLAY_IDENTIFIER C_V_MAP_MAX_DIAG FORMAT "%6.5" /end CHARACTERISTIC
/begin CHARACTERISTIC c_map_amp_ofs_min_diag "" VALUE 0x85bf2c _REC_VAL_20_u2 5434. _CNV_A_R_LINEAR_____21_CM 0. 5434. DISPLAY_IDENTIFIER C_MAP_AMP_OFS_MIN_DIAG FORMAT "%6.2" /end CHARACTERISTIC
/begin CHARACTERISTIC c_map_is_ofs_max_diag "" VALUE 0x85bf32 _REC_VAL_20_u2 5434. _CNV_A_R_LINEAR_____21_CM 0. 5434. DISPLAY_IDENTIFIER C_MAP_IS_OFS_MAX_DIAG FORMAT "%6.2" /end CHARACTERISTIC
/begin CHARACTERISTIC c_map_amp_ofs_max_diag "" VALUE 0x85bf2a _REC_VAL_20_u2 5434. _CNV_A_R_LINEAR_____21_CM 0. 5434. DISPLAY_IDENTIFIER C_MAP_AMP_OFS_MAX_DIAG FORMAT "%6.2" /end CHARACTERISTIC
/begin CHARACTERISTIC c_map_is_ofs_min_diag "" VALUE 0x85bf34 _REC_VAL_20_u2 5434. _CNV_A_R_LINEAR_____21_CM 0. 5434. DISPLAY_IDENTIFIER C_MAP_IS_OFS_MIN_DIAG FORMAT "%6.2" /end CHARACTERISTIC
/begin AXIS_PTS ldp_amp_ip_fac_map_is_ofs_diag "" 0x841146 amp _REC_AXS_20_u2 5434. _CNV_A_R_LINEAR_____21_CM 4 0. 5434. FORMAT "%4.3" /end AXIS_PTS
/begin CHARACTERISTIC ip_fac_map_is_ofs_diag__amp "BPA_SP: TIA correction on MAP setpoint" CURVE 0x84bd62 _REC_CUR_20_u2_u2 1.9999696 _CNV_A_R_LINEAR_____53_CM 0. 1.9999696 DISPLAY_IDENTIFIER IP_FAC_MAP_IS_OFS_DIAG__AMP FORMAT "%6.5"
 /begin AXIS_DESCR COM_AXIS amp _CNV_A_R_LINEAR_____21_CM 4 0. 5434. FORMAT "%4.3" AXIS_PTS_REF ldp_amp_ip_fac_map_is_ofs_diag /end AXIS_DESCR
/end CHARACTERISTIC
/begin CHARACTERISTIC c_ctr_map_is_ofs_diag "" VALUE 0x85bdaf _REC_VAL_20_u1 255. _CNV_A_R_LINEAR_____0_CM 0. 255. DISPLAY_IDENTIFIER C_CTR_MAP_IS_OFS_DIAG FORMAT "%3.0" /end CHARACTERISTIC
/begin MEASUREMENT lv_err_map_mes "" UBYTE _CNV_S_2_RANGE______28_CM 1 0. 0. 1. DISPLAY_IDENTIFIER LV_ERR_MAP_MES ECU_ADDRESS 0x7fb44e /end MEASUREMENT
/begin MEASUREMENT ctr_map_is_ofs "" UBYTE _CNV_A_R_LINEAR_____0_CM 1 0. 0. 255. DISPLAY_IDENTIFIER CTR_MAP_IS_OFS ECU_ADDRESS 0x7fb9f4 FORMAT "%3.0" /end MEASUREMENT
/begin CHARACTERISTIC c_abc_inc_map_mes_grd "" VALUE 0x848220 _REC_VAL_20_u1 255. _CNV_A_R_LINEAR_____0_CM 0. 255. DISPLAY_IDENTIFIER C_ABC_INC_MAP_MES_GRD FORMAT "%3.0" /end CHARACTERISTIC
/begin CHARACTERISTIC c_abc_max_map_mes_grd "" VALUE 0x8482a2 _REC_VAL_20_u1 255. _CNV_A_R_LINEAR_____0_CM 0. 255. DISPLAY_IDENTIFIER C_ABC_MAX_MAP_MES_GRD FORMAT "%3.0" /end CHARACTERISTIC
/begin MEASUREMENT lv_err_vcc_map "" UBYTE _CNV_S_2_RANGE______28_CM 1 0. 0. 1. DISPLAY_IDENTIFIER LV_ERR_VCC_MAP ECU_ADDRESS 0x7fb44f /end MEASUREMENT
/begin MEASUREMENT lv_inh_map_amp_ofs "" UBYTE _CNV_S_2_RANGE______11_CM 1 0. 0. 1. DISPLAY_IDENTIFIER LV_INH_MAP_AMP_OFS ECU_ADDRESS 0x7fb450 /end MEASUREMENT
/begin MEASUREMENT lv_inh_map_is_ofs "" UBYTE _CNV_S_2_RANGE______11_CM 1 0. 0. 1. DISPLAY_IDENTIFIER LV_INH_MAP_IS_OFS ECU_ADDRESS 0x7fb451 /end MEASUREMENT
/begin CHARACTERISTIC c_map_mes_grd_diag "" VALUE 0x85bf3a _REC_VAL_20_u2 5434. _CNV_A_R_LINEAR_____54_CM 0. 5434. DISPLAY_IDENTIFIER C_MAP_MES_GRD_DIAG FORMAT "%6.2" /end CHARACTERISTIC
/begin CHARACTERISTIC c_tco_map_amp_ofs_diag "" VALUE 0x85c14c _REC_VAL_20_u2 255. _CNV_A_R_LINEAR_____18_CM -50. 205. DISPLAY_IDENTIFIER C_TCO_MAP_AMP_OFS_DIAG FORMAT "%6.2" /end CHARACTERISTIC
/begin CHARACTERISTIC c_vb_min_maf_diag "" VALUE 0x85c2b8 _REC_VAL_20_u1 28.8 _CNV_A_R_LINEAR_____48_CM 0. 28.8 DISPLAY_IDENTIFIER C_VB_MIN_MAF_DIAG FORMAT "%3.1" /end CHARACTERISTIC
/begin MEASUREMENT lv_err_maf_0_mes "" UBYTE _CNV_S_2_RANGE______28_CM 1 0. 0. 1. DISPLAY_IDENTIFIER LV_ERR_MAF_0_MES ECU_ADDRESS 0x7fb453 /end MEASUREMENT
/begin MEASUREMENT lv_err_maf_mes "" UBYTE _CNV_S_2_RANGE______28_CM 1 0. 0. 1. DISPLAY_IDENTIFIER LV_ERR_MAF_MES ECU_ADDRESS 0x7fb452 /end MEASUREMENT
/begin CHARACTERISTIC c_abc_inc_egrv_0_ctl "" VALUE 0x848211 _REC_VAL_20_u1 255. _CNV_A_R_LINEAR_____0_CM 0. 255. DISPLAY_IDENTIFIER C_ABC_INC_EGRV_0_CTL FORMAT "%3.0" /end CHARACTERISTIC
/begin CHARACTERISTIC c_abc_max_egrv_0_ctl "" VALUE 0x848293 _REC_VAL_20_u1 255. _CNV_A_R_LINEAR_____0_CM 0. 255. DISPLAY_IDENTIFIER C_ABC_MAX_EGRV_0_CTL FORMAT "%3.0" /end CHARACTERISTIC
/begin CHARACTERISTIC c_abc_inc_v_egrv_0_bol_ad "" VALUE 0x848256 _REC_VAL_20_u1 255. _CNV_A_R_LINEAR_____0_CM 0. 255. DISPLAY_IDENTIFIER C_ABC_INC_V_EGRV_0_BOL_AD FORMAT "%3.0" /end CHARACTERISTIC
/begin CHARACTERISTIC c_abc_max_v_egrv_0_bol_ad "" VALUE 0x8482d8 _REC_VAL_20_u1 255. _CNV_A_R_LINEAR_____0_CM 0. 255. DISPLAY_IDENTIFIER C_ABC_MAX_V_EGRV_0_BOL_AD FORMAT "%3.0" /end CHARACTERISTIC
/begin MEASUREMENT ctr_bas_egrv_0_ctl "" UBYTE _CNV_A_R_LINEAR_____0_CM 1 0. 0. 255. DISPLAY_IDENTIFIER CTR_BAS_EGRV_0_CTL ECU_ADDRESS 0x7fb45f FORMAT "%3.0" /end MEASUREMENT
/begin MEASUREMENT ctr_eve_egrv_0_ctl "" UBYTE _CNV_A_R_LINEAR_____0_CM 1 0. 0. 255. DISPLAY_IDENTIFIER CTR_EVE_EGRV_0_CTL ECU_ADDRESS 0x7fb45e FORMAT "%3.0" /end MEASUREMENT
/begin MEASUREMENT t_dly_diag_egrv_ctl_0 "" UWORD _CNV_A_R_LINEAR_____59_CM 1 0. 0. 655.35 DISPLAY_IDENTIFIER T_DLY_DIAG_EGRV_CTL_0 ECU_ADDRESS 0x7fa5a2 BYTE_ORDER MSB_LAST FORMAT "%5.2" /end MEASUREMENT
/begin CHARACTERISTIC c_ctl_dif_egrv_0_min_diag "" VALUE 0x85bd7a _REC_VAL_20_s2 99.99694800000002 _CNV_A_R_LINEAR_____12_CM -100. -3.052e-003 DISPLAY_IDENTIFIER C_CTL_DIF_EGRV_0_MIN_DIAG /end CHARACTERISTIC
/begin CHARACTERISTIC c_ctl_dif_egrv_0_max_diag "" VALUE 0x85bd78 _REC_VAL_20_s2 99.996948242 _CNV_A_R_LINEAR_____50_CM 0. 99.996948242 DISPLAY_IDENTIFIER C_CTL_DIF_EGRV_0_MAX_DIAG /end CHARACTERISTIC
/begin CHARACTERISTIC c_ctr_eve_egrv_0_ctl "" VALUE 0x85bda3 _REC_VAL_20_u1 255. _CNV_A_R_LINEAR_____0_CM 0. 255. DISPLAY_IDENTIFIER C_CTR_EVE_EGRV_0_CTL FORMAT "%3.0" /end CHARACTERISTIC
/begin CHARACTERISTIC c_ctr_bas_egrv_0_ctl "" VALUE 0x85bd9a _REC_VAL_20_u1 255. _CNV_A_R_LINEAR_____0_CM 0. 255. DISPLAY_IDENTIFIER C_CTR_BAS_EGRV_0_CTL FORMAT "%3.0" /end CHARACTERISTIC
/begin CHARACTERISTIC c_t_dly_diag_egrv_ctl "" VALUE 0x85c0aa _REC_VAL_20_u2 655.35 _CNV_A_R_LINEAR_____59_CM 0. 655.35 DISPLAY_IDENTIFIER C_T_DLY_DIAG_EGRV_CTL FORMAT "%5.2" /end CHARACTERISTIC
/begin CHARACTERISTIC c_abc_inc_thr_0_ctl "" VALUE 0x84824b _REC_VAL_20_u1 255. _CNV_A_R_LINEAR_____0_CM 0. 255. DISPLAY_IDENTIFIER C_ABC_INC_THR_0_CTL FORMAT "%3.0" /end CHARACTERISTIC
/begin CHARACTERISTIC c_abc_max_thr_0_ctl "" VALUE 0x8482cd _REC_VAL_20_u1 255. _CNV_A_R_LINEAR_____0_CM 0. 255. DISPLAY_IDENTIFIER C_ABC_MAX_THR_0_CTL FORMAT "%3.0" /end CHARACTERISTIC
/begin CHARACTERISTIC c_abc_inc_v_thr_0_bol_ad "" VALUE 0x848262 _REC_VAL_20_u1 255. _CNV_A_R_LINEAR_____0_CM 0. 255. DISPLAY_IDENTIFIER C_ABC_INC_V_THR_0_BOL_AD FORMAT "%3.0" /end CHARACTERISTIC
/begin CHARACTERISTIC c_abc_max_v_thr_0_bol_ad "" VALUE 0x8482e4 _REC_VAL_20_u1 255. _CNV_A_R_LINEAR_____0_CM 0. 255. DISPLAY_IDENTIFIER C_ABC_MAX_V_THR_0_BOL_AD FORMAT "%3.0" /end CHARACTERISTIC
/begin MEASUREMENT ctr_bas_thr_0_ctl "" UBYTE _CNV_A_R_LINEAR_____0_CM 1 0. 0. 255. DISPLAY_IDENTIFIER CTR_BAS_THR_0_CTL ECU_ADDRESS 0x7fb461 FORMAT "%3.0" /end MEASUREMENT
/begin MEASUREMENT ctr_eve_thr_0_ctl "" UBYTE _CNV_A_R_LINEAR_____0_CM 1 0. 0. 255. DISPLAY_IDENTIFIER CTR_EVE_THR_0_CTL ECU_ADDRESS 0x7fb460 FORMAT "%3.0" /end MEASUREMENT
/begin MEASUREMENT t_dly_diag_thr_ctl_0 "" UWORD _CNV_A_R_LINEAR_____59_CM 1 0. 0. 655.35 DISPLAY_IDENTIFIER T_DLY_DIAG_THR_CTL_0 ECU_ADDRESS 0x7fa5a4 BYTE_ORDER MSB_LAST FORMAT "%5.2" /end MEASUREMENT
/begin CHARACTERISTIC c_ctl_dif_thr_0_min_diag "" VALUE 0x85bd82 _REC_VAL_20_s2 99.99694800000002 _CNV_A_R_LINEAR_____12_CM -100. -3.052e-003 DISPLAY_IDENTIFIER C_CTL_DIF_THR_0_MIN_DIAG /end CHARACTERISTIC
/begin CHARACTERISTIC c_ctl_dif_thr_0_max_diag "" VALUE 0x85bd80 _REC_VAL_20_s2 99.996948242 _CNV_A_R_LINEAR_____50_CM 0. 99.996948242 DISPLAY_IDENTIFIER C_CTL_DIF_THR_0_MAX_DIAG /end CHARACTERISTIC
/begin CHARACTERISTIC c_ctr_eve_thr_0_ctl "" VALUE 0x85bda5 _REC_VAL_20_u1 255. _CNV_A_R_LINEAR_____0_CM 0. 255. DISPLAY_IDENTIFIER C_CTR_EVE_THR_0_CTL FORMAT "%3.0" /end CHARACTERISTIC
/begin CHARACTERISTIC c_ctr_bas_thr_0_ctl "" VALUE 0x85bd9c _REC_VAL_20_u1 255. _CNV_A_R_LINEAR_____0_CM 0. 255. DISPLAY_IDENTIFIER C_CTR_BAS_THR_0_CTL FORMAT "%3.0" /end CHARACTERISTIC
/begin CHARACTERISTIC c_t_dly_diag_thr_ctl "" VALUE 0x85c0ae _REC_VAL_20_u2 655.35 _CNV_A_R_LINEAR_____59_CM 0. 655.35 DISPLAY_IDENTIFIER C_T_DLY_DIAG_THR_CTL FORMAT "%5.2" /end CHARACTERISTIC
/begin CHARACTERISTIC c_abc_inc_bpa_0_ctl "" VALUE 0x8481ee _REC_VAL_20_u1 255. _CNV_A_R_LINEAR_____0_CM 0. 255. DISPLAY_IDENTIFIER C_ABC_INC_BPA_0_CTL FORMAT "%3.0" /end CHARACTERISTIC
/begin CHARACTERISTIC c_abc_max_bpa_0_ctl "" VALUE 0x848270 _REC_VAL_20_u1 255. _CNV_A_R_LINEAR_____0_CM 0. 255. DISPLAY_IDENTIFIER C_ABC_MAX_BPA_0_CTL FORMAT "%3.0" /end CHARACTERISTIC
/begin CHARACTERISTIC c_abc_inc_v_bpa_0_bol_ad "" VALUE 0x848252 _REC_VAL_20_u1 255. _CNV_A_R_LINEAR_____0_CM 0. 255. DISPLAY_IDENTIFIER C_ABC_INC_V_BPA_0_BOL_AD FORMAT "%3.0" /end CHARACTERISTIC
/begin CHARACTERISTIC c_abc_max_v_bpa_0_bol_ad "" VALUE 0x8482d4 _REC_VAL_20_u1 255. _CNV_A_R_LINEAR_____0_CM 0. 255. DISPLAY_IDENTIFIER C_ABC_MAX_V_BPA_0_BOL_AD FORMAT "%3.0" /end CHARACTERISTIC
/begin MEASUREMENT ctr_bas_bpa_0_ctl "" UBYTE _CNV_A_R_LINEAR_____0_CM 1 0. 0. 255. DISPLAY_IDENTIFIER CTR_BAS_BPA_0_CTL ECU_ADDRESS 0x7fca2d FORMAT "%3.0" /end MEASUREMENT
/begin MEASUREMENT ctr_eve_bpa_0_ctl "" UBYTE _CNV_A_R_LINEAR_____0_CM 1 0. 0. 255. DISPLAY_IDENTIFIER CTR_EVE_BPA_0_CTL ECU_ADDRESS 0x7fca2c FORMAT "%3.0" /end MEASUREMENT
/begin MEASUREMENT t_dly_diag_bpa_ctl_0 "" UWORD _CNV_A_R_LINEAR_____59_CM 1 0. 0. 655.35 DISPLAY_IDENTIFIER T_DLY_DIAG_BPA_CTL_0 ECU_ADDRESS 0x7fc914 BYTE_ORDER MSB_LAST FORMAT "%5.2" /end MEASUREMENT
/begin CHARACTERISTIC c_ctl_dif_bpa_0_min_diag "" VALUE 0x85bd6e _REC_VAL_20_s2 99.99694800000002 _CNV_A_R_LINEAR_____12_CM -100. -3.052e-003 DISPLAY_IDENTIFIER C_CTL_DIF_BPA_0_MIN_DIAG /end CHARACTERISTIC
/begin CHARACTERISTIC c_ctl_dif_bpa_0_max_diag "" VALUE 0x85bd6c _REC_VAL_20_s2 99.996948242 _CNV_A_R_LINEAR_____50_CM 0. 99.996948242 DISPLAY_IDENTIFIER C_CTL_DIF_BPA_0_MAX_DIAG /end CHARACTERISTIC
/begin CHARACTERISTIC c_ctr_eve_bpa_0_ctl "" VALUE 0x85bd9f _REC_VAL_20_u1 255. _CNV_A_R_LINEAR_____0_CM 0. 255. DISPLAY_IDENTIFIER C_CTR_EVE_BPA_0_CTL FORMAT "%3.0" /end CHARACTERISTIC
/begin CHARACTERISTIC c_ctr_bas_bpa_0_ctl "" VALUE 0x85bd96 _REC_VAL_20_u1 255. _CNV_A_R_LINEAR_____0_CM 0. 255. DISPLAY_IDENTIFIER C_CTR_BAS_BPA_0_CTL FORMAT "%3.0" /end CHARACTERISTIC
/begin CHARACTERISTIC c_t_dly_diag_bpa_ctl "" VALUE 0x85c0a8 _REC_VAL_20_u2 655.35 _CNV_A_R_LINEAR_____59_CM 0. 655.35 DISPLAY_IDENTIFIER C_T_DLY_DIAG_BPA_CTL FORMAT "%5.2" /end CHARACTERISTIC
/begin CHARACTERISTIC c_abc_inc_byp_0_ctl "" VALUE 0x8481f0 _REC_VAL_20_u1 255. _CNV_A_R_LINEAR_____0_CM 0. 255. DISPLAY_IDENTIFIER C_ABC_INC_BYP_0_CTL FORMAT "%3.0" /end CHARACTERISTIC
/begin CHARACTERISTIC c_abc_max_byp_0_ctl "" VALUE 0x848272 _REC_VAL_20_u1 255. _CNV_A_R_LINEAR_____0_CM 0. 255. DISPLAY_IDENTIFIER C_ABC_MAX_BYP_0_CTL FORMAT "%3.0" /end CHARACTERISTIC
/begin CHARACTERISTIC c_abc_inc_v_byp_0_bol_ad "" VALUE 0x848254 _REC_VAL_20_u1 255. _CNV_A_R_LINEAR_____0_CM 0. 255. DISPLAY_IDENTIFIER C_ABC_INC_V_BYP_0_BOL_AD FORMAT "%3.0" /end CHARACTERISTIC
/begin CHARACTERISTIC c_abc_max_v_byp_0_bol_ad "" VALUE 0x8482d6 _REC_VAL_20_u1 255. _CNV_A_R_LINEAR_____0_CM 0. 255. DISPLAY_IDENTIFIER C_ABC_MAX_V_BYP_0_BOL_AD FORMAT "%3.0" /end CHARACTERISTIC
/begin MEASUREMENT ctr_bas_byp_0_ctl "" UBYTE _CNV_A_R_LINEAR_____0_CM 1 0. 0. 255. DISPLAY_IDENTIFIER CTR_BAS_BYP_0_CTL ECU_ADDRESS 0x7fca2f FORMAT "%3.0" /end MEASUREMENT
/begin MEASUREMENT ctr_eve_byp_0_ctl "" UBYTE _CNV_A_R_LINEAR_____0_CM 1 0. 0. 255. DISPLAY_IDENTIFIER CTR_EVE_BYP_0_CTL ECU_ADDRESS 0x7fca2e FORMAT "%3.0" /end MEASUREMENT
/begin CHARACTERISTIC c_ctl_dif_byp_0_min_diag "" VALUE 0x85bd76 _REC_VAL_20_s2 99.99694800000002 _CNV_A_R_LINEAR_____12_CM -100. -3.052e-003 DISPLAY_IDENTIFIER C_CTL_DIF_BYP_0_MIN_DIAG /end CHARACTERISTIC
/begin CHARACTERISTIC c_ctl_dif_byp_0_max_diag "" VALUE 0x85bd74 _REC_VAL_20_s2 99.996948242 _CNV_A_R_LINEAR_____50_CM 0. 99.996948242 DISPLAY_IDENTIFIER C_CTL_DIF_BYP_0_MAX_DIAG /end CHARACTERISTIC
/begin CHARACTERISTIC c_ctr_eve_byp_0_ctl "" VALUE 0x85bda1 _REC_VAL_20_u1 255. _CNV_A_R_LINEAR_____0_CM 0. 255. DISPLAY_IDENTIFIER C_CTR_EVE_BYP_0_CTL FORMAT "%3.0" /end CHARACTERISTIC
/begin CHARACTERISTIC c_ctr_bas_byp_0_ctl "" VALUE 0x85bd98 _REC_VAL_20_u1 255. _CNV_A_R_LINEAR_____0_CM 0. 255. DISPLAY_IDENTIFIER C_CTR_BAS_BYP_0_CTL FORMAT "%3.0" /end CHARACTERISTIC
/begin CHARACTERISTIC c_abc_inc_map_ctl_min "" VALUE 0x84821d _REC_VAL_20_u1 255. _CNV_A_R_LINEAR_____0_CM 0. 255. DISPLAY_IDENTIFIER C_ABC_INC_MAP_CTL_MIN FORMAT "%3.0" /end CHARACTERISTIC
/begin CHARACTERISTIC c_abc_max_map_ctl_min "" VALUE 0x84829f _REC_VAL_20_u1 255. _CNV_A_R_LINEAR_____0_CM 0. 255. DISPLAY_IDENTIFIER C_ABC_MAX_MAP_CTL_MIN FORMAT "%3.0" /end CHARACTERISTIC
/begin CHARACTERISTIC c_abc_inc_map_ctl_max "" VALUE 0x84821c _REC_VAL_20_u1 255. _CNV_A_R_LINEAR_____0_CM 0. 255. DISPLAY_IDENTIFIER C_ABC_INC_MAP_CTL_MAX FORMAT "%3.0" /end CHARACTERISTIC
/begin CHARACTERISTIC c_abc_max_map_ctl_max "" VALUE 0x84829e _REC_VAL_20_u1 255. _CNV_A_R_LINEAR_____0_CM 0. 255. DISPLAY_IDENTIFIER C_ABC_MAX_MAP_CTL_MAX FORMAT "%3.0" /end CHARACTERISTIC
/begin MEASUREMENT ctr_map_ctl_min "" UBYTE _CNV_A_R_LINEAR_____0_CM 1 0. 0. 255. DISPLAY_IDENTIFIER CTR_MAP_CTL_MIN ECU_ADDRESS 0x7fb9fa FORMAT "%3.0" /end MEASUREMENT
/begin MEASUREMENT ctr_map_ctl_max "" UBYTE _CNV_A_R_LINEAR_____0_CM 1 0. 0. 255. DISPLAY_IDENTIFIER CTR_MAP_CTL_MAX ECU_ADDRESS 0x7fb9fb FORMAT "%3.0" /end MEASUREMENT
/begin CHARACTERISTIC c_map_dif_min_diag "" VALUE 0x85bf30 _REC_VAL_20_s2 2716.917080000001 _CNV_A_R_LINEAR_____60_CM -2717. -8.291999999999999e-002 DISPLAY_IDENTIFIER C_MAP_DIF_MIN_DIAG /end CHARACTERISTIC
/begin CHARACTERISTIC c_map_dif_max_diag "" VALUE 0x85bf2e _REC_VAL_20_s2 2716.917080000001 _CNV_A_R_LINEAR_____61_CM 0. 2716.91708 DISPLAY_IDENTIFIER C_MAP_DIF_MAX_DIAG FORMAT "%7.3" /end CHARACTERISTIC
/begin CHARACTERISTIC c_n_min_map_ctl_diag "" VALUE 0x85bfc2 _REC_VAL_20_u2 6375. _CNV_A_R_LINEAR_____5_CM 0. 6375. DISPLAY_IDENTIFIER C_N_MIN_MAP_CTL_DIAG FORMAT "%4.0" /end CHARACTERISTIC
/begin CHARACTERISTIC c_tqi_sp_min_map_ctl_diag "" VALUE 0x85c1e0 _REC_VAL_20_s2 2047.96875 _CNV_A_R_LINEAR_____62_CM -1024. 1023.96875 DISPLAY_IDENTIFIER C_TQI_SP_MIN_MAP_CTL_DIAG FORMAT "%4.1" /end CHARACTERISTIC
/begin CHARACTERISTIC ip_ctr_max_map_ctl_min__n "DIAG_MAP: maximum value of CTR_MAP_CTL_MIN" CURVE 0x84a452 _REC_CUR_20_u1_u2 255. _CNV_A_R_LINEAR_____0_CM 0. 255. DISPLAY_IDENTIFIER IP_CTR_MAX_MAP_CTL_MIN__N FORMAT "%3.0"
 /begin AXIS_DESCR COM_AXIS n _CNV_A_R_LINEAR_____5_CM 8 0. 6375. FORMAT "%4.0" AXIS_PTS_REF ldpm_n__ip_ctr_max_map_ctl_diag /end AXIS_DESCR
/end CHARACTERISTIC
/begin CHARACTERISTIC ip_ctr_max_map_ctl_max__n "DIAG_MAP: maximum value of CTR_MAP_CTL_MAX" CURVE 0x84a44a _REC_CUR_20_u1_u2 255. _CNV_A_R_LINEAR_____0_CM 0. 255. DISPLAY_IDENTIFIER IP_CTR_MAX_MAP_CTL_MAX__N FORMAT "%3.0"
 /begin AXIS_DESCR COM_AXIS n _CNV_A_R_LINEAR_____5_CM 8 0. 6375. FORMAT "%4.0" AXIS_PTS_REF ldpm_n__ip_ctr_max_map_ctl_diag /end AXIS_DESCR
/end CHARACTERISTIC
/begin AXIS_PTS ldpm_n__ip_ctr_max_map_ctl_diag "" 0x8438e2 n _REC_AXS_20_u2 6375. _CNV_A_R_LINEAR_____5_CM 8 0. 6375. FORMAT "%4.0" /end AXIS_PTS
/begin CHARACTERISTIC c_abc_inc_cs "" VALUE 0x848201 _REC_VAL_20_u1 255. _CNV_A_R_LINEAR_____0_CM 0. 255. DISPLAY_IDENTIFIER C_ABC_INC_CS FORMAT "%3.0" /end CHARACTERISTIC
/begin CHARACTERISTIC c_abc_max_cs "" VALUE 0x848283 _REC_VAL_20_u1 255. _CNV_A_R_LINEAR_____0_CM 0. 255. DISPLAY_IDENTIFIER C_ABC_MAX_CS FORMAT "%3.0" /end CHARACTERISTIC
/begin MEASUREMENT ctr_cs_plaus_1 "" UBYTE _CNV_A_R_LINEAR_____0_CM 1 0. 0. 255. DISPLAY_IDENTIFIER CTR_CS_PLAUS_1 ECU_ADDRESS 0x7fca30 FORMAT "%3.0" /end MEASUREMENT
/begin MEASUREMENT ctr_cs_plaus_2 "" UBYTE _CNV_A_R_LINEAR_____0_CM 1 0. 0. 255. DISPLAY_IDENTIFIER CTR_CS_PLAUS_2 ECU_ADDRESS 0x7fca31 FORMAT "%3.0" /end MEASUREMENT
/begin MEASUREMENT lv_cs_chg_1 "" UBYTE _CNV_S_2_RANGE______11_CM 1 0. 0. 1. DISPLAY_IDENTIFIER LV_CS_CHG_1 ECU_ADDRESS 0x7fca32 /end MEASUREMENT
/begin MEASUREMENT lv_cs_chg_2 "" UBYTE _CNV_S_2_RANGE______11_CM 1 0. 0. 1. DISPLAY_IDENTIFIER LV_CS_CHG_2 ECU_ADDRESS 0x7fca33 /end MEASUREMENT
/begin CHARACTERISTIC c_vs_cs_plaus_2_diag "" VALUE 0x85c2d3 _REC_VAL_20_u1 255. _CNV_A_R_LINEAR_____39_CM 0. 255. DISPLAY_IDENTIFIER C_VS_CS_PLAUS_2_DIAG FORMAT "%3.0" /end CHARACTERISTIC
/begin CHARACTERISTIC c_ctr_max_cs_plaus_1 "" VALUE 0x85bdb0 _REC_VAL_20_u1 254. _CNV_A_R_LINEAR_____0_CM 0. 254. DISPLAY_IDENTIFIER C_CTR_MAX_CS_PLAUS_1 FORMAT "%3.0" /end CHARACTERISTIC
/begin CHARACTERISTIC c_ctr_max_cs_plaus_2 "" VALUE 0x85bdb1 _REC_VAL_20_u1 254. _CNV_A_R_LINEAR_____0_CM 0. 254. DISPLAY_IDENTIFIER C_CTR_MAX_CS_PLAUS_2 FORMAT "%3.0" /end CHARACTERISTIC
/begin CHARACTERISTIC lc_act_plaus_1_diag "" VALUE 0x85c2ef _REC_VAL_20_u1 1. _CNV_A_R_LINEAR_____0_CM 0. 1. DISPLAY_IDENTIFIER LC_ACT_PLAUS_1_DIAG FORMAT "%1.0" /end CHARACTERISTIC
/begin CHARACTERISTIC c_vs_cs_plaus_1_diag "" VALUE 0x85c2d2 _REC_VAL_20_u1 255. _CNV_A_R_LINEAR_____39_CM 0. 255. DISPLAY_IDENTIFIER C_VS_CS_PLAUS_1_DIAG FORMAT "%3.0" /end CHARACTERISTIC
/begin CHARACTERISTIC c_abc_inc_bls "" VALUE 0x8481eb _REC_VAL_20_u1 255. _CNV_A_R_LINEAR_____0_CM 0. 255. DISPLAY_IDENTIFIER C_ABC_INC_BLS FORMAT "%3.0" /end CHARACTERISTIC
/begin CHARACTERISTIC c_abc_max_bls "" VALUE 0x84826d _REC_VAL_20_u1 255. _CNV_A_R_LINEAR_____0_CM 0. 255. DISPLAY_IDENTIFIER C_ABC_MAX_BLS FORMAT "%3.0" /end CHARACTERISTIC
/begin CHARACTERISTIC c_abc_inc_bls_bts_dece "" VALUE 0x8481ec _REC_VAL_20_u1 255. _CNV_A_R_LINEAR_____0_CM 0. 255. DISPLAY_IDENTIFIER C_ABC_INC_BLS_BTS_DECE FORMAT "%3.0" /end CHARACTERISTIC
/begin CHARACTERISTIC c_abc_max_bls_bts_dece "" VALUE 0x84826e _REC_VAL_20_u1 255. _CNV_A_R_LINEAR_____0_CM 0. 255. DISPLAY_IDENTIFIER C_ABC_MAX_BLS_BTS_DECE FORMAT "%3.0" /end CHARACTERISTIC
/begin CHARACTERISTIC c_abc_inc_bls_bts_plaus "" VALUE 0x8481ed _REC_VAL_20_u1 255. _CNV_A_R_LINEAR_____0_CM 0. 255. DISPLAY_IDENTIFIER C_ABC_INC_BLS_BTS_PLAUS FORMAT "%3.0" /end CHARACTERISTIC
/begin CHARACTERISTIC c_abc_max_bls_bts_plaus "" VALUE 0x84826f _REC_VAL_20_u1 255. _CNV_A_R_LINEAR_____0_CM 0. 255. DISPLAY_IDENTIFIER C_ABC_MAX_BLS_BTS_PLAUS FORMAT "%3.0" /end CHARACTERISTIC
/begin MEASUREMENT lv_err_bls_bts "" UBYTE _CNV_S_2_RANGE______28_CM 1 0. 0. 1. DISPLAY_IDENTIFIER LV_ERR_BLS_BTS ECU_ADDRESS 0x7fb465 /end MEASUREMENT
/begin MEASUREMENT t_bls_bts_plaus "" UWORD _CNV_A_R_LINEAR_____59_CM 1 0. 0. 655.35 DISPLAY_IDENTIFIER T_BLS_BTS_PLAUS ECU_ADDRESS 0x7fa5ac BYTE_ORDER MSB_LAST FORMAT "%5.2" /end MEASUREMENT
/begin CHARACTERISTIC c_vs_ac_bls_bts_diag "" VALUE 0x85c2d0 _REC_VAL_20_u1 20.31 _CNV_A_R_LINEAR_____75_CM -14. 6.31 DISPLAY_IDENTIFIER C_VS_AC_BLS_BTS_DIAG FORMAT "%3.2" /end CHARACTERISTIC
/begin CHARACTERISTIC c_dri_bls_bts_diag "" VALUE 0x85bdce _REC_VAL_20_u1 6. _CNV_A_R_LINEAR_____0_CM 0. 6. DISPLAY_IDENTIFIER C_DRI_BLS_BTS_DIAG FORMAT "%1.0" /end CHARACTERISTIC
/begin CHARACTERISTIC lc_bls_bts_plaus_conf "" VALUE 0x85c2f2 _REC_VAL_20_u1 1. _CNV_A_R_LINEAR_____0_CM 0. 1. DISPLAY_IDENTIFIER LC_BLS_BTS_PLAUS_CONF FORMAT "%1.0" /end CHARACTERISTIC
/begin CHARACTERISTIC c_t_max_1_bls_bts_plaus "" VALUE 0x85c0ec _REC_VAL_20_u2 655.35 _CNV_A_R_LINEAR_____59_CM 0. 655.35 DISPLAY_IDENTIFIER C_T_MAX_1_BLS_BTS_PLAUS FORMAT "%5.2" /end CHARACTERISTIC
/begin CHARACTERISTIC c_t_max_2_bls_bts_plaus "" VALUE 0x85c0ee _REC_VAL_20_u2 655.35 _CNV_A_R_LINEAR_____59_CM 0. 655.35 DISPLAY_IDENTIFIER C_T_MAX_2_BLS_BTS_PLAUS FORMAT "%5.2" /end CHARACTERISTIC
/begin MEASUREMENT lv_err_can_boff "Fehler CAN_BOFF entprellt" UBYTE _CNV_S_2_RANGE__0___88_CM 1 0. 0. 1. DISPLAY_IDENTIFIER LV_ERR_CAN_BOFF ECU_ADDRESS 0x7fb51b BIT_MASK 0x1 /end MEASUREMENT
/begin MEASUREMENT lv_err_can_tcs "Fehler CAN_TCS entprellt" UBYTE _CNV_S_2_RANGE__0___88_CM 1 0. 0. 1. DISPLAY_IDENTIFIER LV_ERR_CAN_TCS ECU_ADDRESS 0x7fb514 BIT_MASK 0x1 /end MEASUREMENT
/begin MEASUREMENT lv_ack_tcs "logische Variable für unplausible TCS-Botschaft" UBYTE _CNV_S_2_RANGE__0___88_CM 1 0. 0. 1. DISPLAY_IDENTIFIER LV_ACK_TCS ECU_ADDRESS 0x7fb3b5 BIT_MASK 0x1 /end MEASUREMENT
/begin MEASUREMENT lv_err_can_tcu "Fehler CAN_TCU entprellt" UBYTE _CNV_S_2_RANGE__0___88_CM 1 0. 0. 1. DISPLAY_IDENTIFIER LV_ERR_CAN_TCU ECU_ADDRESS 0x7fb515 BIT_MASK 0x1 /end MEASUREMENT
/begin MEASUREMENT lv_err_can_smls "Fehler CAN_SMLS entprellt" UBYTE _CNV_S_2_RANGE__0___88_CM 1 0. 0. 1. DISPLAY_IDENTIFIER LV_ERR_CAN_SMLS ECU_ADDRESS 0x7fb51a BIT_MASK 0x1 /end MEASUREMENT
/begin CHARACTERISTIC c_abc_inc_can_boff "Inkrement Entprellzähler" VALUE 0x8481f3 _REC_VAL_20_u1 255. _CNV_A_R_LINEAR_____1_CM 0. 255. DISPLAY_IDENTIFIER C_ABC_INC_CAN_BOFF FORMAT "%3.0" /end CHARACTERISTIC
/begin MEASUREMENT lv_err_can_if_cft "Fehler CAN_CCU entprellt" UBYTE _CNV_S_2_RANGE__0___88_CM 1 0. 0. 1. DISPLAY_IDENTIFIER LV_ERR_CAN_IF_CFT ECU_ADDRESS 0x7fb51d BIT_MASK 0x1 /end MEASUREMENT
/begin CHARACTERISTIC c_abc_max_can_boff "Maximum Entprellzähler" VALUE 0x848275 _REC_VAL_20_u1 254. _CNV_A_R_LINEAR_____1_CM 1. 255. DISPLAY_IDENTIFIER C_ABC_MAX_CAN_BOFF FORMAT "%3.0" /end CHARACTERISTIC
/begin CHARACTERISTIC c_abc_inc_can_tcs "Inkrement Entprellzähler" VALUE 0x8481fb _REC_VAL_20_u1 255. _CNV_A_R_LINEAR_____1_CM 0. 255. DISPLAY_IDENTIFIER C_ABC_INC_CAN_TCS FORMAT "%3.0" /end CHARACTERISTIC
/begin CHARACTERISTIC c_abc_inc_can_tcu "Inkrement Entprellzähler" VALUE 0x8481fc _REC_VAL_20_u1 255. _CNV_A_R_LINEAR_____1_CM 0. 255. DISPLAY_IDENTIFIER C_ABC_INC_CAN_TCU FORMAT "%3.0" /end CHARACTERISTIC
/begin CHARACTERISTIC c_abc_max_can_tcu "Maximum Entprellzähler" VALUE 0x84827e _REC_VAL_20_u1 254. _CNV_A_R_LINEAR_____1_CM 1. 255. DISPLAY_IDENTIFIER C_ABC_MAX_CAN_TCU FORMAT "%3.0" /end CHARACTERISTIC
/begin CHARACTERISTIC c_abc_max_can_ccu "Maximum Entprellzähler" VALUE 0x848276 _REC_VAL_20_u1 254. _CNV_A_R_LINEAR_____1_CM 1. 255. DISPLAY_IDENTIFIER C_ABC_MAX_CAN_CCU FORMAT "%3.0" /end CHARACTERISTIC
/begin CHARACTERISTIC c_abc_inc_can_icl "Inkrement Entprellzähler" VALUE 0x8481f7 _REC_VAL_20_u1 255. _CNV_A_R_LINEAR_____1_CM 0. 255. DISPLAY_IDENTIFIER C_ABC_INC_CAN_ICL FORMAT "%3.0" /end CHARACTERISTIC
/begin CHARACTERISTIC c_abc_max_can_icl "Maximum Entprellzähler" VALUE 0x848279 _REC_VAL_20_u1 254. _CNV_A_R_LINEAR_____1_CM 1. 255. DISPLAY_IDENTIFIER C_ABC_MAX_CAN_ICL FORMAT "%3.0" /end CHARACTERISTIC
/begin CHARACTERISTIC c_abc_inc_can_vecu "Inkrement Entprellzähler" VALUE 0x8481fe _REC_VAL_20_u1 255. _CNV_A_R_LINEAR_____1_CM 0. 255. DISPLAY_IDENTIFIER C_ABC_INC_CAN_VECU FORMAT "%3.0" /end CHARACTERISTIC
/begin CHARACTERISTIC c_abc_max_can_vecu "Maximum Entprellzähler" VALUE 0x848280 _REC_VAL_20_u1 254. _CNV_A_R_LINEAR_____1_CM 1. 255. DISPLAY_IDENTIFIER C_ABC_MAX_CAN_VECU FORMAT "%3.0" /end CHARACTERISTIC
/begin CHARACTERISTIC c_abc_inc_can_smls "Inkrement Entprellzähler" VALUE 0x8481fa _REC_VAL_20_u1 255. _CNV_A_R_LINEAR_____1_CM 0. 255. DISPLAY_IDENTIFIER C_ABC_INC_CAN_SMLS FORMAT "%3.0" /end CHARACTERISTIC
/begin CHARACTERISTIC c_abc_max_can_smls "Maximum Entprellzähler" VALUE 0x84827c _REC_VAL_20_u1 254. _CNV_A_R_LINEAR_____1_CM 1. 255. DISPLAY_IDENTIFIER C_ABC_MAX_CAN_SMLS FORMAT "%3.0" /end CHARACTERISTIC
/begin CHARACTERISTIC c_abc_inc_can_bem "Inkrement Entprellzähler" VALUE 0x8481f2 _REC_VAL_20_u1 255. _CNV_A_R_LINEAR_____1_CM 0. 255. DISPLAY_IDENTIFIER C_ABC_INC_CAN_BEM FORMAT "%3.0" /end CHARACTERISTIC
/begin CHARACTERISTIC c_abc_max_can_bem "Maximum Entprellzähler" VALUE 0x848274 _REC_VAL_20_u1 254. _CNV_A_R_LINEAR_____1_CM 1. 255. DISPLAY_IDENTIFIER C_ABC_MAX_CAN_BEM FORMAT "%3.0" /end CHARACTERISTIC
/begin CHARACTERISTIC c_abc_inc_can_if_cft "Inkrement Entprellzähler" VALUE 0x8481f8 _REC_VAL_20_u1 255. _CNV_A_R_LINEAR_____1_CM 0. 255. DISPLAY_IDENTIFIER C_ABC_INC_CAN_IF_CFT FORMAT "%3.0" /end CHARACTERISTIC
/begin CHARACTERISTIC c_abc_max_can_if_cft "Maximum Entprellzähler" VALUE 0x84827a _REC_VAL_20_u1 254. _CNV_A_R_LINEAR_____1_CM 1. 255. DISPLAY_IDENTIFIER C_ABC_MAX_CAN_IF_CFT FORMAT "%3.0" /end CHARACTERISTIC
/begin MEASUREMENT tout_ctr_if_cft_1 "" UBYTE _CNV_A_R_LINEAR_____223_CM 1 0. 0. 2.55 DISPLAY_IDENTIFIER TOUT_CTR_IF_CFT_1 ECU_ADDRESS 0x7fb328 FORMAT "%4.2" /end MEASUREMENT
/begin MEASUREMENT tout_ctr_icl2 "" UBYTE _CNV_A_R_LINEAR_____223_CM 1 0. 0. 2.55 DISPLAY_IDENTIFIER TOUT_CTR_ICL2 ECU_ADDRESS 0x7fb326 FORMAT "%4.2" /end MEASUREMENT
/begin MEASUREMENT tout_ctr_icl3 "" UBYTE _CNV_A_R_LINEAR_____223_CM 1 0. 0. 2.55 DISPLAY_IDENTIFIER TOUT_CTR_ICL3 ECU_ADDRESS 0x7fb327 FORMAT "%4.2" /end MEASUREMENT
/begin MEASUREMENT tout_ctr_icl1 "" UBYTE _CNV_A_R_LINEAR_____223_CM 1 0. 0. 2.55 DISPLAY_IDENTIFIER TOUT_CTR_ICL1 ECU_ADDRESS 0x7fb31c FORMAT "%4.2" /end MEASUREMENT
/begin MEASUREMENT tout_ctr_tcs2 "" UBYTE _CNV_A_R_LINEAR_____223_CM 1 0. 0. 2.55 DISPLAY_IDENTIFIER TOUT_CTR_TCS2 ECU_ADDRESS 0x7fb317 FORMAT "%4.2" /end MEASUREMENT
/begin MEASUREMENT tout_ctr_tcs8 "" UBYTE _CNV_A_R_LINEAR_____223_CM 1 0. 0. 2.55 DISPLAY_IDENTIFIER TOUT_CTR_TCS8 ECU_ADDRESS 0x7fb319 FORMAT "%4.2" /end MEASUREMENT
/begin MEASUREMENT tout_ctr_tcs1 "" UBYTE _CNV_A_R_LINEAR_____223_CM 1 0. 0. 2.55 DISPLAY_IDENTIFIER TOUT_CTR_TCS1 ECU_ADDRESS 0x7fb316 FORMAT "%4.2" /end MEASUREMENT
/begin MEASUREMENT tout_ctr_tcu1 "" UBYTE _CNV_A_R_LINEAR_____223_CM 1 0. 0. 2.55 DISPLAY_IDENTIFIER TOUT_CTR_TCU1 ECU_ADDRESS 0x7fb31a FORMAT "%4.2" /end MEASUREMENT
/begin MEASUREMENT tout_ctr_bem "" UBYTE _CNV_A_R_LINEAR_____223_CM 1 0. 0. 2.55 DISPLAY_IDENTIFIER TOUT_CTR_BEM ECU_ADDRESS 0x7fb31d FORMAT "%4.2" /end MEASUREMENT
/begin MEASUREMENT tout_ctr_cru "" UBYTE _CNV_A_R_LINEAR_____223_CM 1 0. 0. 2.55 DISPLAY_IDENTIFIER TOUT_CTR_CRU ECU_ADDRESS 0x7fb31f FORMAT "%4.2" /end MEASUREMENT
/begin MEASUREMENT tout_ctr_vecu1 "" UBYTE _CNV_A_R_LINEAR_____223_CM 1 0. 0. 2.55 DISPLAY_IDENTIFIER TOUT_CTR_VECU1 ECU_ADDRESS 0x7fb329 FORMAT "%4.2" /end MEASUREMENT
/begin MEASUREMENT tout_ctr_tog1 "" UWORD _CNV_A_R_LINEAR_____113_CM 1 0. 0. 655.35 DISPLAY_IDENTIFIER TOUT_CTR_TOG1 ECU_ADDRESS 0x7f9728 BYTE_ORDER MSB_LAST FORMAT "%4.2" /end MEASUREMENT
/begin MEASUREMENT tout_ctr_acu1 "" UBYTE _CNV_A_R_LINEAR_____223_CM 1 0. 0. 2.55 DISPLAY_IDENTIFIER TOUT_CTR_ACU1 ECU_ADDRESS 0x7fb31e FORMAT "%4.2" /end MEASUREMENT
/begin MEASUREMENT dly_diag_can_10ms "" UBYTE _CNV_A_R_LINEAR_____223_CM 1 0. 0. 2.55 DISPLAY_IDENTIFIER DLY_DIAG_CAN_10MS ECU_ADDRESS 0x7fb9a1 FORMAT "%4.2" /end MEASUREMENT
/begin MEASUREMENT max_hld_tcs "Merkwert fuer Timeout-Ueberschreitung ABS" UBYTE _CNV_A_R_LINEAR_____224_CM 1 0. 0. 12750. DISPLAY_IDENTIFIER MAX_HLD_TCS ECU_ADDRESS 0x7fb3b6 FORMAT "%5.0" /end MEASUREMENT
/begin MEASUREMENT max_hld_tcs_av "Messwert fuer Timeout-Ueberschreitung ABS" UBYTE _CNV_A_R_LINEAR_____224_CM 1 0. 0. 12750. DISPLAY_IDENTIFIER MAX_HLD_TCS_AV ECU_ADDRESS 0x7fb3b7 FORMAT "%5.0" /end MEASUREMENT
/begin MEASUREMENT max_hld_tcu "Merkwert fuer Timeout-Ueberschreitung Getriebesteuergeraet" UBYTE _CNV_A_R_LINEAR_____224_CM 1 0. 0. 12750. DISPLAY_IDENTIFIER MAX_HLD_TCU ECU_ADDRESS 0x7fb3b8 FORMAT "%5.0" /end MEASUREMENT
/begin MEASUREMENT max_hld_tcu_av "Messwert fuer Timeout-Ueberschreitung Getriebesteuergeraet" UBYTE _CNV_A_R_LINEAR_____224_CM 1 0. 0. 12750. DISPLAY_IDENTIFIER MAX_HLD_TCU_AV ECU_ADDRESS 0x7fb3b9 FORMAT "%5.0" /end MEASUREMENT
/begin MEASUREMENT max_hld_acu "Merkwert fuer Timeout-Ueberschreitung Airbag" UBYTE _CNV_A_R_LINEAR_____224_CM 1 0. 0. 12750. DISPLAY_IDENTIFIER MAX_HLD_ACU ECU_ADDRESS 0x7fb3ba FORMAT "%5.0" /end MEASUREMENT
/begin MEASUREMENT max_hld_acu_av "Messwert fuer Timeout-Ueberschreitung Airbag" UBYTE _CNV_A_R_LINEAR_____224_CM 1 0. 0. 12750. DISPLAY_IDENTIFIER MAX_HLD_ACU_AV ECU_ADDRESS 0x7fb3bb FORMAT "%5.0" /end MEASUREMENT
/begin MEASUREMENT max_hld_ccu_av "Messwert fuer Timeout-Ueberschreitung Klimaanlage" UBYTE _CNV_A_R_LINEAR_____224_CM 1 0. 0. 12750. DISPLAY_IDENTIFIER MAX_HLD_CCU_AV ECU_ADDRESS 0x7fb3bd FORMAT "%5.0" /end MEASUREMENT
/begin MEASUREMENT max_hld_icl "Merkwert fuer Timeout-Ueberschreitung Kombi" UBYTE _CNV_A_R_LINEAR_____224_CM 1 0. 0. 12750. DISPLAY_IDENTIFIER MAX_HLD_ICL ECU_ADDRESS 0x7fb3be FORMAT "%5.0" /end MEASUREMENT
/begin MEASUREMENT max_hld_icl_av "Messwert fuer Timeout-Ueberschreitung Kombi" UBYTE _CNV_A_R_LINEAR_____224_CM 1 0. 0. 12750. DISPLAY_IDENTIFIER MAX_HLD_ICL_AV ECU_ADDRESS 0x7fb3bf FORMAT "%5.0" /end MEASUREMENT
/begin MEASUREMENT max_hld_vecu "Merkwert fuer Timeout-Ueberschreitung Bordnetz" UBYTE _CNV_A_R_LINEAR_____225_CM 1 0. 0. 51000. DISPLAY_IDENTIFIER MAX_HLD_VECU ECU_ADDRESS 0x7fb3c0 FORMAT "%5.0" /end MEASUREMENT
/begin MEASUREMENT max_hld_vecu_av "Messwert fuer Timeout-Ueberschreitung Bordnetz" UBYTE _CNV_A_R_LINEAR_____225_CM 1 0. 0. 51000. DISPLAY_IDENTIFIER MAX_HLD_VECU_AV ECU_ADDRESS 0x7fb3c1 FORMAT "%5.0" /end MEASUREMENT
/begin MEASUREMENT max_hld_smls "Merkwert fuer Timeout-Ueberschreitung Lenkstocksaeule" UBYTE _CNV_A_R_LINEAR_____224_CM 1 0. 0. 12750. DISPLAY_IDENTIFIER MAX_HLD_SMLS ECU_ADDRESS 0x7fb3c2 FORMAT "%5.0" /end MEASUREMENT
/begin MEASUREMENT max_hld_smls_av "Messwert fuer Timeout-Ueberschreitung Lenkstocksaeule" UBYTE _CNV_A_R_LINEAR_____224_CM 1 0. 0. 12750. DISPLAY_IDENTIFIER MAX_HLD_SMLS_AV ECU_ADDRESS 0x7fb3c3 FORMAT "%5.0" /end MEASUREMENT
/begin MEASUREMENT max_hld_bem "Merkwert fuer Timeout-Ueberschreitung Bordnetz-Energiemanager" UBYTE _CNV_A_R_LINEAR_____225_CM 1 0. 0. 51000. DISPLAY_IDENTIFIER MAX_HLD_BEM ECU_ADDRESS 0x7fb3c4 FORMAT "%5.0" /end MEASUREMENT
/begin MEASUREMENT max_hld_bem_av "Messwert fuer Timeout-Ueberschreitung Bordnetz-Energiemanager" UBYTE _CNV_A_R_LINEAR_____225_CM 1 0. 0. 51000. DISPLAY_IDENTIFIER MAX_HLD_BEM_AV ECU_ADDRESS 0x7fb3c5 FORMAT "%5.0" /end MEASUREMENT
/begin MEASUREMENT max_hld_if_cft "Merkwert fuer Timeout-Ueberschreitung Gateway Komfort" UBYTE _CNV_A_R_LINEAR_____225_CM 1 0. 0. 51000. DISPLAY_IDENTIFIER MAX_HLD_IF_CFT ECU_ADDRESS 0x7fb3c6 FORMAT "%5.0" /end MEASUREMENT
/begin MEASUREMENT max_hld_if_cft_av "Messwert fuer Timeout-Ueberschreitung Gateway Komfort" UBYTE _CNV_A_R_LINEAR_____225_CM 1 0. 0. 51000. DISPLAY_IDENTIFIER MAX_HLD_IF_CFT_AV ECU_ADDRESS 0x7fb3c7 FORMAT "%5.0" /end MEASUREMENT
/begin CHARACTERISTIC c_abc_inc_can_acu "Inkrement Entprellzähler" VALUE 0x8481f1 _REC_VAL_20_u1 255. _CNV_A_R_LINEAR_____1_CM 0. 255. DISPLAY_IDENTIFIER C_ABC_INC_CAN_ACU FORMAT "%3.0" /end CHARACTERISTIC
/begin CHARACTERISTIC c_abc_max_can_tcs "Maximum Entprellzähler" VALUE 0x84827d _REC_VAL_20_u1 254. _CNV_A_R_LINEAR_____1_CM 1. 255. DISPLAY_IDENTIFIER C_ABC_MAX_CAN_TCS FORMAT "%3.0" /end CHARACTERISTIC
/begin MEASUREMENT lv_err_can_bem "Fehler CAN_BEM entprellt" UBYTE _CNV_S_2_RANGE__0___88_CM 1 0. 0. 1. DISPLAY_IDENTIFIER LV_ERR_CAN_BEM ECU_ADDRESS 0x7fb51c BIT_MASK 0x1 /end MEASUREMENT
/begin MEASUREMENT lv_err_can_bem_all "" UBYTE _CNV_S_2_RANGE__0___88_CM 1 0. 0. 1. DISPLAY_IDENTIFIER LV_ERR_CAN_BEM_ALL ECU_ADDRESS 0x7fb9ac BIT_MASK 0x1 /end MEASUREMENT
/begin MEASUREMENT lv_err_can_vecu "Fehler CAN_VECU entprellt" UBYTE _CNV_S_2_RANGE__0___88_CM 1 0. 0. 1. DISPLAY_IDENTIFIER LV_ERR_CAN_VECU ECU_ADDRESS 0x7fb519 BIT_MASK 0x1 /end MEASUREMENT
/begin MEASUREMENT lv_err_can_vecu_all "" UBYTE _CNV_S_2_RANGE__0___88_CM 1 0. 0. 1. DISPLAY_IDENTIFIER LV_ERR_CAN_VECU_ALL ECU_ADDRESS 0x7fb9aa BIT_MASK 0x1 /end MEASUREMENT
/begin MEASUREMENT ctr_boff_diag "" UBYTE _CNV_A_R_LINEAR_____1_CM 1 0. 0. 255. DISPLAY_IDENTIFIER CTR_BOFF_DIAG ECU_ADDRESS 0x7fb321 FORMAT "%3.0" /end MEASUREMENT
/begin MEASUREMENT can_status "" UWORD _CNV_A_R_LINEAR_____226_CM 1 0. 0. 65535. DISPLAY_IDENTIFIER CAN_STATUS ECU_ADDRESS 0x7fa538 BYTE_ORDER MSB_LAST FORMAT "%5.0" /end MEASUREMENT
/begin MEASUREMENT t_can_boff_dly "" UBYTE _CNV_A_R_LINEAR_____223_CM 1 0. 0. 2.55 DISPLAY_IDENTIFIER T_CAN_BOFF_DLY ECU_ADDRESS 0x7fb970 FORMAT "%4.2" /end MEASUREMENT
/begin MEASUREMENT lv_fmy_can_boff "logische Variable für ABS-Bremsung" UBYTE _CNV_S_2_RANGE__0___88_CM 1 0. 0. 1. DISPLAY_IDENTIFIER LV_FMY_CAN_BOFF ECU_ADDRESS 0x7fb32c BIT_MASK 0x1 /end MEASUREMENT
/begin MEASUREMENT lv_can_boff_first "logische Variable für ABS-Bremsung" UBYTE _CNV_S_2_RANGE__0___88_CM 1 0. 0. 1. DISPLAY_IDENTIFIER LV_CAN_BOFF_FIRST ECU_ADDRESS 0x7fb972 BIT_MASK 0x1 /end MEASUREMENT
/begin MEASUREMENT lv_can_boff_next "logische Variable für ABS-Bremsung" UBYTE _CNV_S_2_RANGE__0___88_CM 1 0. 0. 1. DISPLAY_IDENTIFIER LV_CAN_BOFF_NEXT ECU_ADDRESS 0x7fb973 BIT_MASK 0x1 /end MEASUREMENT
/begin CHARACTERISTIC c_abc_max_can_tot "Maximum Entprellzähler" VALUE 0x84827f _REC_VAL_20_u1 254. _CNV_A_R_LINEAR_____1_CM 1. 255. DISPLAY_IDENTIFIER C_ABC_MAX_CAN_TOT FORMAT "%3.0" /end CHARACTERISTIC
/begin CHARACTERISTIC c_abc_inc_can_tot "Inkrement Entprellzähler" VALUE 0x8481fd _REC_VAL_20_u1 255. _CNV_A_R_LINEAR_____1_CM 0. 255. DISPLAY_IDENTIFIER C_ABC_INC_CAN_TOT FORMAT "%3.0" /end CHARACTERISTIC
/begin MEASUREMENT tmp_can_cod "" UWORD _CNV_A_R_LINEAR_____1_CM 1 0. 0. 65535. DISPLAY_IDENTIFIER TMP_CAN_COD ECU_ADDRESS 0x7fa548 BYTE_ORDER MSB_LAST FORMAT "%5.0" /end MEASUREMENT
/begin MEASUREMENT tmp_can_diag "" UWORD _CNV_A_R_LINEAR_____1_CM 1 0. 0. 65535. DISPLAY_IDENTIFIER TMP_CAN_DIAG ECU_ADDRESS 0x7fa54a BYTE_ORDER MSB_LAST FORMAT "%5.0" /end MEASUREMENT
/begin MEASUREMENT lv_err_can_ccu "Fehler CAN_CCU entprellt" UBYTE _CNV_S_2_RANGE__0___88_CM 1 0. 0. 1. DISPLAY_IDENTIFIER LV_ERR_CAN_CCU ECU_ADDRESS 0x7fb517 BIT_MASK 0x1 /end MEASUREMENT
/begin MEASUREMENT lv_err_can_tot "Fehler CAN_TOT entprellt" UBYTE _CNV_S_2_RANGE__0___88_CM 1 0. 0. 1. DISPLAY_IDENTIFIER LV_ERR_CAN_TOT ECU_ADDRESS 0x7fb51e BIT_MASK 0x1 /end MEASUREMENT
/begin MEASUREMENT lv_err_can_acu "Fehler CAN_ACU entprellt" UBYTE _CNV_S_2_RANGE__0___88_CM 1 0. 0. 1. DISPLAY_IDENTIFIER LV_ERR_CAN_ACU ECU_ADDRESS 0x7fb516 BIT_MASK 0x1 /end MEASUREMENT
/begin MEASUREMENT lv_err_can_stop "" UBYTE _CNV_S_2_RANGE__0___88_CM 1 0. 0. 1. DISPLAY_IDENTIFIER LV_ERR_CAN_STOP ECU_ADDRESS 0x7fb9ae BIT_MASK 0x1 /end MEASUREMENT
/begin MEASUREMENT lv_err_can_icl "Fehler CAN_ICL entprellt" UBYTE _CNV_S_2_RANGE__0___88_CM 1 0. 0. 1. DISPLAY_IDENTIFIER LV_ERR_CAN_ICL ECU_ADDRESS 0x7fb518 BIT_MASK 0x1 /end MEASUREMENT
/begin MEASUREMENT lv_err_can_dcc "Fehler CAN_DCC entprellt" UBYTE _CNV_S_2_RANGE__0___88_CM 1 0. 0. 1. DISPLAY_IDENTIFIER LV_ERR_CAN_DCC ECU_ADDRESS 0x7fb789 BIT_MASK 0x1 /end MEASUREMENT
/begin MEASUREMENT tout_ctr_ccu1 "" UBYTE _CNV_A_R_LINEAR_____223_CM 1 0. 0. 2.55 DISPLAY_IDENTIFIER TOUT_CTR_CCU1 ECU_ADDRESS 0x7fb320 FORMAT "%4.2" /end MEASUREMENT
/begin MEASUREMENT tout_ctr_eilu1 "" UBYTE _CNV_A_R_LINEAR_____223_CM 1 0. 0. 2.55 DISPLAY_IDENTIFIER TOUT_CTR_EILU1 ECU_ADDRESS 0x7fb32a FORMAT "%4.2" /end MEASUREMENT
/begin CHARACTERISTIC c_abc_inc_can_ccu "Inkrement Entprellzähler" VALUE 0x8481f4 _REC_VAL_20_u1 255. _CNV_A_R_LINEAR_____1_CM 0. 255. DISPLAY_IDENTIFIER C_ABC_INC_CAN_CCU FORMAT "%3.0" /end CHARACTERISTIC
/begin CHARACTERISTIC c_abc_max_can_acu "Maximum Entprellzähler" VALUE 0x848273 _REC_VAL_20_u1 254. _CNV_A_R_LINEAR_____1_CM 1. 255. DISPLAY_IDENTIFIER C_ABC_MAX_CAN_ACU FORMAT "%3.0" /end CHARACTERISTIC
/begin CHARACTERISTIC c_abc_max_can_dcc "Maximum Entprellzähler" VALUE 0x848277 _REC_VAL_20_u1 254. _CNV_A_R_LINEAR_____1_CM 1. 255. DISPLAY_IDENTIFIER C_ABC_MAX_CAN_DCC FORMAT "%3.0" /end CHARACTERISTIC
/begin CHARACTERISTIC c_abc_max_can_eilu "Maximum Entprellzähler" VALUE 0x848278 _REC_VAL_20_u1 254. _CNV_A_R_LINEAR_____1_CM 1. 255. DISPLAY_IDENTIFIER C_ABC_MAX_CAN_EILU FORMAT "%3.0" /end CHARACTERISTIC
/begin CHARACTERISTIC c_abc_inc_can_dcc "Inkrement Entprellzähler" VALUE 0x8481f5 _REC_VAL_20_u1 255. _CNV_A_R_LINEAR_____1_CM 0. 255. DISPLAY_IDENTIFIER C_ABC_INC_CAN_DCC FORMAT "%3.0" /end CHARACTERISTIC
/begin CHARACTERISTIC c_abc_inc_can_eilu "Inkrement Entprellzähler" VALUE 0x8481f6 _REC_VAL_20_u1 255. _CNV_A_R_LINEAR_____1_CM 0. 255. DISPLAY_IDENTIFIER C_ABC_INC_CAN_EILU FORMAT "%3.0" /end CHARACTERISTIC
/begin MEASUREMENT max_hld_ccu "Merkwert fuer Timeout-Ueberschreitung Klimaanlage" UBYTE _CNV_A_R_LINEAR_____224_CM 1 0. 0. 12750. DISPLAY_IDENTIFIER MAX_HLD_CCU ECU_ADDRESS 0x7fb3bc FORMAT "%5.0" /end MEASUREMENT
/begin MEASUREMENT tout_ctr_whl "" UBYTE _CNV_A_R_LINEAR_____223_CM 1 0. 0. 2.55 DISPLAY_IDENTIFIER TOUT_CTR_WHL ECU_ADDRESS 0x7fb323 FORMAT "%4.2" /end MEASUREMENT
/begin MEASUREMENT tout_ctr_tcu2 "" UBYTE _CNV_A_R_LINEAR_____223_CM 1 0. 0. 2.55 DISPLAY_IDENTIFIER TOUT_CTR_TCU2 ECU_ADDRESS 0x7fb31b FORMAT "%4.2" /end MEASUREMENT
/begin MEASUREMENT tout_ctr_sys_info "" UBYTE _CNV_A_R_LINEAR_____223_CM 1 0. 0. 2.55 DISPLAY_IDENTIFIER TOUT_CTR_SYS_INFO ECU_ADDRESS 0x7fb324 FORMAT "%4.2" /end MEASUREMENT
/begin MEASUREMENT tout_ctr_nom_sys "" UBYTE _CNV_A_R_LINEAR_____223_CM 1 0. 0. 2.55 DISPLAY_IDENTIFIER TOUT_CTR_NOM_SYS ECU_ADDRESS 0x7fb325 FORMAT "%4.2" /end MEASUREMENT
/begin MEASUREMENT tout_ctr_tcs4 "" UBYTE _CNV_A_R_LINEAR_____223_CM 1 0. 0. 2.55 DISPLAY_IDENTIFIER TOUT_CTR_TCS4 ECU_ADDRESS 0x7fb322 FORMAT "%4.2" /end MEASUREMENT
/begin MEASUREMENT tout_ctr_tcs3 "" UBYTE _CNV_A_R_LINEAR_____223_CM 1 0. 0. 2.55 DISPLAY_IDENTIFIER TOUT_CTR_TCS3 ECU_ADDRESS 0x7fb318 FORMAT "%4.2" /end MEASUREMENT
/begin CHARACTERISTIC c_acp_mes_max_diag "upper threshold for ACP_MES signal" VALUE 0x85bcb3 _REC_VAL_20_u1 3100. _CNV_A_R_LINEAR_____206_CM 0. 3100. DISPLAY_IDENTIFIER C_ACP_MES_MAX_DIAG FORMAT "%4.0" /end CHARACTERISTIC
/begin CHARACTERISTIC c_acp_mes_min_diag "lower threshold for ACP_MES signal" VALUE 0x85bcb4 _REC_VAL_20_u1 3100. _CNV_A_R_LINEAR_____206_CM 0. 3100. DISPLAY_IDENTIFIER C_ACP_MES_MIN_DIAG FORMAT "%4.0" /end CHARACTERISTIC
/begin CHARACTERISTIC c_acp_mes_grd_diag "c_acp_mes_grd_diag" VALUE 0x85bcb2 _REC_VAL_20_u1 255. _CNV_A_R_LINEAR_____233_CM 0. 255. DISPLAY_IDENTIFIER C_ACP_MES_GRD_DIAG FORMAT "%3.0" /end CHARACTERISTIC
/begin MEASUREMENT cool_req_ecf_1 "cooling request for electrical cooling fan 1" UBYTE _CNV_A_R_LINEAR_____82_CM 1 0. 0. 99.609375 DISPLAY_IDENTIFIER COOL_REQ_ECF_1 ECU_ADDRESS 0x7fb811 FORMAT "%4.1" /end MEASUREMENT
/begin MEASUREMENT cool_req_ecf_2 "cooling request for electrical cooling fan 2" UBYTE _CNV_A_R_LINEAR_____82_CM 1 0. 0. 99.609375 DISPLAY_IDENTIFIER COOL_REQ_ECF_2 ECU_ADDRESS 0x7fb812 FORMAT "%4.1" /end MEASUREMENT
/begin MEASUREMENT cool_req_tot_inter "Intermediate value" UBYTE _CNV_A_R_LINEAR_____82_CM 1 0. 0. 99.609375 DISPLAY_IDENTIFIER COOL_REQ_TOT_INTER ECU_ADDRESS 0x7fbbe3 FORMAT "%4.1" /end MEASUREMENT
/begin MEASUREMENT cool_req_tcu "cooling request of transmission control unit" UBYTE _CNV_A_R_LINEAR_____82_CM 1 0. 0. 99.609375 DISPLAY_IDENTIFIER COOL_REQ_TCU ECU_ADDRESS 0x7fb813 FORMAT "%4.1" /end MEASUREMENT
/begin MEASUREMENT cool_req_tot_inter_save "Saved value for support function for DIACPS" UBYTE _CNV_A_R_LINEAR_____82_CM 1 0. 0. 99.609375 DISPLAY_IDENTIFIER COOL_REQ_TOT_INTER_SAVE ECU_ADDRESS 0x7fbbe4 FORMAT "%4.1" /end MEASUREMENT
/begin MEASUREMENT lv_cool_req_save_diagcps "Support function for DIACPS for ECF active" UBYTE _CNV_S_2_RANGE__0___88_CM 1 0. 0. 1. DISPLAY_IDENTIFIER LV_COOL_REQ_SAVE_DIAGCPS ECU_ADDRESS 0x7fbbfd BIT_MASK 0x1 /end MEASUREMENT
/begin MEASUREMENT cool_req_ecf_clc "Cooling request for electrical cooling fan 1 after support function for DIACPS" UBYTE _CNV_A_R_LINEAR_____82_CM 1 0. 0. 99.609375 DISPLAY_IDENTIFIER COOL_REQ_ECF_CLC ECU_ADDRESS 0x7fbbe5 FORMAT "%4.1" /end MEASUREMENT
/begin MEASUREMENT cool_req_ac_save "saved value for support function for DIACPS" UBYTE _CNV_A_R_LINEAR_____82_CM 1 0. 0. 99.609375 DISPLAY_IDENTIFIER COOL_REQ_AC_SAVE ECU_ADDRESS 0x7fbbe6 FORMAT "%4.1" /end MEASUREMENT
/begin CHARACTERISTIC lc_cool_req_save_diagcps_ena "Activation switch for CPSDIAG support function" VALUE 0x848793 _REC_VAL_20_u1 1. _CNV_A_R_LINEAR_____1_CM 0. 1. DISPLAY_IDENTIFIER LC_COOL_REQ_SAVE_DIAGCPS_ENA FORMAT "%1.0" /end CHARACTERISTIC
/begin CHARACTERISTIC c_tco_max_cool_req_save_diagcps "maximum TCO threshold for activation of CPSDIAG support function" VALUE 0x8486cc _REC_VAL_20_u1 190.5 _CNV_A_R_LINEAR_____235_CM -48. 142.5 DISPLAY_IDENTIFIER C_TCO_MAX_COOL_REQ_SAVE_DIAGCPS FORMAT "%5.1" /end CHARACTERISTIC
/begin CHARACTERISTIC c_cool_req_ac_save_ofs "offset on COOL_REQ_AC for activation of CPSDIAG support function" VALUE 0x848352 _REC_VAL_20_u1 99.609375 _CNV_A_R_LINEAR_____82_CM 0. 99.609375 DISPLAY_IDENTIFIER C_COOL_REQ_AC_SAVE_OFS FORMAT "%4.1" /end CHARACTERISTIC
/begin CHARACTERISTIC c_cool_req_ecf_1_lgrd "limitation gradient for COOL_REQ_ECF_1" VALUE 0x848353 _REC_VAL_20_u1 99.609375 _CNV_A_R_LINEAR_____236_CM 0. 99.609375 DISPLAY_IDENTIFIER C_COOL_REQ_ECF_1_LGRD FORMAT "%4.1" /end CHARACTERISTIC
/begin CHARACTERISTIC c_cool_req_ecf_2_lgrd "limitation gradient for COOL_REQ_ECF_2" VALUE 0x848354 _REC_VAL_20_u1 99.609375 _CNV_A_R_LINEAR_____236_CM 0. 99.609375 DISPLAY_IDENTIFIER C_COOL_REQ_ECF_2_LGRD FORMAT "%4.1" /end CHARACTERISTIC
/begin AXIS_PTS ldp_cool_req_tcu_can__cool_req "" 0x8444f4 cool_req_tcu_can _REC_AXS_20_u1 3. _CNV_A_R_LINEAR_____0_CM 4 0. 3. FORMAT "%1.0" /end AXIS_PTS
/begin CHARACTERISTIC ip_cool_req_tcu "cooling request of TCU" CURVE 0x8455ba _REC_CUR_20_u1_u1 99.609375 _CNV_A_R_LINEAR_____82_CM 0. 99.609375 DISPLAY_IDENTIFIER IP_COOL_REQ_TCU FORMAT "%4.1"
 /begin AXIS_DESCR COM_AXIS cool_req_tcu_can _CNV_A_R_LINEAR_____0_CM 4 0. 3. FORMAT "%1.0" AXIS_PTS_REF ldp_cool_req_tcu_can__cool_req /end AXIS_DESCR
/end CHARACTERISTIC
/begin MEASUREMENT n_sp_ecf_1 "" UBYTE _CNV_A_R_LINEAR_____237_CM 1 0. 0. 4080. DISPLAY_IDENTIFIER N_SP_ECF_1 ECU_ADDRESS 0x7fb814 FORMAT "%4.0" /end MEASUREMENT
/begin MEASUREMENT n_sp_ecf_2 "" UBYTE _CNV_A_R_LINEAR_____237_CM 1 0. 0. 4080. DISPLAY_IDENTIFIER N_SP_ECF_2 ECU_ADDRESS 0x7fb815 FORMAT "%4.0" /end MEASUREMENT
/begin MEASUREMENT lv_n_sp_ecf_1_hys "activation hysteresis for ECF_1 active" UBYTE _CNV_S_2_RANGE__0___88_CM 1 0. 0. 1. DISPLAY_IDENTIFIER LV_N_SP_ECF_1_HYS ECU_ADDRESS 0x7fbbfe BIT_MASK 0x1 /end MEASUREMENT
/begin MEASUREMENT lv_n_sp_ecf_2_hys "activation hysteresis for ECF_2 active" UBYTE _CNV_S_2_RANGE__0___88_CM 1 0. 0. 1. DISPLAY_IDENTIFIER LV_N_SP_ECF_2_HYS ECU_ADDRESS 0x7fbbff BIT_MASK 0x1 /end MEASUREMENT
/begin MEASUREMENT n_sp_ecf_1_raw "raw ECF_1 speed setpoint" UBYTE _CNV_A_R_LINEAR_____237_CM 1 0. 0. 4080. DISPLAY_IDENTIFIER N_SP_ECF_1_RAW ECU_ADDRESS 0x7fbbe8 FORMAT "%4.0" /end MEASUREMENT
/begin MEASUREMENT n_sp_ecf_2_raw "raw ECF_2 speed setpoint" UBYTE _CNV_A_R_LINEAR_____237_CM 1 0. 0. 4080. DISPLAY_IDENTIFIER N_SP_ECF_2_RAW ECU_ADDRESS 0x7fbbe9 FORMAT "%4.0" /end MEASUREMENT
/begin MEASUREMENT n_sp_ecf_1_inter_1 "Raw ECF_1 speed setpoint after air density correction" UBYTE _CNV_A_R_LINEAR_____237_CM 1 0. 0. 4080. DISPLAY_IDENTIFIER N_SP_ECF_1_INTER_1 ECU_ADDRESS 0x7fbbea FORMAT "%4.0" /end MEASUREMENT
/begin MEASUREMENT n_sp_ecf_2_inter_1 "Raw ECF_2 speed setpoint after air density correction" UBYTE _CNV_A_R_LINEAR_____237_CM 1 0. 0. 4080. DISPLAY_IDENTIFIER N_SP_ECF_2_INTER_1 ECU_ADDRESS 0x7fbbeb FORMAT "%4.0" /end MEASUREMENT
/begin MEASUREMENT n_sp_ecf_1_inter_2 "raw ECF_1 speed setpoint before fade out ECF speed areas" UBYTE _CNV_A_R_LINEAR_____237_CM 1 0. 0. 4080. DISPLAY_IDENTIFIER N_SP_ECF_1_INTER_2 ECU_ADDRESS 0x7fbbec FORMAT "%4.0" /end MEASUREMENT
/begin MEASUREMENT n_sp_ecf_2_inter_2 "raw ECF_2 speed setpoint before fade out ECF speed areas" UBYTE _CNV_A_R_LINEAR_____237_CM 1 0. 0. 4080. DISPLAY_IDENTIFIER N_SP_ECF_2_INTER_2 ECU_ADDRESS 0x7fbbed FORMAT "%4.0" /end MEASUREMENT
/begin MEASUREMENT lv_n_sp_ecf_1_fout "raw ECF_1 speed setpoint within fade out area" UBYTE _CNV_S_2_RANGE__0___88_CM 1 0. 0. 1. DISPLAY_IDENTIFIER LV_N_SP_ECF_1_FOUT ECU_ADDRESS 0x7fbc00 BIT_MASK 0x1 /end MEASUREMENT
/begin MEASUREMENT lv_n_sp_ecf_2_fout "raw ECF_2 speed setpoint within fade out area" UBYTE _CNV_S_2_RANGE__0___88_CM 1 0. 0. 1. DISPLAY_IDENTIFIER LV_N_SP_ECF_2_FOUT ECU_ADDRESS 0x7fbc01 BIT_MASK 0x1 /end MEASUREMENT
/begin MEASUREMENT fac_n_sp_ecf_1 "Air density correction for N_SP_ECF_1" UBYTE _CNV_A_R_LINEAR_____238_CM 1 0. 0. 3.984375 DISPLAY_IDENTIFIER FAC_N_SP_ECF_1 ECU_ADDRESS 0x7fbbee FORMAT "%4.2" /end MEASUREMENT
/begin MEASUREMENT fac_n_sp_ecf_2 "Air density correction for N_SP_ECF_2" UBYTE _CNV_A_R_LINEAR_____238_CM 1 0. 0. 3.984375 DISPLAY_IDENTIFIER FAC_N_SP_ECF_2 ECU_ADDRESS 0x7fbbef FORMAT "%4.2" /end MEASUREMENT
/begin CHARACTERISTIC c_n_sp_ecf_1_min_tol "top level for activation hysteresis for ECF_1" VALUE 0x8484fa _REC_VAL_20_u1 4080. _CNV_A_R_LINEAR_____237_CM 0. 4080. DISPLAY_IDENTIFIER C_N_SP_ECF_1_MIN_TOL FORMAT "%4.0" /end CHARACTERISTIC
/begin CHARACTERISTIC c_n_sp_ecf_1_min_bol "bottom level for activation hysteresis for ECF_1" VALUE 0x8484f9 _REC_VAL_20_u1 4080. _CNV_A_R_LINEAR_____237_CM 0. 4080. DISPLAY_IDENTIFIER C_N_SP_ECF_1_MIN_BOL FORMAT "%4.0" /end CHARACTERISTIC
/begin CHARACTERISTIC c_n_sp_ecf_2_min_tol "top level for activation hysteresis for ECF_2" VALUE 0x848507 _REC_VAL_20_u1 4080. _CNV_A_R_LINEAR_____237_CM 0. 4080. DISPLAY_IDENTIFIER C_N_SP_ECF_2_MIN_TOL FORMAT "%4.0" /end CHARACTERISTIC
/begin CHARACTERISTIC c_n_sp_ecf_2_min_bol "bottom level for activation hysteresis for ECF_2" VALUE 0x848506 _REC_VAL_20_u1 4080. _CNV_A_R_LINEAR_____237_CM 0. 4080. DISPLAY_IDENTIFIER C_N_SP_ECF_2_MIN_BOL FORMAT "%4.0" /end CHARACTERISTIC
/begin CHARACTERISTIC c_n_sp_ecf_1_min "absolute minimum ECF_1 speed" VALUE 0x8484f8 _REC_VAL_20_u1 4080. _CNV_A_R_LINEAR_____237_CM 0. 4080. DISPLAY_IDENTIFIER C_N_SP_ECF_1_MIN FORMAT "%4.0" /end CHARACTERISTIC
/begin CHARACTERISTIC c_n_sp_ecf_2_min "absolute minimum ECF_2 speed" VALUE 0x848505 _REC_VAL_20_u1 4080. _CNV_A_R_LINEAR_____237_CM 0. 4080. DISPLAY_IDENTIFIER C_N_SP_ECF_2_MIN FORMAT "%4.0" /end CHARACTERISTIC
/begin CHARACTERISTIC c_n_sp_ecf_1_fout_1_bol "bottom limit for ECF_1 fade out area 1" VALUE 0x8484ee _REC_VAL_20_u1 4080. _CNV_A_R_LINEAR_____237_CM 0. 4080. DISPLAY_IDENTIFIER C_N_SP_ECF_1_FOUT_1_BOL FORMAT "%4.0" /end CHARACTERISTIC
/begin CHARACTERISTIC c_n_sp_ecf_1_fout_1_tol "top limit for ECF_1 fade out area 1" VALUE 0x8484ef _REC_VAL_20_u1 4080. _CNV_A_R_LINEAR_____237_CM 0. 4080. DISPLAY_IDENTIFIER C_N_SP_ECF_1_FOUT_1_TOL FORMAT "%4.0" /end CHARACTERISTIC
/begin CHARACTERISTIC c_n_sp_ecf_1_fout_2_bol "bottom limit for ECF_1 fade out area 2" VALUE 0x8484f0 _REC_VAL_20_u1 4080. _CNV_A_R_LINEAR_____237_CM 0. 4080. DISPLAY_IDENTIFIER C_N_SP_ECF_1_FOUT_2_BOL FORMAT "%4.0" /end CHARACTERISTIC
/begin CHARACTERISTIC c_n_sp_ecf_1_fout_2_tol "top limit for ECF_1 fade out area 2" VALUE 0x8484f1 _REC_VAL_20_u1 4080. _CNV_A_R_LINEAR_____237_CM 0. 4080. DISPLAY_IDENTIFIER C_N_SP_ECF_1_FOUT_2_TOL FORMAT "%4.0" /end CHARACTERISTIC
/begin CHARACTERISTIC c_n_sp_ecf_1_fout_3_bol "bottom limit for ECF_1 fade out area 3" VALUE 0x8484f2 _REC_VAL_20_u1 4080. _CNV_A_R_LINEAR_____237_CM 0. 4080. DISPLAY_IDENTIFIER C_N_SP_ECF_1_FOUT_3_BOL FORMAT "%4.0" /end CHARACTERISTIC
/begin CHARACTERISTIC c_n_sp_ecf_1_fout_3_tol "top limit for ECF_1 fade out area 3" VALUE 0x8484f3 _REC_VAL_20_u1 4080. _CNV_A_R_LINEAR_____237_CM 0. 4080. DISPLAY_IDENTIFIER C_N_SP_ECF_1_FOUT_3_TOL FORMAT "%4.0" /end CHARACTERISTIC
/begin CHARACTERISTIC c_n_sp_ecf_1_fout_4_bol "bottom limit for ECF_1 fade out area 4" VALUE 0x8484f4 _REC_VAL_20_u1 4080. _CNV_A_R_LINEAR_____237_CM 0. 4080. DISPLAY_IDENTIFIER C_N_SP_ECF_1_FOUT_4_BOL FORMAT "%4.0" /end CHARACTERISTIC
/begin CHARACTERISTIC c_n_sp_ecf_1_fout_4_tol "top limit for ECF_1 fade out area 4" VALUE 0x8484f5 _REC_VAL_20_u1 4080. _CNV_A_R_LINEAR_____237_CM 0. 4080. DISPLAY_IDENTIFIER C_N_SP_ECF_1_FOUT_4_TOL FORMAT "%4.0" /end CHARACTERISTIC
/begin CHARACTERISTIC c_n_sp_ecf_1_fout_5_bol "bottom limit for ECF_1 fade out area 5" VALUE 0x8484f6 _REC_VAL_20_u1 4080. _CNV_A_R_LINEAR_____237_CM 0. 4080. DISPLAY_IDENTIFIER C_N_SP_ECF_1_FOUT_5_BOL FORMAT "%4.0" /end CHARACTERISTIC
/begin CHARACTERISTIC c_n_sp_ecf_1_fout_5_tol "top limit for ECF_1 fade out area 5" VALUE 0x8484f7 _REC_VAL_20_u1 4080. _CNV_A_R_LINEAR_____237_CM 0. 4080. DISPLAY_IDENTIFIER C_N_SP_ECF_1_FOUT_5_TOL FORMAT "%4.0" /end CHARACTERISTIC
/begin CHARACTERISTIC c_n_sp_ecf_2_fout_1_bol "bottom limit for ECF_2 fade out area 1" VALUE 0x8484fb _REC_VAL_20_u1 4080. _CNV_A_R_LINEAR_____237_CM 0. 4080. DISPLAY_IDENTIFIER C_N_SP_ECF_2_FOUT_1_BOL FORMAT "%4.0" /end CHARACTERISTIC
/begin CHARACTERISTIC c_n_sp_ecf_2_fout_1_tol "top limit for ECF_2 fade out area 1" VALUE 0x8484fc _REC_VAL_20_u1 4080. _CNV_A_R_LINEAR_____237_CM 0. 4080. DISPLAY_IDENTIFIER C_N_SP_ECF_2_FOUT_1_TOL FORMAT "%4.0" /end CHARACTERISTIC
/begin CHARACTERISTIC c_n_sp_ecf_2_fout_2_bol "bottom limit for ECF_2 fade out area 2" VALUE 0x8484fd _REC_VAL_20_u1 4080. _CNV_A_R_LINEAR_____237_CM 0. 4080. DISPLAY_IDENTIFIER C_N_SP_ECF_2_FOUT_2_BOL FORMAT "%4.0" /end CHARACTERISTIC
/begin CHARACTERISTIC c_n_sp_ecf_2_fout_2_tol "top limit for ECF_2 fade out area 2" VALUE 0x8484fe _REC_VAL_20_u1 4080. _CNV_A_R_LINEAR_____237_CM 0. 4080. DISPLAY_IDENTIFIER C_N_SP_ECF_2_FOUT_2_TOL FORMAT "%4.0" /end CHARACTERISTIC
/begin CHARACTERISTIC c_n_sp_ecf_2_fout_3_bol "bottom limit for ECF_2 fade out area 3" VALUE 0x8484ff _REC_VAL_20_u1 4080. _CNV_A_R_LINEAR_____237_CM 0. 4080. DISPLAY_IDENTIFIER C_N_SP_ECF_2_FOUT_3_BOL FORMAT "%4.0" /end CHARACTERISTIC
/begin CHARACTERISTIC c_n_sp_ecf_2_fout_3_tol "top limit for ECF_2 fade out area 3" VALUE 0x848500 _REC_VAL_20_u1 4080. _CNV_A_R_LINEAR_____237_CM 0. 4080. DISPLAY_IDENTIFIER C_N_SP_ECF_2_FOUT_3_TOL FORMAT "%4.0" /end CHARACTERISTIC
/begin CHARACTERISTIC c_n_sp_ecf_2_fout_4_bol "bottom limit for ECF_2 fade out area 4" VALUE 0x848501 _REC_VAL_20_u1 4080. _CNV_A_R_LINEAR_____237_CM 0. 4080. DISPLAY_IDENTIFIER C_N_SP_ECF_2_FOUT_4_BOL FORMAT "%4.0" /end CHARACTERISTIC
/begin CHARACTERISTIC c_n_sp_ecf_2_fout_4_tol "top limit for ECF_2 fade out area 4" VALUE 0x848502 _REC_VAL_20_u1 4080. _CNV_A_R_LINEAR_____237_CM 0. 4080. DISPLAY_IDENTIFIER C_N_SP_ECF_2_FOUT_4_TOL FORMAT "%4.0" /end CHARACTERISTIC
/begin CHARACTERISTIC c_n_sp_ecf_2_fout_5_bol "bottom limit for ECF_2 fade out area 5" VALUE 0x848503 _REC_VAL_20_u1 4080. _CNV_A_R_LINEAR_____237_CM 0. 4080. DISPLAY_IDENTIFIER C_N_SP_ECF_2_FOUT_5_BOL FORMAT "%4.0" /end CHARACTERISTIC
/begin CHARACTERISTIC c_n_sp_ecf_2_fout_5_tol "top limit for ECF_2 fade out area 5" VALUE 0x848504 _REC_VAL_20_u1 4080. _CNV_A_R_LINEAR_____237_CM 0. 4080. DISPLAY_IDENTIFIER C_N_SP_ECF_2_FOUT_5_TOL FORMAT "%4.0" /end CHARACTERISTIC
/begin CHARACTERISTIC lc_ena_fac_n_sp_ecf_1 "EC-fan ECF_1 built in; 1 = correction needed" VALUE 0x8487a1 _REC_VAL_20_u1 1. _CNV_A_R_LINEAR_____1_CM 0. 1. DISPLAY_IDENTIFIER LC_ENA_FAC_N_SP_ECF_1 FORMAT "%1.0" /end CHARACTERISTIC
/begin CHARACTERISTIC lc_ena_fac_n_sp_ecf_2 "EC-fan ECF_2 built in; 1 = correction needed" VALUE 0x8487a2 _REC_VAL_20_u1 1. _CNV_A_R_LINEAR_____1_CM 0. 1. DISPLAY_IDENTIFIER LC_ENA_FAC_N_SP_ECF_2 FORMAT "%1.0" /end CHARACTERISTIC
/begin AXIS_PTS ldp_cool_req_ecf_1 "" 0x8444dd cool_req_ecf_1 _REC_AXS_20_u1 99.609375 _CNV_A_R_LINEAR_____82_CM 6 0. 99.609375 FORMAT "%4.1" /end AXIS_PTS
/begin AXIS_PTS ldp_cool_req_ecf_2 "" 0x8444e4 cool_req_ecf_2 _REC_AXS_20_u1 99.609375 _CNV_A_R_LINEAR_____82_CM 6 0. 99.609375 FORMAT "%4.1" /end AXIS_PTS
/begin AXIS_PTS ldpm_n_32__n_sp_ecf "" 0x84495d n_32 _REC_AXS_20_u1 8160. _CNV_A_R_LINEAR_____84_CM 6 0. 8160. FORMAT "%4.0" /end AXIS_PTS
/begin CHARACTERISTIC ip_n_sp_ecf_1 "raw ECF_1 speed setpoint" MAP 0x8472a4 _REC_MAP_20_u1_u1_u1 4080. _CNV_A_R_LINEAR_____237_CM 0. 4080. DISPLAY_IDENTIFIER IP_N_SP_ECF_1 FORMAT "%4.0"
 /begin AXIS_DESCR COM_AXIS cool_req_ecf_1 _CNV_A_R_LINEAR_____82_CM 6 0. 99.609375 FORMAT "%4.1" AXIS_PTS_REF ldp_cool_req_ecf_1 /end AXIS_DESCR
 /begin AXIS_DESCR COM_AXIS n_32 _CNV_A_R_LINEAR_____84_CM 6 0. 8160. FORMAT "%4.0" AXIS_PTS_REF ldpm_n_32__n_sp_ecf /end AXIS_DESCR
/end CHARACTERISTIC
/begin CHARACTERISTIC ip_n_sp_ecf_2 "Raw ECF_2 speed setpoint" MAP 0x8472c8 _REC_MAP_20_u1_u1_u1 4080. _CNV_A_R_LINEAR_____237_CM 0. 4080. DISPLAY_IDENTIFIER IP_N_SP_ECF_2 FORMAT "%4.0"
 /begin AXIS_DESCR COM_AXIS cool_req_ecf_2 _CNV_A_R_LINEAR_____82_CM 6 0. 99.609375 FORMAT "%4.1" AXIS_PTS_REF ldp_cool_req_ecf_2 /end AXIS_DESCR
 /begin AXIS_DESCR COM_AXIS n_32 _CNV_A_R_LINEAR_____84_CM 6 0. 8160. FORMAT "%4.0" AXIS_PTS_REF ldpm_n_32__n_sp_ecf /end AXIS_DESCR
/end CHARACTERISTIC
/begin AXIS_PTS ldp_vs__n_sp_ecf "" 0x8448a5 vs _REC_AXS_20_u1 255. _CNV_A_R_LINEAR_____239_CM 8 0. 255. FORMAT "%3.0" /end AXIS_PTS
/begin CHARACTERISTIC ip_fac_n_sp_ecf_vs "Factor on N_SP_ECF vs. vehicle speed" CURVE 0x846b7e _REC_CUR_20_u1_u1 1.9921875 _CNV_A_R_LINEAR_____240_CM 0. 1.9921875 DISPLAY_IDENTIFIER IP_FAC_N_SP_ECF_VS FORMAT "%5.3"
 /begin AXIS_DESCR COM_AXIS vs _CNV_A_R_LINEAR_____239_CM 8 0. 255. FORMAT "%3.0" AXIS_PTS_REF ldp_vs__n_sp_ecf /end AXIS_DESCR
/end CHARACTERISTIC
/begin AXIS_PTS ldp_tam__fac_n_sp_ecf "" 0x844723 tam _REC_AXS_20_u1 190.5 _CNV_A_R_LINEAR_____235_CM 8 -48. 142.5 FORMAT "%5.1" /end AXIS_PTS
/begin AXIS_PTS ldp_amp__fac_n_sp_ecf "" 0x8444ba amp _REC_AXS_20_u2 5434. _CNV_A_R_LINEAR_____241_CM 8 0. 5434. FORMAT "%7.2" /end AXIS_PTS
/begin CHARACTERISTIC ip_fac_n_sp_ecf_amp "Factor on N_SP_ECF vs. TAM and AMP" MAP 0x846b3e _REC_MAP_20_u1_u1_u2 2. _CNV_A_R_LINEAR_____238_CM 0. 2. DISPLAY_IDENTIFIER IP_FAC_N_SP_ECF_AMP FORMAT "%4.2"
 /begin AXIS_DESCR COM_AXIS tam _CNV_A_R_LINEAR_____235_CM 8 -48. 142.5 FORMAT "%5.1" AXIS_PTS_REF ldp_tam__fac_n_sp_ecf /end AXIS_DESCR
 /begin AXIS_DESCR COM_AXIS amp _CNV_A_R_LINEAR_____241_CM 8 0. 5434. FORMAT "%7.2" AXIS_PTS_REF ldp_amp__fac_n_sp_ecf /end AXIS_DESCR
/end CHARACTERISTIC
/begin MEASUREMENT ecfpwm_1 "output ECFPWM to drive ECF_1" UBYTE _CNV_A_R_LINEAR_____82_CM 1 0. 5.078125 87.890625 DISPLAY_IDENTIFIER ECFPWM_1 ECU_ADDRESS 0x7fb816 FORMAT "%4.1" /end MEASUREMENT
/begin MEASUREMENT ecfpwm_2 "output ECFPWM to drive ECF_2" UBYTE _CNV_A_R_LINEAR_____82_CM 1 0. 5.078125 87.890625 DISPLAY_IDENTIFIER ECFPWM_2 ECU_ADDRESS 0x7fb817 FORMAT "%4.1" /end MEASUREMENT
/begin MEASUREMENT ecfpwm_1_raw "raw value for ECFPWM_1" UBYTE _CNV_A_R_LINEAR_____82_CM 1 0. 5.078125 87.890625 DISPLAY_IDENTIFIER ECFPWM_1_RAW ECU_ADDRESS 0x7fbbf0 FORMAT "%4.1" /end MEASUREMENT
/begin MEASUREMENT ecfpwm_2_raw "raw value for ECFPWM_2" UBYTE _CNV_A_R_LINEAR_____82_CM 1 0. 5.078125 87.890625 DISPLAY_IDENTIFIER ECFPWM_2_RAW ECU_ADDRESS 0x7fbbf1 FORMAT "%4.1" /end MEASUREMENT
/begin MEASUREMENT lv_ecfpwm_tco_max "flag for critical TCO reached" UBYTE _CNV_S_2_RANGE__0___88_CM 1 0. 0. 1. DISPLAY_IDENTIFIER LV_ECFPWM_TCO_MAX ECU_ADDRESS 0x7fbc02 BIT_MASK 0x1 /end MEASUREMENT
/begin MEASUREMENT lv_ecfpwm_tco_2_max "flag for critical TCO_2 reached" UBYTE _CNV_S_2_RANGE__0___88_CM 1 0. 0. 1. DISPLAY_IDENTIFIER LV_ECFPWM_TCO_2_MAX ECU_ADDRESS 0x7fbc03 BIT_MASK 0x1 /end MEASUREMENT
/begin MEASUREMENT lv_ecfpwm_max "flag for critical TCO or TCO_2 reached" UBYTE _CNV_S_2_RANGE__0___88_CM 1 0. 0. 1. DISPLAY_IDENTIFIER LV_ECFPWM_MAX ECU_ADDRESS 0x7fbc04 BIT_MASK 0x1 /end MEASUREMENT
/begin MEASUREMENT ecfpwm_1_inter_1 "ECFPWM_2 after regarding engine start phase" UBYTE _CNV_A_R_LINEAR_____82_CM 1 0. 5.078125 87.890625 DISPLAY_IDENTIFIER ECFPWM_1_INTER_1 ECU_ADDRESS 0x7fbbf2 FORMAT "%4.1" /end MEASUREMENT
/begin MEASUREMENT ecfpwm_2_inter_1 "ECFPWM_2 regarding status critical coolant temperatures" UBYTE _CNV_A_R_LINEAR_____82_CM 1 0. 5.078125 87.890625 DISPLAY_IDENTIFIER ECFPWM_2_INTER_1 ECU_ADDRESS 0x7fbbf3 FORMAT "%4.1" /end MEASUREMENT
/begin MEASUREMENT n_rel_ecf_can "relative cooling power for CAN output" UBYTE _CNV_A_R_LINEAR_____242_CM 1 0. 0. 101.6 DISPLAY_IDENTIFIER N_REL_ECF_CAN ECU_ADDRESS 0x7fb818 FORMAT "%4.1" /end MEASUREMENT
/begin MEASUREMENT ecfpwm_1_inter_4_lgrd "Limitation gradient for ramp down ECFPWM_1 before end of power latch phase" UBYTE _CNV_A_R_LINEAR_____82_CM 1 0. 0. 99.609375 DISPLAY_IDENTIFIER ECFPWM_1_INTER_4_LGRD ECU_ADDRESS 0x7fbbf7 FORMAT "%4.1" /end MEASUREMENT
/begin MEASUREMENT ecfpwm_2_inter_4_lgrd "Limitation gradient for ramp down ECFPWM_2 before end of power latch phase" UBYTE _CNV_A_R_LINEAR_____82_CM 1 0. 0. 99.609375 DISPLAY_IDENTIFIER ECFPWM_2_INTER_4_LGRD ECU_ADDRESS 0x7fbbf8 FORMAT "%4.1" /end MEASUREMENT
/begin MEASUREMENT ecfpwm_sub_vecu "ECFPWM in case of request set by VECU in case of VB error" UBYTE _CNV_A_R_LINEAR_____82_CM 1 0. 5.078125 87.890625 DISPLAY_IDENTIFIER ECFPWM_SUB_VECU ECU_ADDRESS 0x7fbbf4 FORMAT "%4.1" /end MEASUREMENT
/begin MEASUREMENT ecfpwm_1_inter_4 "ECFPWM_1 after regarding engine power latch phase" UBYTE _CNV_A_R_LINEAR_____82_CM 1 0. 5.078125 87.890625 DISPLAY_IDENTIFIER ECFPWM_1_INTER_4 ECU_ADDRESS 0x7fbbf5 FORMAT "%4.1" /end MEASUREMENT
/begin MEASUREMENT ecfpwm_2_inter_4 "ECFPWM_2 after regarding engine power latch phase" UBYTE _CNV_A_R_LINEAR_____82_CM 1 0. 5.078125 87.890625 DISPLAY_IDENTIFIER ECFPWM_2_INTER_4 ECU_ADDRESS 0x7fbbf6 FORMAT "%4.1" /end MEASUREMENT
/begin CHARACTERISTIC lc_ecf_1_dc "switch to select if ECF_1 is a DC fan (1 means DC)" VALUE 0x84879c _REC_VAL_20_u1 1. _CNV_A_R_LINEAR_____1_CM 0. 1. DISPLAY_IDENTIFIER LC_ECF_1_DC FORMAT "%1.0" /end CHARACTERISTIC
/begin CHARACTERISTIC lc_ecf_2_dc "switch to select if ECF_2 is a DC fan (1 means DC)" VALUE 0x84879d _REC_VAL_20_u1 1. _CNV_A_R_LINEAR_____1_CM 0. 1. DISPLAY_IDENTIFIER LC_ECF_2_DC FORMAT "%1.0" /end CHARACTERISTIC
/begin CHARACTERISTIC c_tco_max_ecf_hys "hysteresis for activation of maximum ECFPWM" VALUE 0x8486cf _REC_VAL_20_u1 190.5 _CNV_A_R_LINEAR_____243_CM 0. 190.5 DISPLAY_IDENTIFIER C_TCO_MAX_ECF_HYS FORMAT "%5.1" /end CHARACTERISTIC
/begin CHARACTERISTIC c_tco_2_max_ecf "critical TCO_2 for activating maximum ECFPWM" VALUE 0x8486c0 _REC_VAL_20_u1 190.5 _CNV_A_R_LINEAR_____235_CM -48. 142.5 DISPLAY_IDENTIFIER C_TCO_2_MAX_ECF FORMAT "%5.1" /end CHARACTERISTIC
/begin CHARACTERISTIC lc_equip_tco_2 "logical switch to activate regarding of TCO_2 (1 means TCO_2 sensor available)" VALUE 0x8487a6 _REC_VAL_20_u1 1. _CNV_A_R_LINEAR_____1_CM 0. 1. DISPLAY_IDENTIFIER LC_EQUIP_TCO_2 FORMAT "%1.0" /end CHARACTERISTIC
/begin CHARACTERISTIC c_ecfpwm_1_tco_max "constant for ECFPWM_1 while LV_ECFPWM_MAX = 1" VALUE 0x8483f3 _REC_VAL_20_u1 82.8125 _CNV_A_R_LINEAR_____82_CM 5.078125 87.890625 DISPLAY_IDENTIFIER C_ECFPWM_1_TCO_MAX FORMAT "%4.1" /end CHARACTERISTIC
/begin CHARACTERISTIC c_ecfpwm_2_tco_max "constant for ECFPWM_2 while LV_ECFPWM_MAX = 1" VALUE 0x8483f7 _REC_VAL_20_u1 82.8125 _CNV_A_R_LINEAR_____82_CM 5.078125 87.890625 DISPLAY_IDENTIFIER C_ECFPWM_2_TCO_MAX FORMAT "%4.1" /end CHARACTERISTIC
/begin CHARACTERISTIC c_t_ecf_ast_act "time after start while start ECFPWM is constant" VALUE 0x848634 _REC_VAL_20_u2 6553.5 _CNV_A_R_LINEAR_____234_CM 0. 6553.5 DISPLAY_IDENTIFIER C_T_ECF_AST_ACT FORMAT "%6.1" /end CHARACTERISTIC
/begin CHARACTERISTIC c_ecfpwm_1_st_ast "ECFPWM_1 while start and after start" VALUE 0x8483f2 _REC_VAL_20_u1 82.8125 _CNV_A_R_LINEAR_____82_CM 5.078125 87.890625 DISPLAY_IDENTIFIER C_ECFPWM_1_ST_AST FORMAT "%4.1" /end CHARACTERISTIC
/begin CHARACTERISTIC c_ecfpwm_2_st_ast "ECFPWM_2 while start and after start" VALUE 0x8483f6 _REC_VAL_20_u1 82.8125 _CNV_A_R_LINEAR_____82_CM 5.078125 87.890625 DISPLAY_IDENTIFIER C_ECFPWM_2_ST_AST FORMAT "%4.1" /end CHARACTERISTIC
/begin CHARACTERISTIC c_ecfpwm_1_lgrd "limitation gradient for ECFPWM_1" VALUE 0x8483f0 _REC_VAL_20_u1 99.609375 _CNV_A_R_LINEAR_____236_CM 0. 99.609375 DISPLAY_IDENTIFIER C_ECFPWM_1_LGRD FORMAT "%4.1" /end CHARACTERISTIC
/begin CHARACTERISTIC c_ecfpwm_2_lgrd "limitation gradient for ECFPWM_2" VALUE 0x8483f4 _REC_VAL_20_u1 99.609375 _CNV_A_R_LINEAR_____236_CM 0. 99.609375 DISPLAY_IDENTIFIER C_ECFPWM_2_LGRD FORMAT "%4.1" /end CHARACTERISTIC
/begin CHARACTERISTIC c_t_ecfpwm_pwl_lgrd "ramp down time for ECFPWM_1/_2 before end of power latch phase" VALUE 0x848636 _REC_VAL_20_u1 25.5 _CNV_A_R_LINEAR_____234_CM 0. 25.5 DISPLAY_IDENTIFIER C_T_ECFPWM_PWL_LGRD FORMAT "%4.1" /end CHARACTERISTIC
/begin CHARACTERISTIC c_tco_2_max_ecf_hys "Hysteresis for activation of maximum ECFPWM" VALUE 0x8486c1 _REC_VAL_20_u1 190.5 _CNV_A_R_LINEAR_____243_CM 0. 190.5 DISPLAY_IDENTIFIER C_TCO_2_MAX_ECF_HYS FORMAT "%5.1" /end CHARACTERISTIC
/begin CHARACTERISTIC c_ecfpwm_vecu_lgrd "Gradient limitation in case of VECU request via CAN" VALUE 0x8483f9 _REC_VAL_20_u1 82.8125 _CNV_A_R_LINEAR_____236_CM 5.078125 87.890625 DISPLAY_IDENTIFIER C_ECFPWM_VECU_LGRD FORMAT "%4.1" /end CHARACTERISTIC
/begin CHARACTERISTIC c_ecfpwm_vecu_max "Resulting value in case of VECU request via CAN" VALUE 0x8483fa _REC_VAL_20_u1 82.8125 _CNV_A_R_LINEAR_____82_CM 5.078125 87.890625 DISPLAY_IDENTIFIER C_ECFPWM_VECU_MAX FORMAT "%4.1" /end CHARACTERISTIC
/begin CHARACTERISTIC c_ecfpwm_deac "Minimum ECFPWM while power latch phase and engine stop (default: 10%)" VALUE 0x8483f8 _REC_VAL_20_u1 82.8125 _CNV_A_R_LINEAR_____82_CM 5.078125 87.890625 DISPLAY_IDENTIFIER C_ECFPWM_DEAC FORMAT "%4.1" /end CHARACTERISTIC
/begin CHARACTERISTIC c_ecfpwm_1_max "Maximum value for ECFPWM_1" VALUE 0x8483f1 _REC_VAL_20_u1 82.8125 _CNV_A_R_LINEAR_____82_CM 5.078125 87.890625 DISPLAY_IDENTIFIER C_ECFPWM_1_MAX FORMAT "%4.1" /end CHARACTERISTIC
/begin CHARACTERISTIC c_ecfpwm_2_max "Maximum value for ECFPWM_2" VALUE 0x8483f5 _REC_VAL_20_u1 82.8125 _CNV_A_R_LINEAR_____82_CM 5.078125 87.890625 DISPLAY_IDENTIFIER C_ECFPWM_2_MAX FORMAT "%4.1" /end CHARACTERISTIC
/begin AXIS_PTS ldpm_vb_mmv__ecfpwm "" 0x8449a6 vb_mmv _REC_AXS_20_u1 3.12 _CNV_A_R_LINEAR_____244_CM 6 0. 26. FORMAT "%4.1" /end AXIS_PTS
/begin CHARACTERISTIC ip_ecfpwm_1_fac_vb "factor to increase ECFPWM_1 vs. VB" CURVE 0x8467a8 _REC_CUR_20_u1_u1 15.9375 _CNV_A_R_LINEAR_____245_CM 0. 15.9375 DISPLAY_IDENTIFIER IP_ECFPWM_1_FAC_VB FORMAT "%5.2"
 /begin AXIS_DESCR COM_AXIS vb_mmv _CNV_A_R_LINEAR_____244_CM 6 0. 26. FORMAT "%4.1" AXIS_PTS_REF ldpm_vb_mmv__ecfpwm /end AXIS_DESCR
/end CHARACTERISTIC
/begin CHARACTERISTIC ip_ecfpwm_2_fac_vb "factor to increase ECFPWM_2 vs. VB" CURVE 0x8467dc _REC_CUR_20_u1_u1 15.9375 _CNV_A_R_LINEAR_____245_CM 0. 15.9375 DISPLAY_IDENTIFIER IP_ECFPWM_2_FAC_VB FORMAT "%5.2"
 /begin AXIS_DESCR COM_AXIS vb_mmv _CNV_A_R_LINEAR_____244_CM 6 0. 26. FORMAT "%4.1" AXIS_PTS_REF ldpm_vb_mmv__ecfpwm /end AXIS_DESCR
/end CHARACTERISTIC
/begin AXIS_PTS ldp_n_sp_ecf_1__ecfpwm "" 0x844618 n_sp_ecf_1 _REC_AXS_20_u1 4080. _CNV_A_R_LINEAR_____237_CM 10 0. 4080. FORMAT "%4.0" /end AXIS_PTS
/begin CHARACTERISTIC ip_ecfpwm_1 "Basic ECFPWM_1 map" CURVE 0x84679e _REC_CUR_20_u1_u1 82.8125 _CNV_A_R_LINEAR_____82_CM 5.078125 87.890625 DISPLAY_IDENTIFIER IP_ECFPWM_1 FORMAT "%4.1"
 /begin AXIS_DESCR COM_AXIS n_sp_ecf_1 _CNV_A_R_LINEAR_____237_CM 10 0. 4080. FORMAT "%4.0" AXIS_PTS_REF ldp_n_sp_ecf_1__ecfpwm /end AXIS_DESCR
/end CHARACTERISTIC
/begin AXIS_PTS ldp_n_sp_ecf_2__ecfpwm "" 0x844623 n_sp_ecf_2 _REC_AXS_20_u1 4080. _CNV_A_R_LINEAR_____237_CM 10 0. 4080. FORMAT "%4.0" /end AXIS_PTS
/begin CHARACTERISTIC ip_ecfpwm_2 "basic ECFPWM_2 map" CURVE 0x8467d2 _REC_CUR_20_u1_u1 82.8125 _CNV_A_R_LINEAR_____82_CM 5.078125 87.890625 DISPLAY_IDENTIFIER IP_ECFPWM_2 FORMAT "%4.1"
 /begin AXIS_DESCR COM_AXIS n_sp_ecf_2 _CNV_A_R_LINEAR_____237_CM 10 0. 4080. FORMAT "%4.0" AXIS_PTS_REF ldp_n_sp_ecf_2__ecfpwm /end AXIS_DESCR
/end CHARACTERISTIC
/begin AXIS_PTS ldpm_tco__ecfpwm_pwl "" 0x84498c tco _REC_AXS_20_u1 190.5 _CNV_A_R_LINEAR_____235_CM 6 -48. 142.5 FORMAT "%5.1" /end AXIS_PTS
/begin AXIS_PTS ldpm_tam__ecfpwm_pwl "" 0x844985 tam _REC_AXS_20_u1 190.5 _CNV_A_R_LINEAR_____235_CM 6 -48. 142.5 FORMAT "%5.1" /end AXIS_PTS
/begin CHARACTERISTIC ip_ecfpwm_1_pwl "ECFPWM_1 while ECF power latch phase" MAP 0x8467ae _REC_MAP_20_u1_u1_u1 82.8125 _CNV_A_R_LINEAR_____82_CM 5.078125 87.890625 DISPLAY_IDENTIFIER IP_ECFPWM_1_PWL FORMAT "%4.1"
 /begin AXIS_DESCR COM_AXIS tco _CNV_A_R_LINEAR_____235_CM 6 -48. 142.5 FORMAT "%5.1" AXIS_PTS_REF ldpm_tco__ecfpwm_pwl /end AXIS_DESCR
 /begin AXIS_DESCR COM_AXIS tam _CNV_A_R_LINEAR_____235_CM 6 -48. 142.5 FORMAT "%5.1" AXIS_PTS_REF ldpm_tam__ecfpwm_pwl /end AXIS_DESCR
/end CHARACTERISTIC
/begin CHARACTERISTIC ip_ecfpwm_2_pwl "ECFPWM_2 while ECF power latch phase" MAP 0x8467e2 _REC_MAP_20_u1_u1_u1 82.8125 _CNV_A_R_LINEAR_____82_CM 5.078125 87.890625 DISPLAY_IDENTIFIER IP_ECFPWM_2_PWL FORMAT "%4.1"
 /begin AXIS_DESCR COM_AXIS tco _CNV_A_R_LINEAR_____235_CM 6 -48. 142.5 FORMAT "%5.1" AXIS_PTS_REF ldpm_tco__ecfpwm_pwl /end AXIS_DESCR
 /begin AXIS_DESCR COM_AXIS tam _CNV_A_R_LINEAR_____235_CM 6 -48. 142.5 FORMAT "%5.1" AXIS_PTS_REF ldpm_tam__ecfpwm_pwl /end AXIS_DESCR
/end CHARACTERISTIC
/begin AXIS_PTS ldp_ecfpwm_1__n_rel_ecf_can "" 0x84451b ecfpwm_1 _REC_AXS_20_u1 82.8125 _CNV_A_R_LINEAR_____82_CM 10 5.078125 87.890625 FORMAT "%4.1" /end AXIS_PTS
/begin AXIS_PTS ldp_ecfpwm_2__n_rel_ecf_can "" 0x844526 ecfpwm_2 _REC_AXS_20_u1 82.8125 _CNV_A_R_LINEAR_____82_CM 10 5.078125 87.890625 FORMAT "%4.1" /end AXIS_PTS
/begin CHARACTERISTIC ip_n_rel_ecf_can "transition from ECFPWM_1 and _2 to N_REL_ECF_CAN for CAN output" MAP 0x847210 _REC_MAP_20_u1_u1_u1 101.6 _CNV_A_R_LINEAR_____242_CM 0. 101.6 DISPLAY_IDENTIFIER IP_N_REL_ECF_CAN FORMAT "%4.1"
 /begin AXIS_DESCR COM_AXIS ecfpwm_1 _CNV_A_R_LINEAR_____82_CM 10 5.078125 87.890625 FORMAT "%4.1" AXIS_PTS_REF ldp_ecfpwm_1__n_rel_ecf_can /end AXIS_DESCR
 /begin AXIS_DESCR COM_AXIS ecfpwm_2 _CNV_A_R_LINEAR_____82_CM 10 5.078125 87.890625 FORMAT "%4.1" AXIS_PTS_REF ldp_ecfpwm_2__n_rel_ecf_can /end AXIS_DESCR
/end CHARACTERISTIC
/begin MEASUREMENT t_pop_coc "engine cooling management post operating phase timer" UWORD _CNV_A_R_LINEAR_____234_CM 1 0. 0. 6553.5 DISPLAY_IDENTIFIER T_POP_COC ECU_ADDRESS 0x7fb12e BYTE_ORDER MSB_LAST FORMAT "%6.1" /end MEASUREMENT
/begin MEASUREMENT t_pop_bas "basic post operating time vs. TCO and FCO_VS" UWORD _CNV_A_R_LINEAR_____234_CM 1 0. 0. 6553.5 DISPLAY_IDENTIFIER T_POP_BAS ECU_ADDRESS 0x7fb130 BYTE_ORDER MSB_LAST FORMAT "%6.1" /end MEASUREMENT
/begin MEASUREMENT t_pop_bas_cor "basic post operating time including factor" UWORD _CNV_A_R_LINEAR_____234_CM 1 0. 0. 6553.5 DISPLAY_IDENTIFIER T_POP_BAS_COR ECU_ADDRESS 0x7fb132 BYTE_ORDER MSB_LAST FORMAT "%6.1" /end MEASUREMENT
/begin MEASUREMENT t_pop_cor "maximum post operating time vs. TCO and TAM" UWORD _CNV_A_R_LINEAR_____234_CM 1 0. 0. 6553.5 DISPLAY_IDENTIFIER T_POP_COR ECU_ADDRESS 0x7fb134 BYTE_ORDER MSB_LAST FORMAT "%6.1" /end MEASUREMENT
/begin MEASUREMENT t_pop_toil "maximum post operating time vs. TOIL_POP_COC" UWORD _CNV_A_R_LINEAR_____234_CM 1 0. 0. 6553.5 DISPLAY_IDENTIFIER T_POP_TOIL ECU_ADDRESS 0x7fb136 BYTE_ORDER MSB_LAST FORMAT "%6.1" /end MEASUREMENT
/begin MEASUREMENT tco_sp_pop_stop "TCO threshold to cancel post operating if post operating phase 2 is active" UBYTE _CNV_A_R_LINEAR_____235_CM 1 0. -48. 142.5 DISPLAY_IDENTIFIER TCO_SP_POP_STOP ECU_ADDRESS 0x7fbbfc FORMAT "%5.1" /end MEASUREMENT
/begin MEASUREMENT t_pop_2 "post operating time for phase 2" UWORD _CNV_A_R_LINEAR_____234_CM 1 0. 0. 6553.5 DISPLAY_IDENTIFIER T_POP_2 ECU_ADDRESS 0x7fb138 BYTE_ORDER MSB_LAST FORMAT "%6.1" /end MEASUREMENT
/begin MEASUREMENT state_pop_coc "" UBYTE _CNV_S_4_STATE_POP__246_CM 1 0. 0. 3. DISPLAY_IDENTIFIER STATE_POP_COC ECU_ADDRESS 0x7fb819 /end MEASUREMENT
/begin MEASUREMENT t_pop_coc_end "" UWORD _CNV_A_R_LINEAR_____234_CM 1 0. 0. 6553.5 DISPLAY_IDENTIFIER T_POP_COC_END ECU_ADDRESS 0x7fa27a BYTE_ORDER MSB_LAST FORMAT "%6.1" /end MEASUREMENT
/begin CHARACTERISTIC c_fac_t_pop_phase_2 "percentage of time of T_PWL_1 elapsed for check of phase 2 activation" VALUE 0x848464 _REC_VAL_20_u1 99.609375 _CNV_A_R_LINEAR_____82_CM 0. 99.609375 DISPLAY_IDENTIFIER C_FAC_T_POP_PHASE_2 FORMAT "%4.1" /end CHARACTERISTIC
/begin CHARACTERISTIC c_t_pop_coc_max "maximum PWL time for engine cooling management power latch" VALUE 0x84869c _REC_VAL_20_u2 6553.5 _CNV_A_R_LINEAR_____234_CM 0. 6553.5 DISPLAY_IDENTIFIER C_T_POP_COC_MAX FORMAT "%6.1" /end CHARACTERISTIC
/begin AXIS_PTS ldp_tco__t_pop_bas "" 0x84478e tco _REC_AXS_20_u1 190.5 _CNV_A_R_LINEAR_____235_CM 6 -48. 142.5 FORMAT "%5.1" /end AXIS_PTS
/begin AXIS_PTS ldp_fco_vs__t_pop_bas "" 0x844578 fco_vs _REC_AXS_20_u2 92.52 _CNV_A_R_LINEAR_____247_CM 6 0. 92.52 /end AXIS_PTS
/begin AXIS_PTS ldp_tam__t_pop_fac "" 0x84473a tam _REC_AXS_20_u1 190.5 _CNV_A_R_LINEAR_____235_CM 6 -48. 142.5 FORMAT "%5.1" /end AXIS_PTS
/begin AXIS_PTS ldp_tco__t_pop_2 "" 0x844787 tco _REC_AXS_20_u1 190.5 _CNV_A_R_LINEAR_____235_CM 6 -48. 142.5 FORMAT "%5.1" /end AXIS_PTS
/begin AXIS_PTS ldp_tam__t_pop_2 "" 0x84472c tam _REC_AXS_20_u1 190.5 _CNV_A_R_LINEAR_____235_CM 6 -48. 142.5 FORMAT "%5.1" /end AXIS_PTS
/begin AXIS_PTS ldp_tco_stop__tco_sp_pop_stop "" 0x84480a tco_stop _REC_AXS_20_u1 190.5 _CNV_A_R_LINEAR_____235_CM 6 -48. 142.5 FORMAT "%5.1" /end AXIS_PTS
/begin AXIS_PTS ldp_tco__t_pop_cor "" 0x844795 tco _REC_AXS_20_u1 190.5 _CNV_A_R_LINEAR_____235_CM 6 -48. 142.5 FORMAT "%5.1" /end AXIS_PTS
/begin AXIS_PTS ldp_tam__t_pop_cor "" 0x844733 tam _REC_AXS_20_u1 190.5 _CNV_A_R_LINEAR_____235_CM 6 -48. 142.5 FORMAT "%5.1" /end AXIS_PTS
/begin AXIS_PTS ldp_toil__t_pop_toil "" 0x844821 toil _REC_AXS_20_u1 200. _CNV_A_R_LINEAR_____68_CM 4 -40. 160. FORMAT "%3.0" /end AXIS_PTS
/begin CHARACTERISTIC ip_t_pop_bas "basic post operating time" MAP 0x84789a _REC_MAP_20_u2_u1_u2 6553.5 _CNV_A_R_LINEAR_____234_CM 0. 6553.5 DISPLAY_IDENTIFIER IP_T_POP_BAS FORMAT "%6.1"
 /begin AXIS_DESCR COM_AXIS tco _CNV_A_R_LINEAR_____235_CM 6 -48. 142.5 FORMAT "%5.1" AXIS_PTS_REF ldp_tco__t_pop_bas /end AXIS_DESCR
 /begin AXIS_DESCR COM_AXIS fco_vs _CNV_A_R_LINEAR_____247_CM 6 0. 92.52 AXIS_PTS_REF ldp_fco_vs__t_pop_bas /end AXIS_DESCR
/end CHARACTERISTIC
/begin CHARACTERISTIC ip_t_pop_fac "factor on basic post operating time" CURVE 0x84792a _REC_CUR_20_u1_u1 0.99609375 _CNV_A_R_LINEAR_____248_CM 0. 0.99609375 DISPLAY_IDENTIFIER IP_T_POP_FAC FORMAT "%5.3"
 /begin AXIS_DESCR COM_AXIS tam _CNV_A_R_LINEAR_____235_CM 6 -48. 142.5 FORMAT "%5.1" AXIS_PTS_REF ldp_tam__t_pop_fac /end AXIS_DESCR
/end CHARACTERISTIC
/begin CHARACTERISTIC ip_t_pop_2 "maximum post operating time for phase 2 vs. TCO and TAM" MAP 0x847852 _REC_MAP_20_u2_u1_u1 6553.5 _CNV_A_R_LINEAR_____234_CM 0. 6553.5 DISPLAY_IDENTIFIER IP_T_POP_2 FORMAT "%6.1"
 /begin AXIS_DESCR COM_AXIS tco _CNV_A_R_LINEAR_____235_CM 6 -48. 142.5 FORMAT "%5.1" AXIS_PTS_REF ldp_tco__t_pop_2 /end AXIS_DESCR
 /begin AXIS_DESCR COM_AXIS tam _CNV_A_R_LINEAR_____235_CM 6 -48. 142.5 FORMAT "%5.1" AXIS_PTS_REF ldp_tam__t_pop_2 /end AXIS_DESCR
/end CHARACTERISTIC
/begin CHARACTERISTIC ip_tco_sp_pop_stop "TCO_STOP threshold to cancel PWL phase while phase 2" CURVE 0x847cfc _REC_CUR_20_u1_u1 190.5 _CNV_A_R_LINEAR_____235_CM -48. 142.5 DISPLAY_IDENTIFIER IP_TCO_SP_POP_STOP FORMAT "%5.1"
 /begin AXIS_DESCR COM_AXIS tco_stop _CNV_A_R_LINEAR_____235_CM 6 -48. 142.5 FORMAT "%5.1" AXIS_PTS_REF ldp_tco_stop__tco_sp_pop_stop /end AXIS_DESCR
/end CHARACTERISTIC
/begin CHARACTERISTIC ip_t_pop_cor "maximum post operating time vs. TCO and TAM" MAP 0x8478e2 _REC_MAP_20_u2_u1_u1 6553.5 _CNV_A_R_LINEAR_____234_CM 0. 6553.5 DISPLAY_IDENTIFIER IP_T_POP_COR FORMAT "%6.1"
 /begin AXIS_DESCR COM_AXIS tco _CNV_A_R_LINEAR_____235_CM 6 -48. 142.5 FORMAT "%5.1" AXIS_PTS_REF ldp_tco__t_pop_cor /end AXIS_DESCR
 /begin AXIS_DESCR COM_AXIS tam _CNV_A_R_LINEAR_____235_CM 6 -48. 142.5 FORMAT "%5.1" AXIS_PTS_REF ldp_tam__t_pop_cor /end AXIS_DESCR
/end CHARACTERISTIC
/begin CHARACTERISTIC ip_t_pop_toil "maximum post operating time vs. TOIL" CURVE 0x847930 _REC_CUR_20_u2_u1 6553.5 _CNV_A_R_LINEAR_____234_CM 0. 6553.5 DISPLAY_IDENTIFIER IP_T_POP_TOIL FORMAT "%6.1"
 /begin AXIS_DESCR COM_AXIS toil _CNV_A_R_LINEAR_____68_CM 4 -40. 160. FORMAT "%3.0" AXIS_PTS_REF ldp_toil__t_pop_toil /end AXIS_DESCR
/end CHARACTERISTIC
/begin MEASUREMENT cool_req_ac_clc "Normalized cooling request by AC" UBYTE _CNV_A_R_LINEAR_____82_CM 1 0. 0. 99.609375 DISPLAY_IDENTIFIER COOL_REQ_AC_CLC ECU_ADDRESS 0x7fbbe7 FORMAT "%4.1" /end MEASUREMENT
/begin AXIS_PTS ldp_cool_req_ac_ip_cool_ac_clc "" 0x8444d8 cool_req_ac _REC_AXS_20_u1 99.609375 _CNV_A_R_LINEAR_____82_CM 4 0. 99.609375 FORMAT "%4.1" /end AXIS_PTS
/begin CHARACTERISTIC ip_cool_req_ac_clc "Adaptation table for Cooling Request of AC" CURVE 0x8454a5 _REC_CUR_20_u1_u1 99.609375 _CNV_A_R_LINEAR_____82_CM 0. 99.609375 DISPLAY_IDENTIFIER IP_COOL_REQ_AC_CLC FORMAT "%4.1"
 /begin AXIS_DESCR COM_AXIS cool_req_ac _CNV_A_R_LINEAR_____82_CM 4 0. 99.609375 FORMAT "%4.1" AXIS_PTS_REF ldp_cool_req_ac_ip_cool_ac_clc /end AXIS_DESCR
/end CHARACTERISTIC
/begin MEASUREMENT t_hld_ecfpwm_max "Time for max. ECFPWM due to high cooling requests by AC" UBYTE _CNV_A_R_LINEAR_____234_CM 1 0. 0. 25.5 DISPLAY_IDENTIFIER T_HLD_ECFPWM_MAX ECU_ADDRESS 0x7fbbf9 FORMAT "%4.1" /end MEASUREMENT
/begin AXIS_PTS ldp_tco__ecfpwm_max "" 0x844780 tco _REC_AXS_20_u1 190.5 _CNV_A_R_LINEAR_____235_CM 6 -48. 142.5 FORMAT "%5.1" /end AXIS_PTS
/begin AXIS_PTS ldp_fco_t__ecfpwm_max "" 0x84455c fco_t _REC_AXS_20_u2 16.38375 _CNV_A_R_LINEAR_____249_CM 6 0. 16.38375 FORMAT "%7.2" /end AXIS_PTS
/begin CHARACTERISTIC ip_tco_fco_t_max_ecf "critical TCO for activating maximum ECFPWM" MAP 0x847a4e _REC_MAP_20_u1_u1_u2 190.5 _CNV_A_R_LINEAR_____235_CM -48. 142.5 DISPLAY_IDENTIFIER IP_TCO_FCO_T_MAX_ECF FORMAT "%5.1"
 /begin AXIS_DESCR COM_AXIS tco _CNV_A_R_LINEAR_____235_CM 6 -48. 142.5 FORMAT "%5.1" AXIS_PTS_REF ldp_tco__ecfpwm_max /end AXIS_DESCR
 /begin AXIS_DESCR COM_AXIS fco_t _CNV_A_R_LINEAR_____249_CM 6 0. 16.38375 FORMAT "%7.2" AXIS_PTS_REF ldp_fco_t__ecfpwm_max /end AXIS_DESCR
/end CHARACTERISTIC
/begin CHARACTERISTIC c_acp_ecfpwm_max "Air Conditioning pressure for map ECFPWM" VALUE 0x8482f1 _REC_VAL_20_u1 40. _CNV_A_R_LINEAR_____250_CM 0. 40. DISPLAY_IDENTIFIER C_ACP_ECFPWM_MAX FORMAT "%4.1" /end CHARACTERISTIC
/begin CHARACTERISTIC c_tam_ecfpwm_max "Ambient temperature for max ECFPWM" VALUE 0x8486bc _REC_VAL_20_u1 190.5 _CNV_A_R_LINEAR_____251_CM -48. 142.5 DISPLAY_IDENTIFIER C_TAM_ECFPWM_MAX FORMAT "%6.2" /end CHARACTERISTIC
/begin CHARACTERISTIC c_t_hld_ecfpwm_max "Max. time for max. ECFPWM due to high cooling requests by AC" VALUE 0x848648 _REC_VAL_20_u1 25.5 _CNV_A_R_LINEAR_____234_CM 0. 25.5 DISPLAY_IDENTIFIER C_T_HLD_ECFPWM_MAX FORMAT "%4.1" /end CHARACTERISTIC
/begin CHARACTERISTIC c_cool_req_ac_ecfpwm_max "Cooling request by AC to enable max ECFPWM" VALUE 0x848351 _REC_VAL_20_u1 99.609375 _CNV_A_R_LINEAR_____82_CM 0. 99.609375 DISPLAY_IDENTIFIER C_COOL_REQ_AC_ECFPWM_MAX FORMAT "%4.1" /end CHARACTERISTIC
/begin MEASUREMENT t_pop_coc_inter_1 "Engine cooling management post operating phase timer 1" UWORD _CNV_A_R_LINEAR_____234_CM 1 0. 0. 6553.5 DISPLAY_IDENTIFIER T_POP_COC_INTER_1 ECU_ADDRESS 0x7fb13a BYTE_ORDER MSB_LAST FORMAT "%6.1" /end MEASUREMENT
/begin MEASUREMENT t_pop_coc_inter_2 "Engine cooling management post operating phase timer 2" UWORD _CNV_A_R_LINEAR_____234_CM 1 0. 0. 6553.5 DISPLAY_IDENTIFIER T_POP_COC_INTER_2 ECU_ADDRESS 0x7fb13c BYTE_ORDER MSB_LAST FORMAT "%6.1" /end MEASUREMENT
/begin CHARACTERISTIC c_t_ast_tol_pop_coc "Maximum engine run time to reduce POP_COC" VALUE 0x8485f2 _REC_VAL_20_u2 6553.5 _CNV_A_R_LINEAR_____234_CM 0. 6553.5 DISPLAY_IDENTIFIER C_T_AST_TOL_POP_COC FORMAT "%6.1" /end CHARACTERISTIC
/begin CHARACTERISTIC c_t_ast_bol_pop_coc "Minimum engine run time to reduce POP_COC" VALUE 0x8485e8 _REC_VAL_20_u2 6553.5 _CNV_A_R_LINEAR_____234_CM 0. 6553.5 DISPLAY_IDENTIFIER C_T_AST_BOL_POP_COC FORMAT "%6.1" /end CHARACTERISTIC
/begin MEASUREMENT ectpwm "PWM signal to control the electrical heated coolant thermostat" UWORD _CNV_A_R_LINEAR_____252_CM 1 0. 0. 99.99847412109381 DISPLAY_IDENTIFIER ECTPWM ECU_ADDRESS 0x7f9fa0 BYTE_ORDER MSB_LAST /end MEASUREMENT
/begin MEASUREMENT ectpwm_bas "pre control value for ECTPWM" UWORD _CNV_A_R_LINEAR_____252_CM 1 0. 0. 99.99847412109381 DISPLAY_IDENTIFIER ECTPWM_BAS ECU_ADDRESS 0x7faf7c BYTE_ORDER MSB_LAST /end MEASUREMENT
/begin MEASUREMENT ectpwm_i "integral part for ECTPWM control" SWORD _CNV_A_R_LINEAR_____253_CM 1 0. -100. 99.9969482421875 DISPLAY_IDENTIFIER ECTPWM_I ECU_ADDRESS 0x7faf84 BYTE_ORDER MSB_LAST FORMAT "%8.3" /end MEASUREMENT
/begin MEASUREMENT ectpwm_raw "raw value for ECTPWM before limitation and external requests" UWORD _CNV_A_R_LINEAR_____252_CM 1 0. 0. 99.99847412109381 DISPLAY_IDENTIFIER ECTPWM_RAW ECU_ADDRESS 0x7faf7e BYTE_ORDER MSB_LAST /end MEASUREMENT
/begin MEASUREMENT ectpwm_inter_1 "ECTPWM Intermediate value" UWORD _CNV_A_R_LINEAR_____252_CM 1 0. 0. 99.99847412109381 DISPLAY_IDENTIFIER ECTPWM_INTER_1 ECU_ADDRESS 0x7faf80 BYTE_ORDER MSB_LAST /end MEASUREMENT
/begin MEASUREMENT ectpwm_inter_2 "ECTPWM Intermediate value" UWORD _CNV_A_R_LINEAR_____252_CM 1 0. 0. 99.99847412109381 DISPLAY_IDENTIFIER ECTPWM_INTER_2 ECU_ADDRESS 0x7faf82 BYTE_ORDER MSB_LAST /end MEASUREMENT
/begin CHARACTERISTIC c_tco_dif_min_ectpwm_i "minimum TCO_DIF threshold to activate I-controller" VALUE 0x8486cb _REC_VAL_20_s1 191.25 _CNV_A_R_LINEAR_____254_CM -96. 95.25 DISPLAY_IDENTIFIER C_TCO_DIF_MIN_ECTPWM_I FORMAT "%4.1" /end CHARACTERISTIC
/begin CHARACTERISTIC c_tco_dif_max_ectpwm_i "maximum TCO_DIF threshold to activate I-controller" VALUE 0x8486ca _REC_VAL_20_s1 191.25 _CNV_A_R_LINEAR_____254_CM -96. 95.25 DISPLAY_IDENTIFIER C_TCO_DIF_MAX_ECTPWM_I FORMAT "%4.1" /end CHARACTERISTIC
/begin CHARACTERISTIC c_ectpwm_i_min "minimum value for integral part of ECTPWM control" VALUE 0x848402 _REC_VAL_20_s2 199.9969482421875 _CNV_A_R_LINEAR_____253_CM -100. 99.9969482421875 DISPLAY_IDENTIFIER C_ECTPWM_I_MIN FORMAT "%8.3" /end CHARACTERISTIC
/begin CHARACTERISTIC c_ectpwm_i_max "maximum value for integral part of ECTPWM control" VALUE 0x848400 _REC_VAL_20_s2 199.9969482421875 _CNV_A_R_LINEAR_____253_CM -100. 99.9969482421875 DISPLAY_IDENTIFIER C_ECTPWM_I_MAX FORMAT "%8.3" /end CHARACTERISTIC
/begin CHARACTERISTIC c_tco_2_max_ectpwm_tol "Maximum TCO_2 threshold to activate ECTPWM_SUB (upper limit)" VALUE 0x8486c3 _REC_VAL_20_u1 190.5 _CNV_A_R_LINEAR_____235_CM -48. 142.5 DISPLAY_IDENTIFIER C_TCO_2_MAX_ECTPWM_TOL FORMAT "%5.1" /end CHARACTERISTIC
/begin CHARACTERISTIC c_ectpwm_sub "substitute value for ECTPWM while power latch phase or while TCO_2 > C_TCO_2_MAX_ECTPWM" VALUE 0x848408 _REC_VAL_20_u2 99.99847412109381 _CNV_A_R_LINEAR_____252_CM 0. 99.99847412109381 DISPLAY_IDENTIFIER C_ECTPWM_SUB /end CHARACTERISTIC
/begin CHARACTERISTIC c_ectpwm_max "maximum value for ECTPWM" VALUE 0x848404 _REC_VAL_20_u2 99.99847412109381 _CNV_A_R_LINEAR_____252_CM 0. 99.99847412109381 DISPLAY_IDENTIFIER C_ECTPWM_MAX /end CHARACTERISTIC
/begin CHARACTERISTIC c_ectpwm_min "minimum value for ECTPWM" VALUE 0x848406 _REC_VAL_20_u2 99.99847412109381 _CNV_A_R_LINEAR_____252_CM 0. 99.99847412109381 DISPLAY_IDENTIFIER C_ECTPWM_MIN /end CHARACTERISTIC
/begin CHARACTERISTIC c_tco_2_max_ectpwm_bol "Maximum TCO_2 threshold to activate ECTPWM_SUB(lower limit)" VALUE 0x8486c2 _REC_VAL_20_u1 190.5 _CNV_A_R_LINEAR_____235_CM -48. 142.5 DISPLAY_IDENTIFIER C_TCO_2_MAX_ECTPWM_BOL FORMAT "%5.1" /end CHARACTERISTIC
/begin CHARACTERISTIC c_ectpwm_sub_st "ECTPWM while Start phase" VALUE 0x84840c _REC_VAL_20_u2 99.99847412109381 _CNV_A_R_LINEAR_____252_CM 0. 99.99847412109381 DISPLAY_IDENTIFIER C_ECTPWM_SUB_ST /end CHARACTERISTIC
/begin CHARACTERISTIC c_ectpwm_sub_pwl "ECTPWM while non cooling management power latch phase" VALUE 0x84840a _REC_VAL_20_u2 99.99847412109381 _CNV_A_R_LINEAR_____252_CM 0. 99.99847412109381 DISPLAY_IDENTIFIER C_ECTPWM_SUB_PWL /end CHARACTERISTIC
/begin CHARACTERISTIC c_t_ast_min_ectpwm "Time after Start for setting ECTPWM to substitute value C_ECTPWM_SUB_ST" VALUE 0x8485ee _REC_VAL_20_u2 6553.5 _CNV_A_R_LINEAR_____234_CM 0. 6553.5 DISPLAY_IDENTIFIER C_T_AST_MIN_ECTPWM FORMAT "%6.1" /end CHARACTERISTIC
/begin AXIS_PTS ldp_tco_dif__ectpwm_i "" 0x8447c6 tco_dif _REC_AXS_20_u1 191.25 _CNV_A_R_LINEAR_____255_CM 12 -96. 95.25 FORMAT "%4.1" /end AXIS_PTS
/begin CHARACTERISTIC ip_ectpwm_i "integral part of ECTPWM controller" CURVE 0x846886 _REC_CUR_20_u2_u1 199.9969482 _CNV_A_R_LINEAR_____158_CM -100. 99.99694820000001 DISPLAY_IDENTIFIER IP_ECTPWM_I FORMAT "%8.3"
 /begin AXIS_DESCR COM_AXIS tco_dif _CNV_A_R_LINEAR_____255_CM 12 -96. 95.25 FORMAT "%4.1" AXIS_PTS_REF ldp_tco_dif__ectpwm_i /end AXIS_DESCR
/end CHARACTERISTIC
/begin AXIS_PTS ldp_tco_dif__ectpwm_bas "" 0x8447bd tco_dif _REC_AXS_20_u1 191.25 _CNV_A_R_LINEAR_____255_CM 8 -96. 95.25 FORMAT "%4.1" /end AXIS_PTS
/begin AXIS_PTS ldp_tco_sp__ectpwm_bas "" 0x844801 tco_sp _REC_AXS_20_u1 190.5 _CNV_A_R_LINEAR_____235_CM 8 -48. 142.5 FORMAT "%5.1" /end AXIS_PTS
/begin CHARACTERISTIC ip_ectpwm_bas "basic map for ECTPWM (pre control)" MAP 0x846806 _REC_MAP_20_u2_u1_u1 99.99847412109381 _CNV_A_R_LINEAR_____252_CM 0. 99.99847412109381 DISPLAY_IDENTIFIER IP_ECTPWM_BAS
 /begin AXIS_DESCR COM_AXIS tco_dif _CNV_A_R_LINEAR_____255_CM 8 -96. 95.25 FORMAT "%4.1" AXIS_PTS_REF ldp_tco_dif__ectpwm_bas /end AXIS_DESCR
 /begin AXIS_DESCR COM_AXIS tco_sp _CNV_A_R_LINEAR_____235_CM 8 -48. 142.5 FORMAT "%5.1" AXIS_PTS_REF ldp_tco_sp__ectpwm_bas /end AXIS_DESCR
/end CHARACTERISTIC
/begin MEASUREMENT cool_req_eng "additional relative engine cooling request" UBYTE _CNV_A_R_LINEAR_____82_CM 1 0. 0. 99.609375 DISPLAY_IDENTIFIER COOL_REQ_ENG ECU_ADDRESS 0x7fb711 FORMAT "%4.1" /end MEASUREMENT
/begin MEASUREMENT cool_req_eng_inter "relative engine cooling request" UBYTE _CNV_A_R_LINEAR_____82_CM 1 0. 0. 99.609375 DISPLAY_IDENTIFIER COOL_REQ_ENG_INTER ECU_ADDRESS 0x7fbb15 FORMAT "%4.1" /end MEASUREMENT
/begin MEASUREMENT cool_req_eng_dyn "dynamic relative engine cooling request" UBYTE _CNV_A_R_LINEAR_____82_CM 1 0. 0. 99.609375 DISPLAY_IDENTIFIER COOL_REQ_ENG_DYN ECU_ADDRESS 0x7fbb16 FORMAT "%4.1" /end MEASUREMENT
/begin MEASUREMENT cool_req_eng_tco "relative engine cooling request depending on TCP and TAM" UBYTE _CNV_A_R_LINEAR_____82_CM 1 0. 0. 99.609375 DISPLAY_IDENTIFIER COOL_REQ_ENG_TCO ECU_ADDRESS 0x7fbb17 FORMAT "%4.1" /end MEASUREMENT
/begin MEASUREMENT cool_req_eng_clc "relative engine cooling request, intermediate value" UBYTE _CNV_A_R_LINEAR_____82_CM 1 0. 0. 99.609375 DISPLAY_IDENTIFIER COOL_REQ_ENG_CLC ECU_ADDRESS 0x7fbb18 FORMAT "%4.1" /end MEASUREMENT
/begin MEASUREMENT t_dly_1_tco_2_sp_add "Timer for activating additional TCO_2_SP_COR_2" UBYTE _CNV_A_R_LINEAR_____32_CM 1 0. 0. 255. DISPLAY_IDENTIFIER T_DLY_1_TCO_2_SP_ADD ECU_ADDRESS 0x7fbb19 FORMAT "%3.0" /end MEASUREMENT
/begin MEASUREMENT t_dly_2_tco_2_sp_add "Timer for activating additional TCO_2_SP_COR_2" UBYTE _CNV_A_R_LINEAR_____32_CM 1 0. 0. 255. DISPLAY_IDENTIFIER T_DLY_2_TCO_2_SP_ADD ECU_ADDRESS 0x7fbb1a FORMAT "%3.0" /end MEASUREMENT
/begin MEASUREMENT tco_2_sp_1 "TCO_2_SP intermediate value" UBYTE _CNV_A_R_LINEAR_____235_CM 1 0. -48. 142.5 DISPLAY_IDENTIFIER TCO_2_SP_1 ECU_ADDRESS 0x7fbb1b FORMAT "%5.1" /end MEASUREMENT
/begin MEASUREMENT tco_2_sp_2 "TCO_2_SP intermediate value" UBYTE _CNV_A_R_LINEAR_____235_CM 1 0. -48. 142.5 DISPLAY_IDENTIFIER TCO_2_SP_2 ECU_ADDRESS 0x7fbb1c FORMAT "%5.1" /end MEASUREMENT
/begin MEASUREMENT tco_2_sp_3 "TCO_2_SP intermediate value" UBYTE _CNV_A_R_LINEAR_____235_CM 1 0. -48. 142.5 DISPLAY_IDENTIFIER TCO_2_SP_3 ECU_ADDRESS 0x7fbb1d FORMAT "%5.1" /end MEASUREMENT
/begin MEASUREMENT tco_2_sp_4 "TCO_2_SP intermediate value" UBYTE _CNV_A_R_LINEAR_____235_CM 1 0. -48. 142.5 DISPLAY_IDENTIFIER TCO_2_SP_4 ECU_ADDRESS 0x7fbb1e FORMAT "%5.1" /end MEASUREMENT
/begin MEASUREMENT tco_2_sp_5 "TCO_2_SP intermediate value" UBYTE _CNV_A_R_LINEAR_____235_CM 1 0. -48. 142.5 DISPLAY_IDENTIFIER TCO_2_SP_5 ECU_ADDRESS 0x7fbb1f FORMAT "%5.1" /end MEASUREMENT
/begin MEASUREMENT tco_2_sp_6 "TCO_2_SP intermediate value" UBYTE _CNV_A_R_LINEAR_____235_CM 1 0. -48. 142.5 DISPLAY_IDENTIFIER TCO_2_SP_6 ECU_ADDRESS 0x7fbb20 FORMAT "%5.1" /end MEASUREMENT
/begin MEASUREMENT tco_2_sp_cor_2 "TCO_2_SP corrective value" UBYTE _CNV_A_R_LINEAR_____235_CM 1 0. -48. 142.5 DISPLAY_IDENTIFIER TCO_2_SP_COR_2 ECU_ADDRESS 0x7fbb21 FORMAT "%5.1" /end MEASUREMENT
/begin MEASUREMENT tco_2_sp "TCO_2_SP resulting value for COOL_REQ_ENG calculation" UBYTE _CNV_A_R_LINEAR_____235_CM 1 0. -48. 142.5 DISPLAY_IDENTIFIER TCO_2_SP ECU_ADDRESS 0x7fb713 FORMAT "%5.1" /end MEASUREMENT
/begin MEASUREMENT tco_2_dif "Diference between TCO_2_SP and TCO_2" SBYTE _CNV_A_R_LINEAR_____254_CM 1 0. -96. 95.25 DISPLAY_IDENTIFIER TCO_2_DIF ECU_ADDRESS 0x7fbb2e FORMAT "%4.1" /end MEASUREMENT
/begin MEASUREMENT tco_2_sp_mmv "Filtered value of TCO_2_SP_1" UBYTE _CNV_A_R_LINEAR_____235_CM 1 0. -48. 142.5 DISPLAY_IDENTIFIER TCO_2_SP_MMV ECU_ADDRESS 0x7fbb22 FORMAT "%5.1" /end MEASUREMENT
/begin MEASUREMENT vs_cool_req "Vehicle speed as input value for basic cooling map (IP_COOL_REQ_ENG_BAS)" UBYTE _CNV_A_R_LINEAR_____239_CM 1 0. 0. 255. DISPLAY_IDENTIFIER VS_COOL_REQ ECU_ADDRESS 0x7fbb23 FORMAT "%3.0" /end MEASUREMENT
/begin MEASUREMENT cool_req_eng_bas "Basic value for engine cooling request derived from map IP_COOL_REQ_ENG_BAS" UBYTE _CNV_A_R_LINEAR_____82_CM 1 0. 0. 99.609375 DISPLAY_IDENTIFIER COOL_REQ_ENG_BAS ECU_ADDRESS 0x7fbb24 FORMAT "%4.1" /end MEASUREMENT
/begin MEASUREMENT cool_req_eng_cor "Corrective (controler) value for engine cooling request; derived from map IP_COOL_REQ_ENG_I" UBYTE _CNV_A_R_LINEAR_____82_CM 1 0. 0. 99.609375 DISPLAY_IDENTIFIER COOL_REQ_ENG_COR ECU_ADDRESS 0x7fbb25 FORMAT "%4.1" /end MEASUREMENT
/begin CHARACTERISTIC c_cool_req_eng_inter_sub "Default value in case of failure entries" VALUE 0x848355 _REC_VAL_20_u1 99.609375 _CNV_A_R_LINEAR_____82_CM 0. 99.609375 DISPLAY_IDENTIFIER C_COOL_REQ_ENG_INTER_SUB FORMAT "%4.1" /end CHARACTERISTIC
/begin CHARACTERISTIC c_cool_req_eng_min "minimum value for COOL_REQ" VALUE 0x848357 _REC_VAL_20_u1 99.609375 _CNV_A_R_LINEAR_____82_CM 0. 99.609375 DISPLAY_IDENTIFIER C_COOL_REQ_ENG_MIN FORMAT "%4.1" /end CHARACTERISTIC
/begin CHARACTERISTIC c_cool_req_eng_max "maximum value for COOL_REQ" VALUE 0x848356 _REC_VAL_20_u1 99.609375 _CNV_A_R_LINEAR_____82_CM 0. 99.609375 DISPLAY_IDENTIFIER C_COOL_REQ_ENG_MAX FORMAT "%4.1" /end CHARACTERISTIC
/begin CHARACTERISTIC lc_tco_2_sp_mdl_ena "Switch to activate cooling request calculation based on a TCO_2_SP model (1 = model based; Version 1)" VALUE 0x8487d9 _REC_VAL_20_u1 1. _CNV_A_R_LINEAR_____1_CM 0. 1. DISPLAY_IDENTIFIER LC_TCO_2_SP_MDL_ENA FORMAT "%1.0" /end CHARACTERISTIC
/begin CHARACTERISTIC c_crlc_tco_2_sp_inc "PT1 filter constant for increasing TCO_2_SP_1 value" VALUE 0x84835d _REC_VAL_20_u1 1. _CNV_A_R_LINEAR_____256_CM 0. 1. DISPLAY_IDENTIFIER C_CRLC_TCO_2_SP_INC FORMAT "%5.3" /end CHARACTERISTIC
/begin CHARACTERISTIC c_crlc_tco_2_sp_dec "PT1 filter constant for decreasing TCO_2_SP_1 value" VALUE 0x84835c _REC_VAL_20_u1 1. _CNV_A_R_LINEAR_____256_CM 0. 1. DISPLAY_IDENTIFIER C_CRLC_TCO_2_SP_DEC FORMAT "%5.3" /end CHARACTERISTIC
/begin CHARACTERISTIC lc_inp_tco_sp "Switch to choose TCO or TCO_SP as input for Kf IP_TCO_2_SP_3 (1 = TCO)" VALUE 0x8487ad _REC_VAL_20_u1 1. _CNV_A_R_LINEAR_____1_CM 0. 1. DISPLAY_IDENTIFIER LC_INP_TCO_SP FORMAT "%1.0" /end CHARACTERISTIC
/begin CHARACTERISTIC c_ectpwm_1_tco_2_sp_add "ECTPWM threshold to activate TCO_2_SP_COR_2 offset" VALUE 0x8483fc _REC_VAL_20_u2 99.99847412109381 _CNV_A_R_LINEAR_____252_CM 0. 99.99847412109381 DISPLAY_IDENTIFIER C_ECTPWM_1_TCO_2_SP_ADD /end CHARACTERISTIC
/begin CHARACTERISTIC c_ectpwm_2_tco_2_sp_add "ECTPWM threshold to deactivate TCO_2_SP_COR_2 offset" VALUE 0x8483fe _REC_VAL_20_u2 99.99847412109381 _CNV_A_R_LINEAR_____252_CM 0. 99.99847412109381 DISPLAY_IDENTIFIER C_ECTPWM_2_TCO_2_SP_ADD /end CHARACTERISTIC
/begin CHARACTERISTIC c_tco_dif_1_tco_2_sp_add "TCO_DIF threshold to activate TCO_2_SP_COR_2 offset" VALUE 0x8486c8 _REC_VAL_20_s1 191.25 _CNV_A_R_LINEAR_____254_CM -96. 95.25 DISPLAY_IDENTIFIER C_TCO_DIF_1_TCO_2_SP_ADD FORMAT "%4.1" /end CHARACTERISTIC
/begin CHARACTERISTIC c_tco_dif_2_tco_2_sp_add "TCO_DIF threshold to activate TCO_2_SP_COR_2 offset" VALUE 0x8486c9 _REC_VAL_20_s1 191.25 _CNV_A_R_LINEAR_____254_CM -96. 95.25 DISPLAY_IDENTIFIER C_TCO_DIF_2_TCO_2_SP_ADD FORMAT "%4.1" /end CHARACTERISTIC
/begin CHARACTERISTIC c_t_dly_1_tco_2_sp_add "Time to activate TCO_2_SP_COR_2 offset" VALUE 0x848628 _REC_VAL_20_u1 255. _CNV_A_R_LINEAR_____32_CM 0. 255. DISPLAY_IDENTIFIER C_T_DLY_1_TCO_2_SP_ADD FORMAT "%3.0" /end CHARACTERISTIC
/begin CHARACTERISTIC c_t_dly_2_tco_2_sp_add "Time to deactivate TCO_2_SP_COR_2 offset" VALUE 0x848629 _REC_VAL_20_u1 255. _CNV_A_R_LINEAR_____32_CM 0. 255. DISPLAY_IDENTIFIER C_T_DLY_2_TCO_2_SP_ADD FORMAT "%3.0" /end CHARACTERISTIC
/begin CHARACTERISTIC c_tco_2_sp_sub "TCO_2_SP substitute value in case of relevant error active" VALUE 0x8486c4 _REC_VAL_20_u1 190.5 _CNV_A_R_LINEAR_____251_CM -48. 142.5 DISPLAY_IDENTIFIER C_TCO_2_SP_SUB FORMAT "%6.2" /end CHARACTERISTIC
/begin CHARACTERISTIC c_tco_2_sub_cool_req "TCO_2 substitute value in case of relevant error active" VALUE 0x8486c5 _REC_VAL_20_u1 190.5 _CNV_A_R_LINEAR_____251_CM -48. 142.5 DISPLAY_IDENTIFIER C_TCO_2_SUB_COOL_REQ FORMAT "%6.2" /end CHARACTERISTIC
/begin CHARACTERISTIC c_vs_cool_req_sub "VS substitute value in case of relevant error active" VALUE 0x848778 _REC_VAL_20_u1 255. _CNV_A_R_LINEAR_____239_CM 0. 255. DISPLAY_IDENTIFIER C_VS_COOL_REQ_SUB FORMAT "%3.0" /end CHARACTERISTIC
/begin CHARACTERISTIC c_tco_2_dif_hys "Hysteresis for activation COOL_REQ_ENG integral controler" VALUE 0x8486bf _REC_VAL_20_s1 191.25 _CNV_A_R_LINEAR_____254_CM -96. 95.25 DISPLAY_IDENTIFIER C_TCO_2_DIF_HYS FORMAT "%4.1" /end CHARACTERISTIC
/begin AXIS_PTS ldp_tco__cool_req_eng_tco "" 0x844777 tco _REC_AXS_20_u1 190.5 _CNV_A_R_LINEAR_____235_CM 8 -48. 142.5 FORMAT "%5.1" /end AXIS_PTS
/begin AXIS_PTS ldp_tam__cool_req_eng_tco "" 0x84471a tam _REC_AXS_20_u1 190.5 _CNV_A_R_LINEAR_____235_CM 8 -48. 142.5 FORMAT "%5.1" /end AXIS_PTS
/begin CHARACTERISTIC ip_cool_req_eng_tco "relative engine cooling request vs. TCO and TAM" MAP 0x84557a _REC_MAP_20_u1_u1_u1 99.609375 _CNV_A_R_LINEAR_____82_CM 0. 99.609375 DISPLAY_IDENTIFIER IP_COOL_REQ_ENG_TCO FORMAT "%4.1"
 /begin AXIS_DESCR COM_AXIS tco _CNV_A_R_LINEAR_____235_CM 8 -48. 142.5 FORMAT "%5.1" AXIS_PTS_REF ldp_tco__cool_req_eng_tco /end AXIS_DESCR
 /begin AXIS_DESCR COM_AXIS tam _CNV_A_R_LINEAR_____235_CM 8 -48. 142.5 FORMAT "%5.1" AXIS_PTS_REF ldp_tam__cool_req_eng_tco /end AXIS_DESCR
/end CHARACTERISTIC
/begin AXIS_PTS ldp_tco_dif__cool_req_eng_dyn "" 0x8447b4 tco_dif _REC_AXS_20_u1 191.25 _CNV_A_R_LINEAR_____255_CM 8 -96. 95.25 FORMAT "%4.1" /end AXIS_PTS
/begin AXIS_PTS ldp_tco_1_2__cool_req_eng_dyn "" 0x84474a tco_1_2 _REC_AXS_20_u1 190.5 _CNV_A_R_LINEAR_____243_CM 8 0. 190.5 FORMAT "%5.1" /end AXIS_PTS
/begin CHARACTERISTIC ip_cool_req_eng_dyn "relative engine cooling request vs. TCO_DIF and TCO_1_2" MAP 0x845529 _REC_MAP_20_u1_u1_u1 99.609375 _CNV_A_R_LINEAR_____82_CM 0. 99.609375 DISPLAY_IDENTIFIER IP_COOL_REQ_ENG_DYN FORMAT "%4.1"
 /begin AXIS_DESCR COM_AXIS tco_dif _CNV_A_R_LINEAR_____255_CM 8 -96. 95.25 FORMAT "%4.1" AXIS_PTS_REF ldp_tco_dif__cool_req_eng_dyn /end AXIS_DESCR
 /begin AXIS_DESCR COM_AXIS tco_1_2 _CNV_A_R_LINEAR_____243_CM 8 0. 190.5 FORMAT "%5.1" AXIS_PTS_REF ldp_tco_1_2__cool_req_eng_dyn /end AXIS_DESCR
/end CHARACTERISTIC
/begin AXIS_PTS ldp_cool_req_eng_inter__cool_req_eng_cor "" 0x8444eb cool_req_eng_inter _REC_AXS_20_u1 99.609375 _CNV_A_R_LINEAR_____82_CM 8 0. 99.609375 FORMAT "%4.1" /end AXIS_PTS
/begin AXIS_PTS ldp_vs_cool_req__cool_req_eng_cor "" 0x8448c0 vs_cool_req _REC_AXS_20_u1 255. _CNV_A_R_LINEAR_____239_CM 8 0. 255. FORMAT "%3.0" /end AXIS_PTS
/begin CHARACTERISTIC ip_cool_req_eng_cor "Correction map for additional relative engine cooling request vs vehicle speed" MAP 0x8454e9 _REC_MAP_20_u1_u1_u1 99.609375 _CNV_A_R_LINEAR_____82_CM 0. 99.609375 DISPLAY_IDENTIFIER IP_COOL_REQ_ENG_COR FORMAT "%4.1"
 /begin AXIS_DESCR COM_AXIS cool_req_eng_inter _CNV_A_R_LINEAR_____82_CM 8 0. 99.609375 FORMAT "%4.1" AXIS_PTS_REF ldp_cool_req_eng_inter__cool_req_eng_cor /end AXIS_DESCR
 /begin AXIS_DESCR COM_AXIS vs_cool_req _CNV_A_R_LINEAR_____239_CM 8 0. 255. FORMAT "%3.0" AXIS_PTS_REF ldp_vs_cool_req__cool_req_eng_cor /end AXIS_DESCR
/end CHARACTERISTIC
/begin AXIS_PTS ldp_n__tco_2_sp_1 "" 0x8445ec n _REC_AXS_20_u2 8160. _CNV_A_R_LINEAR_____257_CM 8 0. 8160. FORMAT "%4.0" /end AXIS_PTS
/begin AXIS_PTS ldp_tqi_req_slow__tco_2_sp_1 "" 0x844856 tqi_req_slow _REC_AXS_20_u2 2047.97875 _CNV_A_R_LINEAR_____83_CM 8 -1024. 1023.97875 FORMAT "%8.2" /end AXIS_PTS
/begin CHARACTERISTIC ip_tco_2_sp_1 "Basic TCO_2_SP map" MAP 0x84794e _REC_MAP_20_u1_u2_u2 190.5 _CNV_A_R_LINEAR_____235_CM -48. 142.5 DISPLAY_IDENTIFIER IP_TCO_2_SP_1 FORMAT "%5.1"
 /begin AXIS_DESCR COM_AXIS n _CNV_A_R_LINEAR_____257_CM 8 0. 8160. FORMAT "%4.0" AXIS_PTS_REF ldp_n__tco_2_sp_1 /end AXIS_DESCR
 /begin AXIS_DESCR COM_AXIS tqi_req_slow _CNV_A_R_LINEAR_____83_CM 8 -1024. 1023.97875 FORMAT "%8.2" AXIS_PTS_REF ldp_tqi_req_slow__tco_2_sp_1 /end AXIS_DESCR
/end CHARACTERISTIC
/begin AXIS_PTS ldp_tco_inp__tco_2_sp_3 "" 0x8447dc tco_inp _REC_AXS_20_u1 190.5 _CNV_A_R_LINEAR_____235_CM 8 -48. 142.5 FORMAT "%5.1" /end AXIS_PTS
/begin AXIS_PTS ldp_tco_2_sp_mmv__tco_2_sp_3 "" 0x84476e tco_2_sp_mmv _REC_AXS_20_u1 190.5 _CNV_A_R_LINEAR_____235_CM 8 -48. 142.5 FORMAT "%5.1" /end AXIS_PTS
/begin CHARACTERISTIC ip_tco_2_sp_3 "Correction map for TCO_2_SP" MAP 0x8479ce _REC_MAP_20_u1_u1_u1 190.5 _CNV_A_R_LINEAR_____235_CM -48. 142.5 DISPLAY_IDENTIFIER IP_TCO_2_SP_3 FORMAT "%5.1"
 /begin AXIS_DESCR COM_AXIS tco_inp _CNV_A_R_LINEAR_____235_CM 8 -48. 142.5 FORMAT "%5.1" AXIS_PTS_REF ldp_tco_inp__tco_2_sp_3 /end AXIS_DESCR
 /begin AXIS_DESCR COM_AXIS tco_2_sp_mmv _CNV_A_R_LINEAR_____235_CM 8 -48. 142.5 FORMAT "%5.1" AXIS_PTS_REF ldp_tco_2_sp_mmv__tco_2_sp_3 /end AXIS_DESCR
/end CHARACTERISTIC
/begin AXIS_PTS ldp_tco__tco_2_sp_2 "" 0x84479c tco _REC_AXS_20_u1 190.5 _CNV_A_R_LINEAR_____235_CM 8 -48. 142.5 FORMAT "%5.1" /end AXIS_PTS
/begin AXIS_PTS ldp_tam__tco_2_sp_2 "" 0x844741 tam _REC_AXS_20_u1 190.5 _CNV_A_R_LINEAR_____235_CM 8 -48. 142.5 FORMAT "%5.1" /end AXIS_PTS
/begin CHARACTERISTIC ip_tco_2_sp_2 "Correction map for TCO_2_SP" MAP 0x84798e _REC_MAP_20_u1_u1_u1 190.5 _CNV_A_R_LINEAR_____235_CM -48. 142.5 DISPLAY_IDENTIFIER IP_TCO_2_SP_2 FORMAT "%5.1"
 /begin AXIS_DESCR COM_AXIS tco _CNV_A_R_LINEAR_____235_CM 8 -48. 142.5 FORMAT "%5.1" AXIS_PTS_REF ldp_tco__tco_2_sp_2 /end AXIS_DESCR
 /begin AXIS_DESCR COM_AXIS tam _CNV_A_R_LINEAR_____235_CM 8 -48. 142.5 FORMAT "%5.1" AXIS_PTS_REF ldp_tam__tco_2_sp_2 /end AXIS_DESCR
/end CHARACTERISTIC
/begin AXIS_PTS ldp_n__fac_tco_2_sp_cor "" 0x8445c6 n _REC_AXS_20_u2 8160. _CNV_A_R_LINEAR_____257_CM 8 0. 8160. FORMAT "%4.0" /end AXIS_PTS
/begin CHARACTERISTIC ip_fac_tco_2_sp_cor "Factor on TCO_2_SP_2 to regard volumetric flow of coolant" CURVE 0x846cc5 _REC_CUR_20_u1_u2 25.5 _CNV_A_R_LINEAR_____258_CM 0. 25.5 DISPLAY_IDENTIFIER IP_FAC_TCO_2_SP_COR FORMAT "%4.1"
 /begin AXIS_DESCR COM_AXIS n _CNV_A_R_LINEAR_____257_CM 8 0. 8160. FORMAT "%4.0" AXIS_PTS_REF ldp_n__fac_tco_2_sp_cor /end AXIS_DESCR
/end CHARACTERISTIC
/begin AXIS_PTS ldp_tco_dif__tco_2_sp_cor_2 "" 0x8447d3 tco_dif _REC_AXS_20_u1 191.25 _CNV_A_R_LINEAR_____255_CM 8 -96. 95.25 FORMAT "%4.1" /end AXIS_PTS
/begin AXIS_PTS ldp_tco_1_2__tco_2_sp_cor_2 "" 0x844753 tco_1_2 _REC_AXS_20_u1 190.5 _CNV_A_R_LINEAR_____243_CM 8 0. 190.5 FORMAT "%5.1" /end AXIS_PTS
/begin CHARACTERISTIC ip_tco_2_sp_cor_2 "Correction map on TCO_2_SP_5" MAP 0x847a0e _REC_MAP_20_u1_u1_u1 190.5 _CNV_A_R_LINEAR_____235_CM -48. 142.5 DISPLAY_IDENTIFIER IP_TCO_2_SP_COR_2 FORMAT "%5.1"
 /begin AXIS_DESCR COM_AXIS tco_dif _CNV_A_R_LINEAR_____255_CM 8 -96. 95.25 FORMAT "%4.1" AXIS_PTS_REF ldp_tco_dif__tco_2_sp_cor_2 /end AXIS_DESCR
 /begin AXIS_DESCR COM_AXIS tco_1_2 _CNV_A_R_LINEAR_____243_CM 8 0. 190.5 FORMAT "%5.1" AXIS_PTS_REF ldp_tco_1_2__tco_2_sp_cor_2 /end AXIS_DESCR
/end CHARACTERISTIC
/begin AXIS_PTS ldp_vs_cool_req__cool_req_eng_bas "" 0x8448b7 vs_cool_req _REC_AXS_20_u1 255. _CNV_A_R_LINEAR_____239_CM 8 0. 255. FORMAT "%3.0" /end AXIS_PTS
/begin AXIS_PTS ldp_tco_2_dif__cool_req_eng_bas "" 0x84475c tco_2_dif _REC_AXS_20_u1 191.25 _CNV_A_R_LINEAR_____255_CM 8 -96. 95.25 FORMAT "%4.1" /end AXIS_PTS
/begin CHARACTERISTIC ip_cool_req_eng_bas "Basic map for engine cooling request if TCO_2_SP model is used" MAP 0x8454a9 _REC_MAP_20_u1_u1_u1 99.609375 _CNV_A_R_LINEAR_____82_CM 0. 99.609375 DISPLAY_IDENTIFIER IP_COOL_REQ_ENG_BAS FORMAT "%4.1"
 /begin AXIS_DESCR COM_AXIS vs_cool_req _CNV_A_R_LINEAR_____239_CM 8 0. 255. FORMAT "%3.0" AXIS_PTS_REF ldp_vs_cool_req__cool_req_eng_bas /end AXIS_DESCR
 /begin AXIS_DESCR COM_AXIS tco_2_dif _CNV_A_R_LINEAR_____255_CM 8 -96. 95.25 FORMAT "%4.1" AXIS_PTS_REF ldp_tco_2_dif__cool_req_eng_bas /end AXIS_DESCR
/end CHARACTERISTIC
/begin AXIS_PTS ldp_tco_2_dif__cool_req_eng_i "" 0x844765 tco_2_dif _REC_AXS_20_u1 191.25 _CNV_A_R_LINEAR_____255_CM 8 -96. 95.25 FORMAT "%4.1" /end AXIS_PTS
/begin CHARACTERISTIC ip_cool_req_eng_i "Integral controler for small deviations between TCO_2_SP and TCO_2" CURVE 0x84556a _REC_CUR_20_u2_u1 199.9969482 _CNV_A_R_LINEAR_____158_CM -100. 99.99694820000001 DISPLAY_IDENTIFIER IP_COOL_REQ_ENG_I FORMAT "%8.3"
 /begin AXIS_DESCR COM_AXIS tco_2_dif _CNV_A_R_LINEAR_____255_CM 8 -96. 95.25 FORMAT "%4.1" AXIS_PTS_REF ldp_tco_2_dif__cool_req_eng_i /end AXIS_DESCR
/end CHARACTERISTIC
/begin MEASUREMENT cool_req_ac "" UBYTE _CNV_A_R_LINEAR_____82_CM 1 0. 0. 40. DISPLAY_IDENTIFIER COOL_REQ_AC ECU_ADDRESS 0x7fb712 FORMAT "%4.1" /end MEASUREMENT
/begin MEASUREMENT acp_cor "corrected air conditioning pressure value" UBYTE _CNV_A_R_LINEAR_____250_CM 1 0. 0. 40. DISPLAY_IDENTIFIER ACP_COR ECU_ADDRESS 0x7fbb26 FORMAT "%5.1" /end MEASUREMENT
/begin MEASUREMENT cool_req_ac_acp "relative cooling request by calculation based on ACP" UBYTE _CNV_A_R_LINEAR_____82_CM 1 0. 0. 40. DISPLAY_IDENTIFIER COOL_REQ_AC_ACP ECU_ADDRESS 0x7fbb27 FORMAT "%4.1" /end MEASUREMENT
/begin MEASUREMENT cool_req_ac_can "relative cooling request by calculation based on ACC_CAN message" UBYTE _CNV_A_R_LINEAR_____82_CM 1 0. 0. 40. DISPLAY_IDENTIFIER COOL_REQ_AC_CAN ECU_ADDRESS 0x7fbb28 FORMAT "%4.1" /end MEASUREMENT
/begin MEASUREMENT cool_req_ac_inter "Relative cooling request intermediate value" UBYTE _CNV_A_R_LINEAR_____82_CM 1 0. 0. 99.609375 DISPLAY_IDENTIFIER COOL_REQ_AC_INTER ECU_ADDRESS 0x7fbb29 FORMAT "%4.1" /end MEASUREMENT
/begin CHARACTERISTIC c_acp_cool_req_hys "hysteresis for ACP_COR calculation" VALUE 0x8482ef _REC_VAL_20_u1 40. _CNV_A_R_LINEAR_____250_CM 0. 40. DISPLAY_IDENTIFIER C_ACP_COOL_REQ_HYS FORMAT "%4.1" /end CHARACTERISTIC
/begin CHARACTERISTIC c_acp_sub_cool_req_ac "substitute value for ACP_COR in case of failure ACP" VALUE 0x8482f6 _REC_VAL_20_u1 40. _CNV_A_R_LINEAR_____250_CM 0. 40. DISPLAY_IDENTIFIER C_ACP_SUB_COOL_REQ_AC FORMAT "%4.1" /end CHARACTERISTIC
/begin CHARACTERISTIC c_acp_cool_req_inc "Increment for ACP quantizer" VALUE 0x8482f0 _REC_VAL_20_u1 40. _CNV_A_R_LINEAR_____250_CM 0. 40. DISPLAY_IDENTIFIER C_ACP_COOL_REQ_INC FORMAT "%4.1" /end CHARACTERISTIC
/begin CHARACTERISTIC c_acp_cool_req_dec "Decrement for ACP quantizer" VALUE 0x8482ee _REC_VAL_20_u1 40. _CNV_A_R_LINEAR_____250_CM 0. 40. DISPLAY_IDENTIFIER C_ACP_COOL_REQ_DEC FORMAT "%4.1" /end CHARACTERISTIC
/begin AXIS_PTS ldp_ecf_req_ac_can__cool_req "" 0x844512 ecf_req_ac_can _REC_AXS_20_u1 99.609375 _CNV_A_R_LINEAR_____82_CM 8 0. 99.609375 FORMAT "%4.1" /end AXIS_PTS
/begin CHARACTERISTIC ip_cool_req_ac_can "map to derive relative cooling request out of CAN cooling request message" CURVE 0x84549d _REC_CUR_20_u1_u1 99.609375 _CNV_A_R_LINEAR_____82_CM 0. 99.609375 DISPLAY_IDENTIFIER IP_COOL_REQ_AC_CAN FORMAT "%4.1"
 /begin AXIS_DESCR COM_AXIS ecf_req_ac_can _CNV_A_R_LINEAR_____82_CM 8 0. 99.609375 FORMAT "%4.1" AXIS_PTS_REF ldp_ecf_req_ac_can__cool_req /end AXIS_DESCR
/end CHARACTERISTIC
/begin AXIS_PTS ldpm_acp_cor__cool_req_acp "" 0x844954 acp_cor _REC_AXS_20_u1 40. _CNV_A_R_LINEAR_____250_CM 8 0. 40. FORMAT "%4.1" /end AXIS_PTS
/begin CHARACTERISTIC ip_cool_req_ac_acp_act "Map to derive relative cooling request out of ACP message (ACC active)" CURVE 0x84548d _REC_CUR_20_u1_u1 99.609375 _CNV_A_R_LINEAR_____82_CM 0. 99.609375 DISPLAY_IDENTIFIER IP_COOL_REQ_AC_ACP_ACT FORMAT "%4.1"
 /begin AXIS_DESCR COM_AXIS acp_cor _CNV_A_R_LINEAR_____250_CM 8 0. 40. FORMAT "%4.1" AXIS_PTS_REF ldpm_acp_cor__cool_req_acp /end AXIS_DESCR
/end CHARACTERISTIC
/begin CHARACTERISTIC ip_cool_req_ac_acp_deac "Map to derive relative cooling request out of ACP message (ACC inactive)" CURVE 0x845495 _REC_CUR_20_u1_u1 99.609375 _CNV_A_R_LINEAR_____82_CM 0. 99.609375 DISPLAY_IDENTIFIER IP_COOL_REQ_AC_ACP_DEAC FORMAT "%4.1"
 /begin AXIS_DESCR COM_AXIS acp_cor _CNV_A_R_LINEAR_____250_CM 8 0. 40. FORMAT "%4.1" AXIS_PTS_REF ldpm_acp_cor__cool_req_acp /end AXIS_DESCR
/end CHARACTERISTIC
/begin AXIS_PTS ldp_vs__fac_cool_req_ac_vs "" 0x84489c vs _REC_AXS_20_u1 255. _CNV_A_R_LINEAR_____239_CM 8 0. 255. FORMAT "%3.0" /end AXIS_PTS
/begin CHARACTERISTIC ip_fac_cool_req_ac_vs "Factor on COOL_REQ_AC_INTER regarding VS" CURVE 0x846993 _REC_CUR_20_u1_u1 15.9375 _CNV_A_R_LINEAR_____245_CM 0. 15.9375 DISPLAY_IDENTIFIER IP_FAC_COOL_REQ_AC_VS FORMAT "%5.2"
 /begin AXIS_DESCR COM_AXIS vs _CNV_A_R_LINEAR_____239_CM 8 0. 255. FORMAT "%3.0" AXIS_PTS_REF ldp_vs__fac_cool_req_ac_vs /end AXIS_DESCR
/end CHARACTERISTIC
/begin MEASUREMENT tco_inp "" UBYTE _CNV_A_R_LINEAR_____235_CM 1 0. -48. 142.5 DISPLAY_IDENTIFIER TCO_INP ECU_ADDRESS 0x7fbb2a FORMAT "%5.1" /end MEASUREMENT
/begin MEASUREMENT lv_err_tia "Error flag for diagnostics instance ACP_MES_GRD" UBYTE _CNV_S_2_RANGE______11_CM 1 0. 0. 1. DISPLAY_IDENTIFIER LV_ERR_TIA ECU_ADDRESS 0x7fb46a /end MEASUREMENT
/begin CHARACTERISTIC c_abc_inc_v_dcdc_rng "anti bounce counter increment for diagnosis instance V_DCDC_RNG" VALUE 0x848255 _REC_VAL_20_u1 255. _CNV_A_R_LINEAR_____0_CM 0. 255. DISPLAY_IDENTIFIER C_ABC_INC_V_DCDC_RNG FORMAT "%3.0" /end CHARACTERISTIC
/begin CHARACTERISTIC c_abc_max_v_dcdc_rng "maximum value of anti bounce counter for diagnosis instance V_DCDC_RNG" VALUE 0x8482d7 _REC_VAL_20_u1 255. _CNV_A_R_LINEAR_____0_CM 0. 255. DISPLAY_IDENTIFIER C_ABC_MAX_V_DCDC_RNG FORMAT "%3.0" /end CHARACTERISTIC
/begin MEASUREMENT t_dcdc_diag "" UBYTE _CNV_A_R_LINEAR_____19_CM 1 0. 0. 25.5 DISPLAY_IDENTIFIER T_DCDC_DIAG ECU_ADDRESS 0x7fb9ec FORMAT "%3.1" /end MEASUREMENT
/begin CHARACTERISTIC c_t_dcdc_diag "" VALUE 0x85c0a2 _REC_VAL_20_u1 25.5 _CNV_A_R_LINEAR_____19_CM 0. 25.5 DISPLAY_IDENTIFIER C_T_DCDC_DIAG FORMAT "%3.2" /end CHARACTERISTIC
/begin CHARACTERISTIC c_v_dcdc_min_diag "" VALUE 0x85c20c _REC_VAL_20_u2 96.32231400000001 _CNV_A_R_LINEAR_____264_CM 0. 96.32231400000001 DISPLAY_IDENTIFIER C_V_DCDC_MIN_DIAG FORMAT "%4.2" /end CHARACTERISTIC
/begin CHARACTERISTIC c_v_dcdc_max_diag "" VALUE 0x85c20a _REC_VAL_20_u2 96.32231400000001 _CNV_A_R_LINEAR_____264_CM 0. 96.32231400000001 DISPLAY_IDENTIFIER C_V_DCDC_MAX_DIAG FORMAT "%4.2" /end CHARACTERISTIC
/begin MEASUREMENT lv_oil_level1_nplaus "Fuellstand 1 unplausibel" UBYTE _CNV_S_2_RANGE__0___88_CM 1 0. 0. 1. DISPLAY_IDENTIFIER LV_OIL_LEVEL1_NPLAUS ECU_ADDRESS 0x7fbc1a BIT_MASK 0x1 /end MEASUREMENT
/begin MEASUREMENT lv_oil_level2_nplaus "Fuellstand 2 unplausibel" UBYTE _CNV_S_2_RANGE__0___88_CM 1 0. 0. 1. DISPLAY_IDENTIFIER LV_OIL_LEVEL2_NPLAUS ECU_ADDRESS 0x7fbc1b BIT_MASK 0x1 /end MEASUREMENT
/begin MEASUREMENT lv_oil_level3_nplaus "Fuellstand 3 unplausibel" UBYTE _CNV_S_2_RANGE__0___88_CM 1 0. 0. 1. DISPLAY_IDENTIFIER LV_OIL_LEVEL3_NPLAUS ECU_ADDRESS 0x7fbc1c BIT_MASK 0x1 /end MEASUREMENT
/begin MEASUREMENT lv_oil_level4_nplaus "Fuellstand 4 unplausibel" UBYTE _CNV_S_2_RANGE__0___88_CM 1 0. 0. 1. DISPLAY_IDENTIFIER LV_OIL_LEVEL4_NPLAUS ECU_ADDRESS 0x7fbc1d BIT_MASK 0x1 /end MEASUREMENT
/begin MEASUREMENT lv_oil_level4_chk "Bereichsckeck Fuellstand 4" UBYTE _CNV_S_2_RANGE__0___88_CM 1 0. 0. 1. DISPLAY_IDENTIFIER LV_OIL_LEVEL4_CHK ECU_ADDRESS 0x7fbc19 BIT_MASK 0x1 /end MEASUREMENT
/begin MEASUREMENT lv_oil_level1_chk "Bereichsckeck Fuellstand 1" UBYTE _CNV_S_2_RANGE__0___88_CM 1 0. 0. 1. DISPLAY_IDENTIFIER LV_OIL_LEVEL1_CHK ECU_ADDRESS 0x7fbc16 BIT_MASK 0x1 /end MEASUREMENT
/begin MEASUREMENT lv_oil_level2_chk "Bereichsckeck Fuellstand 2" UBYTE _CNV_S_2_RANGE__0___88_CM 1 0. 0. 1. DISPLAY_IDENTIFIER LV_OIL_LEVEL2_CHK ECU_ADDRESS 0x7fbc17 BIT_MASK 0x1 /end MEASUREMENT
/begin MEASUREMENT lv_oil_level3_chk "Bereichsckeck Fuellstand 3" UBYTE _CNV_S_2_RANGE__0___88_CM 1 0. 0. 1. DISPLAY_IDENTIFIER LV_OIL_LEVEL3_CHK ECU_ADDRESS 0x7fbc18 BIT_MASK 0x1 /end MEASUREMENT
/begin MEASUREMENT oil_level2_vol "Fuellstand 2 in l" SWORD _CNV_A_R_LINEAR_____288_CM 1 0. -2.048 2.0479375 DISPLAY_IDENTIFIER OIL_LEVEL2_VOL ECU_ADDRESS 0x7fb15e BYTE_ORDER MSB_LAST FORMAT "%8.6" /end MEASUREMENT
/begin MEASUREMENT oil_level3_vol "Fuellstand 3 in l" SWORD _CNV_A_R_LINEAR_____288_CM 1 0. -2.048 2.0479375 DISPLAY_IDENTIFIER OIL_LEVEL3_VOL ECU_ADDRESS 0x7fb160 BYTE_ORDER MSB_LAST FORMAT "%8.6" /end MEASUREMENT
/begin MEASUREMENT oil_level4_vol "Fuellstand 4 in l" SWORD _CNV_A_R_LINEAR_____288_CM 1 0. -2.048 2.0479375 DISPLAY_IDENTIFIER OIL_LEVEL4_VOL ECU_ADDRESS 0x7fb162 BYTE_ORDER MSB_LAST FORMAT "%8.6" /end MEASUREMENT
/begin MEASUREMENT oil_level_sum_cor "Summe Oelstand mit Guetefaktor" SWORD _CNV_A_R_LINEAR_____289_CM 1 0. -8192. 8191.75 DISPLAY_IDENTIFIER OIL_LEVEL_SUM_COR ECU_ADDRESS 0x7fa29e BYTE_ORDER MSB_LAST FORMAT "%7.2" /end MEASUREMENT
/begin CHARACTERISTIC c_t_oil_level_min "minimale Fuellstandszeit" VALUE 0x848696 _REC_VAL_20_u2 1023.5 _CNV_A_R_LINEAR_____290_CM 100. 1123.5 DISPLAY_IDENTIFIER C_T_OIL_LEVEL_MIN FORMAT "%6.1" /end CHARACTERISTIC
/begin CHARACTERISTIC c_t_oil_level_max "maximale Fuellstandszeit" VALUE 0x848694 _REC_VAL_20_u2 1023.5 _CNV_A_R_LINEAR_____290_CM 100. 1123.5 DISPLAY_IDENTIFIER C_T_OIL_LEVEL_MAX FORMAT "%6.1" /end CHARACTERISTIC
/begin AXIS_PTS ldp_t_oil_level1_can "" 0x844704 online_dummy _REC_AXS_20_u2 1023.5 _CNV_A_R_LINEAR_____290_CM 10 100. 1123.5 FORMAT "%6.1" /end AXIS_PTS
/begin CHARACTERISTIC ip_oil_level_t_cool_wiv "Kennlinie Kuehlstand-Fuellstand" CURVE 0x847436 _REC_CUR_20_u2_u2 127. _CNV_A_R_LINEAR_____291_CM 0. 127. DISPLAY_IDENTIFIER IP_OIL_LEVEL_T_COOL_WIV FORMAT "%8.4"
 /begin AXIS_DESCR COM_AXIS online_dummy _CNV_A_R_LINEAR_____290_CM 10 100. 1123.5 FORMAT "%6.1" AXIS_PTS_REF ldp_t_oil_level1_can /end AXIS_DESCR
/end CHARACTERISTIC
/begin MEASUREMENT oil_level_ctr "Oelstandszaehler" UBYTE _CNV_A_R_LINEAR_____1_CM 1 0. 0. 255. DISPLAY_IDENTIFIER OIL_LEVEL_CTR ECU_ADDRESS 0x7fb829 FORMAT "%3.0" /end MEASUREMENT
/begin MEASUREMENT oil_level_dif_mv_sho "Kurzzeitmittelwert" UBYTE _CNV_A_R_LINEAR_____292_CM 1 0. -1905. 1920. DISPLAY_IDENTIFIER OIL_LEVEL_DIF_MV_SHO ECU_ADDRESS 0x7fb82a FORMAT "%5.0" /end MEASUREMENT
/begin MEASUREMENT lv_oil_warn "Oelwarnung" UBYTE _CNV_S_2_RANGE__0___88_CM 1 0. 0. 1. DISPLAY_IDENTIFIER LV_OIL_WARN ECU_ADDRESS 0x7fb832 BIT_MASK 0x1 /end MEASUREMENT
/begin MEASUREMENT lv_oil_sens_warn "Sensorwarnung" UBYTE _CNV_S_2_RANGE__0___88_CM 1 0. 0. 1. DISPLAY_IDENTIFIER LV_OIL_SENS_WARN ECU_ADDRESS 0x7fb831 BIT_MASK 0x1 /end MEASUREMENT
/begin CHARACTERISTIC c_oil_level_ctr_sub "Ersatzwert Oelstandszaehler" VALUE 0x848587 _REC_VAL_20_u1 255. _CNV_A_R_LINEAR_____1_CM 0. 255. DISPLAY_IDENTIFIER C_OIL_LEVEL_CTR_SUB FORMAT "%3.0" /end CHARACTERISTIC
/begin CHARACTERISTIC c_oil_level_dif_mv_sho_sub "Ersatzwert Kurzeitmittelwert" VALUE 0x848588 _REC_VAL_20_u1 3825. _CNV_A_R_LINEAR_____292_CM -1905. 1920. DISPLAY_IDENTIFIER C_OIL_LEVEL_DIF_MV_SHO_SUB FORMAT "%5.0" /end CHARACTERISTIC
/begin MEASUREMENT lv_emsf_state_2 "Toggelbit Oefuellstand" UBYTE _CNV_S_2_RANGE__0___88_CM 1 0. 0. 1. DISPLAY_IDENTIFIER LV_EMSF_STATE_2 ECU_ADDRESS 0x7fb830 BIT_MASK 0x1 /end MEASUREMENT
/begin MEASUREMENT lv_fcn_clc_4400 "Trigger 4400 ms" UBYTE _CNV_S_2_RANGE__0___88_CM 1 0. 0. 1. DISPLAY_IDENTIFIER LV_FCN_CLC_4400 ECU_ADDRESS 0x7fbc1e BIT_MASK 0x1 /end MEASUREMENT
/begin MEASUREMENT lv_fcn_clc_2400 "Trigger 2400 ms" UBYTE _CNV_S_2_RANGE__0___88_CM 1 0. 0. 1. DISPLAY_IDENTIFIER LV_FCN_CLC_2400 ECU_ADDRESS 0x7fbc14 BIT_MASK 0x1 /end MEASUREMENT
/begin MEASUREMENT ctr_fcn_clc_4400 "Zaehler 4400 ms" UBYTE _CNV_A_R_LINEAR_____1_CM 1 0. 0. 255. DISPLAY_IDENTIFIER CTR_FCN_CLC_4400 ECU_ADDRESS 0x7fbc0d FORMAT "%3.0" /end MEASUREMENT
/begin MEASUREMENT ctr_fcn_clc_2400 "Zaehler 2400 ms" UBYTE _CNV_A_R_LINEAR_____1_CM 1 0. 0. 255. DISPLAY_IDENTIFIER CTR_FCN_CLC_2400 ECU_ADDRESS 0x7fbc09 FORMAT "%3.0" /end MEASUREMENT
/begin MEASUREMENT wear_fco_equ "Verbrauchaequivalent" UWORD _CNV_A_R_LINEAR_____293_CM 1 0. 0. 1.3107e-003 DISPLAY_IDENTIFIER WEAR_FCO_EQU ECU_ADDRESS 0x7fa296 BYTE_ORDER MSB_LAST FORMAT "%10.8" /end MEASUREMENT
/begin MEASUREMENT lv_emsf_state_1_tmp "Toggelbit Aequivalent lokal" UBYTE _CNV_S_2_RANGE__0___88_CM 1 0. 0. 1. DISPLAY_IDENTIFIER LV_EMSF_STATE_1_TMP ECU_ADDRESS 0x7fbc13 BIT_MASK 0x1 /end MEASUREMENT
/begin MEASUREMENT fac_oil_wiv "Bewertungsfaktor" UWORD _CNV_A_R_LINEAR_____294_CM 1 0. 0. 0.13107 DISPLAY_IDENTIFIER FAC_OIL_WIV ECU_ADDRESS 0x7fb158 BYTE_ORDER MSB_LAST FORMAT "%8.6" /end MEASUREMENT
/begin MEASUREMENT toil_wiv "Oeltemperatur aus WIV-Funktion" UBYTE _CNV_A_R_LINEAR_____295_CM 1 0. -60. 195. DISPLAY_IDENTIFIER TOIL_WIV ECU_ADDRESS 0x7fb826 FORMAT "%3.0" /end MEASUREMENT
/begin MEASUREMENT lv_emsf_state_1 "Toggelbit Aequivalent" UBYTE _CNV_S_2_RANGE__0___88_CM 1 0. 0. 1. DISPLAY_IDENTIFIER LV_EMSF_STATE_1 ECU_ADDRESS 0x7fb82e BIT_MASK 0x1 /end MEASUREMENT
/begin MEASUREMENT lv_oil_level_not_vld "Fuellstandsbereich nicht ok" UBYTE _CNV_S_2_RANGE__0___88_CM 1 0. 0. 1. DISPLAY_IDENTIFIER LV_OIL_LEVEL_NOT_VLD ECU_ADDRESS 0x7fb82c BIT_MASK 0x1 /end MEASUREMENT
/begin MEASUREMENT oil_level_cor_wiv "kompensierte Oelniveauschwelle" UWORD _CNV_A_R_LINEAR_____296_CM 1 0. 0. 4095.9375 DISPLAY_IDENTIFIER OIL_LEVEL_COR_WIV ECU_ADDRESS 0x7fa298 BYTE_ORDER MSB_LAST FORMAT "%9.4" /end MEASUREMENT
/begin MEASUREMENT fac_qly_wiv_cor "Guetefaktor" UBYTE _CNV_A_R_LINEAR_____1_CM 1 0. 0. 255. DISPLAY_IDENTIFIER FAC_QLY_WIV_COR ECU_ADDRESS 0x7fb827 FORMAT "%3.0" /end MEASUREMENT
/begin MEASUREMENT fac_level_estim_wiv "fuellstandsabhaengige Verbrauchsbewertung" UBYTE _CNV_A_R_LINEAR_____297_CM 1 0. 0. 12.75 DISPLAY_IDENTIFIER FAC_LEVEL_ESTIM_WIV ECU_ADDRESS 0x7fbc12 FORMAT "%4.2" /end MEASUREMENT
/begin MEASUREMENT ac_trv_wiv_fil "Querbeschleunigung gefiltert" SWORD _CNV_A_R_LINEAR_____298_CM 1 0. -12.7 12.899609375 DISPLAY_IDENTIFIER AC_TRV_WIV_FIL ECU_ADDRESS 0x7fb15a BYTE_ORDER MSB_LAST FORMAT "%7.4" /end MEASUREMENT
/begin MEASUREMENT toil_wiv_clc "Oeltemperatur gerechnet" UBYTE _CNV_A_R_LINEAR_____295_CM 1 0. -60. 195. DISPLAY_IDENTIFIER TOIL_WIV_CLC ECU_ADDRESS 0x7fbc08 FORMAT "%3.0" /end MEASUREMENT
/begin MEASUREMENT toil_wiv_raw "Oeltemperatur nach Kennlinie" UBYTE _CNV_A_R_LINEAR_____295_CM 1 0. -60. 195. DISPLAY_IDENTIFIER TOIL_WIV_RAW ECU_ADDRESS 0x7fbc0b FORMAT "%3.0" /end MEASUREMENT
/begin CHARACTERISTIC c_toil_max_fac_chrg "Grenztemperatur Turbofaktor" VALUE 0x8486f4 _REC_VAL_20_u1 255. _CNV_A_R_LINEAR_____295_CM -60. 195. DISPLAY_IDENTIFIER C_TOIL_MAX_FAC_CHRG FORMAT "%3.0" /end CHARACTERISTIC
/begin CHARACTERISTIC c_fac_chrg "Turbofaktor" VALUE 0x848432 _REC_VAL_20_u1 7.96875 _CNV_A_R_LINEAR_____299_CM 0. 7.96875 DISPLAY_IDENTIFIER C_FAC_CHRG FORMAT "%4.2" /end CHARACTERISTIC
/begin CHARACTERISTIC c_fac_level_estim_wiv_cor "Ersatzwert oelabhaengige Verbrauchsbewertung" VALUE 0x848456 _REC_VAL_20_u1 12.75 _CNV_A_R_LINEAR_____297_CM 0. 12.75 DISPLAY_IDENTIFIER C_FAC_LEVEL_ESTIM_WIV_COR FORMAT "%4.2" /end CHARACTERISTIC
/begin CHARACTERISTIC lc_ac_trv_wiv_fil_use "Schalter Filterung Querbeschleunigung" VALUE 0x84878c _REC_VAL_20_u1 1. _CNV_A_R_LINEAR_____1_CM 0. 1. DISPLAY_IDENTIFIER LC_AC_TRV_WIV_FIL_USE FORMAT "%1.0" /end CHARACTERISTIC
/begin CHARACTERISTIC c_fac_ac_trv_wiv "Filterfaktor Querbeschleunigung" VALUE 0x848430 _REC_VAL_20_u2 0.9999847412109381 _CNV_A_R_LINEAR_____300_CM 0. 0.9999847412109381 DISPLAY_IDENTIFIER C_FAC_AC_TRV_WIV FORMAT "%7.5" /end CHARACTERISTIC
/begin CHARACTERISTIC c_fac_n_wiv "Filterfaktor Motordrezahl" VALUE 0x848458 _REC_VAL_20_u2 0.9999847412109381 _CNV_A_R_LINEAR_____300_CM 0. 0.9999847412109381 DISPLAY_IDENTIFIER C_FAC_N_WIV FORMAT "%7.5" /end CHARACTERISTIC
/begin CHARACTERISTIC lc_toil_wiv_sub_use "Schalter Oelersatztemperatur" VALUE 0x8487df _REC_VAL_20_u1 1. _CNV_A_R_LINEAR_____1_CM 0. 1. DISPLAY_IDENTIFIER LC_TOIL_WIV_SUB_USE FORMAT "%1.0" /end CHARACTERISTIC
/begin CHARACTERISTIC lc_fac_qly_wiv_sub_use "Schalter Guetefaktor" VALUE 0x8487a8 _REC_VAL_20_u1 1. _CNV_A_R_LINEAR_____1_CM 0. 1. DISPLAY_IDENTIFIER LC_FAC_QLY_WIV_SUB_USE FORMAT "%1.0" /end CHARACTERISTIC
/begin CHARACTERISTIC c_n_max_oil_level "maximale Drehzahl fuer Fuellstaende" VALUE 0x8484e4 _REC_VAL_20_u1 8160. _CNV_A_R_LINEAR_____84_CM 0. 8160. DISPLAY_IDENTIFIER C_N_MAX_OIL_LEVEL FORMAT "%4.0" /end CHARACTERISTIC
/begin CHARACTERISTIC c_n_min_oil_level "minimale Drehzahl fuer Fuellstaende" VALUE 0x8484e6 _REC_VAL_20_u1 8160. _CNV_A_R_LINEAR_____84_CM 0. 8160. DISPLAY_IDENTIFIER C_N_MIN_OIL_LEVEL FORMAT "%4.0" /end CHARACTERISTIC
/begin CHARACTERISTIC c_toil_max_oil_level "maximale Oeltemperatur fuer Fuellstaende" VALUE 0x8486f5 _REC_VAL_20_u1 255. _CNV_A_R_LINEAR_____295_CM -60. 195. DISPLAY_IDENTIFIER C_TOIL_MAX_OIL_LEVEL FORMAT "%3.0" /end CHARACTERISTIC
/begin CHARACTERISTIC c_toil_min_oil_level "minimale Oeltemperatur fuer Fuellstaende" VALUE 0x8486f8 _REC_VAL_20_u1 255. _CNV_A_R_LINEAR_____295_CM -60. 195. DISPLAY_IDENTIFIER C_TOIL_MIN_OIL_LEVEL FORMAT "%3.0" /end CHARACTERISTIC
/begin CHARACTERISTIC c_toil_wiv_err "Fehlerwert Oeltemperatur" VALUE 0x8486fe _REC_VAL_20_u1 255. _CNV_A_R_LINEAR_____295_CM -60. 195. DISPLAY_IDENTIFIER C_TOIL_WIV_ERR FORMAT "%3.0" /end CHARACTERISTIC
/begin CHARACTERISTIC c_toil_wiv_nvld "kein Wert Oeltemperatur" VALUE 0x848700 _REC_VAL_20_u1 255. _CNV_A_R_LINEAR_____295_CM -60. 195. DISPLAY_IDENTIFIER C_TOIL_WIV_NVLD FORMAT "%3.0" /end CHARACTERISTIC
/begin CHARACTERISTIC c_toil_wiv_sub "Ersatzwert Oeltemperatur" VALUE 0x848701 _REC_VAL_20_u1 255. _CNV_A_R_LINEAR_____295_CM -60. 195. DISPLAY_IDENTIFIER C_TOIL_WIV_SUB FORMAT "%3.0" /end CHARACTERISTIC
/begin CHARACTERISTIC c_toil_wiv_ini "Initwert Oeltemperatur" VALUE 0x8486ff _REC_VAL_20_u1 255. _CNV_A_R_LINEAR_____295_CM -60. 195. DISPLAY_IDENTIFIER C_TOIL_WIV_INI FORMAT "%3.0" /end CHARACTERISTIC
/begin CHARACTERISTIC c_t_toil_max "maximale Oeltemperaturzeit" VALUE 0x8486b6 _REC_VAL_20_u2 127.875 _CNV_A_R_LINEAR_____301_CM 0. 127.875 DISPLAY_IDENTIFIER C_T_TOIL_MAX FORMAT "%7.3" /end CHARACTERISTIC
/begin CHARACTERISTIC c_t_toil_min "minimale Oeltemperaturzeit" VALUE 0x8486b8 _REC_VAL_20_u2 127.875 _CNV_A_R_LINEAR_____301_CM 0. 127.875 DISPLAY_IDENTIFIER C_T_TOIL_MIN FORMAT "%7.3" /end CHARACTERISTIC
/begin CHARACTERISTIC c_fco_cyl_max "zugestandene Menge pro Zylinder" VALUE 0x848470 _REC_VAL_20_u2 5119.921875 _CNV_A_R_LINEAR_____302_CM 0. 5119.921875 DISPLAY_IDENTIFIER C_FCO_CYL_MAX FORMAT "%11.6" /end CHARACTERISTIC
/begin MEASUREMENT ctr_oil_level_sum_cor "Zaehler Oelstand mit Guetefaktor" UBYTE _CNV_A_R_LINEAR_____1_CM 1 0. 0. 255. DISPLAY_IDENTIFIER CTR_OIL_LEVEL_SUM_COR ECU_ADDRESS 0x7fb828 FORMAT "%3.0" /end MEASUREMENT
/begin MEASUREMENT ctr_oil_level_sum "Zaehler Oelstand aufsummiert" UBYTE _CNV_A_R_LINEAR_____1_CM 1 0. 0. 255. DISPLAY_IDENTIFIER CTR_OIL_LEVEL_SUM ECU_ADDRESS 0x7fbc0c FORMAT "%3.0" /end MEASUREMENT
/begin MEASUREMENT oil_level_sum "Oelstand aufsummiert" SWORD _CNV_A_R_LINEAR_____303_CM 1 0. -65536. 65534. DISPLAY_IDENTIFIER OIL_LEVEL_SUM ECU_ADDRESS 0x7fb164 BYTE_ORDER MSB_LAST FORMAT "%5.0" /end MEASUREMENT
/begin MEASUREMENT oil_level_vol_sum "Oelstand aufsummiert" SWORD _CNV_A_R_LINEAR_____304_CM 1 0. -8.192 8.191750000000001 DISPLAY_IDENTIFIER OIL_LEVEL_VOL_SUM ECU_ADDRESS 0x7fb166 BYTE_ORDER MSB_LAST FORMAT "%7.5" /end MEASUREMENT
/begin AXIS_PTS ldp_t_oil_can "" 0x8446e8 online_dummy _REC_AXS_20_u2 127.875 _CNV_A_R_LINEAR_____301_CM 13 0. 127.875 FORMAT "%7.3" /end AXIS_PTS
/begin AXIS_PTS ldp_n_wiv "" 0x844642 n_wiv _REC_AXS_20_u2 8160. _CNV_A_R_LINEAR_____257_CM 10 0. 8160. FORMAT "%4.0" /end AXIS_PTS
/begin MEASUREMENT n_wiv "Motordrehzahl gefiltert" UWORD _CNV_A_R_LINEAR_____257_CM 1 0. 0. 8160. DISPLAY_IDENTIFIER N_WIV ECU_ADDRESS 0x7fb144 BYTE_ORDER MSB_LAST FORMAT "%4.0" /end MEASUREMENT
/begin AXIS_PTS ldpm_toil_wiv_clc "" 0x844993 toil_wiv_clc _REC_AXS_20_u1 255. _CNV_A_R_LINEAR_____295_CM 9 -60. 195. FORMAT "%3.0" /end AXIS_PTS
/begin AXIS_PTS ldp_ac_trv_tcs2 "" 0x844492 ac_trv_wiv_fil _REC_AXS_20_u2 25.599609375 _CNV_A_R_LINEAR_____305_CM 5 -12.7 12.899609375 FORMAT "%7.4" /end AXIS_PTS
/begin AXIS_PTS ldp_n_wiv_oil_level_cor_wiv "" 0x844684 n_wiv _REC_AXS_20_u2 8160. _CNV_A_R_LINEAR_____257_CM 10 0. 8160. FORMAT "%4.0" /end AXIS_PTS
/begin AXIS_PTS ldp_toil_wiv_temp2 "" 0x84484b toil_wiv_clc _REC_AXS_20_u1 255. _CNV_A_R_LINEAR_____295_CM 10 -60. 195. FORMAT "%3.0" /end AXIS_PTS
/begin CHARACTERISTIC id_fac_fco_estim_wiv "Kennfeld zur Ermittlung der oeltemperaturabhaengigen Verbrauchsbewertung" CURVE 0x844a72 _REC_CUR_20_u1_u1 15.9375 _CNV_A_R_LINEAR_____245_CM 0. 15.9375 DISPLAY_IDENTIFIER ID_FAC_FCO_ESTIM_WIV FORMAT "%5.2"
 /begin AXIS_DESCR COM_AXIS toil_wiv_clc _CNV_A_R_LINEAR_____295_CM 9 -60. 195. FORMAT "%3.0" AXIS_PTS_REF ldpm_toil_wiv_clc /end AXIS_DESCR
/end CHARACTERISTIC
/begin CHARACTERISTIC ip_fac_qly_wiv "Kennfeld zur Ermittlung Guetefaktoren" MAP 0x846c46 _REC_MAP_20_u1_u2_u2 255. _CNV_A_R_LINEAR_____1_CM 0. 255. DISPLAY_IDENTIFIER IP_FAC_QLY_WIV FORMAT "%3.0"
 /begin AXIS_DESCR COM_AXIS n_wiv _CNV_A_R_LINEAR_____257_CM 10 0. 8160. FORMAT "%4.0" AXIS_PTS_REF ldp_n_wiv /end AXIS_DESCR
 /begin AXIS_DESCR COM_AXIS ac_trv_wiv_fil _CNV_A_R_LINEAR_____305_CM 5 -12.7 12.899609375 FORMAT "%7.4" AXIS_PTS_REF ldp_ac_trv_tcs2 /end AXIS_DESCR
/end CHARACTERISTIC
/begin CHARACTERISTIC ip_toil_wiv_temp "Oeltemperatur" CURVE 0x847f74 _REC_CUR_20_u1_u2 255. _CNV_A_R_LINEAR_____295_CM -60. 195. DISPLAY_IDENTIFIER IP_TOIL_WIV_TEMP FORMAT "%3.0"
 /begin AXIS_DESCR COM_AXIS online_dummy _CNV_A_R_LINEAR_____301_CM 13 0. 127.875 FORMAT "%7.3" AXIS_PTS_REF ldp_t_oil_can /end AXIS_DESCR
/end CHARACTERISTIC
/begin CHARACTERISTIC ip_oil_level_cor_wiv "Kompensationskennfeld" MAP 0x84736e _REC_MAP_20_u2_u2_u1 127. _CNV_A_R_LINEAR_____291_CM 0. 127. DISPLAY_IDENTIFIER IP_OIL_LEVEL_COR_WIV FORMAT "%8.4"
 /begin AXIS_DESCR COM_AXIS n_wiv _CNV_A_R_LINEAR_____257_CM 10 0. 8160. FORMAT "%4.0" AXIS_PTS_REF ldp_n_wiv_oil_level_cor_wiv /end AXIS_DESCR
 /begin AXIS_DESCR COM_AXIS toil_wiv_clc _CNV_A_R_LINEAR_____295_CM 10 -60. 195. FORMAT "%3.0" AXIS_PTS_REF ldp_toil_wiv_temp2 /end AXIS_DESCR
/end CHARACTERISTIC
/begin MEASUREMENT lv_toil_wiv_nplaus_tmp "Oeltemperatur unplausibel" UBYTE _CNV_S_2_RANGE__0___88_CM 1 0. 0. 1. DISPLAY_IDENTIFIER LV_TOIL_WIV_NPLAUS_TMP ECU_ADDRESS 0x7fb82d BIT_MASK 0x1 /end MEASUREMENT
/begin MEASUREMENT fac_qly_wiv "Guetefaktor ungerundet" UBYTE _CNV_A_R_LINEAR_____306_CM 1 0. 0. 5.1 DISPLAY_IDENTIFIER FAC_QLY_WIV ECU_ADDRESS 0x7fbc0a FORMAT "%4.2" /end MEASUREMENT
/begin MEASUREMENT fac_fco_estim_wiv "oeltemperaturabhaengige Verbrauchsbewertung" UBYTE _CNV_A_R_LINEAR_____245_CM 1 0. 0. 15.9375 DISPLAY_IDENTIFIER FAC_FCO_ESTIM_WIV ECU_ADDRESS 0x7fbc11 FORMAT "%5.2" /end MEASUREMENT
/begin MEASUREMENT oil_level1_vol "Fuellstand 1 in l" SWORD _CNV_A_R_LINEAR_____288_CM 1 0. -2.048 2.0479375 DISPLAY_IDENTIFIER OIL_LEVEL1_VOL ECU_ADDRESS 0x7fb15c BYTE_ORDER MSB_LAST FORMAT "%8.6" /end MEASUREMENT
/begin MEASUREMENT oil_level1 "Fuellstand 1 in mm" UWORD _CNV_A_R_LINEAR_____291_CM 1 0. 0. 127. DISPLAY_IDENTIFIER OIL_LEVEL1 ECU_ADDRESS 0x7fa29c BYTE_ORDER MSB_LAST FORMAT "%8.4" /end MEASUREMENT
/begin MEASUREMENT oil_level2 "Fuellstand 2 in mm" UWORD _CNV_A_R_LINEAR_____291_CM 1 0. 0. 127. DISPLAY_IDENTIFIER OIL_LEVEL2 ECU_ADDRESS 0x7fb146 BYTE_ORDER MSB_LAST FORMAT "%8.4" /end MEASUREMENT
/begin MEASUREMENT oil_level4 "Fuellstand 4 in mm" UWORD _CNV_A_R_LINEAR_____291_CM 1 0. 0. 127. DISPLAY_IDENTIFIER OIL_LEVEL4 ECU_ADDRESS 0x7fb14a BYTE_ORDER MSB_LAST FORMAT "%8.4" /end MEASUREMENT
/begin MEASUREMENT oil_level3 "Fuellstand 3 in mm" UWORD _CNV_A_R_LINEAR_____291_CM 1 0. 0. 127. DISPLAY_IDENTIFIER OIL_LEVEL3 ECU_ADDRESS 0x7fb148 BYTE_ORDER MSB_LAST FORMAT "%8.4" /end MEASUREMENT
/begin CHARACTERISTIC c_t_fout_oil_sens_caut "Dauer Ausblendung Sensorwarnung" VALUE 0x848644 _REC_VAL_20_u2 655.35 _CNV_A_R_LINEAR_____223_CM 0. 655.35 DISPLAY_IDENTIFIER C_T_FOUT_OIL_SENS_CAUT FORMAT "%6.2" /end CHARACTERISTIC
/begin CHARACTERISTIC c_t_fout_oil_level_dif_mv_sho "Dauer Ausblendung Kurzzeitmittelwert" VALUE 0x848642 _REC_VAL_20_u2 655.35 _CNV_A_R_LINEAR_____223_CM 0. 655.35 DISPLAY_IDENTIFIER C_T_FOUT_OIL_LEVEL_DIF_MV_SHO FORMAT "%6.2" /end CHARACTERISTIC
/begin MEASUREMENT fco_dif_wiv "Kraftstoffverbrauch aufsummiert" UWORD _CNV_A_R_LINEAR_____307_CM 1 0. 0. 65535. DISPLAY_IDENTIFIER FCO_DIF_WIV ECU_ADDRESS 0x7fb154 BYTE_ORDER MSB_LAST FORMAT "%5.0" /end MEASUREMENT
/begin MEASUREMENT soot_equ "Russaequivalent" UWORD _CNV_A_R_LINEAR_____293_CM 1 0. 0. 1.3107e-003 DISPLAY_IDENTIFIER SOOT_EQU ECU_ADDRESS 0x7fa29a BYTE_ORDER MSB_LAST FORMAT "%10.8" /end MEASUREMENT
/begin MEASUREMENT lv_emsf_state_1_ds "Toggelbit fuer Verbrauchsaequivalent Diesel" UBYTE _CNV_S_2_RANGE__0___88_CM 1 0. 0. 1. DISPLAY_IDENTIFIER LV_EMSF_STATE_1_DS ECU_ADDRESS 0x7fbc23 BIT_MASK 0x1 /end MEASUREMENT
/begin MEASUREMENT soot_wiv_value "gemittelter Russindexwert fuer Dieselmotor" UWORD _CNV_A_R_LINEAR_____308_CM 1 0. 0. 65535. DISPLAY_IDENTIFIER SOOT_WIV_VALUE ECU_ADDRESS 0x7fb14c BYTE_ORDER MSB_LAST FORMAT "%5.0" /end MEASUREMENT
/begin MEASUREMENT soot_equ_ds "Russaequivalent fuer Dieselmotor mit Bewertungsfaktor" UWORD _CNV_A_R_LINEAR_____293_CM 1 0. 0. 1.3107e-003 DISPLAY_IDENTIFIER SOOT_EQU_DS ECU_ADDRESS 0x7fb14e BYTE_ORDER MSB_LAST FORMAT "%10.8" /end MEASUREMENT
/begin MEASUREMENT wear_equ_ds "Verbrauchaequivalent" UWORD _CNV_A_R_LINEAR_____293_CM 1 0. 0. 1.3107e-003 DISPLAY_IDENTIFIER WEAR_EQU_DS ECU_ADDRESS 0x7fb150 BYTE_ORDER MSB_LAST FORMAT "%10.8" /end MEASUREMENT
/begin CHARACTERISTIC c_fac_soot_wiv "applizierter Bewertungsfaktor Russaequivalent (DS)" VALUE 0x84845e _REC_VAL_20_u1 2.55e-003 _CNV_A_R_LINEAR_____309_CM 0. 2.55e-003 DISPLAY_IDENTIFIER C_FAC_SOOT_WIV FORMAT "%7.5" /end CHARACTERISTIC
/begin CHARACTERISTIC c_fac_wear_wiv "applizierbarer Bewertungsfaktor Verbrauchsaequivalent (DS)" VALUE 0x84846e _REC_VAL_20_u1 2.55e-003 _CNV_A_R_LINEAR_____309_CM 0. 2.55e-003 DISPLAY_IDENTIFIER C_FAC_WEAR_WIV FORMAT "%7.5" /end CHARACTERISTIC
/begin CHARACTERISTIC c_fac_equ_wiv "normierte Bezugsgroesse zur Aequivalentberechnung (DS)" VALUE 0x84844e _REC_VAL_20_u1 127500. _CNV_A_R_LINEAR_____310_CM 0. 127500. DISPLAY_IDENTIFIER C_FAC_EQU_WIV FORMAT "%6.0" /end CHARACTERISTIC
/begin AXIS_PTS ldp_fco_dif "FCO_DIF" 0x844546 fco_dif _REC_AXS_20_u2 65535. _CNV_A_R_LINEAR_____311_CM 10 0. 65535. FORMAT "%5.0" /end AXIS_PTS
/begin CHARACTERISTIC ip_soot_equ "Kennfeld Russindexwerte Diesel fuer spaetere Russaequivalentberechnung (DS)" MAP 0x847584 _REC_MAP_20_u2_u2_u2 65535. _CNV_A_R_LINEAR_____308_CM 0. 65535. DISPLAY_IDENTIFIER IP_SOOT_EQU FORMAT "%5.0"
 /begin AXIS_DESCR COM_AXIS n_wiv _CNV_A_R_LINEAR_____257_CM 10 0. 8160. FORMAT "%4.0" AXIS_PTS_REF ldp_n_wiv__ip_soot_equ /end AXIS_DESCR
 /begin AXIS_DESCR COM_AXIS fco_dif _CNV_A_R_LINEAR_____311_CM 10 0. 65535. FORMAT "%5.0" AXIS_PTS_REF ldp_fco_dif /end AXIS_DESCR
/end CHARACTERISTIC
/begin AXIS_PTS ldp_n_wiv__ip_wear_equ "N_WIV" 0x84466e n_wiv _REC_AXS_20_u2 8160. _CNV_A_R_LINEAR_____257_CM 10 0. 8160. FORMAT "%4.0" /end AXIS_PTS
/begin AXIS_PTS ldp_toil_wiv_clc "TOIL_WIV" 0x844840 toil_wiv_clc _REC_AXS_20_u1 255. _CNV_A_R_LINEAR_____295_CM 10 -60. 195. FORMAT "%3.0" /end AXIS_PTS
/begin CHARACTERISTIC ip_wear_equ "Kennfeld Verbrauchsindexwerte Diesel fuer spaetere Verbrauchsaequivalentberechnung (DS)" MAP 0x848120 _REC_MAP_20_u2_u2_u1 65535. _CNV_A_R_LINEAR_____308_CM 0. 65535. DISPLAY_IDENTIFIER IP_WEAR_EQU FORMAT "%5.0"
 /begin AXIS_DESCR COM_AXIS n_wiv _CNV_A_R_LINEAR_____257_CM 10 0. 8160. FORMAT "%4.0" AXIS_PTS_REF ldp_n_wiv__ip_wear_equ /end AXIS_DESCR
 /begin AXIS_DESCR COM_AXIS toil_wiv_clc _CNV_A_R_LINEAR_____295_CM 10 -60. 195. FORMAT "%3.0" AXIS_PTS_REF ldp_toil_wiv_clc /end AXIS_DESCR
/end CHARACTERISTIC
/begin AXIS_PTS ldp_n_wiv__ip_soot_equ "N_WIV" 0x844658 n_wiv _REC_AXS_20_u2 8160. _CNV_A_R_LINEAR_____257_CM 10 0. 8160. FORMAT "%4.0" /end AXIS_PTS
/begin MEASUREMENT oil_level_ctr_tmp "Oelstandszaehler" UBYTE _CNV_A_R_LINEAR_____1_CM 1 0. 0. 255. DISPLAY_IDENTIFIER OIL_LEVEL_CTR_TMP ECU_ADDRESS 0x7fbc10 FORMAT "%3.0" /end MEASUREMENT
/begin MEASUREMENT oil_level_dif_mv_sho_tmp "Kurzzeitmittelwert" UBYTE _CNV_A_R_LINEAR_____292_CM 1 0. -1905. 1920. DISPLAY_IDENTIFIER OIL_LEVEL_DIF_MV_SHO_TMP ECU_ADDRESS 0x7fbc0f FORMAT "%5.0" /end MEASUREMENT
/begin MEASUREMENT wear_wiv_value "Gemittelter Verschleissindexwert fuer Dieselmotor" UWORD _CNV_A_R_LINEAR_____308_CM 1 0. 0. 65535. DISPLAY_IDENTIFIER WEAR_WIV_VALUE ECU_ADDRESS 0x7fb152 BYTE_ORDER MSB_LAST FORMAT "%5.0" /end MEASUREMENT
/begin MEASUREMENT lv_emsf_state_1_gs "togglebit fuer Verbrauchsaequivalent Benziner" UBYTE _CNV_S_2_RANGE__0___88_CM 1 0. 0. 1. DISPLAY_IDENTIFIER LV_EMSF_STATE_1_GS ECU_ADDRESS 0x7fbc24 BIT_MASK 0x1 /end MEASUREMENT
/begin MEASUREMENT wear_fco_equ_gs "Verbrauchsaequivalent" UWORD _CNV_A_R_LINEAR_____293_CM 1 0. 0. 1.3107e-003 DISPLAY_IDENTIFIER WEAR_FCO_EQU_GS ECU_ADDRESS 0x7fb156 BYTE_ORDER MSB_LAST FORMAT "%10.8" /end MEASUREMENT
/begin CHARACTERISTIC c_oil_slop_level "Steigung der Befuellungskennlinie" VALUE 0x84858d _REC_VAL_20_u1 0.255 _CNV_A_R_LINEAR_____312_CM 0. 0.255 DISPLAY_IDENTIFIER C_OIL_SLOP_LEVEL FORMAT "%5.3" /end CHARACTERISTIC
/begin MEASUREMENT lv_err_t_toil_can "Fehlerstatus Oeltemperatur" UBYTE _CNV_S_2_RANGE__0___88_CM 1 0. 0. 1. DISPLAY_IDENTIFIER LV_ERR_T_TOIL_CAN ECU_ADDRESS 0x7fb82b BIT_MASK 0x1 /end MEASUREMENT
/begin MEASUREMENT fco_sum_can "summierter Kraftstoffverbrauch zur Ausgabe in der EMS5-CAN-Botschaft" UWORD _CNV_A_R_LINEAR_____307_CM 1 0. 0. 32767. DISPLAY_IDENTIFIER FCO_SUM_CAN ECU_ADDRESS 0x7fa288 BYTE_ORDER MSB_LAST FORMAT "%5.0" /end MEASUREMENT
/begin MEASUREMENT fco_vs "streckenbezogener Kraftstoffverbrauch" UWORD _CNV_A_R_LINEAR_____247_CM 1 0. 0. 92.52 DISPLAY_IDENTIFIER FCO_VS ECU_ADDRESS 0x7fa28c BYTE_ORDER MSB_LAST /end MEASUREMENT
/begin MEASUREMENT lv_fco_sum_ovfl "logische Variable fuer Ueberlauf des Verbrauchssignals" UBYTE _CNV_S_2_RANGE__0___88_CM 1 0. 0. 1. DISPLAY_IDENTIFIER LV_FCO_SUM_OVFL ECU_ADDRESS 0x7fb823 BIT_MASK 0x1 /end MEASUREMENT
/begin CHARACTERISTIC c_fco_stnd "Normierungskonstante Kraftstoffverbrauch" VALUE 0x848472 _REC_VAL_20_u2 65535. _CNV_A_R_LINEAR_____1_CM 0. 65535. DISPLAY_IDENTIFIER C_FCO_STND FORMAT "%5.0" /end CHARACTERISTIC
/begin CHARACTERISTIC c_crlc_fco_vs "Mittelungskonstante fuer die Mittelung des streckenbezogenen Kraftstoffverbrauch" VALUE 0x848358 _REC_VAL_20_u2 0.9999847412109381 _CNV_A_R_LINEAR_____300_CM 0. 0.9999847412109381 DISPLAY_IDENTIFIER C_CRLC_FCO_VS FORMAT "%7.5" /end CHARACTERISTIC
/begin MEASUREMENT fco_sum "summierter Kraftstoffverbrauch" UWORD _CNV_A_R_LINEAR_____307_CM 1 0. 0. 65535. DISPLAY_IDENTIFIER FCO_SUM ECU_ADDRESS 0x7fa28a BYTE_ORDER MSB_LAST FORMAT "%5.0" /end MEASUREMENT
/begin MEASUREMENT fco_t "gefilterter Kraftstoffverbrauch pro Zeit" UWORD _CNV_A_R_LINEAR_____249_CM 1 0. 0. 16.38375 DISPLAY_IDENTIFIER FCO_T ECU_ADDRESS 0x7fa28e BYTE_ORDER MSB_LAST FORMAT "%7.2" /end MEASUREMENT
/begin MEASUREMENT fco_t_raw "Kraftstoffverbrauch pro Zeit" UWORD _CNV_A_R_LINEAR_____313_CM 1 0. 0. 65.535 DISPLAY_IDENTIFIER FCO_T_RAW ECU_ADDRESS 0x7fb140 BYTE_ORDER MSB_LAST /end MEASUREMENT
/begin CHARACTERISTIC c_t_fco_t_clc "Mittelungskonstante fuer die Mittelung des zeitbezogenen Kraftstoffverbrauchs" VALUE 0x848640 _REC_VAL_20_u1 255. _CNV_A_R_LINEAR_____32_CM 0. 255. DISPLAY_IDENTIFIER C_T_FCO_T_CLC FORMAT "%3.0" /end CHARACTERISTIC
/begin MEASUREMENT fco_dif "Difference of fuel consumption related to 100 ms" UWORD _CNV_A_R_LINEAR_____311_CM 1 0. 0. 65535. DISPLAY_IDENTIFIER FCO_DIF ECU_ADDRESS 0x7fa294 BYTE_ORDER MSB_LAST FORMAT "%5.0" /end MEASUREMENT
/begin MEASUREMENT lv_tog1_can_nvld "Logical variable for \"CAN-message TOG1 not valid\"" UBYTE _CNV_S_2_RANGE__0___88_CM 1 0. 0. 1. DISPLAY_IDENTIFIER LV_TOG1_CAN_NVLD ECU_ADDRESS 0x7fb824 BIT_MASK 0x1 /end MEASUREMENT
/begin MEASUREMENT lv_tcs2_can_nvld "Logical variable for \"CAN-message TCS2 not valid\"" UBYTE _CNV_S_2_RANGE__0___88_CM 1 0. 0. 1. DISPLAY_IDENTIFIER LV_TCS2_CAN_NVLD ECU_ADDRESS 0x7fb825 BIT_MASK 0x1 /end MEASUREMENT
/begin MEASUREMENT lv_cdn_amp_obd "o v" UBYTE _CNV_A_R_LINEAR_____0_CM 1 0. 0. 1. DISPLAY_IDENTIFIER LV_CDN_AMP_OBD ECU_ADDRESS 0x7fb46c FORMAT "%1.0" /end MEASUREMENT
/begin MEASUREMENT lv_cdn_tam_st_obd "o v" UBYTE _CNV_A_R_LINEAR_____0_CM 1 0. 0. 1. DISPLAY_IDENTIFIER LV_CDN_TAM_ST_OBD ECU_ADDRESS 0x7fb46d FORMAT "%1.0" /end MEASUREMENT
/begin MEASUREMENT lv_cdn_ftl_obd "o v" UBYTE _CNV_A_R_LINEAR_____0_CM 1 0. 0. 1. DISPLAY_IDENTIFIER LV_CDN_FTL_OBD ECU_ADDRESS 0x7fb46e FORMAT "%1.0" /end MEASUREMENT
/begin MEASUREMENT lv_cdn_pf_obd "o v" UBYTE _CNV_A_R_LINEAR_____0_CM 1 0. 0. 1. DISPLAY_IDENTIFIER LV_CDN_PF_OBD ECU_ADDRESS 0x7fb46f FORMAT "%1.0" /end MEASUREMENT
/begin CHARACTERISTIC c_amp_cdn_obd "" VALUE 0x85bcc2 _REC_VAL_20_u2 5434. _CNV_A_R_LINEAR_____21_CM 0. 5434. DISPLAY_IDENTIFIER C_AMP_CDN_OBD FORMAT "%6.2" /end CHARACTERISTIC
/begin CHARACTERISTIC c_tam_st_cdn_obd "" VALUE 0x85c138 _REC_VAL_20_u1 255. _CNV_A_R_LINEAR_____18_CM -50. 205. DISPLAY_IDENTIFIER C_TAM_ST_CDN_OBD FORMAT "%3.0" /end CHARACTERISTIC
/begin CHARACTERISTIC c_ftl_cdn_obd "" VALUE 0x85be9e _REC_VAL_20_u1 100. _CNV_A_R_LINEAR_____44_CM 0. 100. DISPLAY_IDENTIFIER C_FTL_CDN_OBD FORMAT "%3.0" /end CHARACTERISTIC
/begin CHARACTERISTIC c_abc_inc_v_amp_rng "anti bounce counter increment for diagnosis instance V_AMP_RNG" VALUE 0x848251 _REC_VAL_20_u1 255. _CNV_A_R_LINEAR_____0_CM 0. 255. DISPLAY_IDENTIFIER C_ABC_INC_V_AMP_RNG FORMAT "%3.0" /end CHARACTERISTIC
/begin CHARACTERISTIC c_abc_max_v_amp_rng "maximum value of anti bounce counter for diagnosis instance V_AMP_RNG" VALUE 0x8482d3 _REC_VAL_20_u1 255. _CNV_A_R_LINEAR_____0_CM 0. 255. DISPLAY_IDENTIFIER C_ABC_MAX_V_AMP_RNG FORMAT "%3.0" /end CHARACTERISTIC
/begin CHARACTERISTIC c_abc_inc_amp_mes_grd "anti bounce counter increment for diagnosis instance AMP_MES_GRD" VALUE 0x8481ea _REC_VAL_20_u1 255. _CNV_A_R_LINEAR_____0_CM 0. 255. DISPLAY_IDENTIFIER C_ABC_INC_AMP_MES_GRD FORMAT "%3.0" /end CHARACTERISTIC
/begin CHARACTERISTIC c_abc_max_amp_mes_grd "maximum value of anti bounce counter for diagnosis instance AMP_MES_GRD" VALUE 0x84826c _REC_VAL_20_u1 255. _CNV_A_R_LINEAR_____0_CM 0. 255. DISPLAY_IDENTIFIER C_ABC_MAX_AMP_MES_GRD FORMAT "%3.0" /end CHARACTERISTIC
/begin CHARACTERISTIC c_v_amp_min_diag "AMP minimum threshold for error detection" VALUE 0x85c1e6 _REC_VAL_20_u2 4.9951171875 _CNV_A_R_LINEAR_____33_CM 0. 4.9951171875 DISPLAY_IDENTIFIER C_V_AMP_MIN_DIAG FORMAT "%3.2" /end CHARACTERISTIC
/begin CHARACTERISTIC c_v_amp_max_diag "AMP maximum threshold for error detection" VALUE 0x85c1e4 _REC_VAL_20_u2 4.9951171875 _CNV_A_R_LINEAR_____33_CM 0. 4.9951171875 DISPLAY_IDENTIFIER C_V_AMP_MAX_DIAG FORMAT "%3.2" /end CHARACTERISTIC
/begin MEASUREMENT lv_err_amp_mes "global error flag" UBYTE _CNV_S_2_RANGE______28_CM 1 0. 0. 1. DISPLAY_IDENTIFIER LV_ERR_AMP_MES ECU_ADDRESS 0x7fb470 /end MEASUREMENT
/begin CHARACTERISTIC c_amp_mes_grd_diag "threshold for AMP gradient check" VALUE 0x85bcc8 _REC_VAL_20_u2 5434. _CNV_A_R_LINEAR_____344_CM 0. 5434. DISPLAY_IDENTIFIER C_AMP_MES_GRD_DIAG FORMAT "%3.2" /end CHARACTERISTIC
/begin CHARACTERISTIC c_abc_inc_v_egrv_0_rng "anti bounce counter increment for diagnosis instance V_EGRV_0_RNG" VALUE 0x848258 _REC_VAL_20_u1 255. _CNV_A_R_LINEAR_____0_CM 0. 255. DISPLAY_IDENTIFIER C_ABC_INC_V_EGRV_0_RNG FORMAT "%3.0" /end CHARACTERISTIC
/begin CHARACTERISTIC c_abc_max_v_egrv_0_rng "maximum value of anti bounce counter for diagnosis instance V_EGRV_0_RNG" VALUE 0x8482da _REC_VAL_20_u1 255. _CNV_A_R_LINEAR_____0_CM 0. 255. DISPLAY_IDENTIFIER C_ABC_MAX_V_EGRV_0_RNG FORMAT "%3.0" /end CHARACTERISTIC
/begin CHARACTERISTIC c_abc_inc_v_egrv_0_grd "anti bounce counter increment for diagnosis instance V_EGRV_0_GRD" VALUE 0x848257 _REC_VAL_20_u1 255. _CNV_A_R_LINEAR_____0_CM 0. 255. DISPLAY_IDENTIFIER C_ABC_INC_V_EGRV_0_GRD FORMAT "%3.0" /end CHARACTERISTIC
/begin CHARACTERISTIC c_abc_max_v_egrv_0_grd "maximum value of anti bounce counter for diagnosis instance V_EGRV_0_GRD" VALUE 0x8482d9 _REC_VAL_20_u1 255. _CNV_A_R_LINEAR_____0_CM 0. 255. DISPLAY_IDENTIFIER C_ABC_MAX_V_EGRV_0_GRD FORMAT "%3.0" /end CHARACTERISTIC
/begin MEASUREMENT lv_err_vcc_v_egrv_0 "VCC_V_EGRV_j error flag  (voltage supply of EGR valve Potentiometer j) j = 0 .. NC_EGRV_NR - 1" UBYTE _CNV_S_2_RANGE______28_CM 1 0. 0. 1. DISPLAY_IDENTIFIER LV_ERR_VCC_V_EGRV_0 ECU_ADDRESS 0x7fb472 /end MEASUREMENT
/begin MEASUREMENT lv_err_v_egrv_0_mes "global error flag for potentiometer sensor of EGR valve j ( j = 0 .. NC_EGRV_NR - 1 )" UBYTE _CNV_S_2_RANGE______28_CM 1 0. 0. 1. DISPLAY_IDENTIFIER LV_ERR_V_EGRV_0_MES ECU_ADDRESS 0x7fb471 /end MEASUREMENT
/begin CHARACTERISTIC c_v_egrv_mes_max_diag "upper threshold for range check of  V_EGRV_j_MES (EGR valve potentiometers)" VALUE 0x85c21c _REC_VAL_20_u2 4.9951171875 _CNV_A_R_LINEAR_____33_CM 0. 4.9951171875 DISPLAY_IDENTIFIER C_V_EGRV_MES_MAX_DIAG FORMAT "%4.3" /end CHARACTERISTIC
/begin CHARACTERISTIC c_v_egrv_mes_min_diag "lower threshold for range check of V_EGRV_j_MES (EGR valve potentiometers)" VALUE 0x85c21e _REC_VAL_20_u2 4.9951171875 _CNV_A_R_LINEAR_____33_CM 0. 4.9951171875 DISPLAY_IDENTIFIER C_V_EGRV_MES_MIN_DIAG FORMAT "%4.3" /end CHARACTERISTIC
/begin CHARACTERISTIC c_v_egrv_mes_grd_diag "V_EGRV_MES_GRD threshold for error detection" VALUE 0x85c21a _REC_VAL_20_u2 4.9951171875 _CNV_A_R_LINEAR_____345_CM 0. 4.9951171875 DISPLAY_IDENTIFIER C_V_EGRV_MES_GRD_DIAG FORMAT "%4.3" /end CHARACTERISTIC
/begin CHARACTERISTIC c_abc_inc_ges_maf_0_max "" VALUE 0x848214 _REC_VAL_20_u1 255. _CNV_A_R_LINEAR_____0_CM 0. 255. DISPLAY_IDENTIFIER C_ABC_INC_GES_MAF_0_MAX FORMAT "%3.0" /end CHARACTERISTIC
/begin CHARACTERISTIC c_abc_max_ges_maf_0_max "" VALUE 0x848296 _REC_VAL_20_u1 255. _CNV_A_R_LINEAR_____0_CM 0. 255. DISPLAY_IDENTIFIER C_ABC_MAX_GES_MAF_0_MAX FORMAT "%3.0" /end CHARACTERISTIC
/begin AXIS_PTS ldp_n__ip_maf_kgh_ges_maf_max "" 0x841930 n _REC_AXS_20_u2 6375. _CNV_A_R_LINEAR_____5_CM 6 0. 6375. FORMAT "%4.0" /end AXIS_PTS
/begin CHARACTERISTIC ip_maf_kgh_ges_maf_max__n "DIAG_GES: threshold for range check of MAF" CURVE 0x84cf8a _REC_CUR_20_u2_u2 1023.984375 _CNV_A_R_LINEAR_____112_CM 0. 1023.984375 DISPLAY_IDENTIFIER IP_MAF_KGH_GES_MAF_MAX__N FORMAT "%7.3"
 /begin AXIS_DESCR COM_AXIS n _CNV_A_R_LINEAR_____5_CM 6 0. 6375. FORMAT "%4.0" AXIS_PTS_REF ldp_n__ip_maf_kgh_ges_maf_max /end AXIS_DESCR
/end CHARACTERISTIC
/begin CHARACTERISTIC c_n_ges_maf_max_diag "" VALUE 0x85bf8e _REC_VAL_20_u2 6375. _CNV_A_R_LINEAR_____5_CM 0. 6375. DISPLAY_IDENTIFIER C_N_GES_MAF_MAX_DIAG FORMAT "%4.0" /end CHARACTERISTIC
/begin CHARACTERISTIC c_abc_inc_efp_rly_dps "" VALUE 0x84820a _REC_VAL_20_u1 255. _CNV_A_R_LINEAR_____0_CM 0. 255. DISPLAY_IDENTIFIER C_ABC_INC_EFP_RLY_DPS FORMAT "%3.0" /end CHARACTERISTIC
/begin CHARACTERISTIC c_abc_max_efp_rly_dps "" VALUE 0x84828c _REC_VAL_20_u1 255. _CNV_A_R_LINEAR_____0_CM 0. 255. DISPLAY_IDENTIFIER C_ABC_MAX_EFP_RLY_DPS FORMAT "%3.0" /end CHARACTERISTIC
/begin CHARACTERISTIC c_abc_inc_efp_rly_plaus_1 "" VALUE 0x84820b _REC_VAL_20_u1 255. _CNV_A_R_LINEAR_____0_CM 0. 255. DISPLAY_IDENTIFIER C_ABC_INC_EFP_RLY_PLAUS_1 FORMAT "%3.0" /end CHARACTERISTIC
/begin CHARACTERISTIC c_abc_max_efp_rly_plaus_1 "" VALUE 0x84828d _REC_VAL_20_u1 255. _CNV_A_R_LINEAR_____0_CM 0. 255. DISPLAY_IDENTIFIER C_ABC_MAX_EFP_RLY_PLAUS_1 FORMAT "%3.0" /end CHARACTERISTIC
/begin CHARACTERISTIC c_abc_inc_efp_rly_plaus_2 "" VALUE 0x84820c _REC_VAL_20_u1 255. _CNV_A_R_LINEAR_____0_CM 0. 255. DISPLAY_IDENTIFIER C_ABC_INC_EFP_RLY_PLAUS_2 FORMAT "%3.0" /end CHARACTERISTIC
/begin CHARACTERISTIC c_abc_max_efp_rly_plaus_2 "" VALUE 0x84828e _REC_VAL_20_u1 255. _CNV_A_R_LINEAR_____0_CM 0. 255. DISPLAY_IDENTIFIER C_ABC_MAX_EFP_RLY_PLAUS_2 FORMAT "%3.0" /end CHARACTERISTIC
/begin MEASUREMENT err_sym_mem_efp_rly_dps "" UBYTE _CNV_S_6_CONV_ERRM__27_CM 1 0. 0. 15. DISPLAY_IDENTIFIER ERR_SYM_MEM_EFP_RLY_DPS ECU_ADDRESS 0x7fca38 /end MEASUREMENT
/begin MEASUREMENT ctr_efp_rly_plaus_1_dly "" UBYTE _CNV_A_R_LINEAR_____0_CM 1 0. 0. 255. DISPLAY_IDENTIFIER CTR_EFP_RLY_PLAUS_1_DLY ECU_ADDRESS 0x7fca39 FORMAT "%3.0" /end MEASUREMENT
/begin MEASUREMENT ctr_efp_rly_plaus_2_dly "" UBYTE _CNV_A_R_LINEAR_____0_CM 1 0. 0. 255. DISPLAY_IDENTIFIER CTR_EFP_RLY_PLAUS_2_DLY ECU_ADDRESS 0x7fca3a FORMAT "%3.0" /end MEASUREMENT
/begin CHARACTERISTIC c_ctr_max_efp_rly_plaus_1_dly "" VALUE 0x85bdb2 _REC_VAL_20_u1 255. _CNV_A_R_LINEAR_____0_CM 0. 255. DISPLAY_IDENTIFIER C_CTR_MAX_EFP_RLY_PLAUS_1_DLY FORMAT "%3.0" /end CHARACTERISTIC
/begin CHARACTERISTIC c_ctr_max_efp_rly_plaus_2_dly "" VALUE 0x85bdb3 _REC_VAL_20_u1 255. _CNV_A_R_LINEAR_____0_CM 0. 255. DISPLAY_IDENTIFIER C_CTR_MAX_EFP_RLY_PLAUS_2_DLY FORMAT "%3.0" /end CHARACTERISTIC
/begin MEASUREMENT lv_scg_efp_rly "" UBYTE _CNV_A_R_LINEAR_____0_CM 1 0. 0. 1. DISPLAY_IDENTIFIER LV_SCG_EFP_RLY ECU_ADDRESS 0x7fca3b FORMAT "%1.0" /end MEASUREMENT
/begin MEASUREMENT lv_scg_vld_efp_rly "" UBYTE _CNV_A_R_LINEAR_____0_CM 1 0. 0. 1. DISPLAY_IDENTIFIER LV_SCG_VLD_EFP_RLY ECU_ADDRESS 0x7fca3c FORMAT "%1.0" /end MEASUREMENT
/begin MEASUREMENT lv_scb_efp_rly "" UBYTE _CNV_A_R_LINEAR_____0_CM 1 0. 0. 1. DISPLAY_IDENTIFIER LV_SCB_EFP_RLY ECU_ADDRESS 0x7fca3d FORMAT "%1.0" /end MEASUREMENT
/begin MEASUREMENT lv_scb_vld_efp_rly "" UBYTE _CNV_A_R_LINEAR_____0_CM 1 0. 0. 1. DISPLAY_IDENTIFIER LV_SCB_VLD_EFP_RLY ECU_ADDRESS 0x7fca3e FORMAT "%1.0" /end MEASUREMENT
/begin MEASUREMENT lv_ol_efp_rly "" UBYTE _CNV_A_R_LINEAR_____0_CM 1 0. 0. 1. DISPLAY_IDENTIFIER LV_OL_EFP_RLY ECU_ADDRESS 0x7fca3f FORMAT "%1.0" /end MEASUREMENT
/begin MEASUREMENT lv_ol_vld_efp_rly "" UBYTE _CNV_A_R_LINEAR_____0_CM 1 0. 0. 1. DISPLAY_IDENTIFIER LV_OL_VLD_EFP_RLY ECU_ADDRESS 0x7fca40 FORMAT "%1.0" /end MEASUREMENT
/begin MEASUREMENT lv_efp_rly_diag "" UBYTE _CNV_A_R_LINEAR_____0_CM 1 0. 0. 1. DISPLAY_IDENTIFIER LV_EFP_RLY_DIAG ECU_ADDRESS 0x7fca41 FORMAT "%1.0" /end MEASUREMENT
/begin MEASUREMENT lv_err_toil "flag for oil temperature error (set to 0 because TOIL_MDL is used if no value from sensor or CAN is available" UBYTE _CNV_S_2_RANGE__0___88_CM 1 0. 0. 1. DISPLAY_IDENTIFIER LV_ERR_TOIL ECU_ADDRESS 0x7fb776 BIT_MASK 0x1 /end MEASUREMENT
/begin MEASUREMENT lv_err_toil_sens "globales Fehlerflag Öltemperatursensor entprellt" UBYTE _CNV_S_2_RANGE__0___88_CM 1 0. 0. 1. DISPLAY_IDENTIFIER LV_ERR_TOIL_SENS ECU_ADDRESS 0x7fb78b BIT_MASK 0x1 /end MEASUREMENT
/begin CHARACTERISTIC c_tco_max_toil_diag "TCO-heiss-Schwelle - TOIL-Diagnose" VALUE 0x8486d1 _REC_VAL_20_u1 190.5 _CNV_A_R_LINEAR_____235_CM -48. 142.5 DISPLAY_IDENTIFIER C_TCO_MAX_TOIL_DIAG FORMAT "%5.1" /end CHARACTERISTIC
/begin CHARACTERISTIC c_abc_inc_toil_el "Inkrement Entprellzähler - TOIL_EL-Diagnose" VALUE 0x84824d _REC_VAL_20_u1 255. _CNV_A_R_LINEAR_____1_CM 0. 255. DISPLAY_IDENTIFIER C_ABC_INC_TOIL_EL FORMAT "%3.0" /end CHARACTERISTIC
/begin CHARACTERISTIC c_abc_inc_toil_plaus "Inkrement Entprellzähler - TOIL_PLAUS-Diagnose" VALUE 0x84824e _REC_VAL_20_u1 255. _CNV_A_R_LINEAR_____1_CM 0. 255. DISPLAY_IDENTIFIER C_ABC_INC_TOIL_PLAUS FORMAT "%3.0" /end CHARACTERISTIC
/begin CHARACTERISTIC c_abc_max_toil_el "Maximalwert Entprellzähler - TOIL_EL-Diagnose" VALUE 0x8482cf _REC_VAL_20_u1 254. _CNV_A_R_LINEAR_____1_CM 1. 255. DISPLAY_IDENTIFIER C_ABC_MAX_TOIL_EL FORMAT "%3.0" /end CHARACTERISTIC
/begin CHARACTERISTIC c_abc_max_toil_plaus "Maximalwert Entprellzähler - TOIL_PLAUS-Diagnose" VALUE 0x8482d0 _REC_VAL_20_u1 254. _CNV_A_R_LINEAR_____1_CM 1. 255. DISPLAY_IDENTIFIER C_ABC_MAX_TOIL_PLAUS FORMAT "%3.0" /end CHARACTERISTIC
/begin CHARACTERISTIC c_tco_min_toil_plaus_diag "min. TCO für Plausibilisierung TOIL-Sensor 'Signal unplausibel niedrig'" VALUE 0x8486d8 _REC_VAL_20_u1 190.5 _CNV_A_R_LINEAR_____235_CM -48. 142.5 DISPLAY_IDENTIFIER C_TCO_MIN_TOIL_PLAUS_DIAG FORMAT "%5.1" /end CHARACTERISTIC
/begin CHARACTERISTIC c_tco_min_toil_diag "TCO-kalt-Schwelle - TOIL-Diagnose" VALUE 0x8486d7 _REC_VAL_20_u1 190.5 _CNV_A_R_LINEAR_____235_CM -48. 142.5 DISPLAY_IDENTIFIER C_TCO_MIN_TOIL_DIAG FORMAT "%5.1" /end CHARACTERISTIC
/begin CHARACTERISTIC c_tco_max_toil_plaus_diag "max. TCO für Plausibilisierung TOIL-Sensor 'Signal unplausibel hoch'" VALUE 0x8486d2 _REC_VAL_20_u1 190.5 _CNV_A_R_LINEAR_____235_CM -48. 142.5 DISPLAY_IDENTIFIER C_TCO_MAX_TOIL_PLAUS_DIAG FORMAT "%5.1" /end CHARACTERISTIC
/begin CHARACTERISTIC c_toil_min_plaus_diag "TOIL-Schwelle für Plausibilisierung TOIL-Sensor 'Signal unplausibel niedrig'" VALUE 0x8486f9 _REC_VAL_20_u1 200. _CNV_A_R_LINEAR_____68_CM -40. 160. DISPLAY_IDENTIFIER C_TOIL_MIN_PLAUS_DIAG FORMAT "%3.0" /end CHARACTERISTIC
/begin CHARACTERISTIC c_toil_max_plaus_diag "TOIL-Schwelle für Plausibilisierung TOIL-Sensor 'Signal unplausibel hoch'" VALUE 0x8486f6 _REC_VAL_20_u1 200. _CNV_A_R_LINEAR_____68_CM -40. 160. DISPLAY_IDENTIFIER C_TOIL_MAX_PLAUS_DIAG FORMAT "%3.0" /end CHARACTERISTIC
/begin CHARACTERISTIC c_t_tco_toil_diag "Diagnosesperrzeit nach Übergang aus ES" VALUE 0x8486b4 _REC_VAL_20_u2 6553.400000000001 _CNV_A_R_LINEAR_____234_CM 0.1 6553.5 DISPLAY_IDENTIFIER C_T_TCO_TOIL_DIAG FORMAT "%6.1" /end CHARACTERISTIC
/begin CHARACTERISTIC c_t_toil_plaus_diag "min. Zeit nach Erreichen der TCO-Schwelle bis TOIL-Sensor plausibilisiert wird" VALUE 0x8486ba _REC_VAL_20_u2 65535. _CNV_A_R_LINEAR_____32_CM 0. 65535. DISPLAY_IDENTIFIER C_T_TOIL_PLAUS_DIAG FORMAT "%5.0" /end CHARACTERISTIC
/begin CHARACTERISTIC c_t_pwl_max_stb "threshold for max. PWL-standby" VALUE 0x8486a0 _REC_VAL_20_u2 6553.5 _CNV_A_R_LINEAR_____234_CM 0. 6553.5 DISPLAY_IDENTIFIER C_T_PWL_MAX_STB FORMAT "%6.1" /end CHARACTERISTIC
/begin CHARACTERISTIC c_abc_inc_egr_byp_dps "anti bounce counter increment for diagnosis instance EGR_BYP_DPS" VALUE 0x84820d _REC_VAL_20_u1 255. _CNV_A_R_LINEAR_____0_CM 0. 255. DISPLAY_IDENTIFIER C_ABC_INC_EGR_BYP_DPS FORMAT "%3.0" /end CHARACTERISTIC
/begin CHARACTERISTIC c_abc_max_egr_byp_dps "maximum value of anti bounce counter for diagnosis instance EGR_BYP_DPS" VALUE 0x84828f _REC_VAL_20_u1 255. _CNV_A_R_LINEAR_____0_CM 0. 255. DISPLAY_IDENTIFIER C_ABC_MAX_EGR_BYP_DPS FORMAT "%3.0" /end CHARACTERISTIC
/begin MEASUREMENT err_sym_mem_egr_byp_dps "Memorized symptom of the diagnostics instance EGR_BYP_DPS" UBYTE _CNV_S_6_CONV_ERRM__27_CM 1 0. 0. 15. DISPLAY_IDENTIFIER ERR_SYM_MEM_EGR_BYP_DPS ECU_ADDRESS 0x7fba14 /end MEASUREMENT
/begin MEASUREMENT lv_err_egr_byp "global error flag for diagnosis of EGR_BYP" UBYTE _CNV_S_2_RANGE______28_CM 1 0. 0. 1. DISPLAY_IDENTIFIER LV_ERR_EGR_BYP ECU_ADDRESS 0x7fba13 /end MEASUREMENT
/begin MEASUREMENT lv_scg_egr_byp "" UBYTE _CNV_A_R_LINEAR_____0_CM 1 0. 0. 1. DISPLAY_IDENTIFIER LV_SCG_EGR_BYP ECU_ADDRESS 0x7fba16 FORMAT "%1.0" /end MEASUREMENT
/begin MEASUREMENT lv_scg_vld_egr_byp "" UBYTE _CNV_A_R_LINEAR_____0_CM 1 0. 0. 1. DISPLAY_IDENTIFIER LV_SCG_VLD_EGR_BYP ECU_ADDRESS 0x7fba19 FORMAT "%1.0" /end MEASUREMENT
/begin MEASUREMENT lv_scb_egr_byp "" UBYTE _CNV_A_R_LINEAR_____0_CM 1 0. 0. 1. DISPLAY_IDENTIFIER LV_SCB_EGR_BYP ECU_ADDRESS 0x7fba15 FORMAT "%1.0" /end MEASUREMENT
/begin MEASUREMENT lv_scb_vld_egr_byp "" UBYTE _CNV_A_R_LINEAR_____0_CM 1 0. 0. 1. DISPLAY_IDENTIFIER LV_SCB_VLD_EGR_BYP ECU_ADDRESS 0x7fba18 FORMAT "%1.0" /end MEASUREMENT
/begin MEASUREMENT lv_ol_egr_byp "" UBYTE _CNV_A_R_LINEAR_____0_CM 1 0. 0. 1. DISPLAY_IDENTIFIER LV_OL_EGR_BYP ECU_ADDRESS 0x7fba17 FORMAT "%1.0" /end MEASUREMENT
/begin MEASUREMENT lv_ol_vld_egr_byp "" UBYTE _CNV_A_R_LINEAR_____0_CM 1 0. 0. 1. DISPLAY_IDENTIFIER LV_OL_VLD_EGR_BYP ECU_ADDRESS 0x7fba1a FORMAT "%1.0" /end MEASUREMENT
/begin MEASUREMENT lv_err_varcod "Fehler Variantencodierung entprellt" UBYTE _CNV_S_2_RANGE__0___88_CM 1 0. 0. 1. DISPLAY_IDENTIFIER LV_ERR_VARCOD ECU_ADDRESS 0x7fb51f BIT_MASK 0x1 /end MEASUREMENT
/begin CHARACTERISTIC c_abc_inc_varcod " Inkrement Entprellzaehler" VALUE 0x848265 _REC_VAL_20_u1 255. _CNV_A_R_LINEAR_____1_CM 0. 255. DISPLAY_IDENTIFIER C_ABC_INC_VARCOD FORMAT "%3.0" /end CHARACTERISTIC
/begin CHARACTERISTIC c_abc_max_varcod "Maximalwert Entprellzaehler" VALUE 0x8482e7 _REC_VAL_20_u1 254. _CNV_A_R_LINEAR_____1_CM 1. 255. DISPLAY_IDENTIFIER C_ABC_MAX_VARCOD FORMAT "%3.0" /end CHARACTERISTIC
/begin CHARACTERISTIC c_varcod_diag_di "Konfigurationsbyte fuer Diagnose Variantencodierung (Ausblendung der entsprechenden Diagnose)" VALUE 0x848770 _REC_VAL_20_u1 31. _CNV_A_R_LINEAR_____1_CM 0. 31. DISPLAY_IDENTIFIER C_VARCOD_DIAG_DI FORMAT "%3.0" /end CHARACTERISTIC
/begin COMPU_METHOD _CNV_A_R_LINEAR_____0_CM "" RAT_FUNC "%6.3" "[-]" COEFFS 0 1. 0. 0 0 1 /end COMPU_METHOD
/begin COMPU_METHOD _CNV_A_R_LINEAR_____1_CM "" RAT_FUNC "%6.3" "-" COEFFS 0 1. 0. 0 0 1 /end COMPU_METHOD
/begin COMPU_METHOD _CNV_A_R_LINEAR_____5_CM "" RAT_FUNC "%6.3" "[rpm]" COEFFS 0 1. 0. 0 0 1 /end COMPU_METHOD
/begin COMPU_METHOD _CNV_S_2_RANGE______11_CM "" TAB_VERB "%6.3" "[-]" COMPU_TAB_REF _CNV_S_2_RANGE______11 /end COMPU_METHOD
/begin COMPU_VTAB _CNV_S_2_RANGE______11 "" TAB_VERB 2 0 "0" 1 "1" /end COMPU_VTAB
/begin COMPU_METHOD _CNV_A_R_LINEAR_____12_CM "" RAT_FUNC "%6.3" "[%]" COEFFS 0 327.6800000003072 3.071909304708242e-008 0 0 1 /end COMPU_METHOD
/begin COMPU_METHOD _CNV_A_R_LINEAR_____16_CM "" RAT_FUNC "%6.3" "[s]" COEFFS 0 1. 0. 0 0 1 /end COMPU_METHOD
/begin COMPU_METHOD _CNV_A_R_LINEAR_____18_CM "" RAT_FUNC "%6.3" "[°C]" COEFFS 0 1. 50. 0 0 1 /end COMPU_METHOD
/begin COMPU_METHOD _CNV_A_R_LINEAR_____19_CM "" RAT_FUNC "%6.3" "[s]" COEFFS 0 10. 0. 0 0 1 /end COMPU_METHOD
/begin COMPU_METHOD _CNV_A_R_LINEAR_____21_CM "" RAT_FUNC "%6.3" "[hPa]" COEFFS 0 12.06017666543982 0. 0 0 1 /end COMPU_METHOD
/begin COMPU_METHOD _CNV_S_6_CONV_ERRM__27_CM "" TAB_VERB "%6.3" "[-]" COMPU_TAB_REF _CNV_S_6_CONV_ERRM__27 /end COMPU_METHOD
/begin COMPU_VTAB _CNV_S_6_CONV_ERRM__27 "" TAB_VERB 6 0 "NO_SYM" 1 "SYM_0" 2 "SYM_1" 4 "SYM_2" 8 "SYM_3" 15 "BENCH_MODE" /end COMPU_VTAB
/begin COMPU_METHOD _CNV_S_2_RANGE______28_CM "" TAB_VERB "%6.3" "[-]" COMPU_TAB_REF _CNV_S_2_RANGE______28 /end COMPU_METHOD
/begin COMPU_VTAB _CNV_S_2_RANGE______28 "" TAB_VERB 2 0 "passive" 1 "active" /end COMPU_VTAB
/begin COMPU_METHOD _CNV_A_R_LINEAR_____32_CM "" RAT_FUNC "%6.3" "s" COEFFS 0 1. 0. 0 0 1 /end COMPU_METHOD
/begin COMPU_METHOD _CNV_A_R_LINEAR_____33_CM "" RAT_FUNC "%6.3" "[V]" COEFFS 0 204.8 0. 0 0 1 /end COMPU_METHOD
/begin COMPU_METHOD _CNV_A_R_LINEAR_____39_CM "" RAT_FUNC "%6.3" "[km/h]" COEFFS 0 1. 0. 0 0 1 /end COMPU_METHOD
/begin COMPU_METHOD _CNV_A_R_LINEAR_____44_CM "" RAT_FUNC "%6.3" "[%]" COEFFS 0 2.55 0. 0 0 1 /end COMPU_METHOD
/begin COMPU_METHOD _CNV_A_R_LINEAR_____48_CM "" RAT_FUNC "%6.3" "[V]" COEFFS 0 8.854166666666666 0. 0 0 1 /end COMPU_METHOD
/begin COMPU_METHOD _CNV_A_R_LINEAR_____50_CM "" RAT_FUNC "%6.3" "[%]" COEFFS 0 327.6800000003072 3.071967512372036e-008 0 0 1 /end COMPU_METHOD
/begin COMPU_METHOD _CNV_A_R_LINEAR_____52_CM "" RAT_FUNC "%6.3" "[V]" COEFFS 0 13107.20001587224 0. 0 0 1 /end COMPU_METHOD
/begin COMPU_METHOD _CNV_A_R_LINEAR_____53_CM "" RAT_FUNC "%6.3" "[-]" COEFFS 0 32767.99807357072 0. 0 0 1 /end COMPU_METHOD
/begin COMPU_METHOD _CNV_A_R_LINEAR_____54_CM "" RAT_FUNC "%6.3" "[hPa/10ms]" COEFFS 0 12.06017666543982 0. 0 0 1 /end COMPU_METHOD
/begin COMPU_METHOD _CNV_A_R_LINEAR_____59_CM "" RAT_FUNC "%6.3" "[s]" COEFFS 0 100. 0. 0 0 1 /end COMPU_METHOD
/begin COMPU_METHOD _CNV_A_R_LINEAR_____60_CM "" RAT_FUNC "%6.3" "[hPa]" COEFFS 0 12.06036070024094 2.255463186884299e-005 0 0 1 /end COMPU_METHOD
/begin COMPU_METHOD _CNV_A_R_LINEAR_____61_CM "" RAT_FUNC "%6.3" "[hPa]" COEFFS 0 12.06036070024094 2.255463233158328e-005 0 0 1 /end COMPU_METHOD
/begin COMPU_METHOD _CNV_A_R_LINEAR_____62_CM "" RAT_FUNC "%6.3" "[Nm]" COEFFS 0 32. 0. 0 0 1 /end COMPU_METHOD
/begin COMPU_METHOD _CNV_A_R_LINEAR_____68_CM "" RAT_FUNC "%6.3" "°C" COEFFS 0 1. 40. 0 0 1 /end COMPU_METHOD
/begin COMPU_METHOD _CNV_A_R_LINEAR_____75_CM "" RAT_FUNC "%6.3" "[m/(s*s)]" COEFFS 0 12.5 175. 0 0 1 /end COMPU_METHOD
/begin COMPU_METHOD _CNV_A_R_LINEAR_____82_CM "" RAT_FUNC "%6.3" "[%]" COEFFS 0 2.56 0. 0 0 1 /end COMPU_METHOD
/begin COMPU_METHOD _CNV_A_R_LINEAR_____83_CM "" RAT_FUNC "%6.3" "[Nm]" COEFFS 0 31.99984374837874 32767.83999833983 0 0 1 /end COMPU_METHOD
/begin COMPU_METHOD _CNV_A_R_LINEAR_____84_CM "" RAT_FUNC "%6.3" "rpm" COEFFS 0 3.125e-002 0. 0 0 1 /end COMPU_METHOD
/begin COMPU_METHOD _CNV_S_2_RANGE__0___88_CM "" TAB_VERB "%6.3" "-" COMPU_TAB_REF _CNV_S_2_RANGE__0___88 /end COMPU_METHOD
/begin COMPU_VTAB _CNV_S_2_RANGE__0___88 "" TAB_VERB 2 0 "0" 1 "1" /end COMPU_VTAB
/begin COMPU_METHOD _CNV_A_R_LINEAR_____112_CM "" RAT_FUNC "%6.3" "[kg/h]" COEFFS 0 64. 0. 0 0 1 /end COMPU_METHOD
/begin COMPU_METHOD _CNV_A_R_LINEAR_____113_CM "" RAT_FUNC "%6.3" "[-]" COEFFS 0 100. 0. 0 0 1 /end COMPU_METHOD
/begin COMPU_METHOD _CNV_A_R_LINEAR_____158_CM "" RAT_FUNC "%6.3" "[%]" COEFFS 0 327.680000069121 32768.0000069121 0 0 1 /end COMPU_METHOD
/begin COMPU_METHOD _CNV_A_R_LINEAR_____206_CM "" RAT_FUNC "%6.3" "[kPa]" COEFFS 0 8.225806451612903e-002 0. 0 0 1 /end COMPU_METHOD
/begin COMPU_METHOD _CNV_A_R_LINEAR_____223_CM "" RAT_FUNC "%6.3" "s" COEFFS 0 100. 0. 0 0 1 /end COMPU_METHOD
/begin COMPU_METHOD _CNV_A_R_LINEAR_____224_CM "" RAT_FUNC "%6.3" "ms" COEFFS 0 2.e-002 0. 0 0 1 /end COMPU_METHOD
/begin COMPU_METHOD _CNV_A_R_LINEAR_____225_CM "" RAT_FUNC "%6.3" "ms" COEFFS 0 5.e-003 0. 0 0 1 /end COMPU_METHOD
/begin COMPU_METHOD _CNV_A_R_LINEAR_____226_CM "" RAT_FUNC "%6.3" "µs" COEFFS 0 1. 0. 0 0 1 /end COMPU_METHOD
/begin COMPU_METHOD _CNV_A_R_LINEAR_____233_CM "" RAT_FUNC "%6.3" "[kPa/100ms]" COEFFS 0 1. 0. 0 0 1 /end COMPU_METHOD
/begin COMPU_METHOD _CNV_A_R_LINEAR_____234_CM "" RAT_FUNC "%6.3" "s" COEFFS 0 10. 0. 0 0 1 /end COMPU_METHOD
/begin COMPU_METHOD _CNV_A_R_LINEAR_____235_CM "" RAT_FUNC "%6.3" "[\260C]" COEFFS 0 1.333333333333333 64. 0 0 1 /end COMPU_METHOD
/begin COMPU_METHOD _CNV_A_R_LINEAR_____236_CM "" RAT_FUNC "%6.3" "%/100ms" COEFFS 0 2.56 0. 0 0 1 /end COMPU_METHOD
/begin COMPU_METHOD _CNV_A_R_LINEAR_____237_CM "" RAT_FUNC "%6.3" "[rpm]" COEFFS 0 6.25e-002 0. 0 0 1 /end COMPU_METHOD
/begin COMPU_METHOD _CNV_A_R_LINEAR_____238_CM "" RAT_FUNC "%6.3" "-" COEFFS 0 64. 0. 0 0 1 /end COMPU_METHOD
/begin COMPU_METHOD _CNV_A_R_LINEAR_____239_CM "" RAT_FUNC "%6.3" "km/h" COEFFS 0 1. 0. 0 0 1 /end COMPU_METHOD
/begin COMPU_METHOD _CNV_A_R_LINEAR_____240_CM "" RAT_FUNC "%6.3" "-" COEFFS 0 128. 0. 0 0 1 /end COMPU_METHOD
/begin COMPU_METHOD _CNV_A_R_LINEAR_____241_CM "" RAT_FUNC "%6.3" "hPa" COEFFS 0 12.06017666543982 0. 0 0 1 /end COMPU_METHOD
/begin COMPU_METHOD _CNV_A_R_LINEAR_____242_CM "" RAT_FUNC "%6.3" "[%]" COEFFS 0 2.5 0. 0 0 1 /end COMPU_METHOD
/begin COMPU_METHOD _CNV_A_R_LINEAR_____243_CM "" RAT_FUNC "%6.3" "[°C]" COEFFS 0 1.333333333333333 0. 0 0 1 /end COMPU_METHOD
/begin COMPU_METHOD _CNV_A_R_LINEAR_____244_CM "" RAT_FUNC "%6.3" "[V]" COEFFS 0 9.807692307692308 0. 0 0 1 /end COMPU_METHOD
/begin COMPU_METHOD _CNV_A_R_LINEAR_____245_CM "" RAT_FUNC "%6.3" "-" COEFFS 0 16. 0. 0 0 1 /end COMPU_METHOD
/begin COMPU_METHOD _CNV_S_4_STATE_POP__246_CM "" TAB_VERB "%6.3" "[-]" COMPU_TAB_REF _CNV_S_4_STATE_POP__246 /end COMPU_METHOD
/begin COMPU_VTAB _CNV_S_4_STATE_POP__246 "" TAB_VERB 4 0 "NO_POP_COC" 1 "PHASE_1" 2 "PHASE 2" 3 "Ramp down" /end COMPU_VTAB
/begin COMPU_METHOD _CNV_A_R_LINEAR_____247_CM "" RAT_FUNC "%6.3" "l/100km" COEFFS 0 708.3333333333334 0. 0 0 1 /end COMPU_METHOD
/begin COMPU_METHOD _CNV_A_R_LINEAR_____248_CM "" RAT_FUNC "%6.3" "-" COEFFS 0 256. 0. 0 0 1 /end COMPU_METHOD
/begin COMPU_METHOD _CNV_A_R_LINEAR_____249_CM "" RAT_FUNC "%6.3" "ml/s" COEFFS 0 4000. 0. 0 0 1 /end COMPU_METHOD
/begin COMPU_METHOD _CNV_A_R_LINEAR_____250_CM "" RAT_FUNC "%6.3" "[bar]" COEFFS 0 2. 0. 0 0 1 /end COMPU_METHOD
/begin COMPU_METHOD _CNV_A_R_LINEAR_____251_CM "" RAT_FUNC "%6.3" "°C" COEFFS 0 1.333333333333333 64. 0 0 1 /end COMPU_METHOD
/begin COMPU_METHOD _CNV_A_R_LINEAR_____252_CM "" RAT_FUNC "%6.3" "%" COEFFS 0 655.3599999999997 0. 0 0 1 /end COMPU_METHOD
/begin COMPU_METHOD _CNV_A_R_LINEAR_____253_CM "" RAT_FUNC "%6.3" "%" COEFFS 0 327.68 0. 0 0 1 /end COMPU_METHOD
/begin COMPU_METHOD _CNV_A_R_LINEAR_____254_CM "" RAT_FUNC "%6.3" "[C]" COEFFS 0 1.333333333333333 0. 0 0 1 /end COMPU_METHOD
/begin COMPU_METHOD _CNV_A_R_LINEAR_____255_CM "" RAT_FUNC "%6.3" "[C]" COEFFS 0 1.333333333333333 128. 0 0 1 /end COMPU_METHOD
/begin COMPU_METHOD _CNV_A_R_LINEAR_____256_CM "" RAT_FUNC "%6.3" "-" COEFFS 0 255. 0. 0 0 1 /end COMPU_METHOD
/begin COMPU_METHOD _CNV_A_R_LINEAR_____257_CM "" RAT_FUNC "%6.3" "rpm" COEFFS 0 1. 0. 0 0 1 /end COMPU_METHOD
/begin COMPU_METHOD _CNV_A_R_LINEAR_____258_CM "" RAT_FUNC "%6.3" "[-]" COEFFS 0 10. 0. 0 0 1 /end COMPU_METHOD
/begin COMPU_METHOD _CNV_A_R_LINEAR_____264_CM "" RAT_FUNC "%6.3" "[V]" COEFFS 0 10.62059202605951 0. 0 0 1 /end COMPU_METHOD
/begin COMPU_METHOD _CNV_A_R_LINEAR_____288_CM "" RAT_FUNC "%6.3" "[l]" COEFFS 0 16000. 0. 0 0 1 /end COMPU_METHOD
/begin COMPU_METHOD _CNV_A_R_LINEAR_____289_CM "" RAT_FUNC "%6.3" "[ml]" COEFFS 0 4. 0. 0 0 1 /end COMPU_METHOD
/begin COMPU_METHOD _CNV_A_R_LINEAR_____290_CM "" RAT_FUNC "%6.3" "[ms]" COEFFS 0 2. -200. 0 0 1 /end COMPU_METHOD
/begin COMPU_METHOD _CNV_A_R_LINEAR_____291_CM "" RAT_FUNC "%6.3" "[mm]" COEFFS 0 16. 0. 0 0 1 /end COMPU_METHOD
/begin COMPU_METHOD _CNV_A_R_LINEAR_____292_CM "" RAT_FUNC "%6.3" "[ml]" COEFFS 0 6.666666666666667e-002 127. 0 0 1 /end COMPU_METHOD
/begin COMPU_METHOD _CNV_A_R_LINEAR_____293_CM "" RAT_FUNC "%6.3" "-" COEFFS 0 50000000. 0. 0 0 1 /end COMPU_METHOD
/begin COMPU_METHOD _CNV_A_R_LINEAR_____294_CM "" RAT_FUNC "%6.3" "-" COEFFS 0 500000.0000000001 0. 0 0 1 /end COMPU_METHOD
/begin COMPU_METHOD _CNV_A_R_LINEAR_____295_CM "" RAT_FUNC "%6.3" "°C" COEFFS 0 1. 60. 0 0 1 /end COMPU_METHOD
/begin COMPU_METHOD _CNV_A_R_LINEAR_____296_CM "" RAT_FUNC "%6.3" "mm" COEFFS 0 16. 0. 0 0 1 /end COMPU_METHOD
/begin COMPU_METHOD _CNV_A_R_LINEAR_____297_CM "" RAT_FUNC "%6.3" "-" COEFFS 0 20. 0. 0 0 1 /end COMPU_METHOD
/begin COMPU_METHOD _CNV_A_R_LINEAR_____298_CM "" RAT_FUNC "%6.3" "m/s²" COEFFS 0 2560. -256. 0 0 1 /end COMPU_METHOD
/begin COMPU_METHOD _CNV_A_R_LINEAR_____299_CM "" RAT_FUNC "%6.3" "-" COEFFS 0 32. 0. 0 0 1 /end COMPU_METHOD
/begin COMPU_METHOD _CNV_A_R_LINEAR_____300_CM "" RAT_FUNC "%6.3" "-" COEFFS 0 65535.99999999996 0. 0 0 1 /end COMPU_METHOD
/begin COMPU_METHOD _CNV_A_R_LINEAR_____301_CM "" RAT_FUNC "%6.3" "[ms]" COEFFS 0 8. 0. 0 0 1 /end COMPU_METHOD
/begin COMPU_METHOD _CNV_A_R_LINEAR_____302_CM "" RAT_FUNC "%6.3" "l" COEFFS 0 12.8 0. 0 0 1 /end COMPU_METHOD
/begin COMPU_METHOD _CNV_A_R_LINEAR_____303_CM "" RAT_FUNC "%6.3" "ml" COEFFS 0 0.5 0. 0 0 1 /end COMPU_METHOD
/begin COMPU_METHOD _CNV_A_R_LINEAR_____304_CM "" RAT_FUNC "%6.3" "l" COEFFS 0 4000. 0. 0 0 1 /end COMPU_METHOD
/begin COMPU_METHOD _CNV_A_R_LINEAR_____305_CM "" RAT_FUNC "%6.3" "m/s²" COEFFS 0 2560. 32512. 0 0 1 /end COMPU_METHOD
/begin COMPU_METHOD _CNV_A_R_LINEAR_____306_CM "" RAT_FUNC "%6.3" "-" COEFFS 0 50. 0. 0 0 1 /end COMPU_METHOD
/begin COMPU_METHOD _CNV_A_R_LINEAR_____307_CM "" RAT_FUNC "%6.3" "µl" COEFFS 0 1. 0. 0 0 1 /end COMPU_METHOD
/begin COMPU_METHOD _CNV_A_R_LINEAR_____308_CM "" RAT_FUNC "%6.3" "[m]" COEFFS 0 1. 0. 0 0 1 /end COMPU_METHOD
/begin COMPU_METHOD _CNV_A_R_LINEAR_____309_CM "" RAT_FUNC "%6.3" "-" COEFFS 0 100000. 0. 0 0 1 /end COMPU_METHOD
/begin COMPU_METHOD _CNV_A_R_LINEAR_____310_CM "" RAT_FUNC "%6.3" "[km]" COEFFS 0 2.e-003 0. 0 0 1 /end COMPU_METHOD
/begin COMPU_METHOD _CNV_A_R_LINEAR_____311_CM "" RAT_FUNC "%6.3" "µl/100ms" COEFFS 0 1. 0. 0 0 1 /end COMPU_METHOD
/begin COMPU_METHOD _CNV_A_R_LINEAR_____312_CM "" RAT_FUNC "%6.3" "[l/mm]" COEFFS 0 1000. 0. 0 0 1 /end COMPU_METHOD
/begin COMPU_METHOD _CNV_A_R_LINEAR_____313_CM "" RAT_FUNC "%6.3" "ml/s" COEFFS 0 1000. 0. 0 0 1 /end COMPU_METHOD
/begin COMPU_METHOD _CNV_A_R_LINEAR_____344_CM "" RAT_FUNC "%6.3" "[hPa/100ms]" COEFFS 0 12.06017666543982 0. 0 0 1 /end COMPU_METHOD
/begin COMPU_METHOD _CNV_A_R_LINEAR_____345_CM "" RAT_FUNC "%6.3" "[V/10ms]" COEFFS 0 204.8 0. 0 0 1 /end COMPU_METHOD
/begin RECORD_LAYOUT _REC_VAL_20_u1 FNC_VALUES 1 UBYTE COLUMN_DIR DIRECT /end RECORD_LAYOUT
/begin RECORD_LAYOUT _REC_AXS_20_u2 NO_AXIS_PTS_X 1 UWORD AXIS_PTS_X 2 UWORD INDEX_INCR DIRECT /end RECORD_LAYOUT
/begin RECORD_LAYOUT _REC_CUR_20_u1_u2 FNC_VALUES 1 UBYTE COLUMN_DIR DIRECT /end RECORD_LAYOUT
/begin RECORD_LAYOUT _REC_MAP_20_u1_u2_u2 FNC_VALUES 1 UBYTE COLUMN_DIR DIRECT /end RECORD_LAYOUT
/begin RECORD_LAYOUT _REC_MAP_20_u2_u2_u2 FNC_VALUES 1 UWORD COLUMN_DIR DIRECT /end RECORD_LAYOUT
/begin RECORD_LAYOUT _REC_VAL_20_u2 FNC_VALUES 1 UWORD COLUMN_DIR DIRECT /end RECORD_LAYOUT
/begin RECORD_LAYOUT _REC_VAL_20_s2 FNC_VALUES 1 SWORD COLUMN_DIR DIRECT /end RECORD_LAYOUT
/begin RECORD_LAYOUT _REC_AXS_20_u1 NO_AXIS_PTS_X 1 UBYTE AXIS_PTS_X 2 UBYTE INDEX_INCR DIRECT /end RECORD_LAYOUT
/begin RECORD_LAYOUT _REC_MAP_20_u1_u1_u2 FNC_VALUES 1 UBYTE COLUMN_DIR DIRECT /end RECORD_LAYOUT
/begin RECORD_LAYOUT _REC_CUR_20_u2_u2 FNC_VALUES 1 UWORD COLUMN_DIR DIRECT /end RECORD_LAYOUT
/begin RECORD_LAYOUT _REC_CUR_20_u2_u1 FNC_VALUES 1 UWORD COLUMN_DIR DIRECT /end RECORD_LAYOUT
/begin RECORD_LAYOUT _REC_MAP_20_u2_u1_u1 FNC_VALUES 1 UWORD COLUMN_DIR DIRECT /end RECORD_LAYOUT
/begin RECORD_LAYOUT _REC_MAP_20_u2_u2_u1 FNC_VALUES 1 UWORD COLUMN_DIR DIRECT /end RECORD_LAYOUT
/begin RECORD_LAYOUT _REC_CUR_20_u1_u1 FNC_VALUES 1 UBYTE COLUMN_DIR DIRECT /end RECORD_LAYOUT
/begin RECORD_LAYOUT _REC_MAP_20_u2_u1_u2 FNC_VALUES 1 UWORD COLUMN_DIR DIRECT /end RECORD_LAYOUT
/begin RECORD_LAYOUT _REC_MAP_20_u1_u1_u1 FNC_VALUES 1 UBYTE COLUMN_DIR DIRECT /end RECORD_LAYOUT
/begin RECORD_LAYOUT _REC_VAL_20_s1 FNC_VALUES 1 SBYTE COLUMN_DIR DIRECT /end RECORD_LAYOUT
/begin FUNCTION AUX_Electr_Contr_Thermostat ""
 /begin DEF_CHARACTERISTIC c_tco_dif_min_ectpwm_i c_tco_dif_max_ectpwm_i c_ectpwm_i_min c_ectpwm_i_max c_tco_2_max_ectpwm_tol c_ectpwm_sub c_ectpwm_max c_ectpwm_min c_tco_2_max_ectpwm_bol c_ectpwm_sub_st c_ectpwm_sub_pwl c_t_ast_min_ectpwm ldp_tco_dif__ectpwm_i ip_ectpwm_i ldp_tco_dif__ectpwm_bas ldp_tco_sp__ectpwm_bas ip_ectpwm_bas /end DEF_CHARACTERISTIC
 /begin OUT_MEASUREMENT ectpwm ectpwm_bas ectpwm_i ectpwm_raw ectpwm_inter_1 ectpwm_inter_2 /end OUT_MEASUREMENT
/end FUNCTION
/begin FUNCTION AUX_Electr_Cool_Fans ""
 /begin DEF_CHARACTERISTIC lc_cool_req_save_diagcps_ena c_tco_max_cool_req_save_diagcps c_cool_req_ac_save_ofs c_cool_req_ecf_1_lgrd c_cool_req_ecf_2_lgrd ldp_cool_req_tcu_can__cool_req ip_cool_req_tcu c_n_sp_ecf_1_min_tol c_n_sp_ecf_1_min_bol c_n_sp_ecf_2_min_tol c_n_sp_ecf_2_min_bol c_n_sp_ecf_1_min c_n_sp_ecf_2_min c_n_sp_ecf_1_fout_1_bol c_n_sp_ecf_1_fout_1_tol c_n_sp_ecf_1_fout_2_bol c_n_sp_ecf_1_fout_2_tol c_n_sp_ecf_1_fout_3_bol c_n_sp_ecf_1_fout_3_tol c_n_sp_ecf_1_fout_4_bol c_n_sp_ecf_1_fout_4_tol c_n_sp_ecf_1_fout_5_bol c_n_sp_ecf_1_fout_5_tol c_n_sp_ecf_2_fout_1_bol c_n_sp_ecf_2_fout_1_tol c_n_sp_ecf_2_fout_2_bol c_n_sp_ecf_2_fout_2_tol c_n_sp_ecf_2_fout_3_bol c_n_sp_ecf_2_fout_3_tol c_n_sp_ecf_2_fout_4_bol c_n_sp_ecf_2_fout_4_tol c_n_sp_ecf_2_fout_5_bol c_n_sp_ecf_2_fout_5_tol lc_ena_fac_n_sp_ecf_1 lc_ena_fac_n_sp_ecf_2 ldp_cool_req_ecf_1 ldp_cool_req_ecf_2 ldpm_n_32__n_sp_ecf ip_n_sp_ecf_1 ip_n_sp_ecf_2 ldp_vs__n_sp_ecf ip_fac_n_sp_ecf_vs ldp_tam__fac_n_sp_ecf ldp_amp__fac_n_sp_ecf ip_fac_n_sp_ecf_amp lc_ecf_1_dc lc_ecf_2_dc c_tco_max_ecf_hys c_tco_2_max_ecf lc_equip_tco_2 c_ecfpwm_1_tco_max c_ecfpwm_2_tco_max c_t_ecf_ast_act c_ecfpwm_1_st_ast c_ecfpwm_2_st_ast c_ecfpwm_1_lgrd c_ecfpwm_2_lgrd c_t_ecfpwm_pwl_lgrd c_tco_2_max_ecf_hys c_ecfpwm_vecu_lgrd c_ecfpwm_vecu_max c_ecfpwm_deac c_ecfpwm_1_max c_ecfpwm_2_max ldpm_vb_mmv__ecfpwm ip_ecfpwm_1_fac_vb ip_ecfpwm_2_fac_vb ldp_n_sp_ecf_1__ecfpwm ip_ecfpwm_1 ldp_n_sp_ecf_2__ecfpwm ip_ecfpwm_2 ldpm_tco__ecfpwm_pwl ldpm_tam__ecfpwm_pwl ip_ecfpwm_1_pwl ip_ecfpwm_2_pwl ldp_ecfpwm_1__n_rel_ecf_can ldp_ecfpwm_2__n_rel_ecf_can ip_n_rel_ecf_can c_fac_t_pop_phase_2 c_t_pop_coc_max ldp_tco__t_pop_bas ldp_fco_vs__t_pop_bas ldp_tam__t_pop_fac ldp_tco__t_pop_2 ldp_tam__t_pop_2 ldp_tco_stop__tco_sp_pop_stop ldp_tco__t_pop_cor ldp_tam__t_pop_cor ldp_toil__t_pop_toil ip_t_pop_bas ip_t_pop_fac ip_t_pop_2 ip_tco_sp_pop_stop ip_t_pop_cor ip_t_pop_toil ldp_cool_req_ac_ip_cool_ac_clc ip_cool_req_ac_clc ldp_tco__ecfpwm_max ldp_fco_t__ecfpwm_max ip_tco_fco_t_max_ecf c_acp_ecfpwm_max c_tam_ecfpwm_max c_t_hld_ecfpwm_max c_cool_req_ac_ecfpwm_max c_t_ast_tol_pop_coc c_t_ast_bol_pop_coc /end DEF_CHARACTERISTIC
 /begin OUT_MEASUREMENT cool_req_ecf_1 cool_req_ecf_2 cool_req_tot_inter cool_req_tcu cool_req_tot_inter_save lv_cool_req_save_diagcps cool_req_ecf_clc cool_req_ac_save n_sp_ecf_1 n_sp_ecf_2 lv_n_sp_ecf_1_hys lv_n_sp_ecf_2_hys n_sp_ecf_1_raw n_sp_ecf_2_raw n_sp_ecf_1_inter_1 n_sp_ecf_2_inter_1 n_sp_ecf_1_inter_2 n_sp_ecf_2_inter_2 lv_n_sp_ecf_1_fout lv_n_sp_ecf_2_fout fac_n_sp_ecf_1 fac_n_sp_ecf_2 ecfpwm_1 ecfpwm_2 ecfpwm_1_raw ecfpwm_2_raw lv_ecfpwm_tco_max lv_ecfpwm_tco_2_max lv_ecfpwm_max ecfpwm_1_inter_1 ecfpwm_2_inter_1 n_rel_ecf_can ecfpwm_1_inter_4_lgrd ecfpwm_2_inter_4_lgrd ecfpwm_sub_vecu ecfpwm_1_inter_4 ecfpwm_2_inter_4 t_pop_coc t_pop_bas t_pop_bas_cor t_pop_cor t_pop_toil tco_sp_pop_stop t_pop_2 state_pop_coc t_pop_coc_end cool_req_ac_clc t_hld_ecfpwm_max t_pop_coc_inter_1 t_pop_coc_inter_2 /end OUT_MEASUREMENT
/end FUNCTION
/begin FUNCTION AUX_Eng_Cool_Control ""
 /begin DEF_CHARACTERISTIC c_cool_req_eng_inter_sub c_cool_req_eng_min c_cool_req_eng_max lc_tco_2_sp_mdl_ena c_crlc_tco_2_sp_inc c_crlc_tco_2_sp_dec lc_inp_tco_sp c_ectpwm_1_tco_2_sp_add c_ectpwm_2_tco_2_sp_add c_tco_dif_1_tco_2_sp_add c_tco_dif_2_tco_2_sp_add c_t_dly_1_tco_2_sp_add c_t_dly_2_tco_2_sp_add c_tco_2_sp_sub c_tco_2_sub_cool_req c_vs_cool_req_sub c_tco_2_dif_hys ldp_tco__cool_req_eng_tco ldp_tam__cool_req_eng_tco ip_cool_req_eng_tco ldp_tco_dif__cool_req_eng_dyn ldp_tco_1_2__cool_req_eng_dyn ip_cool_req_eng_dyn ldp_cool_req_eng_inter__cool_req_eng_cor ldp_vs_cool_req__cool_req_eng_cor ip_cool_req_eng_cor ldp_n__tco_2_sp_1 ldp_tqi_req_slow__tco_2_sp_1 ip_tco_2_sp_1 ldp_tco_inp__tco_2_sp_3 ldp_tco_2_sp_mmv__tco_2_sp_3 ip_tco_2_sp_3 ldp_tco__tco_2_sp_2 ldp_tam__tco_2_sp_2 ip_tco_2_sp_2 ldp_n__fac_tco_2_sp_cor ip_fac_tco_2_sp_cor ldp_tco_dif__tco_2_sp_cor_2 ldp_tco_1_2__tco_2_sp_cor_2 ip_tco_2_sp_cor_2 ldp_vs_cool_req__cool_req_eng_bas ldp_tco_2_dif__cool_req_eng_bas ip_cool_req_eng_bas ldp_tco_2_dif__cool_req_eng_i ip_cool_req_eng_i c_acp_cool_req_hys c_acp_sub_cool_req_ac c_acp_cool_req_inc c_acp_cool_req_dec ldp_ecf_req_ac_can__cool_req ip_cool_req_ac_can ldpm_acp_cor__cool_req_acp ip_cool_req_ac_acp_act ip_cool_req_ac_acp_deac ldp_vs__fac_cool_req_ac_vs ip_fac_cool_req_ac_vs /end DEF_CHARACTERISTIC
 /begin OUT_MEASUREMENT cool_req_eng cool_req_eng_inter cool_req_eng_dyn cool_req_eng_tco cool_req_eng_clc t_dly_1_tco_2_sp_add t_dly_2_tco_2_sp_add tco_2_sp_1 tco_2_sp_2 tco_2_sp_3 tco_2_sp_4 tco_2_sp_5 tco_2_sp_6 tco_2_sp_cor_2 tco_2_sp tco_2_dif tco_2_sp_mmv vs_cool_req cool_req_eng_bas cool_req_eng_cor cool_req_ac acp_cor cool_req_ac_acp cool_req_ac_can cool_req_ac_inter tco_inp /end OUT_MEASUREMENT
/end FUNCTION
/begin FUNCTION AUX_Calc_Lubric_Maint_Interv ""
 /begin DEF_CHARACTERISTIC c_t_oil_level_min c_t_oil_level_max ldp_t_oil_level1_can ip_oil_level_t_cool_wiv c_oil_level_ctr_sub c_oil_level_dif_mv_sho_sub c_toil_max_fac_chrg c_fac_chrg c_fac_level_estim_wiv_cor lc_ac_trv_wiv_fil_use c_fac_ac_trv_wiv c_fac_n_wiv lc_toil_wiv_sub_use lc_fac_qly_wiv_sub_use c_n_max_oil_level c_n_min_oil_level c_toil_max_oil_level c_toil_min_oil_level c_toil_wiv_err c_toil_wiv_nvld c_toil_wiv_sub c_toil_wiv_ini c_t_toil_max c_t_toil_min c_fco_cyl_max ldp_t_oil_can ldp_n_wiv ldpm_toil_wiv_clc ldp_ac_trv_tcs2 ldp_n_wiv_oil_level_cor_wiv ldp_toil_wiv_temp2 id_fac_fco_estim_wiv ip_fac_qly_wiv ip_toil_wiv_temp ip_oil_level_cor_wiv c_t_fout_oil_sens_caut c_t_fout_oil_level_dif_mv_sho c_fac_soot_wiv c_fac_wear_wiv c_fac_equ_wiv ldp_fco_dif ip_soot_equ ldp_n_wiv__ip_wear_equ ldp_toil_wiv_clc ip_wear_equ ldp_n_wiv__ip_soot_equ c_oil_slop_level /end DEF_CHARACTERISTIC
 /begin OUT_MEASUREMENT lv_oil_level1_nplaus lv_oil_level2_nplaus lv_oil_level3_nplaus lv_oil_level4_nplaus lv_oil_level4_chk lv_oil_level1_chk lv_oil_level2_chk lv_oil_level3_chk oil_level2_vol oil_level3_vol oil_level4_vol oil_level_sum_cor oil_level_ctr oil_level_dif_mv_sho lv_oil_warn lv_oil_sens_warn lv_emsf_state_2 lv_fcn_clc_4400 lv_fcn_clc_2400 ctr_fcn_clc_4400 ctr_fcn_clc_2400 wear_fco_equ lv_emsf_state_1_tmp fac_oil_wiv toil_wiv lv_emsf_state_1 lv_oil_level_not_vld oil_level_cor_wiv fac_qly_wiv_cor fac_level_estim_wiv ac_trv_wiv_fil toil_wiv_clc toil_wiv_raw ctr_oil_level_sum_cor ctr_oil_level_sum oil_level_sum oil_level_vol_sum n_wiv lv_toil_wiv_nplaus_tmp fac_qly_wiv fac_fco_estim_wiv oil_level1_vol oil_level1 oil_level2 oil_level4 oil_level3 fco_dif_wiv soot_equ lv_emsf_state_1_ds soot_wiv_value soot_equ_ds wear_equ_ds oil_level_ctr_tmp oil_level_dif_mv_sho_tmp wear_wiv_value lv_emsf_state_1_gs wear_fco_equ_gs lv_err_t_toil_can /end OUT_MEASUREMENT
/end FUNCTION
/begin FUNCTION AUX_Calc_Lubric_Maint_Interv__AI "" /begin OUT_MEASUREMENT fco_dif lv_tog1_can_nvld lv_tcs2_can_nvld /end OUT_MEASUREMENT /end FUNCTION
/begin FUNCTION AUX_ECU_Power_Latch_Manag__AI "" /begin DEF_CHARACTERISTIC c_t_pwl_max_stb /end DEF_CHARACTERISTIC /end FUNCTION
/begin FUNCTION AUX_Fuel_Consumption_Calc "Fuel consumption calculation for VAG-Tester and CAN" /begin DEF_CHARACTERISTIC c_fco_stnd c_crlc_fco_vs c_t_fco_t_clc /end DEF_CHARACTERISTIC /begin OUT_MEASUREMENT fco_sum_can fco_vs lv_fco_sum_ovfl fco_sum fco_t fco_t_raw /end OUT_MEASUREMENT /end FUNCTION
/begin FUNCTION C_A_DIA ""
 /begin SUB_FUNCTION DIA_CAN_Diag DIA_Variant_Coding_Diag DIA_TOIL_Oil_Sensor_Diag /end SUB_FUNCTION
/end FUNCTION
/begin FUNCTION DIA_CAN_Diag "CAN_Diag"
 /begin DEF_CHARACTERISTIC c_abc_inc_can_boff c_abc_max_can_boff c_abc_inc_can_tcs c_abc_inc_can_tcu c_abc_max_can_tcu c_abc_max_can_ccu c_abc_inc_can_icl c_abc_max_can_icl c_abc_inc_can_vecu c_abc_max_can_vecu c_abc_inc_can_smls c_abc_max_can_smls c_abc_inc_can_bem c_abc_max_can_bem c_abc_inc_can_if_cft c_abc_max_can_if_cft c_abc_inc_can_acu c_abc_max_can_tcs c_abc_max_can_tot c_abc_inc_can_tot c_abc_inc_can_ccu c_abc_max_can_acu c_abc_max_can_dcc c_abc_max_can_eilu c_abc_inc_can_dcc c_abc_inc_can_eilu /end DEF_CHARACTERISTIC
 /begin OUT_MEASUREMENT lv_err_can_boff lv_err_can_tcs lv_ack_tcs lv_err_can_tcu lv_err_can_smls lv_err_can_if_cft tout_ctr_if_cft_1 tout_ctr_icl2 tout_ctr_icl3 tout_ctr_icl1 tout_ctr_tcs2 tout_ctr_tcs8 tout_ctr_tcs1 tout_ctr_tcu1 tout_ctr_bem tout_ctr_cru tout_ctr_vecu1 tout_ctr_tog1 tout_ctr_acu1 dly_diag_can_10ms max_hld_tcs max_hld_tcs_av max_hld_tcu max_hld_tcu_av max_hld_acu max_hld_acu_av max_hld_ccu_av max_hld_icl max_hld_icl_av max_hld_vecu max_hld_vecu_av max_hld_smls max_hld_smls_av max_hld_bem max_hld_bem_av max_hld_if_cft max_hld_if_cft_av lv_err_can_bem lv_err_can_bem_all lv_err_can_vecu lv_err_can_vecu_all ctr_boff_diag can_status t_can_boff_dly lv_fmy_can_boff lv_can_boff_first lv_can_boff_next tmp_can_cod tmp_can_diag lv_err_can_ccu lv_err_can_tot lv_err_can_acu lv_err_can_stop lv_err_can_icl lv_err_can_dcc tout_ctr_ccu1 tout_ctr_eilu1 max_hld_ccu tout_ctr_whl tout_ctr_tcu2 tout_ctr_sys_info tout_ctr_nom_sys tout_ctr_tcs4 tout_ctr_tcs3 /end OUT_MEASUREMENT
/end FUNCTION
/begin FUNCTION DIA_Variant_Coding_Diag "Variant_Coding_Diag" /begin DEF_CHARACTERISTIC c_abc_inc_varcod c_abc_max_varcod c_varcod_diag_di /end DEF_CHARACTERISTIC /begin OUT_MEASUREMENT lv_err_varcod /end OUT_MEASUREMENT /end FUNCTION
/begin FUNCTION DIA_TOIL_Oil_Sensor_Diag "Oil Temperature (Sensor/Modell)"
 /begin DEF_CHARACTERISTIC c_tco_max_toil_diag c_abc_inc_toil_el c_abc_inc_toil_plaus c_abc_max_toil_el c_abc_max_toil_plaus c_tco_min_toil_plaus_diag c_tco_min_toil_diag c_tco_max_toil_plaus_diag c_toil_min_plaus_diag c_toil_max_plaus_diag c_t_tco_toil_diag c_t_toil_plaus_diag /end DEF_CHARACTERISTIC
 /begin OUT_MEASUREMENT lv_err_toil lv_err_toil_sens /end OUT_MEASUREMENT
/end FUNCTION
/begin FUNCTION C_A_DIAG ""
 /begin SUB_FUNCTION DIAG_MON DIAG_ABPACAD_0 DIAG_ABYPCAD_0 DIAG_AEGRVCAD_0 DIAG_ATHRCAD_0 DIAG_ACSDIAG DIAG_ABRAKE_D DIAG_AMAPCTLD_0 DIAG_AMAPDIAG DIAG_AMAFDIAG_0 DIAG_AAC_DIAG DIAG_ATIADIAG DIAG_ADCDCDGO DIAG_ATCODIAG1 DIAG_ATCODIAG2 DIAG_AEGRBYPD DIAG_EGRV_CTL_AD_0 DIAG_ATMPDI_D DIAG_AAMPDIAG DIAG_AVEGRVDG DIAG_ACAPDIAG_0 DIAG_AEFPDIAG DIAG_ARLYDIAG DIAG_MAF_0 DIAG_MAF_PLAD DIAG_AEGRCTLD_0 DIAG_ALTER DIAG_AALTDIAG DIAG_AAC_INPDIAG DIAG_ACP DIAG_ZZZ DIAG_AINJDIAG DIAG_AINJDIAG_I DIAG_AVB DIAG_ASPIDIAG DIAG_AEGRVDHB /end SUB_FUNCTION
/end FUNCTION
/begin FUNCTION DIAG_MON "Monitoring level 3 diagnosis" /begin DEF_CHARACTERISTIC c_abc_inc_mon_3 c_abc_max_mon_3 /end DEF_CHARACTERISTIC /end FUNCTION
/begin FUNCTION DIAG_ABPACAD_0 ""
 /begin DEF_CHARACTERISTIC c_abc_inc_bpa_0_ctl c_abc_max_bpa_0_ctl c_abc_inc_v_bpa_0_bol_ad c_abc_max_v_bpa_0_bol_ad c_ctl_dif_bpa_0_min_diag c_ctl_dif_bpa_0_max_diag c_ctr_eve_bpa_0_ctl c_ctr_bas_bpa_0_ctl c_t_dly_diag_bpa_ctl /end DEF_CHARACTERISTIC
 /begin OUT_MEASUREMENT ctr_bas_bpa_0_ctl ctr_eve_bpa_0_ctl t_dly_diag_bpa_ctl_0 /end OUT_MEASUREMENT
/end FUNCTION
/begin FUNCTION DIAG_ABYPCAD_0 ""
 /begin DEF_CHARACTERISTIC c_abc_inc_byp_0_ctl c_abc_max_byp_0_ctl c_abc_inc_v_byp_0_bol_ad c_abc_max_v_byp_0_bol_ad c_ctl_dif_byp_0_min_diag c_ctl_dif_byp_0_max_diag c_ctr_eve_byp_0_ctl c_ctr_bas_byp_0_ctl /end DEF_CHARACTERISTIC
 /begin OUT_MEASUREMENT ctr_bas_byp_0_ctl ctr_eve_byp_0_ctl /end OUT_MEASUREMENT
/end FUNCTION
/begin FUNCTION DIAG_AEGRVCAD_0 ""
 /begin DEF_CHARACTERISTIC c_abc_inc_egrv_0_ctl c_abc_max_egrv_0_ctl c_abc_inc_v_egrv_0_bol_ad c_abc_max_v_egrv_0_bol_ad c_ctl_dif_egrv_0_min_diag c_ctl_dif_egrv_0_max_diag c_ctr_eve_egrv_0_ctl c_ctr_bas_egrv_0_ctl c_t_dly_diag_egrv_ctl /end DEF_CHARACTERISTIC
 /begin OUT_MEASUREMENT ctr_bas_egrv_0_ctl ctr_eve_egrv_0_ctl t_dly_diag_egrv_ctl_0 /end OUT_MEASUREMENT
/end FUNCTION
/begin FUNCTION DIAG_ATHRCAD_0 ""
 /begin DEF_CHARACTERISTIC c_abc_inc_thr_0_ctl c_abc_max_thr_0_ctl c_abc_inc_v_thr_0_bol_ad c_abc_max_v_thr_0_bol_ad c_ctl_dif_thr_0_min_diag c_ctl_dif_thr_0_max_diag c_ctr_eve_thr_0_ctl c_ctr_bas_thr_0_ctl c_t_dly_diag_thr_ctl /end DEF_CHARACTERISTIC
 /begin OUT_MEASUREMENT ctr_bas_thr_0_ctl ctr_eve_thr_0_ctl t_dly_diag_thr_ctl_0 /end OUT_MEASUREMENT
/end FUNCTION
/begin FUNCTION DIAG_ACSDIAG ""
 /begin DEF_CHARACTERISTIC c_abc_inc_cs c_abc_max_cs c_vs_cs_plaus_2_diag c_ctr_max_cs_plaus_1 c_ctr_max_cs_plaus_2 lc_act_plaus_1_diag c_vs_cs_plaus_1_diag /end DEF_CHARACTERISTIC
 /begin OUT_MEASUREMENT ctr_cs_plaus_1 ctr_cs_plaus_2 lv_cs_chg_1 lv_cs_chg_2 /end OUT_MEASUREMENT
/end FUNCTION
/begin FUNCTION DIAG_ABRAKE_D ""
 /begin DEF_CHARACTERISTIC c_abc_inc_bls c_abc_max_bls c_abc_inc_bls_bts_dece c_abc_max_bls_bts_dece c_abc_inc_bls_bts_plaus c_abc_max_bls_bts_plaus c_vs_ac_bls_bts_diag c_dri_bls_bts_diag lc_bls_bts_plaus_conf c_t_max_1_bls_bts_plaus c_t_max_2_bls_bts_plaus /end DEF_CHARACTERISTIC
 /begin OUT_MEASUREMENT lv_err_bls_bts t_bls_bts_plaus /end OUT_MEASUREMENT
/end FUNCTION
/begin FUNCTION DIAG_AMAPCTLD_0 ""
 /begin DEF_CHARACTERISTIC c_abc_inc_map_ctl_min c_abc_max_map_ctl_min c_abc_inc_map_ctl_max c_abc_max_map_ctl_max c_map_dif_min_diag c_map_dif_max_diag c_n_min_map_ctl_diag c_tqi_sp_min_map_ctl_diag ip_ctr_max_map_ctl_min__n ip_ctr_max_map_ctl_max__n ldpm_n__ip_ctr_max_map_ctl_diag /end DEF_CHARACTERISTIC
 /begin OUT_MEASUREMENT ctr_map_ctl_min ctr_map_ctl_max /end OUT_MEASUREMENT
/end FUNCTION
/begin FUNCTION DIAG_AMAPDIAG ""
 /begin DEF_CHARACTERISTIC c_abc_inc_v_map_rng c_abc_max_v_map_rng c_abc_inc_map_amp_ofs c_abc_max_map_amp_ofs c_abc_inc_map_is_ofs c_abc_max_map_is_ofs c_v_map_min_diag c_v_map_max_diag c_map_amp_ofs_min_diag c_map_is_ofs_max_diag c_map_amp_ofs_max_diag c_map_is_ofs_min_diag ldp_amp_ip_fac_map_is_ofs_diag ip_fac_map_is_ofs_diag__amp c_ctr_map_is_ofs_diag c_abc_inc_map_mes_grd c_abc_max_map_mes_grd c_map_mes_grd_diag c_tco_map_amp_ofs_diag /end DEF_CHARACTERISTIC
 /begin OUT_MEASUREMENT lv_err_map_mes ctr_map_is_ofs lv_err_vcc_map lv_inh_map_amp_ofs lv_inh_map_is_ofs /end OUT_MEASUREMENT
/end FUNCTION
/begin FUNCTION DIAG_AMAFDIAG_0 "" /begin DEF_CHARACTERISTIC c_vb_min_maf_diag /end DEF_CHARACTERISTIC /begin OUT_MEASUREMENT lv_err_maf_0_mes lv_err_maf_mes /end OUT_MEASUREMENT /end FUNCTION
/begin FUNCTION DIAG_AAC_DIAG "" /begin DEF_CHARACTERISTIC c_acp_mes_max_diag c_acp_mes_min_diag c_acp_mes_grd_diag /end DEF_CHARACTERISTIC /end FUNCTION
/begin FUNCTION DIAG_ATIADIAG "" /begin OUT_MEASUREMENT lv_err_tia /end OUT_MEASUREMENT /end FUNCTION
/begin FUNCTION DIAG_ADCDCDGO ""
 /begin DEF_CHARACTERISTIC c_abc_inc_v_dcdc_rng c_abc_max_v_dcdc_rng c_t_dcdc_diag c_v_dcdc_min_diag c_v_dcdc_max_diag /end DEF_CHARACTERISTIC
 /begin OUT_MEASUREMENT t_dcdc_diag /end OUT_MEASUREMENT
/end FUNCTION
/begin FUNCTION DIAG_ATCODIAG1 ""
 /begin DEF_CHARACTERISTIC c_abc_inc_v_tco_1_rng c_abc_max_v_tco_1_rng c_abc_inc_tco_1_mes_grd c_abc_max_tco_1_mes_grd c_abc_inc_tco_mes_plaus c_abc_max_tco_mes_plaus c_v_tco_max_diag c_v_tco_min_diag c_tfu_min_tco_diag /end DEF_CHARACTERISTIC
 /begin OUT_MEASUREMENT lv_err_tco_mes lv_err_tco_1_mes lv_rst_diag_tco_mes_plaus tco_mes_st_diag ctr_inh_temp_diag /end OUT_MEASUREMENT
/end FUNCTION
/begin FUNCTION DIAG_ATCODIAG2 ""
 /begin DEF_CHARACTERISTIC c_abc_inc_v_tco_2_rng c_abc_max_v_tco_2_rng c_abc_inc_tco_2_mes_grd c_abc_max_tco_2_mes_grd /end DEF_CHARACTERISTIC
 /begin OUT_MEASUREMENT lv_err_tco_2_mes /end OUT_MEASUREMENT
/end FUNCTION
/begin FUNCTION DIAG_AEGRBYPD "EGR Bypass Valve Diagnostics" /begin DEF_CHARACTERISTIC c_abc_inc_egr_byp_dps c_abc_max_egr_byp_dps /end DEF_CHARACTERISTIC
 /begin OUT_MEASUREMENT err_sym_mem_egr_byp_dps lv_err_egr_byp lv_scg_egr_byp lv_scg_vld_egr_byp lv_scb_egr_byp lv_scb_vld_egr_byp lv_ol_egr_byp lv_ol_vld_egr_byp /end OUT_MEASUREMENT
/end FUNCTION
/begin FUNCTION DIAG_EGRV_CTL_AD_0 "" /end FUNCTION
/begin FUNCTION DIAG_ATMPDI_D "" /begin DEF_CHARACTERISTIC c_amp_cdn_obd c_tam_st_cdn_obd c_ftl_cdn_obd /end DEF_CHARACTERISTIC
 /begin OUT_MEASUREMENT lv_cdn_amp_obd lv_cdn_tam_st_obd lv_cdn_ftl_obd lv_cdn_pf_obd /end OUT_MEASUREMENT
/end FUNCTION
/begin FUNCTION DIAG_AAMPDIAG ""
 /begin DEF_CHARACTERISTIC c_abc_inc_v_amp_rng c_abc_max_v_amp_rng c_abc_inc_amp_mes_grd c_abc_max_amp_mes_grd c_v_amp_min_diag c_v_amp_max_diag c_amp_mes_grd_diag /end DEF_CHARACTERISTIC
 /begin OUT_MEASUREMENT lv_err_amp_mes /end OUT_MEASUREMENT
/end FUNCTION
/begin FUNCTION DIAG_AVEGRVDG ""
 /begin DEF_CHARACTERISTIC c_abc_inc_v_egrv_0_rng c_abc_max_v_egrv_0_rng c_abc_inc_v_egrv_0_grd c_abc_max_v_egrv_0_grd c_v_egrv_mes_max_diag c_v_egrv_mes_min_diag c_v_egrv_mes_grd_diag /end DEF_CHARACTERISTIC
 /begin OUT_MEASUREMENT lv_err_vcc_v_egrv_0 lv_err_v_egrv_0_mes /end OUT_MEASUREMENT
/end FUNCTION
/begin FUNCTION DIAG_ACAPDIAG_0 ""
 /begin DEF_CHARACTERISTIC c_abc_inc_ges_maf_0_max c_abc_max_ges_maf_0_max ldp_n__ip_maf_kgh_ges_maf_max ip_maf_kgh_ges_maf_max__n c_n_ges_maf_max_diag /end DEF_CHARACTERISTIC
/end FUNCTION
/begin FUNCTION DIAG_AEFPDIAG ""
 /begin DEF_CHARACTERISTIC c_abc_inc_efp_rly_dps c_abc_max_efp_rly_dps c_abc_inc_efp_rly_plaus_1 c_abc_max_efp_rly_plaus_1 c_abc_inc_efp_rly_plaus_2 c_abc_max_efp_rly_plaus_2 c_ctr_max_efp_rly_plaus_1_dly c_ctr_max_efp_rly_plaus_2_dly /end DEF_CHARACTERISTIC
 /begin OUT_MEASUREMENT err_sym_mem_efp_rly_dps ctr_efp_rly_plaus_1_dly ctr_efp_rly_plaus_2_dly lv_scg_efp_rly lv_scg_vld_efp_rly lv_scb_efp_rly lv_scb_vld_efp_rly lv_ol_efp_rly lv_ol_vld_efp_rly lv_efp_rly_diag /end OUT_MEASUREMENT
/end FUNCTION
/end MODULE
/end PROJECT
