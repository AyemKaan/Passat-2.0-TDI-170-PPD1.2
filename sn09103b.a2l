ASAP2_VERSION 1 41
/begin PROJECT SN0 "SIMOS PPD"
/begin HEADER "_default_HeaderComment" PROJECT_NO PRJ_NUM /end HEADER
/begin MODULE _default_ModuleName "_default_ModuleLongIdentifier"
/begin MOD_COMMON "_default_ModCommonComment" DEPOSIT ABSOLUTE BYTE_ORDER MSB_FIRST ALIGNMENT_BYTE 1 ALIGNMENT_WORD 2 ALIGNMENT_LONG 4 ALIGNMENT_FLOAT32_IEEE 4 ALIGNMENT_FLOAT64_IEEE 8 /end MOD_COMMON
/begin AXIS_PTS ldpm_fup_tra_dif_1_inj "" 0x843490 fup_tra_dif _REC_AXS_20_u2 199.9969482 _CNV_A_R_LINEAR_____119_CM 8 -100. 99.99694820000001 FORMAT "%7.3" /end AXIS_PTS
/begin MEASUREMENT soi_post1 "" UWORD _CNV_A_R_LINEAR_____120_CM 1 0. -120. 240. DISPLAY_IDENTIFIER SOI_POST1 ECU_ADDRESS 0x7f9fb2 BYTE_ORDER MSB_LAST FORMAT "%6.2" /end MEASUREMENT
/begin MEASUREMENT soi_post1_dif "" UWORD _CNV_A_R_LINEAR_____121_CM 1 0. 0. 360. DISPLAY_IDENTIFIER SOI_POST1_DIF ECU_ADDRESS 0x7f9fa8 BYTE_ORDER MSB_LAST FORMAT "%5.2" /end MEASUREMENT
/begin MEASUREMENT soi_post1_bas "" UWORD _CNV_A_R_LINEAR_____120_CM 1 0. -120. 240. DISPLAY_IDENTIFIER SOI_POST1_BAS ECU_ADDRESS 0x7f9fbe BYTE_ORDER MSB_LAST FORMAT "%6.2" /end MEASUREMENT
/begin MEASUREMENT soi_main2 "" UWORD _CNV_A_R_LINEAR_____120_CM 1 0. -120. 240. DISPLAY_IDENTIFIER SOI_MAIN2 ECU_ADDRESS 0x7f9fae BYTE_ORDER MSB_LAST FORMAT "%6.2" /end MEASUREMENT
/begin MEASUREMENT soi_prev1 "" UWORD _CNV_A_R_LINEAR_____120_CM 1 0. -120. 240. DISPLAY_IDENTIFIER SOI_PREV1 ECU_ADDRESS 0x7f9faa BYTE_ORDER MSB_LAST FORMAT "%6.2" /end MEASUREMENT
/begin MEASUREMENT soi_prev2 "" UWORD _CNV_A_R_LINEAR_____120_CM 1 0. -120. 240. DISPLAY_IDENTIFIER SOI_PREV2 ECU_ADDRESS 0x7f9fac BYTE_ORDER MSB_LAST FORMAT "%6.2" /end MEASUREMENT
/begin MEASUREMENT soi_post2 "" UWORD _CNV_A_R_LINEAR_____120_CM 1 0. -120. 240. DISPLAY_IDENTIFIER SOI_POST2 ECU_ADDRESS 0x7f9fb4 BYTE_ORDER MSB_LAST FORMAT "%6.2" /end MEASUREMENT
/begin MEASUREMENT soi_prev1_dif "" UWORD _CNV_A_R_LINEAR_____121_CM 1 0. 0. 360. DISPLAY_IDENTIFIER SOI_PREV1_DIF ECU_ADDRESS 0x7f9fa2 BYTE_ORDER MSB_LAST FORMAT "%5.2" /end MEASUREMENT
/begin MEASUREMENT soi_prev2_dif "" UWORD _CNV_A_R_LINEAR_____121_CM 1 0. 0. 360. DISPLAY_IDENTIFIER SOI_PREV2_DIF ECU_ADDRESS 0x7f9fa4 BYTE_ORDER MSB_LAST FORMAT "%5.2" /end MEASUREMENT
/begin MEASUREMENT soi_main1 "" UWORD _CNV_A_R_LINEAR_____120_CM 1 0. -120. 240. DISPLAY_IDENTIFIER SOI_MAIN1 ECU_ADDRESS 0x7f9fb0 BYTE_ORDER MSB_LAST FORMAT "%6.2" /end MEASUREMENT
/begin MEASUREMENT soi_main2_dif "" UWORD _CNV_A_R_LINEAR_____121_CM 1 0. 0. 360. DISPLAY_IDENTIFIER SOI_MAIN2_DIF ECU_ADDRESS 0x7f9fa6 BYTE_ORDER MSB_LAST FORMAT "%5.2" /end MEASUREMENT
/begin MEASUREMENT soi_main1_bas "" UWORD _CNV_A_R_LINEAR_____120_CM 1 0. -120. 240. DISPLAY_IDENTIFIER SOI_MAIN1_BAS ECU_ADDRESS 0x7f9fb6 BYTE_ORDER MSB_LAST FORMAT "%6.2" /end MEASUREMENT
/begin MEASUREMENT soi_main2_bas "" UWORD _CNV_A_R_LINEAR_____120_CM 1 0. -120. 240. DISPLAY_IDENTIFIER SOI_MAIN2_BAS ECU_ADDRESS 0x7f9fb8 BYTE_ORDER MSB_LAST FORMAT "%6.2" /end MEASUREMENT
/begin MEASUREMENT soi_post2_bas "" UWORD _CNV_A_R_LINEAR_____120_CM 1 0. -120. 240. DISPLAY_IDENTIFIER SOI_POST2_BAS ECU_ADDRESS 0x7f9fc0 BYTE_ORDER MSB_LAST FORMAT "%6.2" /end MEASUREMENT
/begin MEASUREMENT soi_prev2_bas "" UWORD _CNV_A_R_LINEAR_____120_CM 1 0. -120. 240. DISPLAY_IDENTIFIER SOI_PREV2_BAS ECU_ADDRESS 0x7f9fbc BYTE_ORDER MSB_LAST FORMAT "%4.1" /end MEASUREMENT
/begin MEASUREMENT soi_prev1_bas "" UWORD _CNV_A_R_LINEAR_____120_CM 1 0. -120. 240. DISPLAY_IDENTIFIER SOI_PREV1_BAS ECU_ADDRESS 0x7f9fba BYTE_ORDER MSB_LAST FORMAT "%4.1" /end MEASUREMENT
/begin AXIS_PTS ldpm_amp_2_inj "fuel mass AMP-correction factor of PREV1, PREV2, MAIN2 & POST1 at ST" 0x843404 amp _REC_AXS_20_u2 5434. _CNV_A_R_LINEAR_____21_CM 4 0. 5434. FORMAT "%6.2" /end AXIS_PTS
/begin AXIS_PTS ldpm_n_3_inj "start fuel mass of injection PREV1, PREV2, MAIN2 & POST1" 0x8438c8 n _REC_AXS_20_u2 6375. _CNV_A_R_LINEAR_____5_CM 7 0. 6375. FORMAT "%4.0" /end AXIS_PTS
/begin AXIS_PTS ldpm_tco_2_inj "start fuel mass of injection PREV1, PREV2, MAIN2 & POST1" 0x843e85 tco _REC_AXS_20_u1 255. _CNV_A_R_LINEAR_____18_CM 12 -50. 205. FORMAT "%3.0" /end AXIS_PTS
/begin AXIS_PTS ldpm_n_4_inj "amp correction of fuel mass of injection PREV1, PREV2, MAIN2 & POST1 at ST" 0x8438d8 n _REC_AXS_20_u2 6375. _CNV_A_R_LINEAR_____5_CM 4 0. 6375. FORMAT "%4.0" /end AXIS_PTS
/begin AXIS_PTS ldpm_tco_3_inj "amp correction of fuel mass of injection PREV1, PREV2, MAIN2 & POST1 at ST" 0x843e92 tco _REC_AXS_20_u1 255. _CNV_A_R_LINEAR_____18_CM 6 -50. 205. FORMAT "%3.0" /end AXIS_PTS
/begin MEASUREMENT ki_pi_is "integral amplification of PI-controller" UWORD _CNV_A_R_LINEAR_____265_CM 1 0. 0. 1310.4 DISPLAY_IDENTIFIER KI_PI_IS ECU_ADDRESS 0x7f9c22 BYTE_ORDER MSB_LAST FORMAT "%6.2" /end MEASUREMENT
/begin MEASUREMENT kp_pi_is "amplification PI-controller" UWORD _CNV_A_R_LINEAR_____266_CM 1 0. 0. 65.52 DISPLAY_IDENTIFIER KP_PI_IS ECU_ADDRESS 0x7f9c24 BYTE_ORDER MSB_LAST FORMAT "%5.3" /end MEASUREMENT
/begin CHARACTERISTIC c_gain_n_dif_pos_ki "gain for positive control difference" VALUE 0x848478 _REC_VAL_20_u2 16. _CNV_A_R_LINEAR_____267_CM 0. 16. DISPLAY_IDENTIFIER C_GAIN_N_DIF_POS_KI FORMAT "%4.2" /end CHARACTERISTIC
/begin CHARACTERISTIC c_gain_n_dif_neg_ki "gain for negative control difference" VALUE 0x848474 _REC_VAL_20_u2 16. _CNV_A_R_LINEAR_____267_CM 0. 16. DISPLAY_IDENTIFIER C_GAIN_N_DIF_NEG_KI FORMAT "%4.2" /end CHARACTERISTIC
/begin CHARACTERISTIC c_gain_n_dif_pos_kp "gain for positive control difference" VALUE 0x84847a _REC_VAL_20_u2 16. _CNV_A_R_LINEAR_____159_CM 0. 16. DISPLAY_IDENTIFIER C_GAIN_N_DIF_POS_KP FORMAT "%5.3" /end CHARACTERISTIC
/begin CHARACTERISTIC c_gain_n_dif_neg_kp "gain for negative control difference" VALUE 0x848476 _REC_VAL_20_u2 16. _CNV_A_R_LINEAR_____159_CM 0. 16. DISPLAY_IDENTIFIER C_GAIN_N_DIF_NEG_KP FORMAT "%5.3" /end CHARACTERISTIC
/begin CHARACTERISTIC c_n_dif_thd_pos_kp "center point of linear area for positive control difference" VALUE 0x8484d6 _REC_VAL_20_s2 1023. _CNV_A_R_LINEAR_____5_CM -512. 511. DISPLAY_IDENTIFIER C_N_DIF_THD_POS_KP FORMAT "%3.0" /end CHARACTERISTIC
/begin CHARACTERISTIC c_n_dif_thd_neg_kp "center point of linear area for negative control difference" VALUE 0x8484d2 _REC_VAL_20_s2 1023. _CNV_A_R_LINEAR_____5_CM -512. 511. DISPLAY_IDENTIFIER C_N_DIF_THD_NEG_KP FORMAT "%3.0" /end CHARACTERISTIC
/begin CHARACTERISTIC c_n_dif_thd_pos_ki "center point of linear area for positive control difference" VALUE 0x8484d4 _REC_VAL_20_s2 1023. _CNV_A_R_LINEAR_____5_CM -512. 511. DISPLAY_IDENTIFIER C_N_DIF_THD_POS_KI FORMAT "%3.0" /end CHARACTERISTIC
/begin CHARACTERISTIC c_n_dif_thd_neg_ki "center point of linear area for negative control difference" VALUE 0x8484d0 _REC_VAL_20_s2 1023. _CNV_A_R_LINEAR_____5_CM -512. 511. DISPLAY_IDENTIFIER C_N_DIF_THD_NEG_KI FORMAT "%3.0" /end CHARACTERISTIC
/begin CHARACTERISTIC c_n_dif_win_pos_ki "window width of linear area for positve control difference" VALUE 0x8484dc _REC_VAL_20_u2 8160. _CNV_A_R_LINEAR_____5_CM 0. 8160. DISPLAY_IDENTIFIER C_N_DIF_WIN_POS_KI FORMAT "%4.0" /end CHARACTERISTIC
/begin CHARACTERISTIC c_n_dif_win_neg_ki "window width of linear area for negative control difference" VALUE 0x8484d8 _REC_VAL_20_u2 8160. _CNV_A_R_LINEAR_____5_CM 0. 8160. DISPLAY_IDENTIFIER C_N_DIF_WIN_NEG_KI FORMAT "%4.0" /end CHARACTERISTIC
/begin CHARACTERISTIC c_n_dif_win_pos_kp "window width of linear area for positve control difference" VALUE 0x8484de _REC_VAL_20_u2 8160. _CNV_A_R_LINEAR_____5_CM 0. 8160. DISPLAY_IDENTIFIER C_N_DIF_WIN_POS_KP FORMAT "%4.0" /end CHARACTERISTIC
/begin CHARACTERISTIC c_n_dif_win_neg_kp "window width of linear area for negative control difference" VALUE 0x8484da _REC_VAL_20_u2 8160. _CNV_A_R_LINEAR_____5_CM 0. 8160. DISPLAY_IDENTIFIER C_N_DIF_WIN_NEG_KP FORMAT "%4.0" /end CHARACTERISTIC
/begin CHARACTERISTIC lc_is_p_ctl_brake "p controller on brake" VALUE 0x8487b9 _REC_VAL_20_u1 1. _CNV_A_R_LINEAR_____0_CM 0. 1. DISPLAY_IDENTIFIER LC_IS_P_CTL_BRAKE FORMAT "%1.0" /end CHARACTERISTIC
/begin CHARACTERISTIC c_fac_kr_pi_is_brake "factor amplification PI-controller brake" VALUE 0x848454 _REC_VAL_20_u2 0.9999874 _CNV_A_R_LINEAR_____90_CM 0. 0.9999874 DISPLAY_IDENTIFIER C_FAC_KR_PI_IS_BRAKE FORMAT "%6.5" /end CHARACTERISTIC
/begin CHARACTERISTIC id_kr_pi_is__dri "IS_PI: amplification PI-controller" CURVE 0x844a96 _REC_CUR_20_u2_u1 4.095 _CNV_A_R_LINEAR_____266_CM 0. 4.095 DISPLAY_IDENTIFIER ID_KR_PI_IS__DRI FORMAT "%4.3"
 /begin AXIS_DESCR COM_AXIS dri _CNV_A_R_LINEAR_____0_CM 7 0. 6. FORMAT "%1.0" AXIS_PTS_REF ldpm_dri_id_isc /end AXIS_DESCR
/end CHARACTERISTIC
/begin CHARACTERISTIC ip_ki_pi_neg_is_tco "IS_PI: integral gain PI-controller for negative control difference" CURVE 0x846cfc _REC_CUR_20_u2_u1 81.90000000000001 _CNV_A_R_LINEAR_____265_CM 0. 81.90000000000001 DISPLAY_IDENTIFIER IP_KI_PI_NEG_IS_TCO FORMAT "%4.2"
 /begin AXIS_DESCR COM_AXIS tco _CNV_A_R_LINEAR_____18_CM 8 -50. 205. FORMAT "%3.0" AXIS_PTS_REF ldp_tco_ip_ki_pi_neg_is /end AXIS_DESCR
/end CHARACTERISTIC
/begin AXIS_PTS ldp_tco_ip_ki_pi_neg_is "" 0x8427d9 tco _REC_AXS_20_u1 255. _CNV_A_R_LINEAR_____18_CM 8 -50. 205. FORMAT "%3.0" /end AXIS_PTS
/begin CHARACTERISTIC ip_ki_pi_pos_is_tco "IS_PI: integral gain PI-controller for positive control difference" CURVE 0x846d0c _REC_CUR_20_u2_u1 81.90000000000001 _CNV_A_R_LINEAR_____265_CM 0. 81.90000000000001 DISPLAY_IDENTIFIER IP_KI_PI_POS_IS_TCO FORMAT "%4.2"
 /begin AXIS_DESCR COM_AXIS tco _CNV_A_R_LINEAR_____18_CM 8 -50. 205. FORMAT "%3.0" AXIS_PTS_REF ldp_tco_ip_ki_pi_pos_is /end AXIS_DESCR
/end CHARACTERISTIC
/begin AXIS_PTS ldp_tco_ip_ki_pi_pos_is "" 0x8427e2 tco _REC_AXS_20_u1 255. _CNV_A_R_LINEAR_____18_CM 8 -50. 205. FORMAT "%3.0" /end AXIS_PTS
/begin CHARACTERISTIC ip_kr_pi_neg_is__tco "IS_PI: amplification PI-controller negative control difference" CURVE 0x846d1c _REC_CUR_20_u2_u1 4.095 _CNV_A_R_LINEAR_____266_CM 0. 4.095 DISPLAY_IDENTIFIER IP_KR_PI_NEG_IS__TCO FORMAT "%4.3"
 /begin AXIS_DESCR COM_AXIS tco _CNV_A_R_LINEAR_____18_CM 8 -50. 205. FORMAT "%3.0" AXIS_PTS_REF ldp_tco_ip_kr_pi_neg_is /end AXIS_DESCR
/end CHARACTERISTIC
/begin AXIS_PTS ldp_tco_ip_kr_pi_neg_is "" 0x8427eb tco _REC_AXS_20_u1 255. _CNV_A_R_LINEAR_____18_CM 8 -50. 205. FORMAT "%3.0" /end AXIS_PTS
/begin CHARACTERISTIC ip_kr_pi_pos_is__tco "IS_PI: amplification PI-controller positive control difference" CURVE 0x846d2c _REC_CUR_20_u2_u1 4.095 _CNV_A_R_LINEAR_____266_CM 0. 4.095 DISPLAY_IDENTIFIER IP_KR_PI_POS_IS__TCO FORMAT "%4.3"
 /begin AXIS_DESCR COM_AXIS tco _CNV_A_R_LINEAR_____18_CM 8 -50. 205. FORMAT "%3.0" AXIS_PTS_REF ldp_tco_ip_kr_pi_pos_is /end AXIS_DESCR
/end CHARACTERISTIC
/begin AXIS_PTS ldp_tco_ip_kr_pi_pos_is "" 0x8427f4 tco _REC_AXS_20_u1 255. _CNV_A_R_LINEAR_____18_CM 8 -50. 205. FORMAT "%3.0" /end AXIS_PTS
/begin CHARACTERISTIC id_ki_pi_is_dri "IS_PI: integral gain of PI-controller" CURVE 0x844a88 _REC_CUR_20_u2_u1 81.90000000000001 _CNV_A_R_LINEAR_____265_CM 0. 81.90000000000001 DISPLAY_IDENTIFIER ID_KI_PI_IS_DRI FORMAT "%4.2"
 /begin AXIS_DESCR COM_AXIS dri _CNV_A_R_LINEAR_____0_CM 7 0. 6. FORMAT "%1.0" AXIS_PTS_REF ldpm_dri_id_isc /end AXIS_DESCR
/end CHARACTERISTIC
/begin MEASUREMENT lv_is_ena_st "enable idle speed controller" UBYTE _CNV_S_2_RANGE______11_CM 1 0. 0. 1. DISPLAY_IDENTIFIER LV_IS_ENA_ST ECU_ADDRESS 0x7fb63d /end MEASUREMENT
/begin MEASUREMENT dly_ctr_tqi_st "delay counter for start torque" UWORD _CNV_A_R_LINEAR_____0_CM 1 0. 0. 65535. DISPLAY_IDENTIFIER DLY_CTR_TQI_ST ECU_ADDRESS 0x7fa8e4 BYTE_ORDER MSB_LAST FORMAT "%5.0" /end MEASUREMENT
/begin MEASUREMENT tqi_st "start torque" SWORD _CNV_A_R_LINEAR_____62_CM 1 0. -1024. 1023.96875 DISPLAY_IDENTIFIER TQI_ST ECU_ADDRESS 0x7f9c18 BYTE_ORDER MSB_LAST FORMAT "%6.2" /end MEASUREMENT
/begin CHARACTERISTIC ip_dly_ctr_tqi_st "TQISTGEN: delay counter for start torque" CURVE 0x84a4aa _REC_CUR_20_u2_u1 65535. _CNV_A_R_LINEAR_____0_CM 0. 65535. DISPLAY_IDENTIFIER IP_DLY_CTR_TQI_ST FORMAT "%5.0"
 /begin AXIS_DESCR COM_AXIS tco _CNV_A_R_LINEAR_____18_CM 8 -50. 205. FORMAT "%3.0" AXIS_PTS_REF ldp_tco_ip_dly_ctr_tq_st /end AXIS_DESCR
/end CHARACTERISTIC
/begin AXIS_PTS ldp_tco_ip_dly_ctr_tq_st "delay counter for start torque" 0x8426b5 tco _REC_AXS_20_u1 255. _CNV_A_R_LINEAR_____18_CM 8 -50. 205. FORMAT "%3.0" /end AXIS_PTS
/begin CHARACTERISTIC ip_tqi_st "TQISTGEN: start torque" MAP 0x85b71e _REC_MAP_20_u2_u2_u1 2047.96875 _CNV_A_R_LINEAR_____89_CM -1024. 1023.96875 DISPLAY_IDENTIFIER IP_TQI_ST FORMAT "%6.2"
 /begin AXIS_DESCR COM_AXIS n _CNV_A_R_LINEAR_____5_CM 12 0. 6375. FORMAT "%4.0" AXIS_PTS_REF ldp_n_ip_tqi_st /end AXIS_DESCR
 /begin AXIS_DESCR COM_AXIS tco _CNV_A_R_LINEAR_____18_CM 7 -50. 205. FORMAT "%3.0" AXIS_PTS_REF ldp_tco_ip_tqi_st /end AXIS_DESCR
/end CHARACTERISTIC
/begin AXIS_PTS ldp_n_ip_tqi_st "start torque" 0x84237e n _REC_AXS_20_u2 6375. _CNV_A_R_LINEAR_____5_CM 12 0. 6375. FORMAT "%4.0" /end AXIS_PTS
/begin AXIS_PTS ldp_tco_ip_tqi_st "start torque" 0x842864 tco _REC_AXS_20_u1 255. _CNV_A_R_LINEAR_____18_CM 7 -50. 205. FORMAT "%3.0" /end AXIS_PTS
/begin MEASUREMENT n_dif_is "idle speed control difference" SWORD _CNV_A_R_LINEAR_____5_CM 1 0. -512. 511. DISPLAY_IDENTIFIER N_DIF_IS ECU_ADDRESS 0x7f9c1a BYTE_ORDER MSB_LAST FORMAT "%3.0" /end MEASUREMENT
/begin MEASUREMENT tqi_is_ctl "torque idle speed controller" SWORD _CNV_A_R_LINEAR_____62_CM 1 0. -1024. 1023.96875 DISPLAY_IDENTIFIER TQI_IS_CTL ECU_ADDRESS 0x7f9c1c BYTE_ORDER MSB_LAST FORMAT "%6.2" /end MEASUREMENT
/begin MEASUREMENT kr_dt1_is "amplification DT1-function idle speed control" UWORD _CNV_A_R_LINEAR_____268_CM 1 0. 0. 0.9999874 DISPLAY_IDENTIFIER KR_DT1_IS ECU_ADDRESS 0x7fa8fc BYTE_ORDER MSB_LAST FORMAT "%6.5" /end MEASUREMENT
/begin MEASUREMENT tqi_p_is_ctl "idle speed controller p-part" SWORD _CNV_A_R_LINEAR_____62_CM 1 0. -1024. 1023.96875 DISPLAY_IDENTIFIER TQI_P_IS_CTL ECU_ADDRESS 0x7fa8fe BYTE_ORDER MSB_LAST FORMAT "%6.2" /end MEASUREMENT
/begin MEASUREMENT tqi_is_dt1_acin "torque DT1-function idle speed control air condition" SWORD _CNV_A_R_LINEAR_____62_CM 1 0. -1024. 1023.96875 DISPLAY_IDENTIFIER TQI_IS_DT1_ACIN ECU_ADDRESS 0x7fa900 BYTE_ORDER MSB_LAST FORMAT "%6.2" /end MEASUREMENT
/begin MEASUREMENT tqi_is_dt1_n "control torque DT1-function" SWORD _CNV_A_R_LINEAR_____62_CM 1 0. -1024. 1023.96875 DISPLAY_IDENTIFIER TQI_IS_DT1_N ECU_ADDRESS 0x7fa902 BYTE_ORDER MSB_LAST FORMAT "%6.2" /end MEASUREMENT
/begin MEASUREMENT tqi_pi_is_ctl "torque idle speed PI-controller" SWORD _CNV_A_R_LINEAR_____62_CM 1 0. -1024. 1023.96875 DISPLAY_IDENTIFIER TQI_PI_IS_CTL ECU_ADDRESS 0x7fa904 BYTE_ORDER MSB_LAST FORMAT "%6.2" /end MEASUREMENT
/begin MEASUREMENT tqi_i_is_ctl "idle speed controller i-part" SWORD _CNV_A_R_LINEAR_____62_CM 1 0. -1024. 1023.96875 DISPLAY_IDENTIFIER TQI_I_IS_CTL ECU_ADDRESS 0x7fa906 BYTE_ORDER MSB_LAST FORMAT "%6.2" /end MEASUREMENT
/begin MEASUREMENT tqi_dt1_is_ctl "torque DT1-function" SWORD _CNV_A_R_LINEAR_____62_CM 1 0. -1024. 1023.96875 DISPLAY_IDENTIFIER TQI_DT1_IS_CTL ECU_ADDRESS 0x7fa908 BYTE_ORDER MSB_LAST FORMAT "%6.2" /end MEASUREMENT
/begin MEASUREMENT n_dif "engine speed control difference" SWORD _CNV_A_R_LINEAR_____5_CM 1 0. -512. 511. DISPLAY_IDENTIFIER N_DIF ECU_ADDRESS 0x7fa90a BYTE_ORDER MSB_LAST FORMAT "%3.0" /end MEASUREMENT
/begin MEASUREMENT t1_dt1_is "time constant DT1-function idle speed control" UWORD _CNV_A_R_LINEAR_____269_CM 1 0. 0. 8.38848 DISPLAY_IDENTIFIER T1_DT1_IS ECU_ADDRESS 0x7fa90c BYTE_ORDER MSB_LAST FORMAT "%5.4" /end MEASUREMENT
/begin MEASUREMENT lv_act_dt1_is "idle speed DT1-function active" UBYTE _CNV_S_2_RANGE______11_CM 1 0. 0. 1. DISPLAY_IDENTIFIER LV_ACT_DT1_IS ECU_ADDRESS 0x7fbab5 /end MEASUREMENT
/begin MEASUREMENT tqi_is_ini "initialisation torque of idle speed controller" SWORD _CNV_A_R_LINEAR_____62_CM 1 0. -1024. 1023.96875 DISPLAY_IDENTIFIER TQI_IS_INI ECU_ADDRESS 0x7fa90e BYTE_ORDER MSB_LAST FORMAT "%6.2" /end MEASUREMENT
/begin CHARACTERISTIC lc_is_n_pred "switch for engine speed input signal" VALUE 0x8487b8 _REC_VAL_20_u1 1. _CNV_A_R_LINEAR_____0_CM 0. 1. DISPLAY_IDENTIFIER LC_IS_N_PRED FORMAT "%1.0" /end CHARACTERISTIC
/begin CHARACTERISTIC c_t1_dt1_is_acin_off "time constant DT1-function air condition off" VALUE 0x8485e0 _REC_VAL_20_u2 8.38848 _CNV_A_R_LINEAR_____269_CM 0. 8.38848 DISPLAY_IDENTIFIER C_T1_DT1_IS_ACIN_OFF FORMAT "%5.4" /end CHARACTERISTIC
/begin CHARACTERISTIC c_t1_dt1_is_acin_on "time constant DT1-function air condition on" VALUE 0x8485e2 _REC_VAL_20_u2 8.38848 _CNV_A_R_LINEAR_____269_CM 0. 8.38848 DISPLAY_IDENTIFIER C_T1_DT1_IS_ACIN_ON FORMAT "%5.4" /end CHARACTERISTIC
/begin CHARACTERISTIC c_kr_dt1_is_acin_off "amplification DT1-function air condition off" VALUE 0x84848a _REC_VAL_20_u2 3.99998471 _CNV_A_R_LINEAR_____270_CM 0. 3.99998471 DISPLAY_IDENTIFIER C_KR_DT1_IS_ACIN_OFF FORMAT "%6.5" /end CHARACTERISTIC
/begin CHARACTERISTIC c_kr_dt1_is_acin_on "amplification DT1-function air condition on" VALUE 0x84848c _REC_VAL_20_u2 3.99998471 _CNV_A_R_LINEAR_____270_CM 0. 3.99998471 DISPLAY_IDENTIFIER C_KR_DT1_IS_ACIN_ON FORMAT "%1.0" /end CHARACTERISTIC
/begin CHARACTERISTIC c_tqi_dt1_is_min "minimum torque DT1-function" VALUE 0x84870e _REC_VAL_20_s2 2047.96875 _CNV_A_R_LINEAR_____62_CM -1024. 1023.96875 DISPLAY_IDENTIFIER C_TQI_DT1_IS_MIN FORMAT "%6.2" /end CHARACTERISTIC
/begin CHARACTERISTIC c_tqi_dt1_is_max "maximum torque DT1-function" VALUE 0x84870c _REC_VAL_20_s2 2047.96875 _CNV_A_R_LINEAR_____62_CM -1024. 1023.96875 DISPLAY_IDENTIFIER C_TQI_DT1_IS_MAX FORMAT "%6.2" /end CHARACTERISTIC
/begin CHARACTERISTIC c_t_dly_dt1_is "time for activation DT1-function" VALUE 0x84862e _REC_VAL_20_u2 6553.5 _CNV_A_R_LINEAR_____19_CM 0. 6553.5 DISPLAY_IDENTIFIER C_T_DLY_DT1_IS FORMAT "%5.1" /end CHARACTERISTIC
/begin CHARACTERISTIC c_tqi_dt1_is_thd "threshold torque DT1-function" VALUE 0x848710 _REC_VAL_20_s2 2047.96875 _CNV_A_R_LINEAR_____62_CM -1024. 1023.96875 DISPLAY_IDENTIFIER C_TQI_DT1_IS_THD FORMAT "%6.2" /end CHARACTERISTIC
/begin CHARACTERISTIC c_kr_dt1_is "amplification DT1-function" VALUE 0x848488 _REC_VAL_20_u2 3.99998471 _CNV_A_R_LINEAR_____270_CM 0. 3.99998471 DISPLAY_IDENTIFIER C_KR_DT1_IS FORMAT "%6.5" /end CHARACTERISTIC
/begin CHARACTERISTIC c_kr_dt1_is_vs_run "amplification DT1-function running car" VALUE 0x84848e _REC_VAL_20_u2 3.99998471 _CNV_A_R_LINEAR_____270_CM 0. 3.99998471 DISPLAY_IDENTIFIER C_KR_DT1_IS_VS_RUN FORMAT "%1.0" /end CHARACTERISTIC
/begin CHARACTERISTIC c_t1_dt1_is "time constant DT1-function" VALUE 0x8485de _REC_VAL_20_u2 8.38848 _CNV_A_R_LINEAR_____269_CM 0. 8.38848 DISPLAY_IDENTIFIER C_T1_DT1_IS FORMAT "%5.4" /end CHARACTERISTIC
/begin CHARACTERISTIC c_t1_dt1_is_vs_run "time constant DT1-function running car" VALUE 0x8485e4 _REC_VAL_20_u2 8.38848 _CNV_A_R_LINEAR_____269_CM 0. 8.38848 DISPLAY_IDENTIFIER C_T1_DT1_IS_VS_RUN FORMAT "%5.4" /end CHARACTERISTIC
/begin CHARACTERISTIC c_fac_is_tqi_ini_brake "low pass filter factor idle speed controller for torque initialization when braking" VALUE 0x848452 _REC_VAL_20_u2 0.9999874 _CNV_A_R_LINEAR_____90_CM 0. 0.9999874 DISPLAY_IDENTIFIER C_FAC_IS_TQI_INI_BRAKE FORMAT "%6.5" /end CHARACTERISTIC
/begin CHARACTERISTIC c_fac_is_tqi_ini "low pass filter factor idle speed controller torque initialization" VALUE 0x848450 _REC_VAL_20_u2 0.9999874 _CNV_A_R_LINEAR_____90_CM 0. 0.9999874 DISPLAY_IDENTIFIER C_FAC_IS_TQI_INI FORMAT "%6.5" /end CHARACTERISTIC
/begin CHARACTERISTIC c_tqi_ini_add_acin "additive torque idle speed controller if air conditioning switched on" VALUE 0x848714 _REC_VAL_20_s2 2047.96875 _CNV_A_R_LINEAR_____62_CM -1024. 1023.96875 DISPLAY_IDENTIFIER C_TQI_INI_ADD_ACIN FORMAT "%6.2" /end CHARACTERISTIC
/begin CHARACTERISTIC lc_is_ini_bls_on "initialization on brake" VALUE 0x8487b7 _REC_VAL_20_u1 1. _CNV_A_R_LINEAR_____0_CM 0. 1. DISPLAY_IDENTIFIER LC_IS_INI_BLS_ON FORMAT "%1.0" /end CHARACTERISTIC
/begin CHARACTERISTIC id_fac_n_dif_rng_is__dri "TQ_IS: factor gradient switch" CURVE 0x844a7b _REC_CUR_20_u1_u1 0.99609375 _CNV_A_R_LINEAR_____34_CM 0. 0.99609375 DISPLAY_IDENTIFIER ID_FAC_N_DIF_RNG_IS__DRI FORMAT "%4.3"
 /begin AXIS_DESCR COM_AXIS dri _CNV_A_R_LINEAR_____0_CM 7 0. 6. FORMAT "%1.0" AXIS_PTS_REF ldpm_dri_id_isc /end AXIS_DESCR
/end CHARACTERISTIC
/begin AXIS_PTS ldpm_dri_id_isc "" 0x843454 dri _REC_AXS_20_u1 6. _CNV_A_R_LINEAR_____0_CM 7 0. 6. FORMAT "%1.0" /end AXIS_PTS
/begin CHARACTERISTIC id_n_dif_rng_is__dri "TQ_IS: range for gradient switch" CURVE 0x8452a4 _REC_CUR_20_u2_u1 511. _CNV_A_R_LINEAR_____5_CM 0. 511. DISPLAY_IDENTIFIER ID_N_DIF_RNG_IS__DRI FORMAT "%3.0"
 /begin AXIS_DESCR COM_AXIS dri _CNV_A_R_LINEAR_____0_CM 7 0. 6. FORMAT "%1.0" AXIS_PTS_REF ldpm_dri_id_isc /end AXIS_DESCR
/end CHARACTERISTIC
/begin CHARACTERISTIC id_tqi_ini__dri "TQ_IS: intialization torque output idle speed controller for running car" CURVE 0x8452e6 _REC_CUR_20_u2_u1 2047.96875 _CNV_A_R_LINEAR_____89_CM -1024. 1023.96875 DISPLAY_IDENTIFIER ID_TQI_INI__DRI FORMAT "%6.2"
 /begin AXIS_DESCR COM_AXIS dri _CNV_A_R_LINEAR_____0_CM 7 0. 6. FORMAT "%1.0" AXIS_PTS_REF ldpm_dri_id_isc /end AXIS_DESCR
/end CHARACTERISTIC
/begin CHARACTERISTIC ip_n_dif_dt1_is__tco "TQ_IS: control difference for activation DT1-function" CURVE 0x8471f4 _REC_CUR_20_u2_u1 8160. _CNV_A_R_LINEAR_____5_CM 0. 8160. DISPLAY_IDENTIFIER IP_N_DIF_DT1_IS__TCO FORMAT "%4.0"
 /begin AXIS_DESCR COM_AXIS tco _CNV_A_R_LINEAR_____18_CM 8 -50. 205. FORMAT "%3.0" AXIS_PTS_REF ldp_tco_ip_n_dif_dt1_is /end AXIS_DESCR
/end CHARACTERISTIC
/begin AXIS_PTS ldp_tco_ip_n_dif_dt1_is "" 0x842806 tco _REC_AXS_20_u1 255. _CNV_A_R_LINEAR_____18_CM 8 -50. 205. FORMAT "%3.0" /end AXIS_PTS
/begin CHARACTERISTIC ip_tqi_ini__tco "TQ_IS: initialization ouput torque idle speed controller" CURVE 0x84804a _REC_CUR_20_u2_u1 2047.96875 _CNV_A_R_LINEAR_____89_CM -1024. 1023.96875 DISPLAY_IDENTIFIER IP_TQI_INI__TCO FORMAT "%6.2"
 /begin AXIS_DESCR COM_AXIS tco _CNV_A_R_LINEAR_____18_CM 8 -50. 205. FORMAT "%3.0" AXIS_PTS_REF ldp_tco_ip_tqi_ini /end AXIS_DESCR
/end CHARACTERISTIC
/begin AXIS_PTS ldp_tco_ip_tqi_ini "" 0x84285b tco _REC_AXS_20_u1 255. _CNV_A_R_LINEAR_____18_CM 8 -50. 205. FORMAT "%3.0" /end AXIS_PTS
/begin AXIS_PTS ldp_amp_2_inj_x "" 0x841082 amp _REC_AXS_20_u2 5434. _CNV_A_R_LINEAR_____21_CM 1 0. 5434. FORMAT "%7.3" /end AXIS_PTS
/begin AXIS_PTS ldp_n_3_inj_x "" 0x841910 n _REC_AXS_20_u2 6375. _CNV_A_R_LINEAR_____5_CM 1 0. 6375. FORMAT "%4.0" /end AXIS_PTS
/begin AXIS_PTS ldp_tco_2_inj_x "" 0x842696 tco _REC_AXS_20_u1 255. _CNV_A_R_LINEAR_____18_CM 1 -50. 205. FORMAT "%3.0" /end AXIS_PTS
/begin AXIS_PTS ldp_n_4_inj_x "" 0x841914 n _REC_AXS_20_u2 6375. _CNV_A_R_LINEAR_____5_CM 1 0. 6375. FORMAT "%4.0" /end AXIS_PTS
/begin AXIS_PTS ldp_tco_3_inj_x "" 0x842698 tco _REC_AXS_20_u1 255. _CNV_A_R_LINEAR_____18_CM 1 -50. 205. FORMAT "%3.0" /end AXIS_PTS
/begin AXIS_PTS ldp_tqi_sp_ip_mf_tgas_rgn_1 "tgas correction of mf_bas during regeneration" 0x843076 tqi_sp _REC_AXS_20_u2 2047.96875 _CNV_A_R_LINEAR_____89_CM 8 -1024. 1023.96875 FORMAT "%6.2" /end AXIS_PTS
/begin CHARACTERISTIC ip_fac_soi_prev1_cor_amp "amp correction factor for SOI of minor injection PREV1" CURVE 0x84c144 _REC_CUR_20_u2_u2 0.9999847412109381 _CNV_A_R_LINEAR_____14_CM 0. 0.9999847412109381 DISPLAY_IDENTIFIER IP_FAC_SOI_PREV1_COR_AMP FORMAT "%6.5"
 /begin AXIS_DESCR COM_AXIS amp _CNV_A_R_LINEAR_____21_CM 8 0. 5434. FORMAT "%6.2" AXIS_PTS_REF ldp_amp_ip_fac_soi_prev1_cor /end AXIS_DESCR
/end CHARACTERISTIC
/begin AXIS_PTS ldp_amp_ip_fac_soi_prev1_cor "amp correction factor for SOI of prev1 injection" 0x84128e amp _REC_AXS_20_u2 5434. _CNV_A_R_LINEAR_____21_CM 8 0. 5434. FORMAT "%6.2" /end AXIS_PTS
/begin CHARACTERISTIC ip_fac_soi_prev1_cor_tgas "TGAS correction factor for SOI PREV1" CURVE 0x84c184 _REC_CUR_20_u2_u1 0.9999847412109381 _CNV_A_R_LINEAR_____14_CM 0. 0.9999847412109381 DISPLAY_IDENTIFIER IP_FAC_SOI_PREV1_COR_TGAS FORMAT "%6.5"
 /begin AXIS_DESCR COM_AXIS tgas _CNV_A_R_LINEAR_____18_CM 8 -50. 205. FORMAT "%3.0" AXIS_PTS_REF ldp_tgas_ip_fac_soi_prev1_cor /end AXIS_DESCR
/end CHARACTERISTIC
/begin AXIS_PTS ldp_tgas_ip_fac_soi_prev1_cor "SOI correction dependent on TGAS for prev1 injection" 0x8429da tgas _REC_AXS_20_u1 255. _CNV_A_R_LINEAR_____18_CM 8 -50. 205. FORMAT "%3.0" /end AXIS_PTS
/begin CHARACTERISTIC ip_fac_soi_prev1_cor_tco "start of PREV1 injection interpolation dependent on TCO" CURVE 0x84c164 _REC_CUR_20_u2_u1 1.9999696 _CNV_A_R_LINEAR_____53_CM 0. 1.9999696 DISPLAY_IDENTIFIER IP_FAC_SOI_PREV1_COR_TCO FORMAT "%6.5"
 /begin AXIS_DESCR COM_AXIS tco _CNV_A_R_LINEAR_____18_CM 8 -50. 205. FORMAT "%3.0" AXIS_PTS_REF ldp_tco_ip_fac_soi_prev1_cor /end AXIS_DESCR
/end CHARACTERISTIC
/begin AXIS_PTS ldp_tco_ip_fac_soi_prev1_cor "start of prev1 injection interpolation dependent on TCO" 0x842763 tco _REC_AXS_20_u1 255. _CNV_A_R_LINEAR_____18_CM 8 -50. 205. FORMAT "%3.0" /end AXIS_PTS
/begin AXIS_PTS ldpm_n_1_ip_soi_prev1_dif "basic SOI of prev1 injection at warm conditions" 0x843850 n _REC_AXS_20_u2 6375. _CNV_A_R_LINEAR_____5_CM 16 0. 6375. FORMAT "%4.0" /end AXIS_PTS
/begin AXIS_PTS ldpm_tqi_sp_1_ip_soi_prev1_dif "basic SOI of prev1 injection at warm conditions" 0x8443ea tqi_sp _REC_AXS_20_u2 2047.96875 _CNV_A_R_LINEAR_____89_CM 16 -1024. 1023.96875 FORMAT "%6.2" /end AXIS_PTS
/begin CHARACTERISTIC ip_soi_prev1_dif_amp "AMP correction of SOI PREV1" MAP 0x859e9a _REC_MAP_20_u2_u2_u2 720. _CNV_A_R_LINEAR_____397_CM -360. 360. DISPLAY_IDENTIFIER IP_SOI_PREV1_DIF_AMP FORMAT "%5.2"
 /begin AXIS_DESCR COM_AXIS n _CNV_A_R_LINEAR_____5_CM 8 0. 6375. FORMAT "%4.0" AXIS_PTS_REF ldp_n_ip_soi_prev1_dif_amp /end AXIS_DESCR
 /begin AXIS_DESCR COM_AXIS tqi_sp _CNV_A_R_LINEAR_____89_CM 8 -1024. 1023.96875 FORMAT "%6.2" AXIS_PTS_REF ldp_tqi_sp_ip_soi_prev1_dif_amp /end AXIS_DESCR
/end CHARACTERISTIC
/begin AXIS_PTS ldp_n_ip_soi_prev1_dif_amp "ambient pressure temperature correction of SOI for prev1 injection" 0x8421d4 n _REC_AXS_20_u2 6375. _CNV_A_R_LINEAR_____5_CM 8 0. 6375. FORMAT "%4.0" /end AXIS_PTS
/begin AXIS_PTS ldp_tqi_sp_ip_soi_prev1_dif_amp "ambient pressure temperature correction of SOI for prev1 injection" 0x843244 tqi_sp _REC_AXS_20_u2 2047.96875 _CNV_A_R_LINEAR_____89_CM 8 -1024. 1023.96875 FORMAT "%6.2" /end AXIS_PTS
/begin CHARACTERISTIC ip_soi_prev1_dif_tgas "TGAS correction of SOI PREV1" MAP 0x85a872 _REC_MAP_20_u2_u2_u2 720. _CNV_A_R_LINEAR_____397_CM -360. 360. DISPLAY_IDENTIFIER IP_SOI_PREV1_DIF_TGAS FORMAT "%5.2"
 /begin AXIS_DESCR COM_AXIS n _CNV_A_R_LINEAR_____5_CM 8 0. 6375. FORMAT "%4.0" AXIS_PTS_REF ldp_n_ip_soi_prev1_dif_tgas /end AXIS_DESCR
 /begin AXIS_DESCR COM_AXIS tqi_sp _CNV_A_R_LINEAR_____89_CM 8 -1024. 1023.96875 FORMAT "%6.2" AXIS_PTS_REF ldp_tqi_sp_ip_soi_prev1_dif_tgas /end AXIS_DESCR
/end CHARACTERISTIC
/begin AXIS_PTS ldp_n_ip_soi_prev1_dif_tgas "air temperature correction of SOI for prev1 injection" 0x84222a n _REC_AXS_20_u2 6375. _CNV_A_R_LINEAR_____5_CM 8 0. 6375. FORMAT "%4.0" /end AXIS_PTS
/begin AXIS_PTS ldp_tqi_sp_ip_soi_prev1_dif_tgas "air temperature correction of SOI for prev1 injection" 0x843256 tqi_sp _REC_AXS_20_u2 2047.96875 _CNV_A_R_LINEAR_____89_CM 8 -1024. 1023.96875 FORMAT "%6.2" /end AXIS_PTS
/begin CHARACTERISTIC ip_fac_soi_prev2_cor_amp "amp correction factor for SOI of minor injection PREV2" CURVE 0x84c1ac _REC_CUR_20_u2_u2 0.9999847412109381 _CNV_A_R_LINEAR_____14_CM 0. 0.9999847412109381 DISPLAY_IDENTIFIER IP_FAC_SOI_PREV2_COR_AMP FORMAT "%6.5"
 /begin AXIS_DESCR COM_AXIS amp _CNV_A_R_LINEAR_____21_CM 1 0. 5434. FORMAT "%6.2" AXIS_PTS_REF ldp_amp_ip_fac_soi_prev2_cor /end AXIS_DESCR
/end CHARACTERISTIC
/begin AXIS_PTS ldp_amp_ip_fac_soi_prev2_cor "amp correction factor for SOI of prev2 injection" 0x8412b2 amp _REC_AXS_20_u2 5434. _CNV_A_R_LINEAR_____21_CM 1 0. 5434. FORMAT "%6.2" /end AXIS_PTS
/begin CHARACTERISTIC ip_fac_soi_prev2_cor_tgas "TGAS correction factor for SOI PREV2" CURVE 0x84c1b4 _REC_CUR_20_u2_u1 0.9999847412109381 _CNV_A_R_LINEAR_____14_CM 0. 0.9999847412109381 DISPLAY_IDENTIFIER IP_FAC_SOI_PREV2_COR_TGAS FORMAT "%6.5"
 /begin AXIS_DESCR COM_AXIS tgas _CNV_A_R_LINEAR_____18_CM 1 -50. 205. FORMAT "%3.0" AXIS_PTS_REF ldp_tgas_ip_fac_soi_prev2_cor /end AXIS_DESCR
/end CHARACTERISTIC
/begin AXIS_PTS ldp_tgas_ip_fac_soi_prev2_cor "SOI correction dependent on TGAS for prev2 injection" 0x8429ec tgas _REC_AXS_20_u1 255. _CNV_A_R_LINEAR_____18_CM 1 -50. 205. FORMAT "%3.0" /end AXIS_PTS
/begin CHARACTERISTIC ip_fac_soi_prev2_cor_tco "start of PREV2 injection interpolation dependent on TCO" CURVE 0x84c1b0 _REC_CUR_20_u2_u1 1.9999696 _CNV_A_R_LINEAR_____53_CM 0. 1.9999696 DISPLAY_IDENTIFIER IP_FAC_SOI_PREV2_COR_TCO FORMAT "%6.5"
 /begin AXIS_DESCR COM_AXIS tco _CNV_A_R_LINEAR_____18_CM 1 -50. 205. FORMAT "%3.0" AXIS_PTS_REF ldp_tco_ip_fac_soi_prev2_cor /end AXIS_DESCR
/end CHARACTERISTIC
/begin AXIS_PTS ldp_tco_ip_fac_soi_prev2_cor "start of injection prev2 interpolation dependent on TCO" 0x842775 tco _REC_AXS_20_u1 255. _CNV_A_R_LINEAR_____18_CM 1 -50. 205. FORMAT "%3.0" /end AXIS_PTS
/begin AXIS_PTS ldpm_n_1_ip_soi_prev2_dif "basic SOI of prev2 injection at warm conditions" 0x8438b6 n _REC_AXS_20_u2 6375. _CNV_A_R_LINEAR_____5_CM 1 0. 6375. FORMAT "%4.0" /end AXIS_PTS
/begin AXIS_PTS ldpm_tqi_sp_1_ip_soi_prev2_dif "basic SOI of prev2 injection at warm conditions" 0x84440c tqi_sp _REC_AXS_20_u2 2047.96875 _CNV_A_R_LINEAR_____89_CM 1 -1024. 1023.96875 FORMAT "%6.2" /end AXIS_PTS
/begin CHARACTERISTIC ip_soi_prev2_dif_amp "AMP correction of SOI PREV2" MAP 0x85a978 _REC_MAP_20_u2_u2_u2 720. _CNV_A_R_LINEAR_____397_CM -360. 360. DISPLAY_IDENTIFIER IP_SOI_PREV2_DIF_AMP FORMAT "%5.2"
 /begin AXIS_DESCR COM_AXIS n _CNV_A_R_LINEAR_____5_CM 1 0. 6375. FORMAT "%4.0" AXIS_PTS_REF ldp_n_ip_soi_prev2_dif_amp /end AXIS_DESCR
 /begin AXIS_DESCR COM_AXIS tqi_sp _CNV_A_R_LINEAR_____89_CM 1 -1024. 1023.96875 FORMAT "%6.2" AXIS_PTS_REF ldp_tqi_sp_ip_soi_prev2_dif_amp /end AXIS_DESCR
/end CHARACTERISTIC
/begin AXIS_PTS ldp_n_ip_soi_prev2_dif_amp "ambient pressure temperature correction of SOI for prev2 injection" 0x842252 n _REC_AXS_20_u2 6375. _CNV_A_R_LINEAR_____5_CM 1 0. 6375. FORMAT "%4.0" /end AXIS_PTS
/begin AXIS_PTS ldp_tqi_sp_ip_soi_prev2_dif_amp "ambient pressure temperature correction of SOI for prev2 injection" 0x843268 tqi_sp _REC_AXS_20_u2 2047.96875 _CNV_A_R_LINEAR_____89_CM 1 -1024. 1023.96875 FORMAT "%6.2" /end AXIS_PTS
/begin CHARACTERISTIC ip_soi_prev2_dif_tgas "TGAS correction of SOI PREV2" MAP 0x85a988 _REC_MAP_20_u2_u2_u2 720. _CNV_A_R_LINEAR_____397_CM -360. 360. DISPLAY_IDENTIFIER IP_SOI_PREV2_DIF_TGAS FORMAT "%5.2"
 /begin AXIS_DESCR COM_AXIS n _CNV_A_R_LINEAR_____5_CM 1 0. 6375. FORMAT "%4.0" AXIS_PTS_REF ldp_n_ip_soi_prev2_dif_tgas /end AXIS_DESCR
 /begin AXIS_DESCR COM_AXIS tqi_sp _CNV_A_R_LINEAR_____89_CM 1 -1024. 1023.96875 FORMAT "%6.2" AXIS_PTS_REF ldp_tqi_sp_ip_soi_prev2_dif_tgas /end AXIS_DESCR
/end CHARACTERISTIC
/begin AXIS_PTS ldp_n_ip_soi_prev2_dif_tgas "air temperature correction of SOI for prev2 injection" 0x84225e n _REC_AXS_20_u2 6375. _CNV_A_R_LINEAR_____5_CM 1 0. 6375. FORMAT "%4.0" /end AXIS_PTS
/begin AXIS_PTS ldp_tqi_sp_ip_soi_prev2_dif_tgas "air temperature correction of SOI for prev2 injection" 0x84326c tqi_sp _REC_AXS_20_u2 2047.96875 _CNV_A_R_LINEAR_____89_CM 1 -1024. 1023.96875 FORMAT "%6.2" /end AXIS_PTS
/begin CHARACTERISTIC ip_fac_soi_main2_cor_amp "amp correction factor for SOI of minor injection MAIN2" CURVE 0x84c0ce _REC_CUR_20_u2_u2 0.9999847412109381 _CNV_A_R_LINEAR_____14_CM 0. 0.9999847412109381 DISPLAY_IDENTIFIER IP_FAC_SOI_MAIN2_COR_AMP FORMAT "%6.5"
 /begin AXIS_DESCR COM_AXIS amp _CNV_A_R_LINEAR_____21_CM 1 0. 5434. FORMAT "%6.2" AXIS_PTS_REF ldp_amp_ip_fac_soi_main2_cor /end AXIS_DESCR
/end CHARACTERISTIC
/begin AXIS_PTS ldp_amp_ip_fac_soi_main2_cor "amp correction factor for SOI of main2 injection" 0x841262 amp _REC_AXS_20_u2 5434. _CNV_A_R_LINEAR_____21_CM 1 0. 5434. FORMAT "%6.2" /end AXIS_PTS
/begin CHARACTERISTIC ip_fac_soi_main2_cor_tgas "TGAS correction factor for SOI MAIN2" CURVE 0x84c0d6 _REC_CUR_20_u2_u1 0.9999847412109381 _CNV_A_R_LINEAR_____14_CM 0. 0.9999847412109381 DISPLAY_IDENTIFIER IP_FAC_SOI_MAIN2_COR_TGAS FORMAT "%6.5"
 /begin AXIS_DESCR COM_AXIS tgas _CNV_A_R_LINEAR_____18_CM 1 -50. 205. FORMAT "%3.0" AXIS_PTS_REF ldp_tgas_ip_fac_soi_main2_cor /end AXIS_DESCR
/end CHARACTERISTIC
/begin AXIS_PTS ldp_tgas_ip_fac_soi_main2_cor "SOI correction dependent on TGAS for main2 injection" 0x8429c4 tgas _REC_AXS_20_u1 255. _CNV_A_R_LINEAR_____18_CM 1 -50. 205. FORMAT "%3.0" /end AXIS_PTS
/begin CHARACTERISTIC ip_fac_soi_main2_cor_tco "start of MAIN2 injection interpolation dependent on TCO" CURVE 0x84c0d2 _REC_CUR_20_u2_u1 1.9999696 _CNV_A_R_LINEAR_____53_CM 0. 1.9999696 DISPLAY_IDENTIFIER IP_FAC_SOI_MAIN2_COR_TCO FORMAT "%6.5"
 /begin AXIS_DESCR COM_AXIS tco _CNV_A_R_LINEAR_____18_CM 1 -50. 205. FORMAT "%3.0" AXIS_PTS_REF ldp_tco_ip_fac_soi_main2_cor /end AXIS_DESCR
/end CHARACTERISTIC
/begin AXIS_PTS ldp_tco_ip_fac_soi_main2_cor "start of injection main2 interpolation dependent on TCO" 0x84274d tco _REC_AXS_20_u1 255. _CNV_A_R_LINEAR_____18_CM 1 -50. 205. FORMAT "%3.0" /end AXIS_PTS
/begin AXIS_PTS ldpm_n_1_ip_soi_main2_dif "basic SOI of main2 injection at warm conditions" 0x8437de n _REC_AXS_20_u2 6375. _CNV_A_R_LINEAR_____5_CM 1 0. 6375. FORMAT "%4.0" /end AXIS_PTS
/begin AXIS_PTS ldpm_tqi_sp_1_ip_soi_main2_dif "basic SOI of main2 injection at warm conditions" 0x8443c4 tqi_sp _REC_AXS_20_u2 2047.96875 _CNV_A_R_LINEAR_____89_CM 1 -1024. 1023.96875 FORMAT "%6.2" /end AXIS_PTS
/begin CHARACTERISTIC ip_soi_main2_dif_amp "AMP correction of SOI MAIN2" MAP 0x858782 _REC_MAP_20_u2_u2_u2 720. _CNV_A_R_LINEAR_____397_CM -360. 360. DISPLAY_IDENTIFIER IP_SOI_MAIN2_DIF_AMP FORMAT "%5.2"
 /begin AXIS_DESCR COM_AXIS n _CNV_A_R_LINEAR_____5_CM 1 0. 6375. FORMAT "%4.0" AXIS_PTS_REF ldp_n_ip_soi_main2_dif_amp /end AXIS_DESCR
 /begin AXIS_DESCR COM_AXIS tqi_sp _CNV_A_R_LINEAR_____89_CM 1 -1024. 1023.96875 FORMAT "%6.2" AXIS_PTS_REF ldp_tqi_sp_ip_soi_main2_dif_amp /end AXIS_DESCR
/end CHARACTERISTIC
/begin AXIS_PTS ldp_n_ip_soi_main2_dif_amp "ambient pressure temperature correction of SOI for main2 injection" 0x842100 n _REC_AXS_20_u2 6375. _CNV_A_R_LINEAR_____5_CM 1 0. 6375. FORMAT "%4.0" /end AXIS_PTS
/begin AXIS_PTS ldp_tqi_sp_ip_soi_main2_dif_amp "ambient pressure temperature correction of SOI for main2 injection" 0x843218 tqi_sp _REC_AXS_20_u2 2047.96875 _CNV_A_R_LINEAR_____89_CM 1 -1024. 1023.96875 FORMAT "%6.2" /end AXIS_PTS
/begin CHARACTERISTIC ip_soi_main2_dif_tgas "TGAS correction of SOI MAIN2" MAP 0x858792 _REC_MAP_20_u2_u2_u2 720. _CNV_A_R_LINEAR_____397_CM -360. 360. DISPLAY_IDENTIFIER IP_SOI_MAIN2_DIF_TGAS FORMAT "%5.2"
 /begin AXIS_DESCR COM_AXIS n _CNV_A_R_LINEAR_____5_CM 1 0. 6375. FORMAT "%4.0" AXIS_PTS_REF ldp_n_ip_soi_main2_dif_tgas /end AXIS_DESCR
 /begin AXIS_DESCR COM_AXIS tqi_sp _CNV_A_R_LINEAR_____89_CM 1 -1024. 1023.96875 FORMAT "%6.2" AXIS_PTS_REF ldp_tqi_sp_ip_soi_main2_dif_tgas /end AXIS_DESCR
/end CHARACTERISTIC
/begin AXIS_PTS ldp_n_ip_soi_main2_dif_tgas "air temperature correction of SOI for main2 injection" 0x84210c n _REC_AXS_20_u2 6375. _CNV_A_R_LINEAR_____5_CM 1 0. 6375. FORMAT "%4.0" /end AXIS_PTS
/begin AXIS_PTS ldp_tqi_sp_ip_soi_main2_dif_tgas "air temperature correction of SOI for main2 injection" 0x84321c tqi_sp _REC_AXS_20_u2 2047.96875 _CNV_A_R_LINEAR_____89_CM 1 -1024. 1023.96875 FORMAT "%6.2" /end AXIS_PTS
/begin CHARACTERISTIC ip_fac_soi_post1_cor_amp "amp correction factor for SOI of minor injection POST1" CURVE 0x84c0dc _REC_CUR_20_u2_u2 0.9999847412109381 _CNV_A_R_LINEAR_____14_CM 0. 0.9999847412109381 DISPLAY_IDENTIFIER IP_FAC_SOI_POST1_COR_AMP FORMAT "%6.5"
 /begin AXIS_DESCR COM_AXIS amp _CNV_A_R_LINEAR_____21_CM 8 0. 5434. FORMAT "%6.2" AXIS_PTS_REF ldp_amp_ip_fac_soi_post1_cor /end AXIS_DESCR
/end CHARACTERISTIC
/begin AXIS_PTS ldp_amp_ip_fac_soi_post1_cor "amp correction factor for SOI of post1 injection" 0x84126a amp _REC_AXS_20_u2 5434. _CNV_A_R_LINEAR_____21_CM 8 0. 5434. FORMAT "%6.2" /end AXIS_PTS
/begin CHARACTERISTIC ip_fac_soi_post1_cor_tgas "TGAS correction factor for SOI POST1" CURVE 0x84c11c _REC_CUR_20_u2_u1 0.9999847412109381 _CNV_A_R_LINEAR_____14_CM 0. 0.9999847412109381 DISPLAY_IDENTIFIER IP_FAC_SOI_POST1_COR_TGAS FORMAT "%6.5"
 /begin AXIS_DESCR COM_AXIS tgas _CNV_A_R_LINEAR_____18_CM 8 -50. 205. FORMAT "%3.0" AXIS_PTS_REF ldp_tgas_ip_fac_soi_post1_cor /end AXIS_DESCR
/end CHARACTERISTIC
/begin AXIS_PTS ldp_tgas_ip_fac_soi_post1_cor "SOI correction dependent on TGAS for post1 injection" 0x8429c8 tgas _REC_AXS_20_u1 255. _CNV_A_R_LINEAR_____18_CM 8 -50. 205. FORMAT "%3.0" /end AXIS_PTS
/begin CHARACTERISTIC ip_fac_soi_post1_cor_tco "start of POST1 injection interpolation dependent on TCO" CURVE 0x84c0fc _REC_CUR_20_u2_u1 1.9999696 _CNV_A_R_LINEAR_____53_CM 0. 1.9999696 DISPLAY_IDENTIFIER IP_FAC_SOI_POST1_COR_TCO FORMAT "%6.5"
 /begin AXIS_DESCR COM_AXIS tco _CNV_A_R_LINEAR_____18_CM 8 -50. 205. FORMAT "%3.0" AXIS_PTS_REF ldp_tco_ip_fac_soi_post1_cor /end AXIS_DESCR
/end CHARACTERISTIC
/begin AXIS_PTS ldp_tco_ip_fac_soi_post1_cor "start of injection post1 interpolation dependent on TCO" 0x842751 tco _REC_AXS_20_u1 255. _CNV_A_R_LINEAR_____18_CM 8 -50. 205. FORMAT "%3.0" /end AXIS_PTS
/begin AXIS_PTS ldpm_n_1_ip_soi_post1_dif "basic SOI of post1 injection at warm conditions" 0x8437ea n _REC_AXS_20_u2 6375. _CNV_A_R_LINEAR_____5_CM 16 0. 6375. FORMAT "%4.0" /end AXIS_PTS
/begin AXIS_PTS ldpm_tqi_sp_1_ip_soi_post1_dif "basic SOI of post1 injection at warm conditions" 0x8443c8 tqi_sp _REC_AXS_20_u2 2047.96875 _CNV_A_R_LINEAR_____89_CM 16 -1024. 1023.96875 FORMAT "%6.2" /end AXIS_PTS
/begin CHARACTERISTIC ip_soi_post1_dif_amp "AMP correction of SOI POST1" MAP 0x858db6 _REC_MAP_20_u2_u2_u2 720. _CNV_A_R_LINEAR_____397_CM -360. 360. DISPLAY_IDENTIFIER IP_SOI_POST1_DIF_AMP FORMAT "%5.2"
 /begin AXIS_DESCR COM_AXIS n _CNV_A_R_LINEAR_____5_CM 8 0. 6375. FORMAT "%4.0" AXIS_PTS_REF ldp_n_ip_soi_post1_dif_amp /end AXIS_DESCR
 /begin AXIS_DESCR COM_AXIS tqi_sp _CNV_A_R_LINEAR_____89_CM 8 -1024. 1023.96875 FORMAT "%6.2" AXIS_PTS_REF ldp_tqi_sp_ip_soi_post1_dif_amp /end AXIS_DESCR
/end CHARACTERISTIC
/begin AXIS_PTS ldp_n_ip_soi_post1_dif_amp "ambient pressure temperature correction of SOI for post1 injection" 0x842148 n _REC_AXS_20_u2 6375. _CNV_A_R_LINEAR_____5_CM 8 0. 6375. FORMAT "%4.0" /end AXIS_PTS
/begin AXIS_PTS ldp_tqi_sp_ip_soi_post1_dif_amp "ambient pressure temperature correction of SOI for post1 injection" 0x843220 tqi_sp _REC_AXS_20_u2 2047.96875 _CNV_A_R_LINEAR_____89_CM 8 -1024. 1023.96875 FORMAT "%6.2" /end AXIS_PTS
/begin CHARACTERISTIC ip_soi_post1_dif_tgas "TGAS correction of SOI POST1" MAP 0x85978e _REC_MAP_20_u2_u2_u2 720. _CNV_A_R_LINEAR_____397_CM -360. 360. DISPLAY_IDENTIFIER IP_SOI_POST1_DIF_TGAS FORMAT "%5.2"
 /begin AXIS_DESCR COM_AXIS n _CNV_A_R_LINEAR_____5_CM 8 0. 6375. FORMAT "%4.0" AXIS_PTS_REF ldp_n_ip_soi_post1_dif_tgas /end AXIS_DESCR
 /begin AXIS_DESCR COM_AXIS tqi_sp _CNV_A_R_LINEAR_____89_CM 8 -1024. 1023.96875 FORMAT "%6.2" AXIS_PTS_REF ldp_tqi_sp_ip_soi_post1_dif_tgas /end AXIS_DESCR
/end CHARACTERISTIC
/begin AXIS_PTS ldp_n_ip_soi_post1_dif_tgas "air temperature correction of SOI for post1 injection" 0x84219e n _REC_AXS_20_u2 6375. _CNV_A_R_LINEAR_____5_CM 8 0. 6375. FORMAT "%4.0" /end AXIS_PTS
/begin AXIS_PTS ldp_tqi_sp_ip_soi_post1_dif_tgas "air temperature correction of SOI for post1 injection" 0x843232 tqi_sp _REC_AXS_20_u2 2047.96875 _CNV_A_R_LINEAR_____89_CM 8 -1024. 1023.96875 FORMAT "%6.2" /end AXIS_PTS
/begin MEASUREMENT soi_main2_dif_is_pl_rgl "distance between MAIN2 and MAIN1 at IS/PL and regular conditions" UWORD _CNV_A_R_LINEAR_____121_CM 1 0. 0. 360. DISPLAY_IDENTIFIER SOI_MAIN2_DIF_IS_PL_RGL ECU_ADDRESS 0x7f9fc6 BYTE_ORDER MSB_LAST FORMAT "%5.2" /end MEASUREMENT
/begin MEASUREMENT soi_prev2_dif_is_pl_rgl "distance between MAIN1 and PREV2 at IS/PL and regular conditions" UWORD _CNV_A_R_LINEAR_____121_CM 1 0. 0. 360. DISPLAY_IDENTIFIER SOI_PREV2_DIF_IS_PL_RGL ECU_ADDRESS 0x7f9fc4 BYTE_ORDER MSB_LAST FORMAT "%5.2" /end MEASUREMENT
/begin MEASUREMENT soi_prev1_dif_is_pl_rgl "distance between MAIN1 and PREV1 at IS/PL and regular conditions" UWORD _CNV_A_R_LINEAR_____121_CM 1 0. 0. 360. DISPLAY_IDENTIFIER SOI_PREV1_DIF_IS_PL_RGL ECU_ADDRESS 0x7f9fc2 BYTE_ORDER MSB_LAST FORMAT "%5.2" /end MEASUREMENT
/begin MEASUREMENT soi_post1_dif_is_pl_rgl "distance between POST1 and MAIN2 at IS/PL and regular conditions" UWORD _CNV_A_R_LINEAR_____121_CM 1 0. 0. 360. DISPLAY_IDENTIFIER SOI_POST1_DIF_IS_PL_RGL ECU_ADDRESS 0x7f9fc8 BYTE_ORDER MSB_LAST FORMAT "%5.2" /end MEASUREMENT
/begin MEASUREMENT soi_post1_dif_cor_rgl "sum of SOI corrections on the distance POST1-MAIN1 at IS/PL" UWORD _CNV_A_R_LINEAR_____120_CM 1 0. -120. 240. DISPLAY_IDENTIFIER SOI_POST1_DIF_COR_RGL ECU_ADDRESS 0x7f9fd0 BYTE_ORDER MSB_LAST FORMAT "%5.2" /end MEASUREMENT
/begin MEASUREMENT soi_prev1_dif_cor_rgl "sum of SOI corrections on the distance PREV1-MAIN1 at IS/PL" UWORD _CNV_A_R_LINEAR_____120_CM 1 0. -120. 240. DISPLAY_IDENTIFIER SOI_PREV1_DIF_COR_RGL ECU_ADDRESS 0x7f9fca BYTE_ORDER MSB_LAST FORMAT "%5.2" /end MEASUREMENT
/begin MEASUREMENT soi_prev2_dif_cor_rgl "sum of SOI corrections on the distance PREV2-MAIN1 at IS/PL" UWORD _CNV_A_R_LINEAR_____120_CM 1 0. -120. 240. DISPLAY_IDENTIFIER SOI_PREV2_DIF_COR_RGL ECU_ADDRESS 0x7f9fcc BYTE_ORDER MSB_LAST FORMAT "%5.2" /end MEASUREMENT
/begin MEASUREMENT soi_main2_dif_cor_rgl "sum of SOI corrections on the distance MAIN2-MAIN1 at IS/PL" UWORD _CNV_A_R_LINEAR_____120_CM 1 0. -120. 240. DISPLAY_IDENTIFIER SOI_MAIN2_DIF_COR_RGL ECU_ADDRESS 0x7f9fce BYTE_ORDER MSB_LAST FORMAT "%5.2" /end MEASUREMENT
/begin CHARACTERISTIC ip_soi_main2_dif_0_0 "basic SOI of minor injection MAIN2 at temperature level 0" MAP 0x85877c _REC_MAP_20_u2_u2_u2 360. _CNV_A_R_LINEAR_____121_CM 0. 360. DISPLAY_IDENTIFIER IP_SOI_MAIN2_DIF_0_0 FORMAT "%5.2"
 /begin AXIS_DESCR COM_AXIS n _CNV_A_R_LINEAR_____5_CM 1 0. 6375. FORMAT "%4.0" AXIS_PTS_REF ldpm_n_1_ip_soi_main2_dif /end AXIS_DESCR
 /begin AXIS_DESCR COM_AXIS tqi_sp _CNV_A_R_LINEAR_____89_CM 1 -1024. 1023.96875 FORMAT "%6.2" AXIS_PTS_REF ldpm_tqi_sp_1_ip_soi_main2_dif /end AXIS_DESCR
/end CHARACTERISTIC
/begin CHARACTERISTIC ip_soi_main2_dif_0_2 "basic SOI of minor injection MAIN2 at temperature level 2" MAP 0x858780 _REC_MAP_20_u2_u2_u2 360. _CNV_A_R_LINEAR_____121_CM 0. 360. DISPLAY_IDENTIFIER IP_SOI_MAIN2_DIF_0_2 FORMAT "%5.2"
 /begin AXIS_DESCR COM_AXIS n _CNV_A_R_LINEAR_____5_CM 1 0. 6375. FORMAT "%4.0" AXIS_PTS_REF ldpm_n_1_ip_soi_main2_dif /end AXIS_DESCR
 /begin AXIS_DESCR COM_AXIS tqi_sp _CNV_A_R_LINEAR_____89_CM 1 -1024. 1023.96875 FORMAT "%6.2" AXIS_PTS_REF ldpm_tqi_sp_1_ip_soi_main2_dif /end AXIS_DESCR
/end CHARACTERISTIC
/begin CHARACTERISTIC ip_soi_main2_dif_0_1 "basic SOI of minor injection MAIN2 at temperature level 1" MAP 0x85877e _REC_MAP_20_u2_u2_u2 360. _CNV_A_R_LINEAR_____121_CM 0. 360. DISPLAY_IDENTIFIER IP_SOI_MAIN2_DIF_0_1 FORMAT "%5.2"
 /begin AXIS_DESCR COM_AXIS n _CNV_A_R_LINEAR_____5_CM 1 0. 6375. FORMAT "%4.0" AXIS_PTS_REF ldpm_n_1_ip_soi_main2_dif /end AXIS_DESCR
 /begin AXIS_DESCR COM_AXIS tqi_sp _CNV_A_R_LINEAR_____89_CM 1 -1024. 1023.96875 FORMAT "%6.2" AXIS_PTS_REF ldpm_tqi_sp_1_ip_soi_main2_dif /end AXIS_DESCR
/end CHARACTERISTIC
/begin CHARACTERISTIC ip_soi_post1_dif_0_0 "basic SOI of minor injection POST1 at temperature level 0" MAP 0x8587b6 _REC_MAP_20_u2_u2_u2 360. _CNV_A_R_LINEAR_____121_CM 0. 360. DISPLAY_IDENTIFIER IP_SOI_POST1_DIF_0_0 FORMAT "%5.2"
 /begin AXIS_DESCR COM_AXIS n _CNV_A_R_LINEAR_____5_CM 16 0. 6375. FORMAT "%4.0" AXIS_PTS_REF ldpm_n_1_ip_soi_post1_dif /end AXIS_DESCR
 /begin AXIS_DESCR COM_AXIS tqi_sp _CNV_A_R_LINEAR_____89_CM 16 -1024. 1023.96875 FORMAT "%6.2" AXIS_PTS_REF ldpm_tqi_sp_1_ip_soi_post1_dif /end AXIS_DESCR
/end CHARACTERISTIC
/begin CHARACTERISTIC ip_soi_post1_dif_0_2 "basic SOI of minor injection POST1 at temperature level 2" MAP 0x858bb6 _REC_MAP_20_u2_u2_u2 360. _CNV_A_R_LINEAR_____121_CM 0. 360. DISPLAY_IDENTIFIER IP_SOI_POST1_DIF_0_2 FORMAT "%5.2"
 /begin AXIS_DESCR COM_AXIS n _CNV_A_R_LINEAR_____5_CM 16 0. 6375. FORMAT "%4.0" AXIS_PTS_REF ldpm_n_1_ip_soi_post1_dif /end AXIS_DESCR
 /begin AXIS_DESCR COM_AXIS tqi_sp _CNV_A_R_LINEAR_____89_CM 16 -1024. 1023.96875 FORMAT "%6.2" AXIS_PTS_REF ldpm_tqi_sp_1_ip_soi_post1_dif /end AXIS_DESCR
/end CHARACTERISTIC
/begin CHARACTERISTIC ip_soi_post1_dif_0_1 "basic SOI of minor injection POST1 at temperature level 1" MAP 0x8589b6 _REC_MAP_20_u2_u2_u2 360. _CNV_A_R_LINEAR_____121_CM 0. 360. DISPLAY_IDENTIFIER IP_SOI_POST1_DIF_0_1 FORMAT "%5.2"
 /begin AXIS_DESCR COM_AXIS n _CNV_A_R_LINEAR_____5_CM 16 0. 6375. FORMAT "%4.0" AXIS_PTS_REF ldpm_n_1_ip_soi_post1_dif /end AXIS_DESCR
 /begin AXIS_DESCR COM_AXIS tqi_sp _CNV_A_R_LINEAR_____89_CM 16 -1024. 1023.96875 FORMAT "%6.2" AXIS_PTS_REF ldpm_tqi_sp_1_ip_soi_post1_dif /end AXIS_DESCR
/end CHARACTERISTIC
/begin CHARACTERISTIC ip_soi_prev1_dif_0_2 "basic SOI of minor injection PREV1 at temperature level 2" MAP 0x859c9a _REC_MAP_20_u2_u2_u2 360. _CNV_A_R_LINEAR_____121_CM 0. 360. DISPLAY_IDENTIFIER IP_SOI_PREV1_DIF_0_2 FORMAT "%5.2"
 /begin AXIS_DESCR COM_AXIS n _CNV_A_R_LINEAR_____5_CM 16 0. 6375. FORMAT "%4.0" AXIS_PTS_REF ldpm_n_1_ip_soi_prev1_dif /end AXIS_DESCR
 /begin AXIS_DESCR COM_AXIS tqi_sp _CNV_A_R_LINEAR_____89_CM 16 -1024. 1023.96875 FORMAT "%6.2" AXIS_PTS_REF ldpm_tqi_sp_1_ip_soi_prev1_dif /end AXIS_DESCR
/end CHARACTERISTIC
/begin CHARACTERISTIC ip_soi_prev1_dif_0_0 "basic SOI of minor injection PREV1 at temperature level 0" MAP 0x85989a _REC_MAP_20_u2_u2_u2 360. _CNV_A_R_LINEAR_____121_CM 0. 360. DISPLAY_IDENTIFIER IP_SOI_PREV1_DIF_0_0 FORMAT "%5.2"
 /begin AXIS_DESCR COM_AXIS n _CNV_A_R_LINEAR_____5_CM 16 0. 6375. FORMAT "%4.0" AXIS_PTS_REF ldpm_n_1_ip_soi_prev1_dif /end AXIS_DESCR
 /begin AXIS_DESCR COM_AXIS tqi_sp _CNV_A_R_LINEAR_____89_CM 16 -1024. 1023.96875 FORMAT "%6.2" AXIS_PTS_REF ldpm_tqi_sp_1_ip_soi_prev1_dif /end AXIS_DESCR
/end CHARACTERISTIC
/begin CHARACTERISTIC ip_soi_prev1_dif_0_1 "basic SOI of minor injection PREV1 at temperature level 1" MAP 0x859a9a _REC_MAP_20_u2_u2_u2 360. _CNV_A_R_LINEAR_____121_CM 0. 360. DISPLAY_IDENTIFIER IP_SOI_PREV1_DIF_0_1 FORMAT "%5.2"
 /begin AXIS_DESCR COM_AXIS n _CNV_A_R_LINEAR_____5_CM 16 0. 6375. FORMAT "%4.0" AXIS_PTS_REF ldpm_n_1_ip_soi_prev1_dif /end AXIS_DESCR
 /begin AXIS_DESCR COM_AXIS tqi_sp _CNV_A_R_LINEAR_____89_CM 16 -1024. 1023.96875 FORMAT "%6.2" AXIS_PTS_REF ldpm_tqi_sp_1_ip_soi_prev1_dif /end AXIS_DESCR
/end CHARACTERISTIC
/begin CHARACTERISTIC ip_soi_prev2_dif_0_0 "basic SOI of minor injection PREV2 at temperature level 0" MAP 0x85a972 _REC_MAP_20_u2_u2_u2 360. _CNV_A_R_LINEAR_____121_CM 0. 360. DISPLAY_IDENTIFIER IP_SOI_PREV2_DIF_0_0 FORMAT "%5.2"
 /begin AXIS_DESCR COM_AXIS n _CNV_A_R_LINEAR_____5_CM 1 0. 6375. FORMAT "%4.0" AXIS_PTS_REF ldpm_n_1_ip_soi_prev2_dif /end AXIS_DESCR
 /begin AXIS_DESCR COM_AXIS tqi_sp _CNV_A_R_LINEAR_____89_CM 1 -1024. 1023.96875 FORMAT "%6.2" AXIS_PTS_REF ldpm_tqi_sp_1_ip_soi_prev2_dif /end AXIS_DESCR
/end CHARACTERISTIC
/begin CHARACTERISTIC ip_soi_prev2_dif_0_2 "basic SOI of minor injection PREV2 at temperature level 2" MAP 0x85a976 _REC_MAP_20_u2_u2_u2 360. _CNV_A_R_LINEAR_____121_CM 0. 360. DISPLAY_IDENTIFIER IP_SOI_PREV2_DIF_0_2 FORMAT "%5.2"
 /begin AXIS_DESCR COM_AXIS n _CNV_A_R_LINEAR_____5_CM 1 0. 6375. FORMAT "%4.0" AXIS_PTS_REF ldpm_n_1_ip_soi_prev2_dif /end AXIS_DESCR
 /begin AXIS_DESCR COM_AXIS tqi_sp _CNV_A_R_LINEAR_____89_CM 1 -1024. 1023.96875 FORMAT "%6.2" AXIS_PTS_REF ldpm_tqi_sp_1_ip_soi_prev2_dif /end AXIS_DESCR
/end CHARACTERISTIC
/begin CHARACTERISTIC ip_soi_prev2_dif_0_1 "basic SOI of minor injection PREV2 at temperature level 1" MAP 0x85a974 _REC_MAP_20_u2_u2_u2 360. _CNV_A_R_LINEAR_____121_CM 0. 360. DISPLAY_IDENTIFIER IP_SOI_PREV2_DIF_0_1 FORMAT "%5.2"
 /begin AXIS_DESCR COM_AXIS n _CNV_A_R_LINEAR_____5_CM 1 0. 6375. FORMAT "%4.0" AXIS_PTS_REF ldpm_n_1_ip_soi_prev2_dif /end AXIS_DESCR
 /begin AXIS_DESCR COM_AXIS tqi_sp _CNV_A_R_LINEAR_____89_CM 1 -1024. 1023.96875 FORMAT "%6.2" AXIS_PTS_REF ldpm_tqi_sp_1_ip_soi_prev2_dif /end AXIS_DESCR
/end CHARACTERISTIC
/begin MEASUREMENT soi_prev1_dif_is_pl_rgn_1 "distance between MAIN1 and PREV1 at IS/PL during rgn level 1" UWORD _CNV_A_R_LINEAR_____121_CM 1 0. 0. 360. DISPLAY_IDENTIFIER SOI_PREV1_DIF_IS_PL_RGN_1 ECU_ADDRESS 0x7f9fe2 BYTE_ORDER MSB_LAST FORMAT "%5.2" /end MEASUREMENT
/begin MEASUREMENT soi_prev2_dif_is_pl_rgn_1 "distance between MAIN1 and PREV2 at IS/PL during rgn level 1" UWORD _CNV_A_R_LINEAR_____121_CM 1 0. 0. 360. DISPLAY_IDENTIFIER SOI_PREV2_DIF_IS_PL_RGN_1 ECU_ADDRESS 0x7f9fe4 BYTE_ORDER MSB_LAST FORMAT "%5.2" /end MEASUREMENT
/begin MEASUREMENT soi_main2_dif_is_pl_rgn_1 "distance between MAIN1 and MAIN2 at IS/PL during rgn level 1" UWORD _CNV_A_R_LINEAR_____121_CM 1 0. 0. 360. DISPLAY_IDENTIFIER SOI_MAIN2_DIF_IS_PL_RGN_1 ECU_ADDRESS 0x7f9fe6 BYTE_ORDER MSB_LAST FORMAT "%5.2" /end MEASUREMENT
/begin MEASUREMENT soi_post1_dif_is_pl_rgn_1 "distance between MAIN1 and POST1 at IS/PL during rgn level 1" UWORD _CNV_A_R_LINEAR_____121_CM 1 0. 0. 360. DISPLAY_IDENTIFIER SOI_POST1_DIF_IS_PL_RGN_1 ECU_ADDRESS 0x7f9fe8 BYTE_ORDER MSB_LAST FORMAT "%5.2" /end MEASUREMENT
/begin MEASUREMENT soi_prev1_dif_is_pl_rgn_2 "distance between MAIN1 and PREV1 at IS/PL during rgn level 2" UWORD _CNV_A_R_LINEAR_____121_CM 1 0. 0. 360. DISPLAY_IDENTIFIER SOI_PREV1_DIF_IS_PL_RGN_2 ECU_ADDRESS 0x7f9fea BYTE_ORDER MSB_LAST FORMAT "%5.2" /end MEASUREMENT
/begin MEASUREMENT soi_prev2_dif_is_pl_rgn_2 "distance between MAIN1 and PREV2 at IS/PL during rgn level 2" UWORD _CNV_A_R_LINEAR_____121_CM 1 0. 0. 360. DISPLAY_IDENTIFIER SOI_PREV2_DIF_IS_PL_RGN_2 ECU_ADDRESS 0x7f9fec BYTE_ORDER MSB_LAST FORMAT "%5.2" /end MEASUREMENT
/begin MEASUREMENT soi_main2_dif_is_pl_rgn_2 "distance between MAIN1 and MAIN2 at IS/PL during rgn level 2" UWORD _CNV_A_R_LINEAR_____121_CM 1 0. 0. 360. DISPLAY_IDENTIFIER SOI_MAIN2_DIF_IS_PL_RGN_2 ECU_ADDRESS 0x7f9fee BYTE_ORDER MSB_LAST FORMAT "%5.2" /end MEASUREMENT
/begin MEASUREMENT soi_post1_dif_is_pl_rgn_2 "distance between MAIN1 and POST1 at IS/PL during rgn level 2" UWORD _CNV_A_R_LINEAR_____121_CM 1 0. 0. 360. DISPLAY_IDENTIFIER SOI_POST1_DIF_IS_PL_RGN_2 ECU_ADDRESS 0x7f9ff0 BYTE_ORDER MSB_LAST FORMAT "%5.2" /end MEASUREMENT
/begin AXIS_PTS ldp_amp_ip_fac_soi_prev1_rgn_1 "amp correction factor for SOI j during rgn" 0x8412a0 amp _REC_AXS_20_u2 5434. _CNV_A_R_LINEAR_____21_CM 8 0. 5434. FORMAT "%6.2" /end AXIS_PTS
/begin AXIS_PTS ldp_amp_ip_fac_soi_prev2_rgn_1 "amp correction factor for SOI j during rgn" 0x8412b6 amp _REC_AXS_20_u2 5434. _CNV_A_R_LINEAR_____21_CM 1 0. 5434. FORMAT "%6.2" /end AXIS_PTS
/begin AXIS_PTS ldp_amp_ip_fac_soi_main2_rgn_1 "amp correction factor for SOI j during rgn" 0x841266 amp _REC_AXS_20_u2 5434. _CNV_A_R_LINEAR_____21_CM 1 0. 5434. FORMAT "%6.2" /end AXIS_PTS
/begin AXIS_PTS ldp_amp_ip_fac_soi_post1_rgn_1 "amp correction factor for SOI j during rgn" 0x84127c amp _REC_AXS_20_u2 5434. _CNV_A_R_LINEAR_____21_CM 8 0. 5434. FORMAT "%6.2" /end AXIS_PTS
/begin AXIS_PTS ldp_n_ip_soi_prev1_amp_rgn_1 "AMP correction of SOI j during rgn" 0x8421c2 n _REC_AXS_20_u2 6375. _CNV_A_R_LINEAR_____5_CM 8 0. 6375. FORMAT "%4.0" /end AXIS_PTS
/begin AXIS_PTS ldp_n_ip_soi_post1_amp_rgn_1 "AMP correction of SOI j during rgn" 0x842136 n _REC_AXS_20_u2 6375. _CNV_A_R_LINEAR_____5_CM 8 0. 6375. FORMAT "%4.0" /end AXIS_PTS
/begin AXIS_PTS ldp_n_ip_soi_main2_amp_rgn_1 "AMP correction of SOI j during rgn" 0x8420fc n _REC_AXS_20_u2 6375. _CNV_A_R_LINEAR_____5_CM 1 0. 6375. FORMAT "%4.0" /end AXIS_PTS
/begin AXIS_PTS ldp_n_ip_soi_post1_dif_rgn_1_0_1 "basic SOI of minor injection j at temp level 1 during rgn" 0x84215a n _REC_AXS_20_u2 6375. _CNV_A_R_LINEAR_____5_CM 16 0. 6375. FORMAT "%4.0" /end AXIS_PTS
/begin AXIS_PTS ldp_n_ip_soi_prev2_dif_rgn_1_0_1 "basic SOI of minor injection j at temp level 1 during rgn" 0x842256 n _REC_AXS_20_u2 6375. _CNV_A_R_LINEAR_____5_CM 1 0. 6375. FORMAT "%4.0" /end AXIS_PTS
/begin AXIS_PTS ldp_n_ip_soi_prev1_dif_rgn_1_0_1 "basic SOI of minor injection j at temp level 1 during rgn" 0x8421e6 n _REC_AXS_20_u2 6375. _CNV_A_R_LINEAR_____5_CM 16 0. 6375. FORMAT "%4.0" /end AXIS_PTS
/begin AXIS_PTS ldp_n_ip_soi_main2_dif_rgn_1_0_1 "basic SOI of minor injection j at temp level 1 during rgn" 0x842104 n _REC_AXS_20_u2 6375. _CNV_A_R_LINEAR_____5_CM 1 0. 6375. FORMAT "%4.0" /end AXIS_PTS
/begin AXIS_PTS ldp_n_ip_soi_prev2_dif_rgn_1_0_2 "basic SOI of minor injection j at temp level 2 during rgn" 0x84225a n _REC_AXS_20_u2 6375. _CNV_A_R_LINEAR_____5_CM 1 0. 6375. FORMAT "%4.0" /end AXIS_PTS
/begin AXIS_PTS ldp_n_ip_soi_post1_dif_rgn_1_0_2 "basic SOI of minor injection j at temp level 2 during rgn" 0x84217c n _REC_AXS_20_u2 6375. _CNV_A_R_LINEAR_____5_CM 16 0. 6375. FORMAT "%4.0" /end AXIS_PTS
/begin AXIS_PTS ldp_n_ip_soi_prev1_dif_rgn_1_0_2 "basic SOI of minor injection j at temp level 2 during rgn" 0x842208 n _REC_AXS_20_u2 6375. _CNV_A_R_LINEAR_____5_CM 16 0. 6375. FORMAT "%4.0" /end AXIS_PTS
/begin AXIS_PTS ldp_n_ip_soi_main2_dif_rgn_1_0_2 "basic SOI of minor injection j at temp level 2 during rgn" 0x842108 n _REC_AXS_20_u2 6375. _CNV_A_R_LINEAR_____5_CM 1 0. 6375. FORMAT "%4.0" /end AXIS_PTS
/begin AXIS_PTS ldp_n_ip_soi_main2_tgas_rgn_1 "TGAS correction of SOI j during rgn" 0x842110 n _REC_AXS_20_u2 6375. _CNV_A_R_LINEAR_____5_CM 1 0. 6375. FORMAT "%4.0" /end AXIS_PTS
/begin AXIS_PTS ldp_n_ip_soi_prev1_tgas_rgn_1 "TGAS correction of SOI j during rgn" 0x84223c n _REC_AXS_20_u2 6375. _CNV_A_R_LINEAR_____5_CM 8 0. 6375. FORMAT "%4.0" /end AXIS_PTS
/begin AXIS_PTS ldp_n_ip_soi_post1_tgas_rgn_1 "TGAS correction of SOI j during rgn" 0x8421b0 n _REC_AXS_20_u2 6375. _CNV_A_R_LINEAR_____5_CM 8 0. 6375. FORMAT "%4.0" /end AXIS_PTS
/begin AXIS_PTS ldp_tco_ip_fac_soi_post1_rgn_1 "start of injection interpolation dependent on TCO during rgn" 0x84275a tco _REC_AXS_20_u1 255. _CNV_A_R_LINEAR_____18_CM 8 -50. 205. FORMAT "%3.0" /end AXIS_PTS
/begin AXIS_PTS ldp_tco_ip_fac_soi_prev1_rgn_1 "start of injection interpolation dependent on TCO during rgn" 0x84276c tco _REC_AXS_20_u1 255. _CNV_A_R_LINEAR_____18_CM 8 -50. 205. FORMAT "%3.0" /end AXIS_PTS
/begin AXIS_PTS ldp_tco_ip_fac_soi_main2_rgn_1 "start of injection interpolation dependent on TCO during rgn" 0x84274f tco _REC_AXS_20_u1 255. _CNV_A_R_LINEAR_____18_CM 1 -50. 205. FORMAT "%3.0" /end AXIS_PTS
/begin AXIS_PTS ldp_tgas_ip_fac_soi_main2_rgn_1 "TGAS correction factor for SOI j during rgn" 0x8429c6 tgas _REC_AXS_20_u1 255. _CNV_A_R_LINEAR_____18_CM 1 -50. 205. FORMAT "%3.0" /end AXIS_PTS
/begin AXIS_PTS ldp_tgas_ip_fac_soi_prev1_rgn_1 "TGAS correction factor for SOI j during rgn" 0x8429e3 tgas _REC_AXS_20_u1 255. _CNV_A_R_LINEAR_____18_CM 8 -50. 205. FORMAT "%3.0" /end AXIS_PTS
/begin AXIS_PTS ldp_tgas_ip_fac_soi_post1_rgn_1 "TGAS correction factor for SOI j during rgn" 0x8429d1 tgas _REC_AXS_20_u1 255. _CNV_A_R_LINEAR_____18_CM 8 -50. 205. FORMAT "%3.0" /end AXIS_PTS
/begin AXIS_PTS ldp_tqi_ip_soi_post1_amp_rgn_1 "AMP correction of SOI j during rgn" 0x842c8c tqi_sp _REC_AXS_20_u2 2047.96875 _CNV_A_R_LINEAR_____89_CM 8 -1024. 1023.96875 FORMAT "%6.2" /end AXIS_PTS
/begin AXIS_PTS ldp_tqi_ip_soi_prev2_amp_rgn_1 "AMP correction of SOI j during rgn" 0x842d5c tqi_sp _REC_AXS_20_u2 2047.96875 _CNV_A_R_LINEAR_____89_CM 1 -1024. 1023.96875 FORMAT "%6.2" /end AXIS_PTS
/begin AXIS_PTS ldp_tqi_ip_soi_prev1_amp_rgn_1 "AMP correction of SOI j during rgn" 0x842cf4 tqi_sp _REC_AXS_20_u2 2047.96875 _CNV_A_R_LINEAR_____89_CM 8 -1024. 1023.96875 FORMAT "%6.2" /end AXIS_PTS
/begin AXIS_PTS ldp_tqi_ip_soi_main2_amp_rgn_1 "AMP correction of SOI j during rgn" 0x842c7c tqi_sp _REC_AXS_20_u2 2047.96875 _CNV_A_R_LINEAR_____89_CM 1 -1024. 1023.96875 FORMAT "%6.2" /end AXIS_PTS
/begin AXIS_PTS ldpm_tqi_ip_soi_prev2_dif_rgn_1 "basic SOI of minor injection j at rgn level k and temp level 0" 0x84421c tqi_sp _REC_AXS_20_u2 2047.96875 _CNV_A_R_LINEAR_____89_CM 1 -1024. 1023.96875 FORMAT "%6.2" /end AXIS_PTS
/begin AXIS_PTS ldpm_tqi_ip_soi_prev2_dif_rgn_2 "basic SOI of minor injection j at rgn level k and temp level 0" 0x844220 tqi_sp _REC_AXS_20_u2 2047.96875 _CNV_A_R_LINEAR_____89_CM 1 -1024. 1023.96875 FORMAT "%6.2" /end AXIS_PTS
/begin AXIS_PTS ldpm_tqi_ip_soi_main2_dif_rgn_1 "basic SOI of minor injection j at rgn level k and temp level 0" 0x84418c tqi_sp _REC_AXS_20_u2 2047.96875 _CNV_A_R_LINEAR_____89_CM 1 -1024. 1023.96875 FORMAT "%6.2" /end AXIS_PTS
/begin AXIS_PTS ldpm_tqi_ip_soi_main2_dif_rgn_2 "basic SOI of minor injection j at rgn level k and temp level 0" 0x844190 tqi_sp _REC_AXS_20_u2 2047.96875 _CNV_A_R_LINEAR_____89_CM 1 -1024. 1023.96875 FORMAT "%6.2" /end AXIS_PTS
/begin AXIS_PTS ldpm_tqi_ip_soi_post1_dif_rgn_1 "basic SOI of minor injection j at rgn level k and temp level 0" 0x844194 tqi_sp _REC_AXS_20_u2 2047.96875 _CNV_A_R_LINEAR_____89_CM 16 -1024. 1023.96875 FORMAT "%6.2" /end AXIS_PTS
/begin AXIS_PTS ldpm_tqi_ip_soi_post1_dif_rgn_2 "basic SOI of minor injection j at rgn level k and temp level 0" 0x8441b6 tqi_sp _REC_AXS_20_u2 2047.96875 _CNV_A_R_LINEAR_____89_CM 16 -1024. 1023.96875 FORMAT "%6.2" /end AXIS_PTS
/begin AXIS_PTS ldpm_tqi_ip_soi_prev1_dif_rgn_1 "basic SOI of minor injection j at rgn level k and temp level 0" 0x8441d8 tqi_sp _REC_AXS_20_u2 2047.96875 _CNV_A_R_LINEAR_____89_CM 16 -1024. 1023.96875 FORMAT "%6.2" /end AXIS_PTS
/begin AXIS_PTS ldpm_tqi_ip_soi_prev1_dif_rgn_2 "basic SOI of minor injection j at rgn level k and temp level 0" 0x8441fa tqi_sp _REC_AXS_20_u2 2047.96875 _CNV_A_R_LINEAR_____89_CM 16 -1024. 1023.96875 FORMAT "%6.2" /end AXIS_PTS
/begin CHARACTERISTIC ip_fac_soi_post1_cor_amp_rgn_1 "ASOI_MAIN_RGN: amp correction factor for SOI j during rgn" CURVE 0x84c0ec _REC_CUR_20_u2_u2 1.9999696 _CNV_A_R_LINEAR_____53_CM 0. 1.9999696 DISPLAY_IDENTIFIER IP_FAC_SOI_POST1_COR_AMP_RGN_1 FORMAT "%6.5"
 /begin AXIS_DESCR COM_AXIS amp _CNV_A_R_LINEAR_____21_CM 8 0. 5434. FORMAT "%6.2" AXIS_PTS_REF ldp_amp_ip_fac_soi_post1_rgn_1 /end AXIS_DESCR
/end CHARACTERISTIC
/begin CHARACTERISTIC ip_fac_soi_prev2_cor_amp_rgn_1 "ASOI_MAIN_RGN: amp correction factor for SOI j during rgn" CURVE 0x84c1ae _REC_CUR_20_u2_u2 1.9999696 _CNV_A_R_LINEAR_____53_CM 0. 1.9999696 DISPLAY_IDENTIFIER IP_FAC_SOI_PREV2_COR_AMP_RGN_1 FORMAT "%6.5"
 /begin AXIS_DESCR COM_AXIS amp _CNV_A_R_LINEAR_____21_CM 1 0. 5434. FORMAT "%6.2" AXIS_PTS_REF ldp_amp_ip_fac_soi_prev2_rgn_1 /end AXIS_DESCR
/end CHARACTERISTIC
/begin CHARACTERISTIC ip_fac_soi_prev1_cor_amp_rgn_1 "ASOI_MAIN_RGN: amp correction factor for SOI j during rgn" CURVE 0x84c154 _REC_CUR_20_u2_u2 1.9999696 _CNV_A_R_LINEAR_____53_CM 0. 1.9999696 DISPLAY_IDENTIFIER IP_FAC_SOI_PREV1_COR_AMP_RGN_1 FORMAT "%6.5"
 /begin AXIS_DESCR COM_AXIS amp _CNV_A_R_LINEAR_____21_CM 8 0. 5434. FORMAT "%6.2" AXIS_PTS_REF ldp_amp_ip_fac_soi_prev1_rgn_1 /end AXIS_DESCR
/end CHARACTERISTIC
/begin CHARACTERISTIC ip_fac_soi_main2_cor_amp_rgn_1 "ASOI_MAIN_RGN: amp correction factor for SOI j during rgn" CURVE 0x84c0d0 _REC_CUR_20_u2_u2 1.9999696 _CNV_A_R_LINEAR_____53_CM 0. 1.9999696 DISPLAY_IDENTIFIER IP_FAC_SOI_MAIN2_COR_AMP_RGN_1 FORMAT "%6.5"
 /begin AXIS_DESCR COM_AXIS amp _CNV_A_R_LINEAR_____21_CM 1 0. 5434. FORMAT "%6.2" AXIS_PTS_REF ldp_amp_ip_fac_soi_main2_rgn_1 /end AXIS_DESCR
/end CHARACTERISTIC
/begin CHARACTERISTIC ip_fac_soi_post1_cor_tco_rgn_1 "ASOI_MAIN_RGN: start of injection interpolation dependent on TCO during rgn" CURVE 0x84c10c _REC_CUR_20_u2_u1 1.9999696 _CNV_A_R_LINEAR_____53_CM 0. 1.9999696 DISPLAY_IDENTIFIER IP_FAC_SOI_POST1_COR_TCO_RGN_1 FORMAT "%6.5"
 /begin AXIS_DESCR COM_AXIS tco _CNV_A_R_LINEAR_____18_CM 8 -50. 205. FORMAT "%3.0" AXIS_PTS_REF ldp_tco_ip_fac_soi_post1_rgn_1 /end AXIS_DESCR
/end CHARACTERISTIC
/begin AXIS_PTS ldp_tco_ip_fac_soi_prev2_rgn_1 "TCO interpolation of soi_prev2 during regeneration" 0x842777 tco _REC_AXS_20_u1 255. _CNV_A_R_LINEAR_____18_CM 1 -50. 205. FORMAT "%3.0" /end AXIS_PTS
/begin CHARACTERISTIC ip_fac_soi_prev2_cor_tco_rgn_1 "ASOI_MAIN_RGN: start of injection interpolation dependent on TCO during rgn" CURVE 0x84c1b2 _REC_CUR_20_u2_u1 1.9999696 _CNV_A_R_LINEAR_____53_CM 0. 1.9999696 DISPLAY_IDENTIFIER IP_FAC_SOI_PREV2_COR_TCO_RGN_1 FORMAT "%6.5"
 /begin AXIS_DESCR COM_AXIS tco _CNV_A_R_LINEAR_____18_CM 1 -50. 205. FORMAT "%3.0" AXIS_PTS_REF ldp_tco_ip_fac_soi_prev2_rgn_1 /end AXIS_DESCR
/end CHARACTERISTIC
/begin CHARACTERISTIC ip_fac_soi_prev1_cor_tco_rgn_1 "ASOI_MAIN_RGN: start of injection interpolation dependent on TCO during rgn" CURVE 0x84c174 _REC_CUR_20_u2_u1 1.9999696 _CNV_A_R_LINEAR_____53_CM 0. 1.9999696 DISPLAY_IDENTIFIER IP_FAC_SOI_PREV1_COR_TCO_RGN_1 FORMAT "%6.5"
 /begin AXIS_DESCR COM_AXIS tco _CNV_A_R_LINEAR_____18_CM 8 -50. 205. FORMAT "%3.0" AXIS_PTS_REF ldp_tco_ip_fac_soi_prev1_rgn_1 /end AXIS_DESCR
/end CHARACTERISTIC
/begin CHARACTERISTIC ip_fac_soi_main2_cor_tco_rgn_1 "ASOI_MAIN_RGN: start of injection interpolation dependent on TCO during rgn" CURVE 0x84c0d4 _REC_CUR_20_u2_u1 1.9999696 _CNV_A_R_LINEAR_____53_CM 0. 1.9999696 DISPLAY_IDENTIFIER IP_FAC_SOI_MAIN2_COR_TCO_RGN_1 FORMAT "%6.5"
 /begin AXIS_DESCR COM_AXIS tco _CNV_A_R_LINEAR_____18_CM 1 -50. 205. FORMAT "%3.0" AXIS_PTS_REF ldp_tco_ip_fac_soi_main2_rgn_1 /end AXIS_DESCR
/end CHARACTERISTIC
/begin AXIS_PTS ldp_tgas_ip_fac_soi_prev2_rgn_1 "tgas correction factor of soi_prev2 during regeneration" 0x8429ee tgas _REC_AXS_20_u1 255. _CNV_A_R_LINEAR_____18_CM 1 -50. 205. FORMAT "%3.0" /end AXIS_PTS
/begin CHARACTERISTIC ip_fac_soi_prev2_cor_tgas_rgn_1 "ASOI_MAIN_RGN: TGAS correction factor for SOI j during rgn" CURVE 0x84c1b6 _REC_CUR_20_u2_u1 0.9999847412109381 _CNV_A_R_LINEAR_____14_CM 0. 0.9999847412109381 DISPLAY_IDENTIFIER IP_FAC_SOI_PREV2_COR_TGAS_RGN_1 FORMAT "%6.5"
 /begin AXIS_DESCR COM_AXIS tgas _CNV_A_R_LINEAR_____18_CM 1 -50. 205. FORMAT "%3.0" AXIS_PTS_REF ldp_tgas_ip_fac_soi_prev2_rgn_1 /end AXIS_DESCR
/end CHARACTERISTIC
/begin CHARACTERISTIC ip_fac_soi_main2_cor_tgas_rgn_1 "ASOI_MAIN_RGN: TGAS correction factor for SOI j during rgn" CURVE 0x84c0d8 _REC_CUR_20_u2_u1 0.9999847412109381 _CNV_A_R_LINEAR_____14_CM 0. 0.9999847412109381 DISPLAY_IDENTIFIER IP_FAC_SOI_MAIN2_COR_TGAS_RGN_1 FORMAT "%6.5"
 /begin AXIS_DESCR COM_AXIS tgas _CNV_A_R_LINEAR_____18_CM 1 -50. 205. FORMAT "%3.0" AXIS_PTS_REF ldp_tgas_ip_fac_soi_main2_rgn_1 /end AXIS_DESCR
/end CHARACTERISTIC
/begin CHARACTERISTIC ip_fac_soi_prev1_cor_tgas_rgn_1 "ASOI_MAIN_RGN: TGAS correction factor for SOI j during rgn" CURVE 0x84c194 _REC_CUR_20_u2_u1 0.9999847412109381 _CNV_A_R_LINEAR_____14_CM 0. 0.9999847412109381 DISPLAY_IDENTIFIER IP_FAC_SOI_PREV1_COR_TGAS_RGN_1 FORMAT "%6.5"
 /begin AXIS_DESCR COM_AXIS tgas _CNV_A_R_LINEAR_____18_CM 8 -50. 205. FORMAT "%3.0" AXIS_PTS_REF ldp_tgas_ip_fac_soi_prev1_rgn_1 /end AXIS_DESCR
/end CHARACTERISTIC
/begin CHARACTERISTIC ip_fac_soi_post1_cor_tgas_rgn_1 "ASOI_MAIN_RGN: TGAS correction factor for SOI j during rgn" CURVE 0x84c12c _REC_CUR_20_u2_u1 0.9999847412109381 _CNV_A_R_LINEAR_____14_CM 0. 0.9999847412109381 DISPLAY_IDENTIFIER IP_FAC_SOI_POST1_COR_TGAS_RGN_1 FORMAT "%6.5"
 /begin AXIS_DESCR COM_AXIS tgas _CNV_A_R_LINEAR_____18_CM 8 -50. 205. FORMAT "%3.0" AXIS_PTS_REF ldp_tgas_ip_fac_soi_post1_rgn_1 /end AXIS_DESCR
/end CHARACTERISTIC
/begin CHARACTERISTIC ip_soi_post1_dif_amp_rgn_1 "ASOI_MAIN_RGN: AMP correction of SOI j during rgn" MAP 0x858e36 _REC_MAP_20_u2_u2_u2 720. _CNV_A_R_LINEAR_____397_CM -360. 360. DISPLAY_IDENTIFIER IP_SOI_POST1_DIF_AMP_RGN_1 FORMAT "%5.2"
 /begin AXIS_DESCR COM_AXIS n _CNV_A_R_LINEAR_____5_CM 8 0. 6375. FORMAT "%4.0" AXIS_PTS_REF ldp_n_ip_soi_post1_amp_rgn_1 /end AXIS_DESCR
 /begin AXIS_DESCR COM_AXIS tqi_sp _CNV_A_R_LINEAR_____89_CM 8 -1024. 1023.96875 FORMAT "%6.2" AXIS_PTS_REF ldp_tqi_ip_soi_post1_amp_rgn_1 /end AXIS_DESCR
/end CHARACTERISTIC
/begin AXIS_PTS ldp_n_ip_soi_prev2_amp_rgn_1 "amp correction of soi_prev2 during regeneration" 0x84224e n _REC_AXS_20_u2 6375. _CNV_A_R_LINEAR_____5_CM 1 0. 6375. FORMAT "%4.0" /end AXIS_PTS
/begin CHARACTERISTIC ip_soi_prev2_dif_amp_rgn_1 "ASOI_MAIN_RGN: AMP correction of SOI j during rgn" MAP 0x85a97a _REC_MAP_20_u2_u2_u2 720. _CNV_A_R_LINEAR_____397_CM -360. 360. DISPLAY_IDENTIFIER IP_SOI_PREV2_DIF_AMP_RGN_1 FORMAT "%5.2"
 /begin AXIS_DESCR COM_AXIS n _CNV_A_R_LINEAR_____5_CM 1 0. 6375. FORMAT "%4.0" AXIS_PTS_REF ldp_n_ip_soi_prev2_amp_rgn_1 /end AXIS_DESCR
 /begin AXIS_DESCR COM_AXIS tqi_sp _CNV_A_R_LINEAR_____89_CM 1 -1024. 1023.96875 FORMAT "%6.2" AXIS_PTS_REF ldp_tqi_ip_soi_prev2_amp_rgn_1 /end AXIS_DESCR
/end CHARACTERISTIC
/begin CHARACTERISTIC ip_soi_prev1_dif_amp_rgn_1 "ASOI_MAIN_RGN: AMP correction of SOI j during rgn" MAP 0x859f1a _REC_MAP_20_u2_u2_u2 720. _CNV_A_R_LINEAR_____397_CM -360. 360. DISPLAY_IDENTIFIER IP_SOI_PREV1_DIF_AMP_RGN_1 FORMAT "%5.2"
 /begin AXIS_DESCR COM_AXIS n _CNV_A_R_LINEAR_____5_CM 8 0. 6375. FORMAT "%4.0" AXIS_PTS_REF ldp_n_ip_soi_prev1_amp_rgn_1 /end AXIS_DESCR
 /begin AXIS_DESCR COM_AXIS tqi_sp _CNV_A_R_LINEAR_____89_CM 8 -1024. 1023.96875 FORMAT "%6.2" AXIS_PTS_REF ldp_tqi_ip_soi_prev1_amp_rgn_1 /end AXIS_DESCR
/end CHARACTERISTIC
/begin CHARACTERISTIC ip_soi_main2_dif_amp_rgn_1 "ASOI_MAIN_RGN: AMP correction of SOI j during rgn" MAP 0x858784 _REC_MAP_20_u2_u2_u2 720. _CNV_A_R_LINEAR_____397_CM -360. 360. DISPLAY_IDENTIFIER IP_SOI_MAIN2_DIF_AMP_RGN_1 FORMAT "%5.2"
 /begin AXIS_DESCR COM_AXIS n _CNV_A_R_LINEAR_____5_CM 1 0. 6375. FORMAT "%4.0" AXIS_PTS_REF ldp_n_ip_soi_main2_amp_rgn_1 /end AXIS_DESCR
 /begin AXIS_DESCR COM_AXIS tqi_sp _CNV_A_R_LINEAR_____89_CM 1 -1024. 1023.96875 FORMAT "%6.2" AXIS_PTS_REF ldp_tqi_ip_soi_main2_amp_rgn_1 /end AXIS_DESCR
/end CHARACTERISTIC
/begin CHARACTERISTIC ip_soi_prev2_dif_rgn_1_0_1 "ASOI_MAIN_RGN: basic SOI of minor injection j at temp level 1 during rgn" MAP 0x85a97e _REC_MAP_20_u2_u2_u2 360. _CNV_A_R_LINEAR_____121_CM 0. 360. DISPLAY_IDENTIFIER IP_SOI_PREV2_DIF_RGN_1_0_1 FORMAT "%5.2"
 /begin AXIS_DESCR COM_AXIS n _CNV_A_R_LINEAR_____5_CM 1 0. 6375. FORMAT "%4.0" AXIS_PTS_REF ldp_n_ip_soi_prev2_dif_rgn_1_0_1 /end AXIS_DESCR
 /begin AXIS_DESCR COM_AXIS tqi_sp _CNV_A_R_LINEAR_____89_CM 1 -1024. 1023.96875 FORMAT "%6.2" AXIS_PTS_REF ldp_tqi_ip_soi_prev2_dif_rgn_1_0_1 /end AXIS_DESCR
/end CHARACTERISTIC
/begin CHARACTERISTIC ip_soi_main2_dif_rgn_1_0_1 "ASOI_MAIN_RGN: basic SOI of minor injection j at temp level 1 during rgn" MAP 0x858788 _REC_MAP_20_u2_u2_u2 360. _CNV_A_R_LINEAR_____121_CM 0. 360. DISPLAY_IDENTIFIER IP_SOI_MAIN2_DIF_RGN_1_0_1 FORMAT "%5.2"
 /begin AXIS_DESCR COM_AXIS n _CNV_A_R_LINEAR_____5_CM 1 0. 6375. FORMAT "%4.0" AXIS_PTS_REF ldp_n_ip_soi_main2_dif_rgn_1_0_1 /end AXIS_DESCR
 /begin AXIS_DESCR COM_AXIS tqi_sp _CNV_A_R_LINEAR_____89_CM 1 -1024. 1023.96875 FORMAT "%6.2" AXIS_PTS_REF ldp_tqi_ip_soi_main2_dif_rgn_1_0_1 /end AXIS_DESCR
/end CHARACTERISTIC
/begin CHARACTERISTIC ip_soi_prev1_dif_rgn_1_0_1 "ASOI_MAIN_RGN: basic SOI of minor injection j at temp level 1 during rgn" MAP 0x85a19a _REC_MAP_20_u2_u2_u2 360. _CNV_A_R_LINEAR_____121_CM 0. 360. DISPLAY_IDENTIFIER IP_SOI_PREV1_DIF_RGN_1_0_1 FORMAT "%5.2"
 /begin AXIS_DESCR COM_AXIS n _CNV_A_R_LINEAR_____5_CM 16 0. 6375. FORMAT "%4.0" AXIS_PTS_REF ldp_n_ip_soi_prev1_dif_rgn_1_0_1 /end AXIS_DESCR
 /begin AXIS_DESCR COM_AXIS tqi_sp _CNV_A_R_LINEAR_____89_CM 16 -1024. 1023.96875 FORMAT "%6.2" AXIS_PTS_REF ldp_tqi_ip_soi_prev1_dif_rgn_1_0_1 /end AXIS_DESCR
/end CHARACTERISTIC
/begin CHARACTERISTIC ip_soi_post1_dif_rgn_1_0_1 "ASOI_MAIN_RGN: basic SOI of minor injection j at temp level 1 during rgn" MAP 0x8590b6 _REC_MAP_20_u2_u2_u2 360. _CNV_A_R_LINEAR_____121_CM 0. 360. DISPLAY_IDENTIFIER IP_SOI_POST1_DIF_RGN_1_0_1 FORMAT "%5.2"
 /begin AXIS_DESCR COM_AXIS n _CNV_A_R_LINEAR_____5_CM 16 0. 6375. FORMAT "%4.0" AXIS_PTS_REF ldp_n_ip_soi_post1_dif_rgn_1_0_1 /end AXIS_DESCR
 /begin AXIS_DESCR COM_AXIS tqi_sp _CNV_A_R_LINEAR_____89_CM 16 -1024. 1023.96875 FORMAT "%6.2" AXIS_PTS_REF ldp_tqi_ip_soi_post1_dif_rgn_1_0_1 /end AXIS_DESCR
/end CHARACTERISTIC
/begin CHARACTERISTIC ip_soi_post1_dif_rgn_1_0_2 "ASOI_MAIN_RGN: basic SOI of minor injection j at temp level 2 during rgn" MAP 0x8592b6 _REC_MAP_20_u2_u2_u2 360. _CNV_A_R_LINEAR_____121_CM 0. 360. DISPLAY_IDENTIFIER IP_SOI_POST1_DIF_RGN_1_0_2 FORMAT "%5.2"
 /begin AXIS_DESCR COM_AXIS n _CNV_A_R_LINEAR_____5_CM 16 0. 6375. FORMAT "%4.0" AXIS_PTS_REF ldp_n_ip_soi_post1_dif_rgn_1_0_2 /end AXIS_DESCR
 /begin AXIS_DESCR COM_AXIS tqi_sp _CNV_A_R_LINEAR_____89_CM 16 -1024. 1023.96875 FORMAT "%6.2" AXIS_PTS_REF ldp_tqi_ip_soi_post1_dif_rgn_1_0_2 /end AXIS_DESCR
/end CHARACTERISTIC
/begin CHARACTERISTIC ip_soi_prev2_dif_rgn_1_0_2 "ASOI_MAIN_RGN: basic SOI of minor injection j at temp level 2 during rgn" MAP 0x85a980 _REC_MAP_20_u2_u2_u2 360. _CNV_A_R_LINEAR_____121_CM 0. 360. DISPLAY_IDENTIFIER IP_SOI_PREV2_DIF_RGN_1_0_2 FORMAT "%5.2"
 /begin AXIS_DESCR COM_AXIS n _CNV_A_R_LINEAR_____5_CM 1 0. 6375. FORMAT "%4.0" AXIS_PTS_REF ldp_n_ip_soi_prev2_dif_rgn_1_0_2 /end AXIS_DESCR
 /begin AXIS_DESCR COM_AXIS tqi_sp _CNV_A_R_LINEAR_____89_CM 1 -1024. 1023.96875 FORMAT "%6.2" AXIS_PTS_REF ldp_tqi_ip_soi_prev2_dif_rgn_1_0_2 /end AXIS_DESCR
/end CHARACTERISTIC
/begin CHARACTERISTIC ip_soi_prev1_dif_rgn_1_0_2 "ASOI_MAIN_RGN: basic SOI of minor injection j at temp level 2 during rgn" MAP 0x85a39a _REC_MAP_20_u2_u2_u2 360. _CNV_A_R_LINEAR_____121_CM 0. 360. DISPLAY_IDENTIFIER IP_SOI_PREV1_DIF_RGN_1_0_2 FORMAT "%5.2"
 /begin AXIS_DESCR COM_AXIS n _CNV_A_R_LINEAR_____5_CM 16 0. 6375. FORMAT "%4.0" AXIS_PTS_REF ldp_n_ip_soi_prev1_dif_rgn_1_0_2 /end AXIS_DESCR
 /begin AXIS_DESCR COM_AXIS tqi_sp _CNV_A_R_LINEAR_____89_CM 16 -1024. 1023.96875 FORMAT "%6.2" AXIS_PTS_REF ldp_tqi_ip_soi_prev1_dif_rgn_1_0_2 /end AXIS_DESCR
/end CHARACTERISTIC
/begin CHARACTERISTIC ip_soi_main2_dif_rgn_1_0_2 "ASOI_MAIN_RGN: basic SOI of minor injection j at temp level 2 during rgn" MAP 0x85878a _REC_MAP_20_u2_u2_u2 360. _CNV_A_R_LINEAR_____121_CM 0. 360. DISPLAY_IDENTIFIER IP_SOI_MAIN2_DIF_RGN_1_0_2 FORMAT "%5.2"
 /begin AXIS_DESCR COM_AXIS n _CNV_A_R_LINEAR_____5_CM 1 0. 6375. FORMAT "%4.0" AXIS_PTS_REF ldp_n_ip_soi_main2_dif_rgn_1_0_2 /end AXIS_DESCR
 /begin AXIS_DESCR COM_AXIS tqi_sp _CNV_A_R_LINEAR_____89_CM 1 -1024. 1023.96875 FORMAT "%6.2" AXIS_PTS_REF ldp_tqi_ip_soi_main2_dif_rgn_1_0_2 /end AXIS_DESCR
/end CHARACTERISTIC
/begin AXIS_PTS ldp_n_ip_soi_prev2_tgas_rgn_1 "tgas correction of soi_prev2 during regeneration" 0x842262 n _REC_AXS_20_u2 6375. _CNV_A_R_LINEAR_____5_CM 1 0. 6375. FORMAT "%4.0" /end AXIS_PTS
/begin CHARACTERISTIC ip_soi_prev2_dif_tgas_rgn_1 "ASOI_MAIN_RGN: TGAS correction of SOI j during rgn" MAP 0x85a98a _REC_MAP_20_u2_u2_u2 720. _CNV_A_R_LINEAR_____397_CM -360. 360. DISPLAY_IDENTIFIER IP_SOI_PREV2_DIF_TGAS_RGN_1 FORMAT "%5.2"
 /begin AXIS_DESCR COM_AXIS n _CNV_A_R_LINEAR_____5_CM 1 0. 6375. FORMAT "%4.0" AXIS_PTS_REF ldp_n_ip_soi_prev2_tgas_rgn_1 /end AXIS_DESCR
 /begin AXIS_DESCR COM_AXIS tqi_sp _CNV_A_R_LINEAR_____89_CM 1 -1024. 1023.96875 FORMAT "%6.2" AXIS_PTS_REF ldp_tqi_ip_soi_prev2_tgas_rgn_1 /end AXIS_DESCR
/end CHARACTERISTIC
/begin CHARACTERISTIC ip_soi_main2_dif_tgas_rgn_1 "ASOI_MAIN_RGN: TGAS correction of SOI j during rgn" MAP 0x858794 _REC_MAP_20_u2_u2_u2 720. _CNV_A_R_LINEAR_____397_CM -360. 360. DISPLAY_IDENTIFIER IP_SOI_MAIN2_DIF_TGAS_RGN_1 FORMAT "%5.2"
 /begin AXIS_DESCR COM_AXIS n _CNV_A_R_LINEAR_____5_CM 1 0. 6375. FORMAT "%4.0" AXIS_PTS_REF ldp_n_ip_soi_main2_tgas_rgn_1 /end AXIS_DESCR
 /begin AXIS_DESCR COM_AXIS tqi_sp _CNV_A_R_LINEAR_____89_CM 1 -1024. 1023.96875 FORMAT "%6.2" AXIS_PTS_REF ldp_tqi_ip_soi_main2_tgas_rgn_1 /end AXIS_DESCR
/end CHARACTERISTIC
/begin CHARACTERISTIC ip_soi_prev1_dif_tgas_rgn_1 "ASOI_MAIN_RGN: TGAS correction of SOI j during rgn" MAP 0x85a8f2 _REC_MAP_20_u2_u2_u2 720. _CNV_A_R_LINEAR_____397_CM -360. 360. DISPLAY_IDENTIFIER IP_SOI_PREV1_DIF_TGAS_RGN_1 FORMAT "%5.2"
 /begin AXIS_DESCR COM_AXIS n _CNV_A_R_LINEAR_____5_CM 8 0. 6375. FORMAT "%4.0" AXIS_PTS_REF ldp_n_ip_soi_prev1_tgas_rgn_1 /end AXIS_DESCR
 /begin AXIS_DESCR COM_AXIS tqi_sp _CNV_A_R_LINEAR_____89_CM 8 -1024. 1023.96875 FORMAT "%6.2" AXIS_PTS_REF ldp_tqi_ip_soi_prev1_tgas_rgn_1 /end AXIS_DESCR
/end CHARACTERISTIC
/begin CHARACTERISTIC ip_soi_post1_dif_tgas_rgn_1 "ASOI_MAIN_RGN: TGAS correction of SOI j during rgn" MAP 0x85980e _REC_MAP_20_u2_u2_u2 720. _CNV_A_R_LINEAR_____397_CM -360. 360. DISPLAY_IDENTIFIER IP_SOI_POST1_DIF_TGAS_RGN_1 FORMAT "%5.2"
 /begin AXIS_DESCR COM_AXIS n _CNV_A_R_LINEAR_____5_CM 8 0. 6375. FORMAT "%4.0" AXIS_PTS_REF ldp_n_ip_soi_post1_tgas_rgn_1 /end AXIS_DESCR
 /begin AXIS_DESCR COM_AXIS tqi_sp _CNV_A_R_LINEAR_____89_CM 8 -1024. 1023.96875 FORMAT "%6.2" AXIS_PTS_REF ldp_tqi_ip_soi_post1_tgas_rgn_1 /end AXIS_DESCR
/end CHARACTERISTIC
/begin CHARACTERISTIC ip_soi_prev2_dif_rgn_1_0_0 "ASOI_MAIN_RGN: basic SOI of minor injection j at rgn level k and temp level 0" MAP 0x85a97c _REC_MAP_20_u2_u2_u2 360. _CNV_A_R_LINEAR_____121_CM 0. 360. DISPLAY_IDENTIFIER IP_SOI_PREV2_DIF_RGN_1_0_0 FORMAT "%5.2"
 /begin AXIS_DESCR COM_AXIS n _CNV_A_R_LINEAR_____5_CM 1 0. 6375. FORMAT "%4.0" AXIS_PTS_REF ldpm_n_1_ip_soi_prev2_dif_rgn_1 /end AXIS_DESCR
 /begin AXIS_DESCR COM_AXIS tqi_sp _CNV_A_R_LINEAR_____89_CM 1 -1024. 1023.96875 FORMAT "%6.2" AXIS_PTS_REF ldpm_tqi_ip_soi_prev2_dif_rgn_1 /end AXIS_DESCR
/end CHARACTERISTIC
/begin CHARACTERISTIC ip_soi_prev2_dif_rgn_2_0_0 "ASOI_MAIN_RGN: basic SOI of minor injection j at rgn level k and temp level 0" MAP 0x85a982 _REC_MAP_20_u2_u2_u2 360. _CNV_A_R_LINEAR_____121_CM 0. 360. DISPLAY_IDENTIFIER IP_SOI_PREV2_DIF_RGN_2_0_0 FORMAT "%5.2"
 /begin AXIS_DESCR COM_AXIS n _CNV_A_R_LINEAR_____5_CM 1 0. 6375. FORMAT "%4.0" AXIS_PTS_REF ldpm_n_1_ip_soi_prev2_dif_rgn_2 /end AXIS_DESCR
 /begin AXIS_DESCR COM_AXIS tqi_sp _CNV_A_R_LINEAR_____89_CM 1 -1024. 1023.96875 FORMAT "%6.2" AXIS_PTS_REF ldpm_tqi_ip_soi_prev2_dif_rgn_2 /end AXIS_DESCR
/end CHARACTERISTIC
/begin CHARACTERISTIC ip_soi_main2_dif_rgn_1_0_0 "ASOI_MAIN_RGN: basic SOI of minor injection j at rgn level k and temp level 0" MAP 0x858786 _REC_MAP_20_u2_u2_u2 360. _CNV_A_R_LINEAR_____121_CM 0. 360. DISPLAY_IDENTIFIER IP_SOI_MAIN2_DIF_RGN_1_0_0 FORMAT "%5.2"
 /begin AXIS_DESCR COM_AXIS n _CNV_A_R_LINEAR_____5_CM 1 0. 6375. FORMAT "%4.0" AXIS_PTS_REF ldpm_n_1_ip_soi_main2_dif_rgn_1 /end AXIS_DESCR
 /begin AXIS_DESCR COM_AXIS tqi_sp _CNV_A_R_LINEAR_____89_CM 1 -1024. 1023.96875 FORMAT "%6.2" AXIS_PTS_REF ldpm_tqi_ip_soi_main2_dif_rgn_1 /end AXIS_DESCR
/end CHARACTERISTIC
/begin CHARACTERISTIC ip_soi_main2_dif_rgn_2_0_0 "ASOI_MAIN_RGN: basic SOI of minor injection j at rgn level k and temp level 0" MAP 0x85878c _REC_MAP_20_u2_u2_u2 360. _CNV_A_R_LINEAR_____121_CM 0. 360. DISPLAY_IDENTIFIER IP_SOI_MAIN2_DIF_RGN_2_0_0 FORMAT "%5.2"
 /begin AXIS_DESCR COM_AXIS n _CNV_A_R_LINEAR_____5_CM 1 0. 6375. FORMAT "%4.0" AXIS_PTS_REF ldpm_n_1_ip_soi_main2_dif_rgn_2 /end AXIS_DESCR
 /begin AXIS_DESCR COM_AXIS tqi_sp _CNV_A_R_LINEAR_____89_CM 1 -1024. 1023.96875 FORMAT "%6.2" AXIS_PTS_REF ldpm_tqi_ip_soi_main2_dif_rgn_2 /end AXIS_DESCR
/end CHARACTERISTIC
/begin CHARACTERISTIC ip_soi_post1_dif_rgn_1_0_0 "ASOI_MAIN_RGN: basic SOI of minor injection j at rgn level k and temp level 0" MAP 0x858eb6 _REC_MAP_20_u2_u2_u2 360. _CNV_A_R_LINEAR_____121_CM 0. 360. DISPLAY_IDENTIFIER IP_SOI_POST1_DIF_RGN_1_0_0 FORMAT "%5.2"
 /begin AXIS_DESCR COM_AXIS n _CNV_A_R_LINEAR_____5_CM 16 0. 6375. FORMAT "%4.0" AXIS_PTS_REF ldpm_n_1_ip_soi_post1_dif_rgn_1 /end AXIS_DESCR
 /begin AXIS_DESCR COM_AXIS tqi_sp _CNV_A_R_LINEAR_____89_CM 16 -1024. 1023.96875 FORMAT "%6.2" AXIS_PTS_REF ldpm_tqi_ip_soi_post1_dif_rgn_1 /end AXIS_DESCR
/end CHARACTERISTIC
/begin CHARACTERISTIC ip_soi_post1_dif_rgn_2_0_0 "ASOI_MAIN_RGN: basic SOI of minor injection j at rgn level k and temp level 0" MAP 0x8594b6 _REC_MAP_20_u2_u2_u2 360. _CNV_A_R_LINEAR_____121_CM 0. 360. DISPLAY_IDENTIFIER IP_SOI_POST1_DIF_RGN_2_0_0 FORMAT "%5.2"
 /begin AXIS_DESCR COM_AXIS n _CNV_A_R_LINEAR_____5_CM 16 0. 6375. FORMAT "%4.0" AXIS_PTS_REF ldpm_n_1_ip_soi_post1_dif_rgn_2 /end AXIS_DESCR
 /begin AXIS_DESCR COM_AXIS tqi_sp _CNV_A_R_LINEAR_____89_CM 16 -1024. 1023.96875 FORMAT "%6.2" AXIS_PTS_REF ldpm_tqi_ip_soi_post1_dif_rgn_2 /end AXIS_DESCR
/end CHARACTERISTIC
/begin CHARACTERISTIC ip_soi_prev1_dif_rgn_1_0_0 "ASOI_MAIN_RGN: basic SOI of minor injection j at rgn level k and temp level 0" MAP 0x859f9a _REC_MAP_20_u2_u2_u2 360. _CNV_A_R_LINEAR_____121_CM 0. 360. DISPLAY_IDENTIFIER IP_SOI_PREV1_DIF_RGN_1_0_0 FORMAT "%5.2"
 /begin AXIS_DESCR COM_AXIS n _CNV_A_R_LINEAR_____5_CM 16 0. 6375. FORMAT "%4.0" AXIS_PTS_REF ldpm_n_1_ip_soi_prev1_dif_rgn_1 /end AXIS_DESCR
 /begin AXIS_DESCR COM_AXIS tqi_sp _CNV_A_R_LINEAR_____89_CM 16 -1024. 1023.96875 FORMAT "%6.2" AXIS_PTS_REF ldpm_tqi_ip_soi_prev1_dif_rgn_1 /end AXIS_DESCR
/end CHARACTERISTIC
/begin CHARACTERISTIC ip_soi_prev1_dif_rgn_2_0_0 "ASOI_MAIN_RGN: basic SOI of minor injection j at rgn level k and temp level 0" MAP 0x85a59a _REC_MAP_20_u2_u2_u2 360. _CNV_A_R_LINEAR_____121_CM 0. 360. DISPLAY_IDENTIFIER IP_SOI_PREV1_DIF_RGN_2_0_0 FORMAT "%5.2"
 /begin AXIS_DESCR COM_AXIS n _CNV_A_R_LINEAR_____5_CM 16 0. 6375. FORMAT "%4.0" AXIS_PTS_REF ldpm_n_1_ip_soi_prev1_dif_rgn_2 /end AXIS_DESCR
 /begin AXIS_DESCR COM_AXIS tqi_sp _CNV_A_R_LINEAR_____89_CM 16 -1024. 1023.96875 FORMAT "%6.2" AXIS_PTS_REF ldpm_tqi_ip_soi_prev1_dif_rgn_2 /end AXIS_DESCR
/end CHARACTERISTIC
/begin AXIS_PTS ldpm_n_1_ip_soi_prev2_dif_rgn_1 "basic SOI of minor injection j at rgn level k and temp level 0" 0x8438ba n _REC_AXS_20_u2 6375. _CNV_A_R_LINEAR_____5_CM 1 0. 6375. FORMAT "%4.0" /end AXIS_PTS
/begin AXIS_PTS ldpm_n_1_ip_soi_prev2_dif_rgn_2 "basic SOI of minor injection j at rgn level k and temp level 0" 0x8438be n _REC_AXS_20_u2 6375. _CNV_A_R_LINEAR_____5_CM 1 0. 6375. FORMAT "%4.0" /end AXIS_PTS
/begin AXIS_PTS ldpm_n_1_ip_soi_main2_dif_rgn_1 "basic SOI of minor injection j at rgn level k and temp level 0" 0x8437e2 n _REC_AXS_20_u2 6375. _CNV_A_R_LINEAR_____5_CM 1 0. 6375. FORMAT "%4.0" /end AXIS_PTS
/begin AXIS_PTS ldpm_n_1_ip_soi_main2_dif_rgn_2 "basic SOI of minor injection j at rgn level k and temp level 0" 0x8437e6 n _REC_AXS_20_u2 6375. _CNV_A_R_LINEAR_____5_CM 1 0. 6375. FORMAT "%4.0" /end AXIS_PTS
/begin AXIS_PTS ldp_tqi_ip_soi_prev2_dif_rgn_1_0_1 "basic SOI of minor injection j at temp level 1 during rgn" 0x842d60 tqi_sp _REC_AXS_20_u2 2047.96875 _CNV_A_R_LINEAR_____89_CM 1 -1024. 1023.96875 FORMAT "%6.2" /end AXIS_PTS
/begin AXIS_PTS ldp_tqi_ip_soi_main2_dif_rgn_1_0_1 "basic SOI of minor injection j at temp level 1 during rgn" 0x842c80 tqi_sp _REC_AXS_20_u2 2047.96875 _CNV_A_R_LINEAR_____89_CM 1 -1024. 1023.96875 FORMAT "%6.2" /end AXIS_PTS
/begin AXIS_PTS ldp_tqi_ip_soi_prev1_dif_rgn_1_0_1 "basic SOI of minor injection j at temp level 1 during rgn" 0x842d06 tqi_sp _REC_AXS_20_u2 2047.96875 _CNV_A_R_LINEAR_____89_CM 16 -1024. 1023.96875 FORMAT "%6.2" /end AXIS_PTS
/begin AXIS_PTS ldp_tqi_ip_soi_post1_dif_rgn_1_0_1 "basic SOI of minor injection j at temp level 1 during rgn" 0x842c9e tqi_sp _REC_AXS_20_u2 2047.96875 _CNV_A_R_LINEAR_____89_CM 16 -1024. 1023.96875 FORMAT "%6.2" /end AXIS_PTS
/begin AXIS_PTS ldp_tqi_ip_soi_prev2_dif_rgn_1_0_2 "basic SOI of minor injection j at temp level 2 during rgn" 0x842d64 tqi_sp _REC_AXS_20_u2 2047.96875 _CNV_A_R_LINEAR_____89_CM 1 -1024. 1023.96875 FORMAT "%6.2" /end AXIS_PTS
/begin AXIS_PTS ldp_tqi_ip_soi_main2_dif_rgn_1_0_2 "basic SOI of minor injection j at temp level 2 during rgn" 0x842c84 tqi_sp _REC_AXS_20_u2 2047.96875 _CNV_A_R_LINEAR_____89_CM 1 -1024. 1023.96875 FORMAT "%6.2" /end AXIS_PTS
/begin AXIS_PTS ldp_tqi_ip_soi_prev1_dif_rgn_1_0_2 "basic SOI of minor injection j at temp level 2 during rgn" 0x842d28 tqi_sp _REC_AXS_20_u2 2047.96875 _CNV_A_R_LINEAR_____89_CM 16 -1024. 1023.96875 FORMAT "%6.2" /end AXIS_PTS
/begin AXIS_PTS ldp_tqi_ip_soi_post1_dif_rgn_1_0_2 "basic SOI of minor injection j at temp level 2 during rgn" 0x842cc0 tqi_sp _REC_AXS_20_u2 2047.96875 _CNV_A_R_LINEAR_____89_CM 16 -1024. 1023.96875 FORMAT "%6.2" /end AXIS_PTS
/begin AXIS_PTS ldp_tqi_ip_soi_prev2_tgas_rgn_1 "TGAS correction of SOI j during rgn" 0x842d68 tqi_sp _REC_AXS_20_u2 2047.96875 _CNV_A_R_LINEAR_____89_CM 1 -1024. 1023.96875 FORMAT "%6.2" /end AXIS_PTS
/begin AXIS_PTS ldp_tqi_ip_soi_main2_tgas_rgn_1 "TGAS correction of SOI j during rgn" 0x842c88 tqi_sp _REC_AXS_20_u2 2047.96875 _CNV_A_R_LINEAR_____89_CM 1 -1024. 1023.96875 FORMAT "%6.2" /end AXIS_PTS
/begin AXIS_PTS ldp_tqi_ip_soi_prev1_tgas_rgn_1 "TGAS correction of SOI j during rgn" 0x842d4a tqi_sp _REC_AXS_20_u2 2047.96875 _CNV_A_R_LINEAR_____89_CM 8 -1024. 1023.96875 FORMAT "%6.2" /end AXIS_PTS
/begin AXIS_PTS ldp_tqi_ip_soi_post1_tgas_rgn_1 "TGAS correction of SOI j during rgn" 0x842ce2 tqi_sp _REC_AXS_20_u2 2047.96875 _CNV_A_R_LINEAR_____89_CM 8 -1024. 1023.96875 FORMAT "%6.2" /end AXIS_PTS
/begin AXIS_PTS ldpm_n_1_ip_soi_post1_dif_rgn_1 "basic SOI of minor injection j at rgn level k and temp level 0" 0x84380c n _REC_AXS_20_u2 6375. _CNV_A_R_LINEAR_____5_CM 16 0. 6375. FORMAT "%4.0" /end AXIS_PTS
/begin AXIS_PTS ldpm_n_1_ip_soi_post1_dif_rgn_2 "basic SOI of minor injection j at rgn level k and temp level 0" 0x84382e n _REC_AXS_20_u2 6375. _CNV_A_R_LINEAR_____5_CM 16 0. 6375. FORMAT "%4.0" /end AXIS_PTS
/begin AXIS_PTS ldpm_n_1_ip_soi_prev1_dif_rgn_2 "basic SOI of minor injection j at rgn level k and temp level 0" 0x843894 n _REC_AXS_20_u2 6375. _CNV_A_R_LINEAR_____5_CM 16 0. 6375. FORMAT "%4.0" /end AXIS_PTS
/begin AXIS_PTS ldpm_n_1_ip_soi_prev1_dif_rgn_1 "basic SOI of minor injection j at rgn level k and temp level 0" 0x843872 n _REC_AXS_20_u2 6375. _CNV_A_R_LINEAR_____5_CM 16 0. 6375. FORMAT "%4.0" /end AXIS_PTS
/begin MEASUREMENT soi_prev2_dif_st "distance between MAIN1 and PREV2 at start" UWORD _CNV_A_R_LINEAR_____121_CM 1 0. 0. 360. DISPLAY_IDENTIFIER SOI_PREV2_DIF_ST ECU_ADDRESS 0x7f9ff4 BYTE_ORDER MSB_LAST FORMAT "%5.2" /end MEASUREMENT
/begin MEASUREMENT soi_main2_dif_st "distance between MAIN2 and MAIN1 at start" UWORD _CNV_A_R_LINEAR_____121_CM 1 0. 0. 360. DISPLAY_IDENTIFIER SOI_MAIN2_DIF_ST ECU_ADDRESS 0x7f9ff6 BYTE_ORDER MSB_LAST FORMAT "%5.2" /end MEASUREMENT
/begin MEASUREMENT soi_prev1_dif_st "distance between MAIN1 and PREV1 at start" UWORD _CNV_A_R_LINEAR_____121_CM 1 0. 0. 360. DISPLAY_IDENTIFIER SOI_PREV1_DIF_ST ECU_ADDRESS 0x7f9ff2 BYTE_ORDER MSB_LAST FORMAT "%5.2" /end MEASUREMENT
/begin MEASUREMENT soi_post1_dif_st "distance between POST1 and MAIN1 at start" UWORD _CNV_A_R_LINEAR_____121_CM 1 0. 0. 360. DISPLAY_IDENTIFIER SOI_POST1_DIF_ST ECU_ADDRESS 0x7f9ff8 BYTE_ORDER MSB_LAST FORMAT "%5.2" /end MEASUREMENT
/begin CHARACTERISTIC ip_fac_soi_main2_dif_st_cor_amp "SOI: AMP correction factor for SOI MAIN2 at ST" CURVE 0x84c0da _REC_CUR_20_u2_u2 3.99993896484375 _CNV_A_R_LINEAR_____15_CM 0. 3.99993896484375 DISPLAY_IDENTIFIER IP_FAC_SOI_MAIN2_DIF_ST_COR_AMP FORMAT "%6.5"
 /begin AXIS_DESCR COM_AXIS amp _CNV_A_R_LINEAR_____21_CM 1 0. 5434. FORMAT "%7.3" AXIS_PTS_REF ldp_amp_2_inj_x /end AXIS_DESCR
/end CHARACTERISTIC
/begin CHARACTERISTIC ip_fac_soi_post1_dif_st_cor_amp "SOI: AMP correction factor for SOI POST1 at ST" CURVE 0x84c13c _REC_CUR_20_u2_u2 3.99993896484375 _CNV_A_R_LINEAR_____15_CM 0. 3.99993896484375 DISPLAY_IDENTIFIER IP_FAC_SOI_POST1_DIF_ST_COR_AMP FORMAT "%6.5"
 /begin AXIS_DESCR COM_AXIS amp _CNV_A_R_LINEAR_____21_CM 4 0. 5434. FORMAT "%6.2" AXIS_PTS_REF ldpm_amp_2_inj /end AXIS_DESCR
/end CHARACTERISTIC
/begin CHARACTERISTIC ip_fac_soi_prev1_dif_st_cor_amp "SOI: AMP correction factor for SOI PREV1 at ST" CURVE 0x84c1a4 _REC_CUR_20_u2_u2 3.99993896484375 _CNV_A_R_LINEAR_____15_CM 0. 3.99993896484375 DISPLAY_IDENTIFIER IP_FAC_SOI_PREV1_DIF_ST_COR_AMP FORMAT "%6.5"
 /begin AXIS_DESCR COM_AXIS amp _CNV_A_R_LINEAR_____21_CM 4 0. 5434. FORMAT "%6.2" AXIS_PTS_REF ldpm_amp_2_inj /end AXIS_DESCR
/end CHARACTERISTIC
/begin CHARACTERISTIC ip_fac_soi_prev2_dif_st_cor_amp "SOI: AMP correction factor for SOI PREV2 at ST" CURVE 0x84c1b8 _REC_CUR_20_u2_u2 3.99993896484375 _CNV_A_R_LINEAR_____15_CM 0. 3.99993896484375 DISPLAY_IDENTIFIER IP_FAC_SOI_PREV2_DIF_ST_COR_AMP FORMAT "%6.5"
 /begin AXIS_DESCR COM_AXIS amp _CNV_A_R_LINEAR_____21_CM 1 0. 5434. FORMAT "%7.3" AXIS_PTS_REF ldp_amp_2_inj_x /end AXIS_DESCR
/end CHARACTERISTIC
/begin CHARACTERISTIC ip_soi_main2_dif_st "SOI: Distance between MAIN2 and MAIN1 at ST" MAP 0x85878e _REC_MAP_20_u2_u2_u1 360. _CNV_A_R_LINEAR_____121_CM 0. 360. DISPLAY_IDENTIFIER IP_SOI_MAIN2_DIF_ST FORMAT "%6.5"
 /begin AXIS_DESCR COM_AXIS n _CNV_A_R_LINEAR_____5_CM 1 0. 6375. FORMAT "%4.0" AXIS_PTS_REF ldp_n_3_inj_x /end AXIS_DESCR
 /begin AXIS_DESCR COM_AXIS tco _CNV_A_R_LINEAR_____18_CM 1 -50. 205. FORMAT "%3.0" AXIS_PTS_REF ldp_tco_2_inj_x /end AXIS_DESCR
/end CHARACTERISTIC
/begin CHARACTERISTIC ip_soi_post1_dif_st "SOI: Distance between POST1 and MAIN1 at ST" MAP 0x8596b6 _REC_MAP_20_u2_u2_u1 360. _CNV_A_R_LINEAR_____121_CM 0. 360. DISPLAY_IDENTIFIER IP_SOI_POST1_DIF_ST FORMAT "%6.5"
 /begin AXIS_DESCR COM_AXIS n _CNV_A_R_LINEAR_____5_CM 7 0. 6375. FORMAT "%4.0" AXIS_PTS_REF ldpm_n_3_inj /end AXIS_DESCR
 /begin AXIS_DESCR COM_AXIS tco _CNV_A_R_LINEAR_____18_CM 12 -50. 205. FORMAT "%3.0" AXIS_PTS_REF ldpm_tco_2_inj /end AXIS_DESCR
/end CHARACTERISTIC
/begin CHARACTERISTIC ip_soi_prev1_dif_st "SOI: Distance between PREV1 and MAIN1 at ST" MAP 0x85a79a _REC_MAP_20_u2_u2_u1 360. _CNV_A_R_LINEAR_____121_CM 0. 360. DISPLAY_IDENTIFIER IP_SOI_PREV1_DIF_ST FORMAT "%6.5"
 /begin AXIS_DESCR COM_AXIS n _CNV_A_R_LINEAR_____5_CM 7 0. 6375. FORMAT "%4.0" AXIS_PTS_REF ldpm_n_3_inj /end AXIS_DESCR
 /begin AXIS_DESCR COM_AXIS tco _CNV_A_R_LINEAR_____18_CM 12 -50. 205. FORMAT "%3.0" AXIS_PTS_REF ldpm_tco_2_inj /end AXIS_DESCR
/end CHARACTERISTIC
/begin CHARACTERISTIC ip_soi_prev2_dif_st "SOI: Distance between PREV2 and MAIN1 at ST" MAP 0x85a984 _REC_MAP_20_u2_u2_u1 360. _CNV_A_R_LINEAR_____121_CM 0. 360. DISPLAY_IDENTIFIER IP_SOI_PREV2_DIF_ST FORMAT "%6.5"
 /begin AXIS_DESCR COM_AXIS n _CNV_A_R_LINEAR_____5_CM 1 0. 6375. FORMAT "%4.0" AXIS_PTS_REF ldp_n_3_inj_x /end AXIS_DESCR
 /begin AXIS_DESCR COM_AXIS tco _CNV_A_R_LINEAR_____18_CM 1 -50. 205. FORMAT "%3.0" AXIS_PTS_REF ldp_tco_2_inj_x /end AXIS_DESCR
/end CHARACTERISTIC
/begin CHARACTERISTIC ip_soi_main2_dif_st_cor_amp "SOI: AMP correction of distance between MAIN2 and MAIN1 at ST" MAP 0x858790 _REC_MAP_20_u2_u2_u1 720. _CNV_A_R_LINEAR_____397_CM -360. 360. DISPLAY_IDENTIFIER IP_SOI_MAIN2_DIF_ST_COR_AMP FORMAT "%6.5"
 /begin AXIS_DESCR COM_AXIS n _CNV_A_R_LINEAR_____5_CM 1 0. 6375. FORMAT "%4.0" AXIS_PTS_REF ldp_n_4_inj_x /end AXIS_DESCR
 /begin AXIS_DESCR COM_AXIS tco _CNV_A_R_LINEAR_____18_CM 1 -50. 205. FORMAT "%3.0" AXIS_PTS_REF ldp_tco_3_inj_x /end AXIS_DESCR
/end CHARACTERISTIC
/begin CHARACTERISTIC ip_soi_post1_dif_st_cor_amp "SOI: AMP correction of distance between POST1 and MAIN1 at ST" MAP 0x85975e _REC_MAP_20_u2_u2_u1 720. _CNV_A_R_LINEAR_____397_CM -360. 360. DISPLAY_IDENTIFIER IP_SOI_POST1_DIF_ST_COR_AMP FORMAT "%6.5"
 /begin AXIS_DESCR COM_AXIS n _CNV_A_R_LINEAR_____5_CM 4 0. 6375. FORMAT "%4.0" AXIS_PTS_REF ldpm_n_4_inj /end AXIS_DESCR
 /begin AXIS_DESCR COM_AXIS tco _CNV_A_R_LINEAR_____18_CM 6 -50. 205. FORMAT "%3.0" AXIS_PTS_REF ldpm_tco_3_inj /end AXIS_DESCR
/end CHARACTERISTIC
/begin CHARACTERISTIC ip_soi_prev1_dif_st_cor_amp "SOI: AMP correction of distance between PREV1 and MAIN1 at ST" MAP 0x85a842 _REC_MAP_20_u2_u2_u1 720. _CNV_A_R_LINEAR_____397_CM -360. 360. DISPLAY_IDENTIFIER IP_SOI_PREV1_DIF_ST_COR_AMP FORMAT "%6.5"
 /begin AXIS_DESCR COM_AXIS n _CNV_A_R_LINEAR_____5_CM 4 0. 6375. FORMAT "%4.0" AXIS_PTS_REF ldpm_n_4_inj /end AXIS_DESCR
 /begin AXIS_DESCR COM_AXIS tco _CNV_A_R_LINEAR_____18_CM 6 -50. 205. FORMAT "%3.0" AXIS_PTS_REF ldpm_tco_3_inj /end AXIS_DESCR
/end CHARACTERISTIC
/begin CHARACTERISTIC ip_soi_prev2_dif_st_cor_amp "SOI: AMP correction of distance between PREV2 and MAIN1 at ST" MAP 0x85a986 _REC_MAP_20_u2_u2_u1 720. _CNV_A_R_LINEAR_____397_CM -360. 360. DISPLAY_IDENTIFIER IP_SOI_PREV2_DIF_ST_COR_AMP FORMAT "%6.5"
 /begin AXIS_DESCR COM_AXIS n _CNV_A_R_LINEAR_____5_CM 1 0. 6375. FORMAT "%4.0" AXIS_PTS_REF ldp_n_4_inj_x /end AXIS_DESCR
 /begin AXIS_DESCR COM_AXIS tco _CNV_A_R_LINEAR_____18_CM 1 -50. 205. FORMAT "%3.0" AXIS_PTS_REF ldp_tco_3_inj_x /end AXIS_DESCR
/end CHARACTERISTIC
/begin MEASUREMENT soi_prev1_dif_bas_sel "distance between MAIN1 and PREV1 after temperature selection" UWORD _CNV_A_R_LINEAR_____121_CM 1 0. 0. 360. DISPLAY_IDENTIFIER SOI_PREV1_DIF_BAS_SEL ECU_ADDRESS 0x7f9fd2 BYTE_ORDER MSB_LAST FORMAT "%6.5" /end MEASUREMENT
/begin MEASUREMENT soi_main2_dif_bas_sel "distance between MAIN1 and MAIN2 after temperature selection" UWORD _CNV_A_R_LINEAR_____121_CM 1 0. 0. 360. DISPLAY_IDENTIFIER SOI_MAIN2_DIF_BAS_SEL ECU_ADDRESS 0x7f9fd6 BYTE_ORDER MSB_LAST FORMAT "%6.5" /end MEASUREMENT
/begin MEASUREMENT soi_prev2_dif_bas_sel "distance between MAIN1 and PREV2 after temperature selection" UWORD _CNV_A_R_LINEAR_____121_CM 1 0. 0. 360. DISPLAY_IDENTIFIER SOI_PREV2_DIF_BAS_SEL ECU_ADDRESS 0x7f9fd4 BYTE_ORDER MSB_LAST FORMAT "%6.5" /end MEASUREMENT
/begin MEASUREMENT soi_post1_dif_bas_sel "distance between MAIN1 and POST1 after temperature selection" UWORD _CNV_A_R_LINEAR_____121_CM 1 0. 0. 360. DISPLAY_IDENTIFIER SOI_POST1_DIF_BAS_SEL ECU_ADDRESS 0x7f9fd8 BYTE_ORDER MSB_LAST FORMAT "%6.5" /end MEASUREMENT
/begin CHARACTERISTIC c_t_rgn_trn_soi_post1 "time constant of rgn transition of soi j" VALUE 0x85c12a _REC_VAL_20_u2 4.19424 _CNV_A_R_LINEAR_____67_CM 0. 4.19424 DISPLAY_IDENTIFIER C_T_RGN_TRN_SOI_POST1 FORMAT "%7.5" /end CHARACTERISTIC
/begin CHARACTERISTIC c_t_rgn_trn_soi_prev1 "time constant of rgn transition of soi j" VALUE 0x85c12c _REC_VAL_20_u2 4.19424 _CNV_A_R_LINEAR_____67_CM 0. 4.19424 DISPLAY_IDENTIFIER C_T_RGN_TRN_SOI_PREV1 FORMAT "%7.5" /end CHARACTERISTIC
/begin CHARACTERISTIC c_t_rgn_trn_soi_main2 "time constant of rgn transition of soi j" VALUE 0x85c128 _REC_VAL_20_u2 4.19424 _CNV_A_R_LINEAR_____67_CM 0. 4.19424 DISPLAY_IDENTIFIER C_T_RGN_TRN_SOI_MAIN2 FORMAT "%7.5" /end CHARACTERISTIC
/begin MEASUREMENT soi_prev1_dif_is_pl "" UWORD _CNV_A_R_LINEAR_____121_CM 1 0. 0. 360. DISPLAY_IDENTIFIER SOI_PREV1_DIF_IS_PL ECU_ADDRESS 0x7f9fda BYTE_ORDER MSB_LAST FORMAT "%5.2" /end MEASUREMENT
/begin MEASUREMENT soi_prev2_dif_is_pl "" UWORD _CNV_A_R_LINEAR_____121_CM 1 0. 0. 360. DISPLAY_IDENTIFIER SOI_PREV2_DIF_IS_PL ECU_ADDRESS 0x7f9fdc BYTE_ORDER MSB_LAST FORMAT "%5.2" /end MEASUREMENT
/begin MEASUREMENT soi_main2_dif_is_pl "" UWORD _CNV_A_R_LINEAR_____121_CM 1 0. 0. 360. DISPLAY_IDENTIFIER SOI_MAIN2_DIF_IS_PL ECU_ADDRESS 0x7f9fde BYTE_ORDER MSB_LAST FORMAT "%5.2" /end MEASUREMENT
/begin MEASUREMENT soi_post1_dif_is_pl "" UWORD _CNV_A_R_LINEAR_____121_CM 1 0. 0. 360. DISPLAY_IDENTIFIER SOI_POST1_DIF_IS_PL ECU_ADDRESS 0x7f9fe0 BYTE_ORDER MSB_LAST FORMAT "%5.2" /end MEASUREMENT
/begin CHARACTERISTIC c_t_rgn_trn_soi_prev2 "" VALUE 0x85c12e _REC_VAL_20_u2 4.19424 _CNV_A_R_LINEAR_____67_CM 0. 4.19424 DISPLAY_IDENTIFIER C_T_RGN_TRN_SOI_PREV2 FORMAT "%6.5" /end CHARACTERISTIC
/begin MEASUREMENT soi_prev1_cor "SOI correction of Injection PREV1" SWORD _CNV_A_R_LINEAR_____121_CM 1 0. -360. 360. DISPLAY_IDENTIFIER SOI_PREV1_COR ECU_ADDRESS 0x7fb072 BYTE_ORDER MSB_LAST FORMAT "%5.2" /end MEASUREMENT
/begin MEASUREMENT soi_prev2_cor "SOI correction of Injection PREV2" SWORD _CNV_A_R_LINEAR_____121_CM 1 0. -360. 360. DISPLAY_IDENTIFIER SOI_PREV2_COR ECU_ADDRESS 0x7f9ffc BYTE_ORDER MSB_LAST FORMAT "%5.2" /end MEASUREMENT
/begin MEASUREMENT soi_main2_cor "SOI correction of Injection MAIN2" SWORD _CNV_A_R_LINEAR_____121_CM 1 0. -360. 360. DISPLAY_IDENTIFIER SOI_MAIN2_COR ECU_ADDRESS 0x7f9ffe BYTE_ORDER MSB_LAST FORMAT "%5.2" /end MEASUREMENT
/begin MEASUREMENT soi_post1_cor "SOI correction of Injection POST1" SWORD _CNV_A_R_LINEAR_____121_CM 1 0. -360. 360. DISPLAY_IDENTIFIER SOI_POST1_COR ECU_ADDRESS 0x7fb0aa BYTE_ORDER MSB_LAST FORMAT "%5.2" /end MEASUREMENT
/begin MEASUREMENT soi_main1_cor_conf_1 "SOI correction of Injection MAIN1, configuration 1" SWORD _CNV_A_R_LINEAR_____121_CM 1 0. -360. 360. DISPLAY_IDENTIFIER SOI_MAIN1_COR_CONF_1 ECU_ADDRESS 0x7fa002 BYTE_ORDER MSB_LAST FORMAT "%5.2" /end MEASUREMENT
/begin MEASUREMENT soi_main1_cor_conf_2 "SOI correction of Injection MAIN1, configuration 2" SWORD _CNV_A_R_LINEAR_____121_CM 1 0. -360. 360. DISPLAY_IDENTIFIER SOI_MAIN1_COR_CONF_2 ECU_ADDRESS 0x7fa004 BYTE_ORDER MSB_LAST FORMAT "%5.2" /end MEASUREMENT
/begin MEASUREMENT soi_main1_cor_conf_0 "SOI correction of Injection MAIN1, configuration 0" SWORD _CNV_A_R_LINEAR_____121_CM 1 0. -360. 360. DISPLAY_IDENTIFIER SOI_MAIN1_COR_CONF_0 ECU_ADDRESS 0x7fa006 BYTE_ORDER MSB_LAST FORMAT "%5.2" /end MEASUREMENT
/begin MEASUREMENT soi_main1_cor_conf_3 "SOI correction of Injection MAIN1, configuration 3" SWORD _CNV_A_R_LINEAR_____121_CM 1 0. -360. 360. DISPLAY_IDENTIFIER SOI_MAIN1_COR_CONF_3 ECU_ADDRESS 0x7fa008 BYTE_ORDER MSB_LAST FORMAT "%5.2" /end MEASUREMENT
/begin MEASUREMENT soi_main1_cor_conf_4 "SOI correction of Injection MAIN1, configuration 4" SWORD _CNV_A_R_LINEAR_____121_CM 1 0. -360. 360. DISPLAY_IDENTIFIER SOI_MAIN1_COR_CONF_4 ECU_ADDRESS 0x7fa00a BYTE_ORDER MSB_LAST FORMAT "%5.2" /end MEASUREMENT
/begin CHARACTERISTIC ip_soi_main1_cor_fup_tra_dif "SOI_COR: FUP_TRA_DIF correction for SOI_MAIN1" CURVE 0x8572f6 _REC_CUR_20_u2_u2 720. _CNV_A_R_LINEAR_____397_CM -360. 360. DISPLAY_IDENTIFIER IP_SOI_MAIN1_COR_FUP_TRA_DIF FORMAT "%5.2"
 /begin AXIS_DESCR COM_AXIS fup_tra_dif _CNV_A_R_LINEAR_____119_CM 8 -100. 99.99694820000001 FORMAT "%7.3" AXIS_PTS_REF ldpm_fup_tra_dif_1_inj /end AXIS_DESCR
/end CHARACTERISTIC
/begin MEASUREMENT soi_prev1_dif_min "Minimal distance between MAIN1 and PREV1" UWORD _CNV_A_R_LINEAR_____121_CM 1 0. 0. 360. DISPLAY_IDENTIFIER SOI_PREV1_DIF_MIN ECU_ADDRESS 0x7fa00c BYTE_ORDER MSB_LAST FORMAT "%5.2" /end MEASUREMENT
/begin MEASUREMENT soi_prev2_dif_min "Minimal distance between MAIN1 and PREV2" UWORD _CNV_A_R_LINEAR_____121_CM 1 0. 0. 360. DISPLAY_IDENTIFIER SOI_PREV2_DIF_MIN ECU_ADDRESS 0x7fa00e BYTE_ORDER MSB_LAST FORMAT "%5.2" /end MEASUREMENT
/begin MEASUREMENT soi_main2_dif_min "Minimal distance between MAIN1 and MAIN2" UWORD _CNV_A_R_LINEAR_____121_CM 1 0. 0. 360. DISPLAY_IDENTIFIER SOI_MAIN2_DIF_MIN ECU_ADDRESS 0x7fa010 BYTE_ORDER MSB_LAST FORMAT "%5.2" /end MEASUREMENT
/begin MEASUREMENT soi_post1_dif_min "Minimal distance between MAIN1 and POST1" UWORD _CNV_A_R_LINEAR_____121_CM 1 0. 0. 360. DISPLAY_IDENTIFIER SOI_POST1_DIF_MIN ECU_ADDRESS 0x7fa012 BYTE_ORDER MSB_LAST FORMAT "%5.2" /end MEASUREMENT
/begin MEASUREMENT soi_prev1_dif_max "Maximal distance between MAIN1 and PREV1" UWORD _CNV_A_R_LINEAR_____121_CM 1 0. 0. 360. DISPLAY_IDENTIFIER SOI_PREV1_DIF_MAX ECU_ADDRESS 0x7fa014 BYTE_ORDER MSB_LAST FORMAT "%5.2" /end MEASUREMENT
/begin MEASUREMENT soi_prev2_dif_max "Maximal distance between MAIN1 and PREV2" UWORD _CNV_A_R_LINEAR_____121_CM 1 0. 0. 360. DISPLAY_IDENTIFIER SOI_PREV2_DIF_MAX ECU_ADDRESS 0x7fa016 BYTE_ORDER MSB_LAST FORMAT "%5.2" /end MEASUREMENT
/begin MEASUREMENT soi_main2_dif_max "Maximal distance between MAIN1 and MAIN2" UWORD _CNV_A_R_LINEAR_____121_CM 1 0. 0. 360. DISPLAY_IDENTIFIER SOI_MAIN2_DIF_MAX ECU_ADDRESS 0x7fa018 BYTE_ORDER MSB_LAST FORMAT "%5.2" /end MEASUREMENT
/begin MEASUREMENT soi_post1_dif_max "Maximal distance between MAIN1 and POST1" UWORD _CNV_A_R_LINEAR_____121_CM 1 0. 0. 360. DISPLAY_IDENTIFIER SOI_POST1_DIF_MAX ECU_ADDRESS 0x7fa01a BYTE_ORDER MSB_LAST FORMAT "%5.2" /end MEASUREMENT
/begin CHARACTERISTIC c_fac_soi_prev1_tu "" VALUE 0x85be76 _REC_VAL_20_u2 1.9999696 _CNV_A_R_LINEAR_____53_CM 0. 1.9999696 DISPLAY_IDENTIFIER C_FAC_SOI_PREV1_TU FORMAT "%5.4" /end CHARACTERISTIC
/begin CHARACTERISTIC lc_soi_prev1_tu_on "" VALUE 0x85c35f _REC_VAL_20_u1 1. _CNV_A_R_LINEAR_____0_CM 0. 1. DISPLAY_IDENTIFIER LC_SOI_PREV1_TU_ON FORMAT "%1.0" /end CHARACTERISTIC
/begin CHARACTERISTIC c_soi_prev1_add_tu "" VALUE 0x85c054 _REC_VAL_20_s2 720. _CNV_A_R_LINEAR_____121_CM -360. 360. DISPLAY_IDENTIFIER C_SOI_PREV1_ADD_TU FORMAT "%6.2" /end CHARACTERISTIC
/begin CHARACTERISTIC c_soi_prev1_add_tu_cyl[0] "" VALUE 0x85c056 _REC_VAL_20_s2 720. _CNV_A_R_LINEAR_____121_CM -360. 360. DISPLAY_IDENTIFIER C_SOI_PREV1_ADD_TU_CYL_0_ FORMAT "%6.2" /end CHARACTERISTIC
/begin CHARACTERISTIC c_soi_prev1_add_tu_cyl[1] "" VALUE 0x85c058 _REC_VAL_20_s2 720. _CNV_A_R_LINEAR_____121_CM -360. 360. DISPLAY_IDENTIFIER C_SOI_PREV1_ADD_TU_CYL_1_ FORMAT "%6.2" /end CHARACTERISTIC
/begin CHARACTERISTIC c_soi_prev1_add_tu_cyl[2] "" VALUE 0x85c05a _REC_VAL_20_s2 720. _CNV_A_R_LINEAR_____121_CM -360. 360. DISPLAY_IDENTIFIER C_SOI_PREV1_ADD_TU_CYL_2_ FORMAT "%6.2" /end CHARACTERISTIC
/begin CHARACTERISTIC c_soi_prev1_add_tu_cyl[3] "" VALUE 0x85c05c _REC_VAL_20_s2 720. _CNV_A_R_LINEAR_____121_CM -360. 360. DISPLAY_IDENTIFIER C_SOI_PREV1_ADD_TU_CYL_3_ FORMAT "%6.2" /end CHARACTERISTIC
/begin CHARACTERISTIC c_fac_soi_prev2_tu "" VALUE 0x85be78 _REC_VAL_20_u2 1.9999696 _CNV_A_R_LINEAR_____53_CM 0. 1.9999696 DISPLAY_IDENTIFIER C_FAC_SOI_PREV2_TU FORMAT "%5.4" /end CHARACTERISTIC
/begin CHARACTERISTIC lc_soi_prev2_tu_on "" VALUE 0x85c360 _REC_VAL_20_u1 1. _CNV_A_R_LINEAR_____0_CM 0. 1. DISPLAY_IDENTIFIER LC_SOI_PREV2_TU_ON FORMAT "%1.0" /end CHARACTERISTIC
/begin CHARACTERISTIC c_soi_prev2_add_tu "" VALUE 0x85c05e _REC_VAL_20_s2 720. _CNV_A_R_LINEAR_____121_CM -360. 360. DISPLAY_IDENTIFIER C_SOI_PREV2_ADD_TU FORMAT "%6.2" /end CHARACTERISTIC
/begin CHARACTERISTIC c_soi_prev2_add_tu_cyl[0] "" VALUE 0x85c060 _REC_VAL_20_s2 720. _CNV_A_R_LINEAR_____121_CM -360. 360. DISPLAY_IDENTIFIER C_SOI_PREV2_ADD_TU_CYL_0_ FORMAT "%6.2" /end CHARACTERISTIC
/begin CHARACTERISTIC c_soi_prev2_add_tu_cyl[1] "" VALUE 0x85c062 _REC_VAL_20_s2 720. _CNV_A_R_LINEAR_____121_CM -360. 360. DISPLAY_IDENTIFIER C_SOI_PREV2_ADD_TU_CYL_1_ FORMAT "%6.2" /end CHARACTERISTIC
/begin CHARACTERISTIC c_soi_prev2_add_tu_cyl[2] "" VALUE 0x85c064 _REC_VAL_20_s2 720. _CNV_A_R_LINEAR_____121_CM -360. 360. DISPLAY_IDENTIFIER C_SOI_PREV2_ADD_TU_CYL_2_ FORMAT "%6.2" /end CHARACTERISTIC
/begin CHARACTERISTIC c_soi_prev2_add_tu_cyl[3] "" VALUE 0x85c066 _REC_VAL_20_s2 720. _CNV_A_R_LINEAR_____121_CM -360. 360. DISPLAY_IDENTIFIER C_SOI_PREV2_ADD_TU_CYL_3_ FORMAT "%6.2" /end CHARACTERISTIC
/begin CHARACTERISTIC c_fac_soi_main1_tu "" VALUE 0x85be6e _REC_VAL_20_u2 1.9999696 _CNV_A_R_LINEAR_____53_CM 0. 1.9999696 DISPLAY_IDENTIFIER C_FAC_SOI_MAIN1_TU FORMAT "%5.4" /end CHARACTERISTIC
/begin CHARACTERISTIC lc_soi_main1_tu_on "" VALUE 0x85c35b _REC_VAL_20_u1 1. _CNV_A_R_LINEAR_____0_CM 0. 1. DISPLAY_IDENTIFIER LC_SOI_MAIN1_TU_ON FORMAT "%1.0" /end CHARACTERISTIC
/begin CHARACTERISTIC c_soi_main1_add_tu "" VALUE 0x85c02a _REC_VAL_20_s2 720. _CNV_A_R_LINEAR_____121_CM -360. 360. DISPLAY_IDENTIFIER C_SOI_MAIN1_ADD_TU FORMAT "%6.2" /end CHARACTERISTIC
/begin CHARACTERISTIC c_soi_main1_add_tu_cyl[0] "" VALUE 0x85c02c _REC_VAL_20_s2 720. _CNV_A_R_LINEAR_____121_CM -360. 360. DISPLAY_IDENTIFIER C_SOI_MAIN1_ADD_TU_CYL_0_ FORMAT "%6.2" /end CHARACTERISTIC
/begin CHARACTERISTIC c_soi_main1_add_tu_cyl[1] "" VALUE 0x85c02e _REC_VAL_20_s2 720. _CNV_A_R_LINEAR_____121_CM -360. 360. DISPLAY_IDENTIFIER C_SOI_MAIN1_ADD_TU_CYL_1_ FORMAT "%6.2" /end CHARACTERISTIC
/begin CHARACTERISTIC c_soi_main1_add_tu_cyl[2] "" VALUE 0x85c030 _REC_VAL_20_s2 720. _CNV_A_R_LINEAR_____121_CM -360. 360. DISPLAY_IDENTIFIER C_SOI_MAIN1_ADD_TU_CYL_2_ FORMAT "%6.2" /end CHARACTERISTIC
/begin CHARACTERISTIC c_soi_main1_add_tu_cyl[3] "" VALUE 0x85c032 _REC_VAL_20_s2 720. _CNV_A_R_LINEAR_____121_CM -360. 360. DISPLAY_IDENTIFIER C_SOI_MAIN1_ADD_TU_CYL_3_ FORMAT "%6.2" /end CHARACTERISTIC
/begin CHARACTERISTIC c_fac_soi_main2_tu "" VALUE 0x85be70 _REC_VAL_20_u2 1.9999696 _CNV_A_R_LINEAR_____53_CM 0. 1.9999696 DISPLAY_IDENTIFIER C_FAC_SOI_MAIN2_TU FORMAT "%5.4" /end CHARACTERISTIC
/begin CHARACTERISTIC lc_soi_main2_tu_on "" VALUE 0x85c35c _REC_VAL_20_u1 1. _CNV_A_R_LINEAR_____0_CM 0. 1. DISPLAY_IDENTIFIER LC_SOI_MAIN2_TU_ON FORMAT "%1.0" /end CHARACTERISTIC
/begin CHARACTERISTIC c_soi_main2_add_tu "" VALUE 0x85c034 _REC_VAL_20_s2 720. _CNV_A_R_LINEAR_____121_CM -360. 360. DISPLAY_IDENTIFIER C_SOI_MAIN2_ADD_TU FORMAT "%6.2" /end CHARACTERISTIC
/begin CHARACTERISTIC c_soi_main2_add_tu_cyl[0] "" VALUE 0x85c036 _REC_VAL_20_s2 720. _CNV_A_R_LINEAR_____121_CM -360. 360. DISPLAY_IDENTIFIER C_SOI_MAIN2_ADD_TU_CYL_0_ FORMAT "%6.2" /end CHARACTERISTIC
/begin CHARACTERISTIC c_soi_main2_add_tu_cyl[1] "" VALUE 0x85c038 _REC_VAL_20_s2 720. _CNV_A_R_LINEAR_____121_CM -360. 360. DISPLAY_IDENTIFIER C_SOI_MAIN2_ADD_TU_CYL_1_ FORMAT "%6.2" /end CHARACTERISTIC
/begin CHARACTERISTIC c_soi_main2_add_tu_cyl[2] "" VALUE 0x85c03a _REC_VAL_20_s2 720. _CNV_A_R_LINEAR_____121_CM -360. 360. DISPLAY_IDENTIFIER C_SOI_MAIN2_ADD_TU_CYL_2_ FORMAT "%6.2" /end CHARACTERISTIC
/begin CHARACTERISTIC c_soi_main2_add_tu_cyl[3] "" VALUE 0x85c03c _REC_VAL_20_s2 720. _CNV_A_R_LINEAR_____121_CM -360. 360. DISPLAY_IDENTIFIER C_SOI_MAIN2_ADD_TU_CYL_3_ FORMAT "%6.2" /end CHARACTERISTIC
/begin CHARACTERISTIC c_soi_main1_test_add_tu[0] "" VALUE 0x848808 _REC_VAL_20_s2 720. _CNV_A_R_LINEAR_____121_CM -360. 360. DISPLAY_IDENTIFIER C_SOI_MAIN1_TEST_ADD_TU_0_ FORMAT "%6.2" /end CHARACTERISTIC
/begin CHARACTERISTIC c_soi_main1_test_add_tu[1] "" VALUE 0x84880a _REC_VAL_20_s2 720. _CNV_A_R_LINEAR_____121_CM -360. 360. DISPLAY_IDENTIFIER C_SOI_MAIN1_TEST_ADD_TU_1_ FORMAT "%6.2" /end CHARACTERISTIC
/begin CHARACTERISTIC c_soi_main1_test_add_tu[2] "" VALUE 0x84880c _REC_VAL_20_s2 720. _CNV_A_R_LINEAR_____121_CM -360. 360. DISPLAY_IDENTIFIER C_SOI_MAIN1_TEST_ADD_TU_2_ FORMAT "%6.2" /end CHARACTERISTIC
/begin CHARACTERISTIC c_soi_main1_test_add_tu[3] "" VALUE 0x84880e _REC_VAL_20_s2 720. _CNV_A_R_LINEAR_____121_CM -360. 360. DISPLAY_IDENTIFIER C_SOI_MAIN1_TEST_ADD_TU_3_ FORMAT "%6.2" /end CHARACTERISTIC
/begin CHARACTERISTIC c_soi_main2_test_add_tu[0] "" VALUE 0x8487f8 _REC_VAL_20_s2 720. _CNV_A_R_LINEAR_____121_CM -360. 360. DISPLAY_IDENTIFIER C_SOI_MAIN2_TEST_ADD_TU_0_ FORMAT "%6.2" /end CHARACTERISTIC
/begin CHARACTERISTIC c_soi_main2_test_add_tu[1] "" VALUE 0x8487fa _REC_VAL_20_s2 720. _CNV_A_R_LINEAR_____121_CM -360. 360. DISPLAY_IDENTIFIER C_SOI_MAIN2_TEST_ADD_TU_1_ FORMAT "%6.2" /end CHARACTERISTIC
/begin CHARACTERISTIC c_soi_main2_test_add_tu[2] "" VALUE 0x8487fc _REC_VAL_20_s2 720. _CNV_A_R_LINEAR_____121_CM -360. 360. DISPLAY_IDENTIFIER C_SOI_MAIN2_TEST_ADD_TU_2_ FORMAT "%6.2" /end CHARACTERISTIC
/begin CHARACTERISTIC c_soi_main2_test_add_tu[3] "" VALUE 0x8487fe _REC_VAL_20_s2 720. _CNV_A_R_LINEAR_____121_CM -360. 360. DISPLAY_IDENTIFIER C_SOI_MAIN2_TEST_ADD_TU_3_ FORMAT "%6.2" /end CHARACTERISTIC
/begin CHARACTERISTIC c_soi_prev1_test_add_tu[0] "" VALUE 0x848800 _REC_VAL_20_s2 720. _CNV_A_R_LINEAR_____121_CM -360. 360. DISPLAY_IDENTIFIER C_SOI_PREV1_TEST_ADD_TU_0_ FORMAT "%6.2" /end CHARACTERISTIC
/begin CHARACTERISTIC c_soi_prev1_test_add_tu[1] "" VALUE 0x848802 _REC_VAL_20_s2 720. _CNV_A_R_LINEAR_____121_CM -360. 360. DISPLAY_IDENTIFIER C_SOI_PREV1_TEST_ADD_TU_1_ FORMAT "%6.2" /end CHARACTERISTIC
/begin CHARACTERISTIC c_soi_prev1_test_add_tu[2] "" VALUE 0x848804 _REC_VAL_20_s2 720. _CNV_A_R_LINEAR_____121_CM -360. 360. DISPLAY_IDENTIFIER C_SOI_PREV1_TEST_ADD_TU_2_ FORMAT "%6.2" /end CHARACTERISTIC
/begin CHARACTERISTIC c_soi_prev1_test_add_tu[3] "" VALUE 0x848806 _REC_VAL_20_s2 720. _CNV_A_R_LINEAR_____121_CM -360. 360. DISPLAY_IDENTIFIER C_SOI_PREV1_TEST_ADD_TU_3_ FORMAT "%6.2" /end CHARACTERISTIC
/begin CHARACTERISTIC c_soi_prev2_test_add_tu[0] "" VALUE 0x8487f0 _REC_VAL_20_s2 720. _CNV_A_R_LINEAR_____121_CM -360. 360. DISPLAY_IDENTIFIER C_SOI_PREV2_TEST_ADD_TU_0_ FORMAT "%6.2" /end CHARACTERISTIC
/begin CHARACTERISTIC c_soi_prev2_test_add_tu[1] "" VALUE 0x8487f2 _REC_VAL_20_s2 720. _CNV_A_R_LINEAR_____121_CM -360. 360. DISPLAY_IDENTIFIER C_SOI_PREV2_TEST_ADD_TU_1_ FORMAT "%6.2" /end CHARACTERISTIC
/begin CHARACTERISTIC c_soi_prev2_test_add_tu[2] "" VALUE 0x8487f4 _REC_VAL_20_s2 720. _CNV_A_R_LINEAR_____121_CM -360. 360. DISPLAY_IDENTIFIER C_SOI_PREV2_TEST_ADD_TU_2_ FORMAT "%6.2" /end CHARACTERISTIC
/begin CHARACTERISTIC c_soi_prev2_test_add_tu[3] "" VALUE 0x8487f6 _REC_VAL_20_s2 720. _CNV_A_R_LINEAR_____121_CM -360. 360. DISPLAY_IDENTIFIER C_SOI_PREV2_TEST_ADD_TU_3_ FORMAT "%6.2" /end CHARACTERISTIC
/begin MEASUREMENT soi_post1_tu "" UWORD _CNV_A_R_LINEAR_____120_CM 1 0. -120. 240. DISPLAY_IDENTIFIER SOI_POST1_TU ECU_ADDRESS 0x7fa024 BYTE_ORDER MSB_LAST FORMAT "%6.2" /end MEASUREMENT
/begin MEASUREMENT soi_post2_tu "" UWORD _CNV_A_R_LINEAR_____120_CM 1 0. -120. 240. DISPLAY_IDENTIFIER SOI_POST2_TU ECU_ADDRESS 0x7fa026 BYTE_ORDER MSB_LAST FORMAT "%6.2" /end MEASUREMENT
/begin MEASUREMENT soi_main1_tu "" UWORD _CNV_A_R_LINEAR_____120_CM 1 0. -120. 240. DISPLAY_IDENTIFIER SOI_MAIN1_TU ECU_ADDRESS 0x7fa01c BYTE_ORDER MSB_LAST FORMAT "%6.2" /end MEASUREMENT
/begin MEASUREMENT soi_main2_tu "" UWORD _CNV_A_R_LINEAR_____120_CM 1 0. -120. 240. DISPLAY_IDENTIFIER SOI_MAIN2_TU ECU_ADDRESS 0x7fa01e BYTE_ORDER MSB_LAST FORMAT "%6.2" /end MEASUREMENT
/begin MEASUREMENT soi_prev2_tu "" UWORD _CNV_A_R_LINEAR_____120_CM 1 0. -120. 240. DISPLAY_IDENTIFIER SOI_PREV2_TU ECU_ADDRESS 0x7fa022 BYTE_ORDER MSB_LAST FORMAT "%6.2" /end MEASUREMENT
/begin MEASUREMENT soi_prev1_tu "" UWORD _CNV_A_R_LINEAR_____120_CM 1 0. -120. 240. DISPLAY_IDENTIFIER SOI_PREV1_TU ECU_ADDRESS 0x7fa020 BYTE_ORDER MSB_LAST FORMAT "%6.2" /end MEASUREMENT
/begin CHARACTERISTIC lc_soi_post1_tu_on "" VALUE 0x85c35d _REC_VAL_20_u1 1. _CNV_A_R_LINEAR_____0_CM 0. 1. DISPLAY_IDENTIFIER LC_SOI_POST1_TU_ON FORMAT "%1.0" /end CHARACTERISTIC
/begin CHARACTERISTIC lc_soi_post2_tu_on "" VALUE 0x85c35e _REC_VAL_20_u1 1. _CNV_A_R_LINEAR_____0_CM 0. 1. DISPLAY_IDENTIFIER LC_SOI_POST2_TU_ON FORMAT "%1.0" /end CHARACTERISTIC
/begin CHARACTERISTIC c_fac_soi_post1_tu "" VALUE 0x85be72 _REC_VAL_20_u2 1.9999696 _CNV_A_R_LINEAR_____53_CM 0. 1.9999696 DISPLAY_IDENTIFIER C_FAC_SOI_POST1_TU FORMAT "%5.4" /end CHARACTERISTIC
/begin CHARACTERISTIC c_fac_soi_post2_tu "" VALUE 0x85be74 _REC_VAL_20_u2 1.9999696 _CNV_A_R_LINEAR_____53_CM 0. 1.9999696 DISPLAY_IDENTIFIER C_FAC_SOI_POST2_TU FORMAT "%5.4" /end CHARACTERISTIC
/begin CHARACTERISTIC c_soi_post1_add_tu "" VALUE 0x85c040 _REC_VAL_20_s2 720. _CNV_A_R_LINEAR_____121_CM -360. 360. DISPLAY_IDENTIFIER C_SOI_POST1_ADD_TU FORMAT "%6.2" /end CHARACTERISTIC
/begin CHARACTERISTIC c_soi_post2_add_tu "" VALUE 0x85c04a _REC_VAL_20_s2 720. _CNV_A_R_LINEAR_____121_CM -360. 360. DISPLAY_IDENTIFIER C_SOI_POST2_ADD_TU FORMAT "%6.2" /end CHARACTERISTIC
/begin CHARACTERISTIC c_soi_post1_add_tu_cyl[0] "" VALUE 0x85c042 _REC_VAL_20_s2 720. _CNV_A_R_LINEAR_____121_CM -360. 360. DISPLAY_IDENTIFIER C_SOI_POST1_ADD_TU_CYL_0_ FORMAT "%6.2" /end CHARACTERISTIC
/begin CHARACTERISTIC c_soi_post1_add_tu_cyl[1] "" VALUE 0x85c044 _REC_VAL_20_s2 720. _CNV_A_R_LINEAR_____121_CM -360. 360. DISPLAY_IDENTIFIER C_SOI_POST1_ADD_TU_CYL_1_ FORMAT "%6.2" /end CHARACTERISTIC
/begin CHARACTERISTIC c_soi_post1_add_tu_cyl[2] "" VALUE 0x85c046 _REC_VAL_20_s2 720. _CNV_A_R_LINEAR_____121_CM -360. 360. DISPLAY_IDENTIFIER C_SOI_POST1_ADD_TU_CYL_2_ FORMAT "%6.2" /end CHARACTERISTIC
/begin CHARACTERISTIC c_soi_post1_add_tu_cyl[3] "" VALUE 0x85c048 _REC_VAL_20_s2 720. _CNV_A_R_LINEAR_____121_CM -360. 360. DISPLAY_IDENTIFIER C_SOI_POST1_ADD_TU_CYL_3_ FORMAT "%6.2" /end CHARACTERISTIC
/begin CHARACTERISTIC c_soi_post2_add_tu_cyl[0] "" VALUE 0x85c04c _REC_VAL_20_s2 720. _CNV_A_R_LINEAR_____121_CM -360. 360. DISPLAY_IDENTIFIER C_SOI_POST2_ADD_TU_CYL_0_ FORMAT "%6.2" /end CHARACTERISTIC
/begin CHARACTERISTIC c_soi_post2_add_tu_cyl[1] "" VALUE 0x85c04e _REC_VAL_20_s2 720. _CNV_A_R_LINEAR_____121_CM -360. 360. DISPLAY_IDENTIFIER C_SOI_POST2_ADD_TU_CYL_1_ FORMAT "%6.2" /end CHARACTERISTIC
/begin CHARACTERISTIC c_soi_post2_add_tu_cyl[2] "" VALUE 0x85c050 _REC_VAL_20_s2 720. _CNV_A_R_LINEAR_____121_CM -360. 360. DISPLAY_IDENTIFIER C_SOI_POST2_ADD_TU_CYL_2_ FORMAT "%6.2" /end CHARACTERISTIC
/begin CHARACTERISTIC c_soi_post2_add_tu_cyl[3] "" VALUE 0x85c052 _REC_VAL_20_s2 720. _CNV_A_R_LINEAR_____121_CM -360. 360. DISPLAY_IDENTIFIER C_SOI_POST2_ADD_TU_CYL_3_ FORMAT "%6.2" /end CHARACTERISTIC
/begin CHARACTERISTIC c_soi_post1_test_add_tu[0] "" VALUE 0x848880 _REC_VAL_20_s2 720. _CNV_A_R_LINEAR_____121_CM -360. 360. DISPLAY_IDENTIFIER C_SOI_POST1_TEST_ADD_TU_0_ FORMAT "%6.2" /end CHARACTERISTIC
/begin CHARACTERISTIC c_soi_post1_test_add_tu[1] "" VALUE 0x848882 _REC_VAL_20_s2 720. _CNV_A_R_LINEAR_____121_CM -360. 360. DISPLAY_IDENTIFIER C_SOI_POST1_TEST_ADD_TU_1_ FORMAT "%6.2" /end CHARACTERISTIC
/begin CHARACTERISTIC c_soi_post1_test_add_tu[2] "" VALUE 0x848884 _REC_VAL_20_s2 720. _CNV_A_R_LINEAR_____121_CM -360. 360. DISPLAY_IDENTIFIER C_SOI_POST1_TEST_ADD_TU_2_ FORMAT "%6.2" /end CHARACTERISTIC
/begin CHARACTERISTIC c_soi_post1_test_add_tu[3] "" VALUE 0x848886 _REC_VAL_20_s2 720. _CNV_A_R_LINEAR_____121_CM -360. 360. DISPLAY_IDENTIFIER C_SOI_POST1_TEST_ADD_TU_3_ FORMAT "%6.2" /end CHARACTERISTIC
/begin CHARACTERISTIC c_soi_post2_test_add_tu[0] "" VALUE 0x848890 _REC_VAL_20_s2 720. _CNV_A_R_LINEAR_____121_CM -360. 360. DISPLAY_IDENTIFIER C_SOI_POST2_TEST_ADD_TU_0_ FORMAT "%6.2" /end CHARACTERISTIC
/begin CHARACTERISTIC c_soi_post2_test_add_tu[1] "" VALUE 0x848892 _REC_VAL_20_s2 720. _CNV_A_R_LINEAR_____121_CM -360. 360. DISPLAY_IDENTIFIER C_SOI_POST2_TEST_ADD_TU_1_ FORMAT "%6.2" /end CHARACTERISTIC
/begin CHARACTERISTIC c_soi_post2_test_add_tu[2] "" VALUE 0x848894 _REC_VAL_20_s2 720. _CNV_A_R_LINEAR_____121_CM -360. 360. DISPLAY_IDENTIFIER C_SOI_POST2_TEST_ADD_TU_2_ FORMAT "%6.2" /end CHARACTERISTIC
/begin CHARACTERISTIC c_soi_post2_test_add_tu[3] "" VALUE 0x848896 _REC_VAL_20_s2 720. _CNV_A_R_LINEAR_____121_CM -360. 360. DISPLAY_IDENTIFIER C_SOI_POST2_TEST_ADD_TU_3_ FORMAT "%6.2" /end CHARACTERISTIC
/begin AXIS_PTS ldp_n_ip_soi_min_tu_ad_2 "" 0x842114 n _REC_AXS_20_u2 8160. _CNV_A_R_LINEAR_____5_CM 16 0. 8160. FORMAT "%4.0" /end AXIS_PTS
/begin CHARACTERISTIC ip_soi_min_tu_ad_2_n "SOI tuning of PREV2 if injection adaption is active" CURVE 0x858796 _REC_CUR_20_u2_u2 360. _CNV_A_R_LINEAR_____120_CM -120. 240. DISPLAY_IDENTIFIER IP_SOI_MIN_TU_AD_2_N FORMAT "%6.2"
 /begin AXIS_DESCR COM_AXIS n _CNV_A_R_LINEAR_____5_CM 16 0. 8160. FORMAT "%4.0" AXIS_PTS_REF ldp_n_ip_soi_min_tu_ad_2 /end AXIS_DESCR
/end CHARACTERISTIC
/begin CHARACTERISTIC ip_soi_main1_inj_test_ad "SOI offset of main1 during adaptation procedure" MAP 0x857306 _REC_MAP_20_u2_u2_u2 720. _CNV_A_R_LINEAR_____397_CM -360. 360. DISPLAY_IDENTIFIER IP_SOI_MAIN1_INJ_TEST_AD FORMAT "%5.2"
 /begin AXIS_DESCR COM_AXIS n _CNV_A_R_LINEAR_____5_CM 16 0. 6375. FORMAT "%4.0" AXIS_PTS_REF ldp_n_ip_soi_main1_inj_test_ad /end AXIS_DESCR
 /begin AXIS_DESCR COM_AXIS tqi_sp _CNV_A_R_LINEAR_____89_CM 16 -1024. 1023.96875 FORMAT "%6.2" AXIS_PTS_REF ldp_tqi_sp_ip_soi_main1_inj_test_ad /end AXIS_DESCR
/end CHARACTERISTIC
/begin AXIS_PTS ldp_n_ip_soi_main1_inj_test_ad "SOI offset of main1 during adaptation procedure" 0x841f6c n _REC_AXS_20_u2 6375. _CNV_A_R_LINEAR_____5_CM 16 0. 6375. FORMAT "%4.0" /end AXIS_PTS
/begin AXIS_PTS ldp_tqi_sp_ip_soi_main1_inj_test_ad "SOI offset of main1 during adaptation procedure" 0x8430ca tqi_sp _REC_AXS_20_u2 2047.96875 _CNV_A_R_LINEAR_____89_CM 16 -1024. 1023.96875 FORMAT "%6.2" /end AXIS_PTS
/begin MEASUREMENT soi_main1_st "start of injection MAIN1 at start" UWORD _CNV_A_R_LINEAR_____120_CM 1 0. -120. 240. DISPLAY_IDENTIFIER SOI_MAIN1_ST ECU_ADDRESS 0x7fa028 BYTE_ORDER MSB_LAST FORMAT "%5.2" /end MEASUREMENT
/begin CHARACTERISTIC ip_fac_soi_main1_st_cor_amp "SOIST: AMP correction factor for SOI_MAIN1 at start" CURVE 0x84c05a _REC_CUR_20_u2_u2 3.99998471 _CNV_A_R_LINEAR_____63_CM 0. 3.99998471 DISPLAY_IDENTIFIER IP_FAC_SOI_MAIN1_ST_COR_AMP FORMAT "%6.5"
 /begin AXIS_DESCR COM_AXIS amp _CNV_A_R_LINEAR_____21_CM 4 0. 5434. FORMAT "%6.2" AXIS_PTS_REF ldpm_amp_2_inj /end AXIS_DESCR
/end CHARACTERISTIC
/begin CHARACTERISTIC ip_soi_main1_st "SOIST: SOI of injection MAIN1 at start" MAP 0x85851e _REC_MAP_20_u2_u2_u1 360. _CNV_A_R_LINEAR_____120_CM -120. 240. DISPLAY_IDENTIFIER IP_SOI_MAIN1_ST FORMAT "%5.2"
 /begin AXIS_DESCR COM_AXIS n _CNV_A_R_LINEAR_____5_CM 7 0. 6375. FORMAT "%4.0" AXIS_PTS_REF ldpm_n_3_inj /end AXIS_DESCR
 /begin AXIS_DESCR COM_AXIS tco _CNV_A_R_LINEAR_____18_CM 12 -50. 205. FORMAT "%3.0" AXIS_PTS_REF ldpm_tco_2_inj /end AXIS_DESCR
/end CHARACTERISTIC
/begin CHARACTERISTIC ip_soi_main1_st_cor_amp "SOIST: AMP correction for SOI of injection MAIN1 at start" MAP 0x8585c6 _REC_MAP_20_u2_u2_u1 720. _CNV_A_R_LINEAR_____397_CM -360. 360. DISPLAY_IDENTIFIER IP_SOI_MAIN1_ST_COR_AMP FORMAT "%5.2"
 /begin AXIS_DESCR COM_AXIS n _CNV_A_R_LINEAR_____5_CM 4 0. 6375. FORMAT "%4.0" AXIS_PTS_REF ldpm_n_4_inj /end AXIS_DESCR
 /begin AXIS_DESCR COM_AXIS tco _CNV_A_R_LINEAR_____18_CM 6 -50. 205. FORMAT "%3.0" AXIS_PTS_REF ldpm_tco_3_inj /end AXIS_DESCR
/end CHARACTERISTIC
/begin MEASUREMENT soi_main1_is_pl_rgl "SOIST: start of injection MAIN1 at IS/PL" UWORD _CNV_A_R_LINEAR_____120_CM 1 0. -120. 240. DISPLAY_IDENTIFIER SOI_MAIN1_IS_PL_RGL ECU_ADDRESS 0x7fa02a BYTE_ORDER MSB_LAST FORMAT "%5.2" /end MEASUREMENT
/begin MEASUREMENT soi_main1_is_pl_cor_sum_rgl "SOIST: sum of corrections on SOI_MAIN1 at IS/P" UWORD _CNV_A_R_LINEAR_____120_CM 1 0. -120. 240. DISPLAY_IDENTIFIER SOI_MAIN1_IS_PL_COR_SUM_RGL ECU_ADDRESS 0x7fa02c BYTE_ORDER MSB_LAST FORMAT "%5.2" /end MEASUREMENT
/begin CHARACTERISTIC ip_fac_soi_main1_amp_0_0 "SOIST: amp correction factor for soi_main1 at inj conf 0" CURVE 0x84c024 _REC_CUR_20_u2_u2 0.9999847412109381 _CNV_A_R_LINEAR_____14_CM 0. 0.9999847412109381 DISPLAY_IDENTIFIER IP_FAC_SOI_MAIN1_AMP_0_0 FORMAT "%6.5"
 /begin AXIS_DESCR COM_AXIS amp _CNV_A_R_LINEAR_____21_CM 8 0. 5434. FORMAT "%6.2" AXIS_PTS_REF ldp_amp_ip_fac_soi_main1_0_0 /end AXIS_DESCR
/end CHARACTERISTIC
/begin AXIS_PTS ldp_amp_ip_fac_soi_main1_0_0 "amp correction factor for soi_main1 at inj conf 0" 0x841232 amp _REC_AXS_20_u2 5434. _CNV_A_R_LINEAR_____21_CM 8 0. 5434. FORMAT "%6.2" /end AXIS_PTS
/begin CHARACTERISTIC ip_fac_soi_main1_amp_1_0 "SOIST: amp correction factor for soi_main1 at inj conf 1" CURVE 0x84c034 _REC_CUR_20_u2_u2 0.9999847412109381 _CNV_A_R_LINEAR_____14_CM 0. 0.9999847412109381 DISPLAY_IDENTIFIER IP_FAC_SOI_MAIN1_AMP_1_0 FORMAT "%6.5"
 /begin AXIS_DESCR COM_AXIS amp _CNV_A_R_LINEAR_____21_CM 8 0. 5434. FORMAT "%6.2" AXIS_PTS_REF ldp_amp_ip_fac_soi_main1_1_0 /end AXIS_DESCR
/end CHARACTERISTIC
/begin AXIS_PTS ldp_amp_ip_fac_soi_main1_1_0 "amp correction factor for soi_main1 at inj conf 1" 0x841244 amp _REC_AXS_20_u2 5434. _CNV_A_R_LINEAR_____21_CM 8 0. 5434. FORMAT "%6.2" /end AXIS_PTS
/begin CHARACTERISTIC ip_fac_soi_main1_amp_2_0 "SOIST: amp correction factor for soi_main1 at inj conf 2" CURVE 0x84c044 _REC_CUR_20_u2_u2 0.9999847412109381 _CNV_A_R_LINEAR_____14_CM 0. 0.9999847412109381 DISPLAY_IDENTIFIER IP_FAC_SOI_MAIN1_AMP_2_0 FORMAT "%6.5"
 /begin AXIS_DESCR COM_AXIS amp _CNV_A_R_LINEAR_____21_CM 1 0. 5434. FORMAT "%6.2" AXIS_PTS_REF ldp_amp_ip_fac_soi_main1_2_0 /end AXIS_DESCR
/end CHARACTERISTIC
/begin AXIS_PTS ldp_amp_ip_fac_soi_main1_2_0 "amp correction factor for soi_main1 at inj conf 2" 0x841256 amp _REC_AXS_20_u2 5434. _CNV_A_R_LINEAR_____21_CM 1 0. 5434. FORMAT "%6.2" /end AXIS_PTS
/begin CHARACTERISTIC ip_fac_soi_main1_amp_3_0 "SOIST: amp correction factor for soi_main1 at inj conf 3" CURVE 0x84c046 _REC_CUR_20_u2_u2 0.9999847412109381 _CNV_A_R_LINEAR_____14_CM 0. 0.9999847412109381 DISPLAY_IDENTIFIER IP_FAC_SOI_MAIN1_AMP_3_0 FORMAT "%6.5"
 /begin AXIS_DESCR COM_AXIS amp _CNV_A_R_LINEAR_____21_CM 1 0. 5434. FORMAT "%6.2" AXIS_PTS_REF ldp_amp_ip_fac_soi_main1_3_0 /end AXIS_DESCR
/end CHARACTERISTIC
/begin AXIS_PTS ldp_amp_ip_fac_soi_main1_3_0 "amp correction factor for soi_main1 at inj conf 3" 0x84125a amp _REC_AXS_20_u2 5434. _CNV_A_R_LINEAR_____21_CM 1 0. 5434. FORMAT "%6.2" /end AXIS_PTS
/begin CHARACTERISTIC ip_fac_soi_main1_amp_4_0 "SOIST: amp correction factor for soi_main1 at inj conf 4" CURVE 0x84c048 _REC_CUR_20_u2_u2 0.9999847412109381 _CNV_A_R_LINEAR_____14_CM 0. 0.9999847412109381 DISPLAY_IDENTIFIER IP_FAC_SOI_MAIN1_AMP_4_0 FORMAT "%6.5"
 /begin AXIS_DESCR COM_AXIS amp _CNV_A_R_LINEAR_____21_CM 1 0. 5434. FORMAT "%6.2" AXIS_PTS_REF ldp_amp_ip_fac_soi_main1_4_0 /end AXIS_DESCR
/end CHARACTERISTIC
/begin AXIS_PTS ldp_amp_ip_fac_soi_main1_4_0 "amp correction factor for soi_main1 at inj conf 4" 0x84125e amp _REC_AXS_20_u2 5434. _CNV_A_R_LINEAR_____21_CM 1 0. 5434. FORMAT "%6.2" /end AXIS_PTS
/begin CHARACTERISTIC ip_fac_soi_main1_tgas_0_0 "SOIST: SOI main1 correction dependent on TGAS at inj conf 0" CURVE 0x84c098 _REC_CUR_20_u2_u1 0.9999847412109381 _CNV_A_R_LINEAR_____14_CM 0. 0.9999847412109381 DISPLAY_IDENTIFIER IP_FAC_SOI_MAIN1_TGAS_0_0 FORMAT "%6.5"
 /begin AXIS_DESCR COM_AXIS tgas _CNV_A_R_LINEAR_____18_CM 8 -50. 205. FORMAT "%3.0" AXIS_PTS_REF ldp_tgas_ip_fac_soi_main1_0_0 /end AXIS_DESCR
/end CHARACTERISTIC
/begin AXIS_PTS ldp_tgas_ip_fac_soi_main1_0_0 "SOI main1 correction dependent on TGAS at inj conf 0" 0x8429a3 tgas _REC_AXS_20_u1 255. _CNV_A_R_LINEAR_____18_CM 8 -50. 205. FORMAT "%3.0" /end AXIS_PTS
/begin CHARACTERISTIC ip_fac_soi_main1_tgas_1_0 "SOIST: SOI main1 correction dependent on TGAS at inj conf 1" CURVE 0x84c0a8 _REC_CUR_20_u2_u1 0.9999847412109381 _CNV_A_R_LINEAR_____14_CM 0. 0.9999847412109381 DISPLAY_IDENTIFIER IP_FAC_SOI_MAIN1_TGAS_1_0 FORMAT "%6.5"
 /begin AXIS_DESCR COM_AXIS tgas _CNV_A_R_LINEAR_____18_CM 8 -50. 205. FORMAT "%3.0" AXIS_PTS_REF ldp_tgas_ip_fac_soi_main1_1_0 /end AXIS_DESCR
/end CHARACTERISTIC
/begin AXIS_PTS ldp_tgas_ip_fac_soi_main1_1_0 "SOI main1 correction dependent on TGAS at inj conf 1" 0x8429ac tgas _REC_AXS_20_u1 255. _CNV_A_R_LINEAR_____18_CM 8 -50. 205. FORMAT "%3.0" /end AXIS_PTS
/begin CHARACTERISTIC ip_fac_soi_main1_tgas_2_0 "SOIST: SOI main1 correction dependent on TGAS at inj conf 2" CURVE 0x84c0b8 _REC_CUR_20_u2_u1 0.9999847412109381 _CNV_A_R_LINEAR_____14_CM 0. 0.9999847412109381 DISPLAY_IDENTIFIER IP_FAC_SOI_MAIN1_TGAS_2_0 FORMAT "%6.5"
 /begin AXIS_DESCR COM_AXIS tgas _CNV_A_R_LINEAR_____18_CM 1 -50. 205. FORMAT "%3.0" AXIS_PTS_REF ldp_tgas_ip_fac_soi_main1_2_0 /end AXIS_DESCR
/end CHARACTERISTIC
/begin AXIS_PTS ldp_tgas_ip_fac_soi_main1_2_0 "SOI main1 correction dependent on TGAS at inj conf 2" 0x8429b5 tgas _REC_AXS_20_u1 255. _CNV_A_R_LINEAR_____18_CM 1 -50. 205. FORMAT "%3.0" /end AXIS_PTS
/begin CHARACTERISTIC ip_fac_soi_main1_tgas_3_0 "SOIST: SOI main1 correction dependent on TGAS at inj conf 3" CURVE 0x84c0ba _REC_CUR_20_u2_u1 0.9999847412109381 _CNV_A_R_LINEAR_____14_CM 0. 0.9999847412109381 DISPLAY_IDENTIFIER IP_FAC_SOI_MAIN1_TGAS_3_0 FORMAT "%6.5"
 /begin AXIS_DESCR COM_AXIS tgas _CNV_A_R_LINEAR_____18_CM 1 -50. 205. FORMAT "%3.0" AXIS_PTS_REF ldp_tgas_ip_fac_soi_main1_3_0 /end AXIS_DESCR
/end CHARACTERISTIC
/begin AXIS_PTS ldp_tgas_ip_fac_soi_main1_3_0 "SOI main1 correction dependent on TGAS at inj conf 3" 0x8429b7 tgas _REC_AXS_20_u1 255. _CNV_A_R_LINEAR_____18_CM 1 -50. 205. FORMAT "%3.0" /end AXIS_PTS
/begin CHARACTERISTIC ip_fac_soi_main1_tgas_4_0 "SOIST: SOI main1 correction dependent on TGAS at inj conf 4" CURVE 0x84c0bc _REC_CUR_20_u2_u1 0.9999847412109381 _CNV_A_R_LINEAR_____14_CM 0. 0.9999847412109381 DISPLAY_IDENTIFIER IP_FAC_SOI_MAIN1_TGAS_4_0 FORMAT "%6.5"
 /begin AXIS_DESCR COM_AXIS tgas _CNV_A_R_LINEAR_____18_CM 1 -50. 205. FORMAT "%3.0" AXIS_PTS_REF ldp_tgas_ip_fac_soi_main1_4_0 /end AXIS_DESCR
/end CHARACTERISTIC
/begin AXIS_PTS ldp_tgas_ip_fac_soi_main1_4_0 "SOI main1 correction dependent on TGAS at inj conf 4" 0x8429b9 tgas _REC_AXS_20_u1 255. _CNV_A_R_LINEAR_____18_CM 1 -50. 205. FORMAT "%3.0" /end AXIS_PTS
/begin CHARACTERISTIC ip_fac_soi_main1_tco_0_0 "SOIST: SOI interpolation dependent on TCO at inj conf 0" CURVE 0x84c062 _REC_CUR_20_u2_u1 1.9999696 _CNV_A_R_LINEAR_____53_CM 0. 1.9999696 DISPLAY_IDENTIFIER IP_FAC_SOI_MAIN1_TCO_0_0 FORMAT "%6.5"
 /begin AXIS_DESCR COM_AXIS tco _CNV_A_R_LINEAR_____18_CM 8 -50. 205. FORMAT "%3.0" AXIS_PTS_REF ldp_tco_ip_fac_soi_main1_0_0 /end AXIS_DESCR
/end CHARACTERISTIC
/begin AXIS_PTS ldp_tco_ip_fac_soi_main1_0_0 "SOI interpolation dependent on TCO at inj conf 0" 0x84272c tco _REC_AXS_20_u1 255. _CNV_A_R_LINEAR_____18_CM 8 -50. 205. FORMAT "%3.0" /end AXIS_PTS
/begin CHARACTERISTIC ip_fac_soi_main1_tco_1_0 "SOIST: SOI interpolation dependent on TCO at inj conf 1" CURVE 0x84c072 _REC_CUR_20_u2_u1 1.9999696 _CNV_A_R_LINEAR_____53_CM 0. 1.9999696 DISPLAY_IDENTIFIER IP_FAC_SOI_MAIN1_TCO_1_0 FORMAT "%6.5"
 /begin AXIS_DESCR COM_AXIS tco _CNV_A_R_LINEAR_____18_CM 8 -50. 205. FORMAT "%3.0" AXIS_PTS_REF ldp_tco_ip_fac_soi_main1_1_0 /end AXIS_DESCR
/end CHARACTERISTIC
/begin AXIS_PTS ldp_tco_ip_fac_soi_main1_1_0 "SOI interpolation dependent on TCO at inj conf 1" 0x842735 tco _REC_AXS_20_u1 255. _CNV_A_R_LINEAR_____18_CM 8 -50. 205. FORMAT "%3.0" /end AXIS_PTS
/begin CHARACTERISTIC ip_fac_soi_main1_tco_2_0 "SOIST: SOI interpolation dependent on TCO at inj conf 2" CURVE 0x84c082 _REC_CUR_20_u2_u1 1.9999696 _CNV_A_R_LINEAR_____53_CM 0. 1.9999696 DISPLAY_IDENTIFIER IP_FAC_SOI_MAIN1_TCO_2_0 FORMAT "%6.5"
 /begin AXIS_DESCR COM_AXIS tco _CNV_A_R_LINEAR_____18_CM 1 -50. 205. FORMAT "%3.0" AXIS_PTS_REF ldp_tco_ip_fac_soi_main1_2_0 /end AXIS_DESCR
/end CHARACTERISTIC
/begin AXIS_PTS ldp_tco_ip_fac_soi_main1_2_0 "SOI interpolation dependent on TCO at inj conf 2" 0x84273e tco _REC_AXS_20_u1 255. _CNV_A_R_LINEAR_____18_CM 1 -50. 205. FORMAT "%3.0" /end AXIS_PTS
/begin CHARACTERISTIC ip_fac_soi_main1_tco_3_0 "SOIST: SOI interpolation dependent on TCO at inj conf 3" CURVE 0x84c084 _REC_CUR_20_u2_u1 1.9999696 _CNV_A_R_LINEAR_____53_CM 0. 1.9999696 DISPLAY_IDENTIFIER IP_FAC_SOI_MAIN1_TCO_3_0 FORMAT "%6.5"
 /begin AXIS_DESCR COM_AXIS tco _CNV_A_R_LINEAR_____18_CM 1 -50. 205. FORMAT "%3.0" AXIS_PTS_REF ldp_tco_ip_fac_soi_main1_3_0 /end AXIS_DESCR
/end CHARACTERISTIC
/begin AXIS_PTS ldp_tco_ip_fac_soi_main1_3_0 "SOI interpolation dependent on TCO at inj conf 3" 0x842740 tco _REC_AXS_20_u1 255. _CNV_A_R_LINEAR_____18_CM 1 -50. 205. FORMAT "%3.0" /end AXIS_PTS
/begin CHARACTERISTIC ip_fac_soi_main1_tco_4_0 "SOIST: SOI interpolation dependent on TCO at inj conf 4" CURVE 0x84c086 _REC_CUR_20_u2_u1 1.9999696 _CNV_A_R_LINEAR_____53_CM 0. 1.9999696 DISPLAY_IDENTIFIER IP_FAC_SOI_MAIN1_TCO_4_0 FORMAT "%6.5"
 /begin AXIS_DESCR COM_AXIS tco _CNV_A_R_LINEAR_____18_CM 1 -50. 205. FORMAT "%3.0" AXIS_PTS_REF ldp_tco_ip_fac_soi_main1_4_0 /end AXIS_DESCR
/end CHARACTERISTIC
/begin AXIS_PTS ldp_tco_ip_fac_soi_main1_4_0 "SOI interpolation dependent on TCO at inj conf 4" 0x842742 tco _REC_AXS_20_u1 255. _CNV_A_R_LINEAR_____18_CM 1 -50. 205. FORMAT "%3.0" /end AXIS_PTS
/begin CHARACTERISTIC ip_soi_main1_0_0 "SOIST: SOI of main injection at inj conf 0 and temp level 0" MAP 0x85596a _REC_MAP_20_u2_u2_u2 360. _CNV_A_R_LINEAR_____120_CM -120. 240. DISPLAY_IDENTIFIER IP_SOI_MAIN1_0_0 FORMAT "%5.2"
 /begin AXIS_DESCR COM_AXIS n _CNV_A_R_LINEAR_____5_CM 16 0. 6375. FORMAT "%4.0" AXIS_PTS_REF ldpm_n_1_ip_soi_main1_0_0 /end AXIS_DESCR
 /begin AXIS_DESCR COM_AXIS tqi_sp _CNV_A_R_LINEAR_____89_CM 16 -1024. 1023.96875 FORMAT "%6.2" AXIS_PTS_REF ldpm_tqi_sp_1_ip_soi_0_0 /end AXIS_DESCR
/end CHARACTERISTIC
/begin AXIS_PTS ldpm_n_1_ip_soi_main1_0_0 "SOI of main injection at inj conf 0 and temp level 0" 0x843734 n _REC_AXS_20_u2 6375. _CNV_A_R_LINEAR_____5_CM 16 0. 6375. FORMAT "%4.0" /end AXIS_PTS
/begin AXIS_PTS ldpm_tqi_sp_1_ip_soi_0_0 "SOI of main injection at inj conf 0 and temp level 0" 0x84431a tqi_sp _REC_AXS_20_u2 2047.96875 _CNV_A_R_LINEAR_____89_CM 16 -1024. 1023.96875 FORMAT "%6.2" /end AXIS_PTS
/begin CHARACTERISTIC ip_soi_main1_0_1 "SOIST: SOI of main injection at inj conf 0 and temp level 1" MAP 0x855b6a _REC_MAP_20_u2_u2_u2 360. _CNV_A_R_LINEAR_____120_CM -120. 240. DISPLAY_IDENTIFIER IP_SOI_MAIN1_0_1 FORMAT "%5.2"
 /begin AXIS_DESCR COM_AXIS n _CNV_A_R_LINEAR_____5_CM 16 0. 6375. FORMAT "%4.0" AXIS_PTS_REF ldpm_n_1_ip_soi_main1_0_0 /end AXIS_DESCR
 /begin AXIS_DESCR COM_AXIS tqi_sp _CNV_A_R_LINEAR_____89_CM 16 -1024. 1023.96875 FORMAT "%6.2" AXIS_PTS_REF ldpm_tqi_sp_1_ip_soi_0_0 /end AXIS_DESCR
/end CHARACTERISTIC
/begin CHARACTERISTIC ip_soi_main1_0_2 "SOIST: SOI of main injection at inj conf 0 and temp level 2" MAP 0x855d6a _REC_MAP_20_u2_u2_u2 360. _CNV_A_R_LINEAR_____120_CM -120. 240. DISPLAY_IDENTIFIER IP_SOI_MAIN1_0_2 FORMAT "%5.2"
 /begin AXIS_DESCR COM_AXIS n _CNV_A_R_LINEAR_____5_CM 16 0. 6375. FORMAT "%4.0" AXIS_PTS_REF ldpm_n_1_ip_soi_main1_0_0 /end AXIS_DESCR
 /begin AXIS_DESCR COM_AXIS tqi_sp _CNV_A_R_LINEAR_____89_CM 16 -1024. 1023.96875 FORMAT "%6.2" AXIS_PTS_REF ldpm_tqi_sp_1_ip_soi_0_0 /end AXIS_DESCR
/end CHARACTERISTIC
/begin CHARACTERISTIC ip_soi_main1_1_0 "SOIST: SOI of main injection at inj conf 1 and temp level 0" MAP 0x855f6a _REC_MAP_20_u2_u2_u2 360. _CNV_A_R_LINEAR_____120_CM -120. 240. DISPLAY_IDENTIFIER IP_SOI_MAIN1_1_0 FORMAT "%5.2"
 /begin AXIS_DESCR COM_AXIS n _CNV_A_R_LINEAR_____5_CM 16 0. 6375. FORMAT "%4.0" AXIS_PTS_REF ldpm_n_1_ip_soi_main1_1_0 /end AXIS_DESCR
 /begin AXIS_DESCR COM_AXIS tqi_sp _CNV_A_R_LINEAR_____89_CM 16 -1024. 1023.96875 FORMAT "%6.2" AXIS_PTS_REF ldpm_tqi_sp_1_ip_soi_1_0 /end AXIS_DESCR
/end CHARACTERISTIC
/begin AXIS_PTS ldpm_n_1_ip_soi_main1_1_0 "SOI of main injection at inj conf 1 and temp level 0" 0x843756 n _REC_AXS_20_u2 6375. _CNV_A_R_LINEAR_____5_CM 16 0. 6375. FORMAT "%4.0" /end AXIS_PTS
/begin AXIS_PTS ldpm_tqi_sp_1_ip_soi_1_0 "SOI of main injection at inj conf 1 and temp level 0" 0x84433c tqi_sp _REC_AXS_20_u2 2047.96875 _CNV_A_R_LINEAR_____89_CM 16 -1024. 1023.96875 FORMAT "%6.2" /end AXIS_PTS
/begin CHARACTERISTIC ip_soi_main1_1_1 "SOIST: SOI of main injection at inj conf 1 and temp level 1" MAP 0x85616a _REC_MAP_20_u2_u2_u2 360. _CNV_A_R_LINEAR_____120_CM -120. 240. DISPLAY_IDENTIFIER IP_SOI_MAIN1_1_1 FORMAT "%5.2"
 /begin AXIS_DESCR COM_AXIS n _CNV_A_R_LINEAR_____5_CM 16 0. 6375. FORMAT "%4.0" AXIS_PTS_REF ldpm_n_1_ip_soi_main1_1_0 /end AXIS_DESCR
 /begin AXIS_DESCR COM_AXIS tqi_sp _CNV_A_R_LINEAR_____89_CM 16 -1024. 1023.96875 FORMAT "%6.2" AXIS_PTS_REF ldpm_tqi_sp_1_ip_soi_1_0 /end AXIS_DESCR
/end CHARACTERISTIC
/begin CHARACTERISTIC ip_soi_main1_1_2 "SOIST: SOI of main injection at inj conf 1 and temp level 2" MAP 0x85636a _REC_MAP_20_u2_u2_u2 360. _CNV_A_R_LINEAR_____120_CM -120. 240. DISPLAY_IDENTIFIER IP_SOI_MAIN1_1_2 FORMAT "%5.2"
 /begin AXIS_DESCR COM_AXIS n _CNV_A_R_LINEAR_____5_CM 16 0. 6375. FORMAT "%4.0" AXIS_PTS_REF ldpm_n_1_ip_soi_main1_1_0 /end AXIS_DESCR
 /begin AXIS_DESCR COM_AXIS tqi_sp _CNV_A_R_LINEAR_____89_CM 16 -1024. 1023.96875 FORMAT "%6.2" AXIS_PTS_REF ldpm_tqi_sp_1_ip_soi_1_0 /end AXIS_DESCR
/end CHARACTERISTIC
/begin CHARACTERISTIC ip_soi_main1_2_0 "SOIST: SOI of main injection at inj conf 2 and temp level 0" MAP 0x85656a _REC_MAP_20_u2_u2_u2 360. _CNV_A_R_LINEAR_____120_CM -120. 240. DISPLAY_IDENTIFIER IP_SOI_MAIN1_2_0 FORMAT "%5.2"
 /begin AXIS_DESCR COM_AXIS n _CNV_A_R_LINEAR_____5_CM 16 0. 6375. FORMAT "%4.0" AXIS_PTS_REF ldpm_n_1_ip_soi_main1_2_0 /end AXIS_DESCR
 /begin AXIS_DESCR COM_AXIS tqi_sp _CNV_A_R_LINEAR_____89_CM 16 -1024. 1023.96875 FORMAT "%6.2" AXIS_PTS_REF ldpm_tqi_sp_1_ip_soi_2_0 /end AXIS_DESCR
/end CHARACTERISTIC
/begin AXIS_PTS ldpm_n_1_ip_soi_main1_2_0 "SOI of main injection at inj conf 2 and temp level 0" 0x843778 n _REC_AXS_20_u2 6375. _CNV_A_R_LINEAR_____5_CM 16 0. 6375. FORMAT "%4.0" /end AXIS_PTS
/begin AXIS_PTS ldp_n_1_ip_soi_main1_2_0_x "SOI of main injection at inj conf 2 and temp level 0" 0x8418de n _REC_AXS_20_u2 6375. _CNV_A_R_LINEAR_____5_CM 1 0. 6375. FORMAT "%4.0" /end AXIS_PTS
/begin AXIS_PTS ldpm_tqi_sp_1_ip_soi_2_0 "SOI of main injection at inj conf 2 and temp level 0" 0x84435e tqi_sp _REC_AXS_20_u2 2047.96875 _CNV_A_R_LINEAR_____89_CM 16 -1024. 1023.96875 FORMAT "%6.2" /end AXIS_PTS
/begin AXIS_PTS ldp_tqi_sp_1_ip_soi_2_0_x "SOI of main injection at inj conf 2 and temp level 0" 0x842d84 tqi_sp _REC_AXS_20_u2 2047.96875 _CNV_A_R_LINEAR_____89_CM 1 -1024. 1023.96875 FORMAT "%6.2" /end AXIS_PTS
/begin CHARACTERISTIC ip_soi_main1_2_1 "SOIST: SOI of main injection at inj conf 2 and temp level 1" MAP 0x85676a _REC_MAP_20_u2_u2_u2 360. _CNV_A_R_LINEAR_____120_CM -120. 240. DISPLAY_IDENTIFIER IP_SOI_MAIN1_2_1 FORMAT "%5.2"
 /begin AXIS_DESCR COM_AXIS n _CNV_A_R_LINEAR_____5_CM 16 0. 6375. FORMAT "%4.0" AXIS_PTS_REF ldpm_n_1_ip_soi_main1_2_0 /end AXIS_DESCR
 /begin AXIS_DESCR COM_AXIS tqi_sp _CNV_A_R_LINEAR_____89_CM 16 -1024. 1023.96875 FORMAT "%6.2" AXIS_PTS_REF ldpm_tqi_sp_1_ip_soi_2_0 /end AXIS_DESCR
/end CHARACTERISTIC
/begin CHARACTERISTIC ip_soi_main1_2_2 "SOIST: SOI of main injection at inj conf 2 and temp level 2" MAP 0x85696a _REC_MAP_20_u2_u2_u2 360. _CNV_A_R_LINEAR_____120_CM -120. 240. DISPLAY_IDENTIFIER IP_SOI_MAIN1_2_2 FORMAT "%5.2"
 /begin AXIS_DESCR COM_AXIS n _CNV_A_R_LINEAR_____5_CM 1 0. 6375. FORMAT "%4.0" AXIS_PTS_REF ldp_n_1_ip_soi_main1_2_0_x /end AXIS_DESCR
 /begin AXIS_DESCR COM_AXIS tqi_sp _CNV_A_R_LINEAR_____89_CM 1 -1024. 1023.96875 FORMAT "%6.2" AXIS_PTS_REF ldp_tqi_sp_1_ip_soi_2_0_x /end AXIS_DESCR
/end CHARACTERISTIC
/begin CHARACTERISTIC ip_soi_main1_3_0 "SOIST: SOI of main injection at inj conf 3 and temp level 0" MAP 0x85696c _REC_MAP_20_u2_u2_u2 360. _CNV_A_R_LINEAR_____120_CM -120. 240. DISPLAY_IDENTIFIER IP_SOI_MAIN1_3_0 FORMAT "%5.2"
 /begin AXIS_DESCR COM_AXIS n _CNV_A_R_LINEAR_____5_CM 16 0. 6375. FORMAT "%4.0" AXIS_PTS_REF ldpm_n_1_ip_soi_main1_3_0 /end AXIS_DESCR
 /begin AXIS_DESCR COM_AXIS tqi_sp _CNV_A_R_LINEAR_____89_CM 16 -1024. 1023.96875 FORMAT "%6.2" AXIS_PTS_REF ldpm_tqi_sp_1_ip_soi_3_0 /end AXIS_DESCR
/end CHARACTERISTIC
/begin AXIS_PTS ldpm_n_1_ip_soi_main1_3_0 "SOI of main injection at inj conf 3 and temp level 0" 0x84379a n _REC_AXS_20_u2 6375. _CNV_A_R_LINEAR_____5_CM 16 0. 6375. FORMAT "%4.0" /end AXIS_PTS
/begin AXIS_PTS ldp_n_1_ip_soi_main1_3_0_x "SOI of main injection at inj conf 3 and temp level 0" 0x8418e2 n _REC_AXS_20_u2 6375. _CNV_A_R_LINEAR_____5_CM 1 0. 6375. FORMAT "%4.0" /end AXIS_PTS
/begin AXIS_PTS ldpm_tqi_sp_1_ip_soi_3_0 "SOI of main injection at inj conf 3 and temp level 0" 0x844380 tqi_sp _REC_AXS_20_u2 2047.96875 _CNV_A_R_LINEAR_____89_CM 16 -1024. 1023.96875 FORMAT "%6.2" /end AXIS_PTS
/begin AXIS_PTS ldp_tqi_sp_1_ip_soi_3_0_x "SOI of main injection at inj conf 3 and temp level 0" 0x842d88 tqi_sp _REC_AXS_20_u2 2047.96875 _CNV_A_R_LINEAR_____89_CM 1 -1024. 1023.96875 FORMAT "%6.2" /end AXIS_PTS
/begin CHARACTERISTIC ip_soi_main1_3_1 "SOIST: SOI of main injection at inj conf 3 and temp level 1" MAP 0x856b6c _REC_MAP_20_u2_u2_u2 360. _CNV_A_R_LINEAR_____120_CM -120. 240. DISPLAY_IDENTIFIER IP_SOI_MAIN1_3_1 FORMAT "%5.2"
 /begin AXIS_DESCR COM_AXIS n _CNV_A_R_LINEAR_____5_CM 16 0. 6375. FORMAT "%4.0" AXIS_PTS_REF ldpm_n_1_ip_soi_main1_3_0 /end AXIS_DESCR
 /begin AXIS_DESCR COM_AXIS tqi_sp _CNV_A_R_LINEAR_____89_CM 16 -1024. 1023.96875 FORMAT "%6.2" AXIS_PTS_REF ldpm_tqi_sp_1_ip_soi_3_0 /end AXIS_DESCR
/end CHARACTERISTIC
/begin CHARACTERISTIC ip_soi_main1_3_2 "SOIST: SOI of main injection at inj conf 3 and temp level 2" MAP 0x856d6c _REC_MAP_20_u2_u2_u2 360. _CNV_A_R_LINEAR_____120_CM -120. 240. DISPLAY_IDENTIFIER IP_SOI_MAIN1_3_2 FORMAT "%5.2"
 /begin AXIS_DESCR COM_AXIS n _CNV_A_R_LINEAR_____5_CM 1 0. 6375. FORMAT "%4.0" AXIS_PTS_REF ldp_n_1_ip_soi_main1_3_0_x /end AXIS_DESCR
 /begin AXIS_DESCR COM_AXIS tqi_sp _CNV_A_R_LINEAR_____89_CM 1 -1024. 1023.96875 FORMAT "%6.2" AXIS_PTS_REF ldp_tqi_sp_1_ip_soi_3_0_x /end AXIS_DESCR
/end CHARACTERISTIC
/begin CHARACTERISTIC ip_soi_main1_4_0 "SOIST: SOI of main injection at inj conf 4 and temp level 0" MAP 0x856d6e _REC_MAP_20_u2_u2_u2 360. _CNV_A_R_LINEAR_____120_CM -120. 240. DISPLAY_IDENTIFIER IP_SOI_MAIN1_4_0 FORMAT "%5.2"
 /begin AXIS_DESCR COM_AXIS n _CNV_A_R_LINEAR_____5_CM 16 0. 6375. FORMAT "%4.0" AXIS_PTS_REF ldpm_n_1_ip_soi_main1_4_0 /end AXIS_DESCR
 /begin AXIS_DESCR COM_AXIS tqi_sp _CNV_A_R_LINEAR_____89_CM 16 -1024. 1023.96875 FORMAT "%6.2" AXIS_PTS_REF ldpm_tqi_sp_1_ip_soi_4_0 /end AXIS_DESCR
/end CHARACTERISTIC
/begin AXIS_PTS ldpm_n_1_ip_soi_main1_4_0 "SOI of main injection at inj conf 4 and temp level 0" 0x8437bc n _REC_AXS_20_u2 6375. _CNV_A_R_LINEAR_____5_CM 16 0. 6375. FORMAT "%4.0" /end AXIS_PTS
/begin AXIS_PTS ldp_n_1_ip_soi_main1_4_0_x "SOI of main injection at inj conf 4 and temp level 0" 0x8418e6 n _REC_AXS_20_u2 6375. _CNV_A_R_LINEAR_____5_CM 1 0. 6375. FORMAT "%4.0" /end AXIS_PTS
/begin AXIS_PTS ldpm_tqi_sp_1_ip_soi_4_0 "SOI of main injection at inj conf 4 and temp level 0" 0x8443a2 tqi_sp _REC_AXS_20_u2 2047.96875 _CNV_A_R_LINEAR_____89_CM 16 -1024. 1023.96875 FORMAT "%6.2" /end AXIS_PTS
/begin AXIS_PTS ldp_tqi_sp_1_ip_soi_4_0_x "SOI of main injection at inj conf 4 and temp level 0" 0x842d8c tqi_sp _REC_AXS_20_u2 2047.96875 _CNV_A_R_LINEAR_____89_CM 1 -1024. 1023.96875 FORMAT "%6.2" /end AXIS_PTS
/begin CHARACTERISTIC ip_soi_main1_4_1 "SOIST: SOI of main injection at inj conf 4 and temp level 1" MAP 0x856f6e _REC_MAP_20_u2_u2_u2 360. _CNV_A_R_LINEAR_____120_CM -120. 240. DISPLAY_IDENTIFIER IP_SOI_MAIN1_4_1 FORMAT "%5.2"
 /begin AXIS_DESCR COM_AXIS n _CNV_A_R_LINEAR_____5_CM 16 0. 6375. FORMAT "%4.0" AXIS_PTS_REF ldpm_n_1_ip_soi_main1_4_0 /end AXIS_DESCR
 /begin AXIS_DESCR COM_AXIS tqi_sp _CNV_A_R_LINEAR_____89_CM 16 -1024. 1023.96875 FORMAT "%6.2" AXIS_PTS_REF ldpm_tqi_sp_1_ip_soi_4_0 /end AXIS_DESCR
/end CHARACTERISTIC
/begin CHARACTERISTIC ip_soi_main1_4_2 "SOIST: SOI of main injection at inj conf 4 and temp level 2" MAP 0x85716e _REC_MAP_20_u2_u2_u2 360. _CNV_A_R_LINEAR_____120_CM -120. 240. DISPLAY_IDENTIFIER IP_SOI_MAIN1_4_2 FORMAT "%5.2"
 /begin AXIS_DESCR COM_AXIS n _CNV_A_R_LINEAR_____5_CM 1 0. 6375. FORMAT "%4.0" AXIS_PTS_REF ldp_n_1_ip_soi_main1_4_0_x /end AXIS_DESCR
 /begin AXIS_DESCR COM_AXIS tqi_sp _CNV_A_R_LINEAR_____89_CM 1 -1024. 1023.96875 FORMAT "%6.2" AXIS_PTS_REF ldp_tqi_sp_1_ip_soi_4_0_x /end AXIS_DESCR
/end CHARACTERISTIC
/begin CHARACTERISTIC ip_soi_main1_amp_0_0 "SOIST: ambient pressure correction of SOI_MAIN1 at inj conf 0" MAP 0x857170 _REC_MAP_20_u2_u2_u2 720. _CNV_A_R_LINEAR_____397_CM -360. 360. DISPLAY_IDENTIFIER IP_SOI_MAIN1_AMP_0_0 FORMAT "%5.2"
 /begin AXIS_DESCR COM_AXIS n _CNV_A_R_LINEAR_____5_CM 8 0. 6375. FORMAT "%4.0" AXIS_PTS_REF ldp_n_ip_soi_amp_0_0 /end AXIS_DESCR
 /begin AXIS_DESCR COM_AXIS tqi_sp _CNV_A_R_LINEAR_____89_CM 8 -1024. 1023.96875 FORMAT "%6.2" AXIS_PTS_REF ldp_tqi_sp_ip_soi_amp_0_0 /end AXIS_DESCR
/end CHARACTERISTIC
/begin AXIS_PTS ldp_n_ip_soi_amp_0_0 "ambient pressure correction of SOI_MAIN1 at inj conf 0" 0x841f18 n _REC_AXS_20_u2 6375. _CNV_A_R_LINEAR_____5_CM 8 0. 6375. FORMAT "%4.0" /end AXIS_PTS
/begin AXIS_PTS ldp_tqi_sp_ip_soi_amp_0_0 "ambient pressure correction of SOI_MAIN1 at inj conf 0" 0x843088 tqi_sp _REC_AXS_20_u2 2047.96875 _CNV_A_R_LINEAR_____89_CM 8 -1024. 1023.96875 FORMAT "%6.2" /end AXIS_PTS
/begin CHARACTERISTIC ip_soi_main1_amp_1_0 "SOIST: ambient pressure correction of SOI_MAIN1 at inj conf 1" MAP 0x8571f0 _REC_MAP_20_u2_u2_u2 720. _CNV_A_R_LINEAR_____397_CM -360. 360. DISPLAY_IDENTIFIER IP_SOI_MAIN1_AMP_1_0 FORMAT "%5.2"
 /begin AXIS_DESCR COM_AXIS n _CNV_A_R_LINEAR_____5_CM 8 0. 6375. FORMAT "%4.0" AXIS_PTS_REF ldp_n_ip_soi_amp_1_0 /end AXIS_DESCR
 /begin AXIS_DESCR COM_AXIS tqi_sp _CNV_A_R_LINEAR_____89_CM 8 -1024. 1023.96875 FORMAT "%6.2" AXIS_PTS_REF ldp_tqi_sp_ip_soi_amp_1_0 /end AXIS_DESCR
/end CHARACTERISTIC
/begin AXIS_PTS ldp_n_ip_soi_amp_1_0 "ambient pressure correction of SOI_MAIN1 at inj conf 1" 0x841f2a n _REC_AXS_20_u2 6375. _CNV_A_R_LINEAR_____5_CM 8 0. 6375. FORMAT "%4.0" /end AXIS_PTS
/begin AXIS_PTS ldp_tqi_sp_ip_soi_amp_1_0 "ambient pressure correction of SOI_MAIN1 at inj conf 1" 0x84309a tqi_sp _REC_AXS_20_u2 2047.96875 _CNV_A_R_LINEAR_____89_CM 8 -1024. 1023.96875 FORMAT "%6.2" /end AXIS_PTS
/begin CHARACTERISTIC ip_soi_main1_amp_2_0 "SOIST: ambient pressure correction of SOI_MAIN1 at inj conf 2" MAP 0x857270 _REC_MAP_20_u2_u2_u2 720. _CNV_A_R_LINEAR_____397_CM -360. 360. DISPLAY_IDENTIFIER IP_SOI_MAIN1_AMP_2_0 FORMAT "%5.2"
 /begin AXIS_DESCR COM_AXIS n _CNV_A_R_LINEAR_____5_CM 1 0. 6375. FORMAT "%4.0" AXIS_PTS_REF ldp_n_ip_soi_amp_2_0 /end AXIS_DESCR
 /begin AXIS_DESCR COM_AXIS tqi_sp _CNV_A_R_LINEAR_____89_CM 1 -1024. 1023.96875 FORMAT "%6.2" AXIS_PTS_REF ldp_tqi_sp_ip_soi_amp_2_0 /end AXIS_DESCR
/end CHARACTERISTIC
/begin AXIS_PTS ldp_n_ip_soi_amp_2_0 "ambient pressure correction of SOI_MAIN1 at inj conf 2" 0x841f3c n _REC_AXS_20_u2 6375. _CNV_A_R_LINEAR_____5_CM 1 0. 6375. FORMAT "%4.0" /end AXIS_PTS
/begin AXIS_PTS ldp_tqi_sp_ip_soi_amp_2_0 "ambient pressure correction of SOI_MAIN1 at inj conf 2" 0x8430ac tqi_sp _REC_AXS_20_u2 2047.96875 _CNV_A_R_LINEAR_____89_CM 1 -1024. 1023.96875 FORMAT "%6.2" /end AXIS_PTS
/begin CHARACTERISTIC ip_soi_main1_amp_3_0 "SOIST: ambient pressure correction of SOI_MAIN1 at inj conf 3" MAP 0x857272 _REC_MAP_20_u2_u2_u2 720. _CNV_A_R_LINEAR_____397_CM -360. 360. DISPLAY_IDENTIFIER IP_SOI_MAIN1_AMP_3_0 FORMAT "%5.2"
 /begin AXIS_DESCR COM_AXIS n _CNV_A_R_LINEAR_____5_CM 1 0. 6375. FORMAT "%4.0" AXIS_PTS_REF ldp_n_ip_soi_amp_3_0 /end AXIS_DESCR
 /begin AXIS_DESCR COM_AXIS tqi_sp _CNV_A_R_LINEAR_____89_CM 1 -1024. 1023.96875 FORMAT "%6.2" AXIS_PTS_REF ldp_tqi_sp_ip_soi_amp_3_0 /end AXIS_DESCR
/end CHARACTERISTIC
/begin AXIS_PTS ldp_n_ip_soi_amp_3_0 "ambient pressure correction of SOI_MAIN1 at inj conf 3" 0x841f40 n _REC_AXS_20_u2 6375. _CNV_A_R_LINEAR_____5_CM 1 0. 6375. FORMAT "%4.0" /end AXIS_PTS
/begin AXIS_PTS ldp_tqi_sp_ip_soi_amp_3_0 "ambient pressure correction of SOI_MAIN1 at inj conf 3" 0x8430b0 tqi_sp _REC_AXS_20_u2 2047.96875 _CNV_A_R_LINEAR_____89_CM 1 -1024. 1023.96875 FORMAT "%6.2" /end AXIS_PTS
/begin CHARACTERISTIC ip_soi_main1_amp_4_0 "SOIST: ambient pressure correction of SOI_MAIN1 at inj conf 4" MAP 0x857274 _REC_MAP_20_u2_u2_u2 720. _CNV_A_R_LINEAR_____397_CM -360. 360. DISPLAY_IDENTIFIER IP_SOI_MAIN1_AMP_4_0 FORMAT "%5.2"
 /begin AXIS_DESCR COM_AXIS n _CNV_A_R_LINEAR_____5_CM 1 0. 6375. FORMAT "%4.0" AXIS_PTS_REF ldp_n_ip_soi_amp_4_0 /end AXIS_DESCR
 /begin AXIS_DESCR COM_AXIS tqi_sp _CNV_A_R_LINEAR_____89_CM 1 -1024. 1023.96875 FORMAT "%6.2" AXIS_PTS_REF ldp_tqi_sp_ip_soi_amp_4_0 /end AXIS_DESCR
/end CHARACTERISTIC
/begin AXIS_PTS ldp_n_ip_soi_amp_4_0 "ambient pressure correction of SOI_MAIN1 at inj conf 4" 0x841f44 n _REC_AXS_20_u2 6375. _CNV_A_R_LINEAR_____5_CM 1 0. 6375. FORMAT "%4.0" /end AXIS_PTS
/begin AXIS_PTS ldp_tqi_sp_ip_soi_amp_4_0 "ambient pressure correction of SOI_MAIN1 at inj conf 4" 0x8430b4 tqi_sp _REC_AXS_20_u2 2047.96875 _CNV_A_R_LINEAR_____89_CM 1 -1024. 1023.96875 FORMAT "%6.2" /end AXIS_PTS
/begin CHARACTERISTIC ip_soi_main1_max_n_tqi_sp "SOIST: maximum SOI_MAIN1" MAP 0x857506 _REC_MAP_20_u2_u2_u2 360. _CNV_A_R_LINEAR_____120_CM -120. 240. DISPLAY_IDENTIFIER IP_SOI_MAIN1_MAX_N_TQI_SP FORMAT "%5.2"
 /begin AXIS_DESCR COM_AXIS n _CNV_A_R_LINEAR_____5_CM 2 0. 6375. FORMAT "%4.0" AXIS_PTS_REF ldp_n_ip_soi_main1_max /end AXIS_DESCR
 /begin AXIS_DESCR COM_AXIS tqi_sp _CNV_A_R_LINEAR_____89_CM 2 -1024. 1023.96875 FORMAT "%6.2" AXIS_PTS_REF ldp_tqi_sp_ip_soi_main1_max /end AXIS_DESCR
/end CHARACTERISTIC
/begin AXIS_PTS ldp_n_ip_soi_main1_max "maximum SOI_MAIN1" 0x841f8e n _REC_AXS_20_u2 6375. _CNV_A_R_LINEAR_____5_CM 2 0. 6375. FORMAT "%4.0" /end AXIS_PTS
/begin AXIS_PTS ldp_tqi_sp_ip_soi_main1_max "maximum SOI_MAIN1" 0x8430ec tqi_sp _REC_AXS_20_u2 2047.96875 _CNV_A_R_LINEAR_____89_CM 2 -1024. 1023.96875 FORMAT "%6.2" /end AXIS_PTS
/begin CHARACTERISTIC ip_soi_main1_min_n_tqi_sp "SOIST: minimum SOI_MAIN1" MAP 0x85750e _REC_MAP_20_u2_u2_u2 360. _CNV_A_R_LINEAR_____120_CM -120. 240. DISPLAY_IDENTIFIER IP_SOI_MAIN1_MIN_N_TQI_SP FORMAT "%5.2"
 /begin AXIS_DESCR COM_AXIS n _CNV_A_R_LINEAR_____5_CM 2 0. 6375. FORMAT "%4.0" AXIS_PTS_REF ldp_n_ip_soi_main1_min /end AXIS_DESCR
 /begin AXIS_DESCR COM_AXIS tqi_sp _CNV_A_R_LINEAR_____89_CM 2 -1024. 1023.96875 FORMAT "%6.2" AXIS_PTS_REF ldp_tqi_sp_ip_soi_main1_min /end AXIS_DESCR
/end CHARACTERISTIC
/begin AXIS_PTS ldp_n_ip_soi_main1_min "minimum SOI_MAIN1" 0x841f94 n _REC_AXS_20_u2 6375. _CNV_A_R_LINEAR_____5_CM 2 0. 6375. FORMAT "%4.0" /end AXIS_PTS
/begin AXIS_PTS ldp_tqi_sp_ip_soi_main1_min "minimum SOI_MAIN1" 0x8430f2 tqi_sp _REC_AXS_20_u2 2047.96875 _CNV_A_R_LINEAR_____89_CM 2 -1024. 1023.96875 FORMAT "%6.2" /end AXIS_PTS
/begin CHARACTERISTIC ip_soi_main1_tgas_0_0 "SOIST: air charge temperature correction of soi_main1 at inj conf 0" MAP 0x8585f6 _REC_MAP_20_u2_u2_u2 720. _CNV_A_R_LINEAR_____397_CM -360. 360. DISPLAY_IDENTIFIER IP_SOI_MAIN1_TGAS_0_0 FORMAT "%5.2"
 /begin AXIS_DESCR COM_AXIS n _CNV_A_R_LINEAR_____5_CM 8 0. 6375. FORMAT "%4.0" AXIS_PTS_REF ldp_n_ip_soi_main1_tgas_0_0 /end AXIS_DESCR
 /begin AXIS_DESCR COM_AXIS tqi_sp _CNV_A_R_LINEAR_____89_CM 8 -1024. 1023.96875 FORMAT "%6.2" AXIS_PTS_REF ldp_tqi_sp_ip_soi_tgas_0_0 /end AXIS_DESCR
/end CHARACTERISTIC
/begin AXIS_PTS ldp_n_ip_soi_main1_tgas_0_0 "air charge temperature correction of soi_main1 at inj conf 0" 0x8420ba n _REC_AXS_20_u2 6375. _CNV_A_R_LINEAR_____5_CM 8 0. 6375. FORMAT "%4.0" /end AXIS_PTS
/begin AXIS_PTS ldp_tqi_sp_ip_soi_tgas_0_0 "air charge temperature correction of soi_main1 at inj conf 0" 0x843270 tqi_sp _REC_AXS_20_u2 2047.96875 _CNV_A_R_LINEAR_____89_CM 8 -1024. 1023.96875 FORMAT "%6.2" /end AXIS_PTS
/begin CHARACTERISTIC ip_soi_main1_tgas_1_0 "SOIST: air charge temperature correction of soi_main1 at inj conf 1" MAP 0x858676 _REC_MAP_20_u2_u2_u2 720. _CNV_A_R_LINEAR_____397_CM -360. 360. DISPLAY_IDENTIFIER IP_SOI_MAIN1_TGAS_1_0 FORMAT "%5.2"
 /begin AXIS_DESCR COM_AXIS n _CNV_A_R_LINEAR_____5_CM 8 0. 6375. FORMAT "%4.0" AXIS_PTS_REF ldp_n_ip_soi_main1_tgas_1_0 /end AXIS_DESCR
 /begin AXIS_DESCR COM_AXIS tqi_sp _CNV_A_R_LINEAR_____89_CM 8 -1024. 1023.96875 FORMAT "%6.2" AXIS_PTS_REF ldp_tqi_sp_ip_soi_tgas_1_0 /end AXIS_DESCR
/end CHARACTERISTIC
/begin AXIS_PTS ldp_n_ip_soi_main1_tgas_1_0 "air charge temperature correction of soi_main1 at inj conf 1" 0x8420cc n _REC_AXS_20_u2 6375. _CNV_A_R_LINEAR_____5_CM 8 0. 6375. FORMAT "%4.0" /end AXIS_PTS
/begin AXIS_PTS ldp_tqi_sp_ip_soi_tgas_1_0 "air charge temperature correction of soi_main1 at inj conf 1" 0x843282 tqi_sp _REC_AXS_20_u2 2047.96875 _CNV_A_R_LINEAR_____89_CM 8 -1024. 1023.96875 FORMAT "%6.2" /end AXIS_PTS
/begin CHARACTERISTIC ip_soi_main1_tgas_2_0 "SOIST: air charge temperature correction of soi_main1 at inj conf 2" MAP 0x8586f6 _REC_MAP_20_u2_u2_u2 720. _CNV_A_R_LINEAR_____397_CM -360. 360. DISPLAY_IDENTIFIER IP_SOI_MAIN1_TGAS_2_0 FORMAT "%5.2"
 /begin AXIS_DESCR COM_AXIS n _CNV_A_R_LINEAR_____5_CM 1 0. 6375. FORMAT "%4.0" AXIS_PTS_REF ldp_n_ip_soi_main1_tgas_2_0 /end AXIS_DESCR
 /begin AXIS_DESCR COM_AXIS tqi_sp _CNV_A_R_LINEAR_____89_CM 1 -1024. 1023.96875 FORMAT "%6.2" AXIS_PTS_REF ldp_tqi_sp_ip_soi_tgas_2_0 /end AXIS_DESCR
/end CHARACTERISTIC
/begin AXIS_PTS ldp_n_ip_soi_main1_tgas_2_0 "air charge temperature correction of soi_main1 at inj conf 2" 0x8420de n _REC_AXS_20_u2 6375. _CNV_A_R_LINEAR_____5_CM 1 0. 6375. FORMAT "%4.0" /end AXIS_PTS
/begin AXIS_PTS ldp_tqi_sp_ip_soi_tgas_2_0 "air charge temperature correction of soi_main1 at inj conf 2" 0x843294 tqi_sp _REC_AXS_20_u2 2047.96875 _CNV_A_R_LINEAR_____89_CM 1 -1024. 1023.96875 FORMAT "%6.2" /end AXIS_PTS
/begin CHARACTERISTIC ip_soi_main1_tgas_3_0 "SOIST: air charge temperature correction of soi_main1 at inj conf 3" MAP 0x8586f8 _REC_MAP_20_u2_u2_u2 720. _CNV_A_R_LINEAR_____397_CM -360. 360. DISPLAY_IDENTIFIER IP_SOI_MAIN1_TGAS_3_0 FORMAT "%5.2"
 /begin AXIS_DESCR COM_AXIS n _CNV_A_R_LINEAR_____5_CM 1 0. 6375. FORMAT "%4.0" AXIS_PTS_REF ldp_n_ip_soi_main1_tgas_3_0 /end AXIS_DESCR
 /begin AXIS_DESCR COM_AXIS tqi_sp _CNV_A_R_LINEAR_____89_CM 1 -1024. 1023.96875 FORMAT "%6.2" AXIS_PTS_REF ldp_tqi_sp_ip_soi_tgas_3_0 /end AXIS_DESCR
/end CHARACTERISTIC
/begin AXIS_PTS ldp_n_ip_soi_main1_tgas_3_0 "air charge temperature correction of soi_main1 at inj conf 3" 0x8420e2 n _REC_AXS_20_u2 6375. _CNV_A_R_LINEAR_____5_CM 1 0. 6375. FORMAT "%4.0" /end AXIS_PTS
/begin AXIS_PTS ldp_tqi_sp_ip_soi_tgas_3_0 "air charge temperature correction of soi_main1 at inj conf 3" 0x843298 tqi_sp _REC_AXS_20_u2 2047.96875 _CNV_A_R_LINEAR_____89_CM 1 -1024. 1023.96875 FORMAT "%6.2" /end AXIS_PTS
/begin CHARACTERISTIC ip_soi_main1_tgas_4_0 "SOIST: air charge temperature correction of soi_main1 at inj conf 4" MAP 0x8586fa _REC_MAP_20_u2_u2_u2 720. _CNV_A_R_LINEAR_____397_CM -360. 360. DISPLAY_IDENTIFIER IP_SOI_MAIN1_TGAS_4_0 FORMAT "%5.2"
 /begin AXIS_DESCR COM_AXIS n _CNV_A_R_LINEAR_____5_CM 1 0. 6375. FORMAT "%4.0" AXIS_PTS_REF ldp_n_ip_soi_main1_tgas_4_0 /end AXIS_DESCR
 /begin AXIS_DESCR COM_AXIS tqi_sp _CNV_A_R_LINEAR_____89_CM 1 -1024. 1023.96875 FORMAT "%6.2" AXIS_PTS_REF ldp_tqi_sp_ip_soi_tgas_4_0 /end AXIS_DESCR
/end CHARACTERISTIC
/begin AXIS_PTS ldp_n_ip_soi_main1_tgas_4_0 "air charge temperature correction of soi_main1 at inj conf 4" 0x8420e6 n _REC_AXS_20_u2 6375. _CNV_A_R_LINEAR_____5_CM 1 0. 6375. FORMAT "%4.0" /end AXIS_PTS
/begin AXIS_PTS ldp_tqi_sp_ip_soi_tgas_4_0 "air charge temperature correction of soi_main1 at inj conf 4" 0x84329c tqi_sp _REC_AXS_20_u2 2047.96875 _CNV_A_R_LINEAR_____89_CM 1 -1024. 1023.96875 FORMAT "%6.2" /end AXIS_PTS
/begin MEASUREMENT soi_main1_sel_conf_0 "start of injection MAIN1 at inj conf 0 after temperature selection" UWORD _CNV_A_R_LINEAR_____120_CM 1 0. -120. 240. DISPLAY_IDENTIFIER SOI_MAIN1_SEL_CONF_0 ECU_ADDRESS 0x7fa02e BYTE_ORDER MSB_LAST FORMAT "%6.2" /end MEASUREMENT
/begin MEASUREMENT soi_main1_sel_conf_1 "start of injection MAIN1 at inj conf 1 after temperature selection" UWORD _CNV_A_R_LINEAR_____120_CM 1 0. -120. 240. DISPLAY_IDENTIFIER SOI_MAIN1_SEL_CONF_1 ECU_ADDRESS 0x7fa030 BYTE_ORDER MSB_LAST FORMAT "%6.2" /end MEASUREMENT
/begin MEASUREMENT soi_main1_sel_conf_2 "start of injection MAIN1 at inj conf 2 after temperature selection" UWORD _CNV_A_R_LINEAR_____120_CM 1 0. -120. 240. DISPLAY_IDENTIFIER SOI_MAIN1_SEL_CONF_2 ECU_ADDRESS 0x7fa032 BYTE_ORDER MSB_LAST FORMAT "%6.2" /end MEASUREMENT
/begin MEASUREMENT soi_main1_sel_conf_3 "start of injection MAIN1 at inj conf 3 after temperature selection" UWORD _CNV_A_R_LINEAR_____120_CM 1 0. -120. 240. DISPLAY_IDENTIFIER SOI_MAIN1_SEL_CONF_3 ECU_ADDRESS 0x7fa034 BYTE_ORDER MSB_LAST FORMAT "%6.2" /end MEASUREMENT
/begin MEASUREMENT soi_main1_sel_conf_4 "start of injection MAIN1 at inj conf 4 after temperature selection" UWORD _CNV_A_R_LINEAR_____120_CM 1 0. -120. 240. DISPLAY_IDENTIFIER SOI_MAIN1_SEL_CONF_4 ECU_ADDRESS 0x7fa036 BYTE_ORDER MSB_LAST FORMAT "%6.2" /end MEASUREMENT
/begin CHARACTERISTIC c_t_rgn_trn_soi_main1 "time constant of rgn transition of soi j" VALUE 0x85c126 _REC_VAL_20_u2 4.19424 _CNV_A_R_LINEAR_____67_CM 0. 4.19424 DISPLAY_IDENTIFIER C_T_RGN_TRN_SOI_MAIN1 FORMAT "%7.5" /end CHARACTERISTIC
/begin MEASUREMENT soi_main1_is_pl "" UWORD _CNV_A_R_LINEAR_____120_CM 1 0. -120. 240. DISPLAY_IDENTIFIER SOI_MAIN1_IS_PL ECU_ADDRESS 0x7fa038 BYTE_ORDER MSB_LAST FORMAT "%6.2" /end MEASUREMENT
/begin AXIS_PTS ldp_n_ip_soi_main1_amp_rgn_1 "amp correction of soi_main1 during regeneration" 0x841f5a n _REC_AXS_20_u2 6375. _CNV_A_R_LINEAR_____5_CM 8 0. 6375. FORMAT "%4.0" /end AXIS_PTS
/begin AXIS_PTS ldp_n_ip_soi_main1_tgas_rgn_1 "tgas correction of soi_main1 during regeneration" 0x8420ea n _REC_AXS_20_u2 6375. _CNV_A_R_LINEAR_____5_CM 8 0. 6375. FORMAT "%4.0" /end AXIS_PTS
/begin AXIS_PTS ldp_tco_ip_fac_soi_main1_rgn_1 "TCO interpolation of soi_main1 during regeneration" 0x842744 tco _REC_AXS_20_u1 255. _CNV_A_R_LINEAR_____18_CM 8 -50. 205. FORMAT "%3.0" /end AXIS_PTS
/begin AXIS_PTS ldp_tgas_ip_fac_soi_main1_rgn_1 "tgas correction factor of soi_main1 during regeneration" 0x8429bb tgas _REC_AXS_20_u1 255. _CNV_A_R_LINEAR_____18_CM 8 -50. 205. FORMAT "%3.0" /end AXIS_PTS
/begin MEASUREMENT soi_main1_is_pl_rgn_1 "start of injection MAIN1 at IS/PL at rgn level 1 after injection configuration selection" UWORD _CNV_A_R_LINEAR_____120_CM 1 0. -120. 240. DISPLAY_IDENTIFIER SOI_MAIN1_IS_PL_RGN_1 ECU_ADDRESS 0x7fa03a BYTE_ORDER MSB_LAST /end MEASUREMENT
/begin MEASUREMENT soi_main1_is_pl_rgn_2 "start of injection MAIN1 at IS/PL at rgn level 2 after injection configuration selection" UWORD _CNV_A_R_LINEAR_____120_CM 1 0. -120. 240. DISPLAY_IDENTIFIER SOI_MAIN1_IS_PL_RGN_2 ECU_ADDRESS 0x7fa03c BYTE_ORDER MSB_LAST /end MEASUREMENT
/begin CHARACTERISTIC ip_fac_soi_main1_tco_rgn_1 "Soi Rgn calibrations: TCO interpolation of soi_main1 during regeneration" CURVE 0x84c088 _REC_CUR_20_u2_u1 1.9999696 _CNV_A_R_LINEAR_____53_CM 0. 1.9999696 DISPLAY_IDENTIFIER IP_FAC_SOI_MAIN1_TCO_RGN_1 FORMAT "%6.5"
 /begin AXIS_DESCR COM_AXIS tco _CNV_A_R_LINEAR_____18_CM 8 -50. 205. FORMAT "%3.0" AXIS_PTS_REF ldp_tco_ip_fac_soi_main1_rgn_1 /end AXIS_DESCR
/end CHARACTERISTIC
/begin CHARACTERISTIC ip_fac_soi_main1_tgas_rgn_1 "Soi Rgn calibrations: tgas correction factor of soi_main1 during regeneration" CURVE 0x84c0be _REC_CUR_20_u2_u1 0.9999847412109381 _CNV_A_R_LINEAR_____14_CM 0. 0.9999847412109381 DISPLAY_IDENTIFIER IP_FAC_SOI_MAIN1_TGAS_RGN_1 FORMAT "%6.5"
 /begin AXIS_DESCR COM_AXIS tgas _CNV_A_R_LINEAR_____18_CM 8 -50. 205. FORMAT "%3.0" AXIS_PTS_REF ldp_tgas_ip_fac_soi_main1_rgn_1 /end AXIS_DESCR
/end CHARACTERISTIC
/begin CHARACTERISTIC ip_fac_soi_main1_amp_rgn_1 "Soi Rgn calibrations: amp correction factor of soi_main1 during regeneration" CURVE 0x84c04a _REC_CUR_20_u2_u2 0.9999847412109381 _CNV_A_R_LINEAR_____14_CM 0. 0.9999847412109381 DISPLAY_IDENTIFIER IP_FAC_SOI_MAIN1_AMP_RGN_1 FORMAT "%6.5"
 /begin AXIS_DESCR COM_AXIS amp _CNV_A_R_LINEAR_____21_CM 8 0. 5434. FORMAT "%6.2" AXIS_PTS_REF ldp_amp_ip_fac_mf_rgn_1 /end AXIS_DESCR
/end CHARACTERISTIC
/begin AXIS_PTS ldp_amp_ip_fac_mf_rgn_1 "amp correction factor of soi_main1 during regeneration" 0x84120e amp _REC_AXS_20_u2 5434. _CNV_A_R_LINEAR_____21_CM 8 0. 5434. FORMAT "%6.2" /end AXIS_PTS
/begin CHARACTERISTIC ip_soi_main1_rgn_1_0_1 "Soi Rgn calibrations: SOI of main injection at rgn level 1 and temp level 1" MAP 0x857716 _REC_MAP_20_u2_u2_u2 360. _CNV_A_R_LINEAR_____120_CM -120. 240. DISPLAY_IDENTIFIER IP_SOI_MAIN1_RGN_1_0_1
 /begin AXIS_DESCR COM_AXIS n _CNV_A_R_LINEAR_____5_CM 16 0. 6375. FORMAT "%4.0" AXIS_PTS_REF ldp_n_ip_soi_main1_rgn_1_0_1 /end AXIS_DESCR
 /begin AXIS_DESCR COM_AXIS tqi_sp _CNV_A_R_LINEAR_____89_CM 16 -1024. 1023.96875 FORMAT "%6.2" AXIS_PTS_REF ldp_tqi_sp_ip_soi_main1_rgn_1_0_1 /end AXIS_DESCR
/end CHARACTERISTIC
/begin AXIS_PTS ldp_n_ip_soi_main1_rgn_1_0_1 "SOI of main injection at rgn level 1 and temp level 1" 0x841fbc n _REC_AXS_20_u2 6375. _CNV_A_R_LINEAR_____5_CM 16 0. 6375. FORMAT "%4.0" /end AXIS_PTS
/begin AXIS_PTS ldp_tqi_sp_ip_soi_main1_rgn_1_0_1 "SOI of main injection at rgn level 1 and temp level 1" 0x84311a tqi_sp _REC_AXS_20_u2 2047.96875 _CNV_A_R_LINEAR_____89_CM 16 -1024. 1023.96875 FORMAT "%6.2" /end AXIS_PTS
/begin CHARACTERISTIC ip_soi_main1_rgn_1_0_2 "Soi Rgn calibrations: SOI of main injection at rgn level 1 and temp level 2" MAP 0x857916 _REC_MAP_20_u2_u2_u2 360. _CNV_A_R_LINEAR_____120_CM -120. 240. DISPLAY_IDENTIFIER IP_SOI_MAIN1_RGN_1_0_2
 /begin AXIS_DESCR COM_AXIS n _CNV_A_R_LINEAR_____5_CM 1 0. 6375. FORMAT "%4.0" AXIS_PTS_REF ldp_n_ip_soi_main1_rgn_1_0_2 /end AXIS_DESCR
 /begin AXIS_DESCR COM_AXIS tqi_sp _CNV_A_R_LINEAR_____89_CM 1 -1024. 1023.96875 FORMAT "%6.2" AXIS_PTS_REF ldp_tqi_sp_ip_soi_main1_rgn_1_0_2 /end AXIS_DESCR
/end CHARACTERISTIC
/begin AXIS_PTS ldp_n_ip_soi_main1_rgn_1_0_2 "SOI of main injection at rgn level 1 and temp level 2" 0x841fde n _REC_AXS_20_u2 6375. _CNV_A_R_LINEAR_____5_CM 1 0. 6375. FORMAT "%4.0" /end AXIS_PTS
/begin AXIS_PTS ldp_tqi_sp_ip_soi_main1_rgn_1_0_2 "SOI of main injection at rgn level 1 and temp level 2" 0x84313c tqi_sp _REC_AXS_20_u2 2047.96875 _CNV_A_R_LINEAR_____89_CM 1 -1024. 1023.96875 FORMAT "%6.2" /end AXIS_PTS
/begin CHARACTERISTIC ip_soi_main1_tgas_rgn_1 "Soi Rgn calibrations: tgas correction of soi_main1 during regeneration" MAP 0x8586fc _REC_MAP_20_u2_u2_u2 720. _CNV_A_R_LINEAR_____397_CM -360. 360. DISPLAY_IDENTIFIER IP_SOI_MAIN1_TGAS_RGN_1
 /begin AXIS_DESCR COM_AXIS n _CNV_A_R_LINEAR_____5_CM 8 0. 6375. FORMAT "%4.0" AXIS_PTS_REF ldp_n_ip_soi_main1_tgas_rgn_1 /end AXIS_DESCR
 /begin AXIS_DESCR COM_AXIS tqi_sp _CNV_A_R_LINEAR_____89_CM 8 -1024. 1023.96875 FORMAT "%6.2" AXIS_PTS_REF ldp_tqi_sp_ip_mf_tgas_rgn_1 /end AXIS_DESCR
/end CHARACTERISTIC
/begin CHARACTERISTIC ip_soi_main1_amp_rgn_1 "Soi Rgn calibrations: amp correction of soi_main1 during regeneration" MAP 0x857276 _REC_MAP_20_u2_u2_u2 720. _CNV_A_R_LINEAR_____397_CM -360. 360. DISPLAY_IDENTIFIER IP_SOI_MAIN1_AMP_RGN_1
 /begin AXIS_DESCR COM_AXIS n _CNV_A_R_LINEAR_____5_CM 8 0. 6375. FORMAT "%4.0" AXIS_PTS_REF ldp_n_ip_soi_main1_amp_rgn_1 /end AXIS_DESCR
 /begin AXIS_DESCR COM_AXIS tqi_sp _CNV_A_R_LINEAR_____89_CM 8 -1024. 1023.96875 FORMAT "%6.2" AXIS_PTS_REF ldp_tqi_sp_ip_soi_main1_amp_rgn_1 /end AXIS_DESCR
/end CHARACTERISTIC
/begin AXIS_PTS ldp_tqi_sp_ip_soi_main1_amp_rgn_1 "amp correction of soi_main1 during regeneration" 0x8430b8 tqi_sp _REC_AXS_20_u2 2047.96875 _CNV_A_R_LINEAR_____89_CM 8 -1024. 1023.96875 FORMAT "%6.2" /end AXIS_PTS
/begin CHARACTERISTIC ip_soi_main1_rgn_1_0_0 "Soi Rgn calibrations: SOI of main injection at rgn level 1 and inj conf 0" MAP 0x857516 _REC_MAP_20_u2_u2_u2 360. _CNV_A_R_LINEAR_____120_CM -120. 240. DISPLAY_IDENTIFIER IP_SOI_MAIN1_RGN_1_0_0
 /begin AXIS_DESCR COM_AXIS n _CNV_A_R_LINEAR_____5_CM 16 0. 6375. FORMAT "%4.0" AXIS_PTS_REF ldp_n_ip_soi_main1_rgn_1_0_0 /end AXIS_DESCR
 /begin AXIS_DESCR COM_AXIS tqi_sp _CNV_A_R_LINEAR_____89_CM 16 -1024. 1023.96875 FORMAT "%6.2" AXIS_PTS_REF ldp_tqi_sp_ip_soi_main1_rgn_1_0_0 /end AXIS_DESCR
/end CHARACTERISTIC
/begin AXIS_PTS ldp_n_ip_soi_main1_rgn_1_0_0 "SOI of main injection at rgn level 1 and inj conf 0" 0x841f9a n _REC_AXS_20_u2 6375. _CNV_A_R_LINEAR_____5_CM 16 0. 6375. FORMAT "%4.0" /end AXIS_PTS
/begin AXIS_PTS ldp_tqi_sp_ip_soi_main1_rgn_1_0_0 "SOI of main injection at rgn level 1 and inj conf 0" 0x8430f8 tqi_sp _REC_AXS_20_u2 2047.96875 _CNV_A_R_LINEAR_____89_CM 16 -1024. 1023.96875 FORMAT "%6.2" /end AXIS_PTS
/begin CHARACTERISTIC ip_soi_main1_rgn_1_1_0 "Soi Rgn calibrations: SOI of main injection at rgn level 1 and inj conf 1" MAP 0x857918 _REC_MAP_20_u2_u2_u2 360. _CNV_A_R_LINEAR_____120_CM -120. 240. DISPLAY_IDENTIFIER IP_SOI_MAIN1_RGN_1_1_0
 /begin AXIS_DESCR COM_AXIS n _CNV_A_R_LINEAR_____5_CM 16 0. 6375. FORMAT "%4.0" AXIS_PTS_REF ldp_n_ip_soi_main1_rgn_1_1_0 /end AXIS_DESCR
 /begin AXIS_DESCR COM_AXIS tqi_sp _CNV_A_R_LINEAR_____89_CM 16 -1024. 1023.96875 FORMAT "%6.2" AXIS_PTS_REF ldp_tqi_sp_ip_soi_main1_rgn_1_1_0 /end AXIS_DESCR
/end CHARACTERISTIC
/begin AXIS_PTS ldp_n_ip_soi_main1_rgn_1_1_0 "SOI of main injection at rgn level 1 and inj conf 1" 0x841fe2 n _REC_AXS_20_u2 6375. _CNV_A_R_LINEAR_____5_CM 16 0. 6375. FORMAT "%4.0" /end AXIS_PTS
/begin AXIS_PTS ldp_tqi_sp_ip_soi_main1_rgn_1_1_0 "SOI of main injection at rgn level 1 and inj conf 1" 0x843140 tqi_sp _REC_AXS_20_u2 2047.96875 _CNV_A_R_LINEAR_____89_CM 16 -1024. 1023.96875 FORMAT "%6.2" /end AXIS_PTS
/begin CHARACTERISTIC ip_soi_main1_rgn_1_2_0 "Soi Rgn calibrations: SOI of main injection at rgn level 1 and inj conf 2" MAP 0x857b18 _REC_MAP_20_u2_u2_u2 360. _CNV_A_R_LINEAR_____120_CM -120. 240. DISPLAY_IDENTIFIER IP_SOI_MAIN1_RGN_1_2_0
 /begin AXIS_DESCR COM_AXIS n _CNV_A_R_LINEAR_____5_CM 16 0. 6375. FORMAT "%4.0" AXIS_PTS_REF ldp_n_ip_soi_main1_rgn_1_2_0 /end AXIS_DESCR
 /begin AXIS_DESCR COM_AXIS tqi_sp _CNV_A_R_LINEAR_____89_CM 16 -1024. 1023.96875 FORMAT "%6.2" AXIS_PTS_REF ldp_tqi_sp_ip_soi_main1_rgn_1_2_0 /end AXIS_DESCR
/end CHARACTERISTIC
/begin AXIS_PTS ldp_n_ip_soi_main1_rgn_1_2_0 "SOI of main injection at rgn level 1 and inj conf 2" 0x842004 n _REC_AXS_20_u2 6375. _CNV_A_R_LINEAR_____5_CM 16 0. 6375. FORMAT "%4.0" /end AXIS_PTS
/begin AXIS_PTS ldp_tqi_sp_ip_soi_main1_rgn_1_2_0 "SOI of main injection at rgn level 1 and inj conf 2" 0x843162 tqi_sp _REC_AXS_20_u2 2047.96875 _CNV_A_R_LINEAR_____89_CM 16 -1024. 1023.96875 FORMAT "%6.2" /end AXIS_PTS
/begin CHARACTERISTIC ip_soi_main1_rgn_1_3_0 "Soi Rgn calibrations: SOI of main injection at rgn level 1 and inj conf 3" MAP 0x857d18 _REC_MAP_20_u2_u2_u2 360. _CNV_A_R_LINEAR_____120_CM -120. 240. DISPLAY_IDENTIFIER IP_SOI_MAIN1_RGN_1_3_0
 /begin AXIS_DESCR COM_AXIS n _CNV_A_R_LINEAR_____5_CM 16 0. 6375. FORMAT "%4.0" AXIS_PTS_REF ldp_n_ip_soi_main1_rgn_1_3_0 /end AXIS_DESCR
 /begin AXIS_DESCR COM_AXIS tqi_sp _CNV_A_R_LINEAR_____89_CM 16 -1024. 1023.96875 FORMAT "%6.2" AXIS_PTS_REF ldp_tqi_sp_ip_soi_main1_rgn_1_3_0 /end AXIS_DESCR
/end CHARACTERISTIC
/begin AXIS_PTS ldp_n_ip_soi_main1_rgn_1_3_0 "SOI of main injection at rgn level 1 and inj conf 3" 0x842026 n _REC_AXS_20_u2 6375. _CNV_A_R_LINEAR_____5_CM 16 0. 6375. FORMAT "%4.0" /end AXIS_PTS
/begin AXIS_PTS ldp_tqi_sp_ip_soi_main1_rgn_1_3_0 "SOI of main injection at rgn level 1 and inj conf 3" 0x843184 tqi_sp _REC_AXS_20_u2 2047.96875 _CNV_A_R_LINEAR_____89_CM 16 -1024. 1023.96875 FORMAT "%6.2" /end AXIS_PTS
/begin CHARACTERISTIC ip_soi_main1_rgn_1_4_0 "Soi Rgn calibrations: SOI of main injection at rgn level 1 and inj conf 4" MAP 0x857f18 _REC_MAP_20_u2_u2_u2 360. _CNV_A_R_LINEAR_____120_CM -120. 240. DISPLAY_IDENTIFIER IP_SOI_MAIN1_RGN_1_4_0
 /begin AXIS_DESCR COM_AXIS n _CNV_A_R_LINEAR_____5_CM 16 0. 6375. FORMAT "%4.0" AXIS_PTS_REF ldp_n_ip_soi_main1_rgn_1_4_0 /end AXIS_DESCR
 /begin AXIS_DESCR COM_AXIS tqi_sp _CNV_A_R_LINEAR_____89_CM 16 -1024. 1023.96875 FORMAT "%6.2" AXIS_PTS_REF ldp_tqi_sp_ip_soi_main1_rgn_1_4_0 /end AXIS_DESCR
/end CHARACTERISTIC
/begin AXIS_PTS ldp_n_ip_soi_main1_rgn_1_4_0 "SOI of main injection at rgn level 1 and inj conf 4" 0x842048 n _REC_AXS_20_u2 6375. _CNV_A_R_LINEAR_____5_CM 16 0. 6375. FORMAT "%4.0" /end AXIS_PTS
/begin AXIS_PTS ldp_tqi_sp_ip_soi_main1_rgn_1_4_0 "SOI of main injection at rgn level 1 and inj conf 4" 0x8431a6 tqi_sp _REC_AXS_20_u2 2047.96875 _CNV_A_R_LINEAR_____89_CM 16 -1024. 1023.96875 FORMAT "%6.2" /end AXIS_PTS
/begin CHARACTERISTIC ip_soi_main1_rgn_2_0_0 "Soi Rgn calibrations: SOI of main injection at rgn level 2 and inj conf 0" MAP 0x858118 _REC_MAP_20_u2_u2_u2 360. _CNV_A_R_LINEAR_____120_CM -120. 240. DISPLAY_IDENTIFIER IP_SOI_MAIN1_RGN_2_0_0
 /begin AXIS_DESCR COM_AXIS n _CNV_A_R_LINEAR_____5_CM 16 0. 6375. FORMAT "%4.0" AXIS_PTS_REF ldp_n_ip_soi_main1_rgn_2_0_0 /end AXIS_DESCR
 /begin AXIS_DESCR COM_AXIS tqi_sp _CNV_A_R_LINEAR_____89_CM 16 -1024. 1023.96875 FORMAT "%6.2" AXIS_PTS_REF ldp_tqi_sp_ip_soi_main1_rgn_2_0_0 /end AXIS_DESCR
/end CHARACTERISTIC
/begin AXIS_PTS ldp_n_ip_soi_main1_rgn_2_0_0 "SOI of main injection at rgn level 2 and inj conf 0" 0x84206a n _REC_AXS_20_u2 6375. _CNV_A_R_LINEAR_____5_CM 16 0. 6375. FORMAT "%4.0" /end AXIS_PTS
/begin AXIS_PTS ldp_tqi_sp_ip_soi_main1_rgn_2_0_0 "SOI of main injection at rgn level 2 and inj conf 0" 0x8431c8 tqi_sp _REC_AXS_20_u2 2047.96875 _CNV_A_R_LINEAR_____89_CM 16 -1024. 1023.96875 FORMAT "%6.2" /end AXIS_PTS
/begin CHARACTERISTIC ip_soi_main1_rgn_2_1_0 "Soi Rgn calibrations: SOI of main injection at rgn level 2 and inj conf 1" MAP 0x858318 _REC_MAP_20_u2_u2_u2 360. _CNV_A_R_LINEAR_____120_CM -120. 240. DISPLAY_IDENTIFIER IP_SOI_MAIN1_RGN_2_1_0
 /begin AXIS_DESCR COM_AXIS n _CNV_A_R_LINEAR_____5_CM 16 0. 6375. FORMAT "%4.0" AXIS_PTS_REF ldp_n_ip_soi_main1_rgn_2_1_0 /end AXIS_DESCR
 /begin AXIS_DESCR COM_AXIS tqi_sp _CNV_A_R_LINEAR_____89_CM 16 -1024. 1023.96875 FORMAT "%6.2" AXIS_PTS_REF ldp_tqi_sp_ip_soi_main1_rgn_2_1_0 /end AXIS_DESCR
/end CHARACTERISTIC
/begin AXIS_PTS ldp_n_ip_soi_main1_rgn_2_1_0 "SOI of main injection at rgn level 2 and inj conf 1" 0x84208c n _REC_AXS_20_u2 6375. _CNV_A_R_LINEAR_____5_CM 16 0. 6375. FORMAT "%4.0" /end AXIS_PTS
/begin AXIS_PTS ldp_tqi_sp_ip_soi_main1_rgn_2_1_0 "SOI of main injection at rgn level 2 and inj conf 1" 0x8431ea tqi_sp _REC_AXS_20_u2 2047.96875 _CNV_A_R_LINEAR_____89_CM 16 -1024. 1023.96875 FORMAT "%6.2" /end AXIS_PTS
/begin CHARACTERISTIC ip_soi_main1_rgn_2_2_0 "Soi Rgn calibrations: SOI of main injection at rgn level 2 and inj conf 2" MAP 0x858518 _REC_MAP_20_u2_u2_u2 360. _CNV_A_R_LINEAR_____120_CM -120. 240. DISPLAY_IDENTIFIER IP_SOI_MAIN1_RGN_2_2_0
 /begin AXIS_DESCR COM_AXIS n _CNV_A_R_LINEAR_____5_CM 1 0. 6375. FORMAT "%4.0" AXIS_PTS_REF ldp_n_ip_soi_main1_rgn_2_2_0 /end AXIS_DESCR
 /begin AXIS_DESCR COM_AXIS tqi_sp _CNV_A_R_LINEAR_____89_CM 1 -1024. 1023.96875 FORMAT "%6.2" AXIS_PTS_REF ldp_tqi_sp_ip_soi_main1_rgn_2_2_0 /end AXIS_DESCR
/end CHARACTERISTIC
/begin AXIS_PTS ldp_n_ip_soi_main1_rgn_2_2_0 "SOI of main injection at rgn level 2 and inj conf 2" 0x8420ae n _REC_AXS_20_u2 6375. _CNV_A_R_LINEAR_____5_CM 1 0. 6375. FORMAT "%4.0" /end AXIS_PTS
/begin AXIS_PTS ldp_tqi_sp_ip_soi_main1_rgn_2_2_0 "SOI of main injection at rgn level 2 and inj conf 2" 0x84320c tqi_sp _REC_AXS_20_u2 2047.96875 _CNV_A_R_LINEAR_____89_CM 1 -1024. 1023.96875 FORMAT "%6.2" /end AXIS_PTS
/begin CHARACTERISTIC ip_soi_main1_rgn_2_3_0 "Soi Rgn calibrations: SOI of main injection at rgn level 2 and inj conf 3" MAP 0x85851a _REC_MAP_20_u2_u2_u2 360. _CNV_A_R_LINEAR_____120_CM -120. 240. DISPLAY_IDENTIFIER IP_SOI_MAIN1_RGN_2_3_0
 /begin AXIS_DESCR COM_AXIS n _CNV_A_R_LINEAR_____5_CM 1 0. 6375. FORMAT "%4.0" AXIS_PTS_REF ldp_n_ip_soi_main1_rgn_2_3_0 /end AXIS_DESCR
 /begin AXIS_DESCR COM_AXIS tqi_sp _CNV_A_R_LINEAR_____89_CM 1 -1024. 1023.96875 FORMAT "%6.2" AXIS_PTS_REF ldp_tqi_sp_ip_soi_main1_rgn_2_3_0 /end AXIS_DESCR
/end CHARACTERISTIC
/begin AXIS_PTS ldp_n_ip_soi_main1_rgn_2_3_0 "SOI of main injection at rgn level 2 and inj conf 3" 0x8420b2 n _REC_AXS_20_u2 6375. _CNV_A_R_LINEAR_____5_CM 1 0. 6375. FORMAT "%4.0" /end AXIS_PTS
/begin AXIS_PTS ldp_tqi_sp_ip_soi_main1_rgn_2_3_0 "SOI of main injection at rgn level 2 and inj conf 3" 0x843210 tqi_sp _REC_AXS_20_u2 2047.96875 _CNV_A_R_LINEAR_____89_CM 1 -1024. 1023.96875 FORMAT "%6.2" /end AXIS_PTS
/begin CHARACTERISTIC ip_soi_main1_rgn_2_4_0 "Soi Rgn calibrations: SOI of main injection at rgn level 2 and inj conf 4" MAP 0x85851c _REC_MAP_20_u2_u2_u2 360. _CNV_A_R_LINEAR_____120_CM -120. 240. DISPLAY_IDENTIFIER IP_SOI_MAIN1_RGN_2_4_0
 /begin AXIS_DESCR COM_AXIS n _CNV_A_R_LINEAR_____5_CM 1 0. 6375. FORMAT "%4.0" AXIS_PTS_REF ldp_n_ip_soi_main1_rgn_2_4_0 /end AXIS_DESCR
 /begin AXIS_DESCR COM_AXIS tqi_sp _CNV_A_R_LINEAR_____89_CM 1 -1024. 1023.96875 FORMAT "%6.2" AXIS_PTS_REF ldp_tqi_sp_ip_soi_main1_rgn_2_4_0 /end AXIS_DESCR
/end CHARACTERISTIC
/begin AXIS_PTS ldp_n_ip_soi_main1_rgn_2_4_0 "SOI of main injection at rgn level 2 and inj conf 4" 0x8420b6 n _REC_AXS_20_u2 6375. _CNV_A_R_LINEAR_____5_CM 1 0. 6375. FORMAT "%4.0" /end AXIS_PTS
/begin AXIS_PTS ldp_tqi_sp_ip_soi_main1_rgn_2_4_0 "SOI of main injection at rgn level 2 and inj conf 4" 0x843214 tqi_sp _REC_AXS_20_u2 2047.96875 _CNV_A_R_LINEAR_____89_CM 1 -1024. 1023.96875 FORMAT "%6.2" /end AXIS_PTS
/begin COMPU_METHOD _CNV_A_R_LINEAR_____0_CM "" RAT_FUNC "%6.3" "[-]" COEFFS 0 1. 0. 0 0 1 /end COMPU_METHOD
/begin COMPU_METHOD _CNV_A_R_LINEAR_____5_CM "" RAT_FUNC "%6.3" "[rpm]" COEFFS 0 1. 0. 0 0 1 /end COMPU_METHOD
/begin COMPU_METHOD _CNV_S_2_RANGE______11_CM "" TAB_VERB "%6.3" "[-]" COMPU_TAB_REF _CNV_S_2_RANGE______11 /end COMPU_METHOD
/begin COMPU_VTAB _CNV_S_2_RANGE______11 "" TAB_VERB 2 0 "0" 1 "1" /end COMPU_VTAB
/begin COMPU_METHOD _CNV_A_R_LINEAR_____14_CM "" RAT_FUNC "%6.3" "[-]" COEFFS 0 65535.99999999996 0. 0 0 1 /end COMPU_METHOD
/begin COMPU_METHOD _CNV_A_R_LINEAR_____15_CM "" RAT_FUNC "%6.3" "[-]" COEFFS 0 16384. 0. 0 0 1 /end COMPU_METHOD
/begin COMPU_METHOD _CNV_A_R_LINEAR_____18_CM "" RAT_FUNC "%6.3" "[°C]" COEFFS 0 1. 50. 0 0 1 /end COMPU_METHOD
/begin COMPU_METHOD _CNV_A_R_LINEAR_____19_CM "" RAT_FUNC "%6.3" "[s]" COEFFS 0 10. 0. 0 0 1 /end COMPU_METHOD
/begin COMPU_METHOD _CNV_A_R_LINEAR_____21_CM "" RAT_FUNC "%6.3" "[hPa]" COEFFS 0 12.06017666543982 0. 0 0 1 /end COMPU_METHOD
/begin COMPU_METHOD _CNV_A_R_LINEAR_____34_CM "" RAT_FUNC "%6.3" "[-]" COEFFS 0 256. 0. 0 0 1 /end COMPU_METHOD
/begin COMPU_METHOD _CNV_A_R_LINEAR_____53_CM "" RAT_FUNC "%6.3" "[-]" COEFFS 0 32767.99807357072 0. 0 0 1 /end COMPU_METHOD
/begin COMPU_METHOD _CNV_A_R_LINEAR_____62_CM "" RAT_FUNC "%6.3" "[Nm]" COEFFS 0 32. 0. 0 0 1 /end COMPU_METHOD
/begin COMPU_METHOD _CNV_A_R_LINEAR_____63_CM "" RAT_FUNC "%6.3" "[-]" COEFFS 0 16383.81262712377 0. 0 0 1 /end COMPU_METHOD
/begin COMPU_METHOD _CNV_A_R_LINEAR_____67_CM "" RAT_FUNC "%6.3" "[s]" COEFFS 0 15625. 0. 0 0 1 /end COMPU_METHOD
/begin COMPU_METHOD _CNV_A_R_LINEAR_____89_CM "" RAT_FUNC "%6.3" "[Nm]" COEFFS 0 32. 32768. 0 0 1 /end COMPU_METHOD
/begin COMPU_METHOD _CNV_A_R_LINEAR_____90_CM "" RAT_FUNC "%6.3" "[-]" COEFFS 0 65535.82575140447 0. 0 0 1 /end COMPU_METHOD
/begin COMPU_METHOD _CNV_A_R_LINEAR_____119_CM "" RAT_FUNC "%6.3" "[MPa]" COEFFS 0 327.680000069121 32768.0000069121 0 0 1 /end COMPU_METHOD
/begin COMPU_METHOD _CNV_A_R_LINEAR_____120_CM "" RAT_FUNC "%6.3" "[°CRK]" COEFFS 0 42.66666666666666 5120. 0 0 1 /end COMPU_METHOD
/begin COMPU_METHOD _CNV_A_R_LINEAR_____121_CM "" RAT_FUNC "%6.3" "[°CRK]" COEFFS 0 42.66666666666666 0. 0 0 1 /end COMPU_METHOD
/begin COMPU_METHOD _CNV_A_R_LINEAR_____159_CM "" RAT_FUNC "%6.3" "[-]" COEFFS 0 1000. 0. 0 0 1 /end COMPU_METHOD
/begin COMPU_METHOD _CNV_A_R_LINEAR_____265_CM "" RAT_FUNC "%6.3" "[Nm/(rpm*s)]" COEFFS 0 50. 0. 0 0 1 /end COMPU_METHOD
/begin COMPU_METHOD _CNV_A_R_LINEAR_____266_CM "" RAT_FUNC "%6.3" "[Nm/rpm]" COEFFS 0 1000. 0. 0 0 1 /end COMPU_METHOD
/begin COMPU_METHOD _CNV_A_R_LINEAR_____267_CM "" RAT_FUNC "%6.3" "[-]" COEFFS 0 50. 0. 0 0 1 /end COMPU_METHOD
/begin COMPU_METHOD _CNV_A_R_LINEAR_____268_CM "" RAT_FUNC "%6.3" "[Nm/rpm]" COEFFS 0 65535.82575140447 0. 0 0 1 /end COMPU_METHOD
/begin COMPU_METHOD _CNV_A_R_LINEAR_____269_CM "" RAT_FUNC "%6.3" "[s]" COEFFS 0 7812.500000000001 0. 0 0 1 /end COMPU_METHOD
/begin COMPU_METHOD _CNV_A_R_LINEAR_____270_CM "" RAT_FUNC "%6.3" "[Nm*s/rpm]" COEFFS 0 16383.81262712377 0. 0 0 1 /end COMPU_METHOD
/begin COMPU_METHOD _CNV_A_R_LINEAR_____397_CM "" RAT_FUNC "%6.3" "[°CRK]" COEFFS 0 42.66666666666666 32768. 0 0 1 /end COMPU_METHOD
/begin RECORD_LAYOUT _REC_VAL_20_u1 FNC_VALUES 1 UBYTE COLUMN_DIR DIRECT /end RECORD_LAYOUT
/begin RECORD_LAYOUT _REC_AXS_20_u2 NO_AXIS_PTS_X 1 UWORD AXIS_PTS_X 2 UWORD INDEX_INCR DIRECT /end RECORD_LAYOUT
/begin RECORD_LAYOUT _REC_MAP_20_u2_u2_u2 FNC_VALUES 1 UWORD COLUMN_DIR DIRECT /end RECORD_LAYOUT
/begin RECORD_LAYOUT _REC_VAL_20_u2 FNC_VALUES 1 UWORD COLUMN_DIR DIRECT /end RECORD_LAYOUT
/begin RECORD_LAYOUT _REC_VAL_20_s2 FNC_VALUES 1 SWORD COLUMN_DIR DIRECT /end RECORD_LAYOUT
/begin RECORD_LAYOUT _REC_AXS_20_u1 NO_AXIS_PTS_X 1 UBYTE AXIS_PTS_X 2 UBYTE INDEX_INCR DIRECT /end RECORD_LAYOUT
/begin RECORD_LAYOUT _REC_CUR_20_u2_u2 FNC_VALUES 1 UWORD COLUMN_DIR DIRECT /end RECORD_LAYOUT
/begin RECORD_LAYOUT _REC_CUR_20_u2_u1 FNC_VALUES 1 UWORD COLUMN_DIR DIRECT /end RECORD_LAYOUT
/begin RECORD_LAYOUT _REC_MAP_20_u2_u2_u1 FNC_VALUES 1 UWORD COLUMN_DIR DIRECT /end RECORD_LAYOUT
/begin RECORD_LAYOUT _REC_CUR_20_u1_u1 FNC_VALUES 1 UBYTE COLUMN_DIR DIRECT /end RECORD_LAYOUT
/begin FUNCTION SOI_ASOI_MINOR ""
 /begin DEF_CHARACTERISTIC ip_fac_soi_prev1_cor_amp ldp_amp_ip_fac_soi_prev1_cor ip_fac_soi_prev1_cor_tgas ldp_tgas_ip_fac_soi_prev1_cor ip_fac_soi_prev1_cor_tco ldp_tco_ip_fac_soi_prev1_cor ldpm_n_1_ip_soi_prev1_dif ldpm_tqi_sp_1_ip_soi_prev1_dif ip_soi_prev1_dif_amp ldp_n_ip_soi_prev1_dif_amp ldp_tqi_sp_ip_soi_prev1_dif_amp ip_soi_prev1_dif_tgas ldp_n_ip_soi_prev1_dif_tgas ldp_tqi_sp_ip_soi_prev1_dif_tgas ip_fac_soi_prev2_cor_amp ldp_amp_ip_fac_soi_prev2_cor ip_fac_soi_prev2_cor_tgas ldp_tgas_ip_fac_soi_prev2_cor ip_fac_soi_prev2_cor_tco ldp_tco_ip_fac_soi_prev2_cor ldpm_n_1_ip_soi_prev2_dif ldpm_tqi_sp_1_ip_soi_prev2_dif ip_soi_prev2_dif_amp ldp_n_ip_soi_prev2_dif_amp ldp_tqi_sp_ip_soi_prev2_dif_amp ip_soi_prev2_dif_tgas ldp_n_ip_soi_prev2_dif_tgas ldp_tqi_sp_ip_soi_prev2_dif_tgas ip_fac_soi_main2_cor_amp ldp_amp_ip_fac_soi_main2_cor ip_fac_soi_main2_cor_tgas ldp_tgas_ip_fac_soi_main2_cor ip_fac_soi_main2_cor_tco ldp_tco_ip_fac_soi_main2_cor ldpm_n_1_ip_soi_main2_dif ldpm_tqi_sp_1_ip_soi_main2_dif ip_soi_main2_dif_amp ldp_n_ip_soi_main2_dif_amp ldp_tqi_sp_ip_soi_main2_dif_amp ip_soi_main2_dif_tgas ldp_n_ip_soi_main2_dif_tgas ldp_tqi_sp_ip_soi_main2_dif_tgas ip_fac_soi_post1_cor_amp ldp_amp_ip_fac_soi_post1_cor ip_fac_soi_post1_cor_tgas ldp_tgas_ip_fac_soi_post1_cor ip_fac_soi_post1_cor_tco ldp_tco_ip_fac_soi_post1_cor ldpm_n_1_ip_soi_post1_dif ldpm_tqi_sp_1_ip_soi_post1_dif ip_soi_post1_dif_amp ldp_n_ip_soi_post1_dif_amp ldp_tqi_sp_ip_soi_post1_dif_amp ip_soi_post1_dif_tgas ldp_n_ip_soi_post1_dif_tgas ldp_tqi_sp_ip_soi_post1_dif_tgas ip_soi_main2_dif_0_0 ip_soi_main2_dif_0_2 ip_soi_main2_dif_0_1 ip_soi_post1_dif_0_0 ip_soi_post1_dif_0_2 ip_soi_post1_dif_0_1 ip_soi_prev1_dif_0_2 ip_soi_prev1_dif_0_0 ip_soi_prev1_dif_0_1 ip_soi_prev2_dif_0_0 ip_soi_prev2_dif_0_2 ip_soi_prev2_dif_0_1 /end DEF_CHARACTERISTIC
 /begin OUT_MEASUREMENT soi_main2_dif_is_pl_rgl soi_prev2_dif_is_pl_rgl soi_prev1_dif_is_pl_rgl soi_post1_dif_is_pl_rgl soi_post1_dif_cor_rgl soi_prev1_dif_cor_rgl soi_prev2_dif_cor_rgl soi_main2_dif_cor_rgl /end OUT_MEASUREMENT
/end FUNCTION
/begin FUNCTION SOI_ASOI_MINOR_ST ""
 /begin DEF_CHARACTERISTIC ip_fac_soi_main2_dif_st_cor_amp ip_fac_soi_post1_dif_st_cor_amp ip_fac_soi_prev1_dif_st_cor_amp ip_fac_soi_prev2_dif_st_cor_amp ip_soi_main2_dif_st ip_soi_post1_dif_st ip_soi_prev1_dif_st ip_soi_prev2_dif_st ip_soi_main2_dif_st_cor_amp ip_soi_post1_dif_st_cor_amp ip_soi_prev1_dif_st_cor_amp ip_soi_prev2_dif_st_cor_amp /end DEF_CHARACTERISTIC
 /begin OUT_MEASUREMENT soi_prev2_dif_st soi_main2_dif_st soi_prev1_dif_st soi_post1_dif_st /end OUT_MEASUREMENT
/end FUNCTION
/begin FUNCTION SOI_ASOICOR "" /begin DEF_CHARACTERISTIC ldpm_fup_tra_dif_1_inj ip_soi_main1_cor_fup_tra_dif /end DEF_CHARACTERISTIC
 /begin OUT_MEASUREMENT soi_prev1_cor soi_prev2_cor soi_main2_cor soi_post1_cor soi_main1_cor_conf_1 soi_main1_cor_conf_2 soi_main1_cor_conf_0 soi_main1_cor_conf_3 soi_main1_cor_conf_4 soi_prev1_dif_min soi_prev2_dif_min soi_main2_dif_min soi_post1_dif_min soi_prev1_dif_max soi_prev2_dif_max soi_main2_dif_max soi_post1_dif_max /end OUT_MEASUREMENT
/end FUNCTION
/begin FUNCTION SOI_ASOI_MINOR_TRAN ""
 /begin DEF_CHARACTERISTIC c_t_rgn_trn_soi_post1 c_t_rgn_trn_soi_prev1 c_t_rgn_trn_soi_main2 c_t_rgn_trn_soi_prev2 /end DEF_CHARACTERISTIC
 /begin OUT_MEASUREMENT soi_prev1_dif_is_pl soi_prev2_dif_is_pl soi_main2_dif_is_pl soi_post1_dif_is_pl /end OUT_MEASUREMENT
/end FUNCTION
/begin FUNCTION SOI_ASOI_MINOR_TEMP ""
 /begin OUT_MEASUREMENT soi_prev1_dif_bas_sel soi_main2_dif_bas_sel soi_prev2_dif_bas_sel soi_post1_dif_bas_sel /end OUT_MEASUREMENT
/end FUNCTION
/begin FUNCTION SOI_ASOI_MINOR_RGN ""
 /begin DEF_CHARACTERISTIC ldp_amp_ip_fac_soi_prev1_rgn_1 ldp_amp_ip_fac_soi_prev2_rgn_1 ldp_amp_ip_fac_soi_main2_rgn_1 ldp_amp_ip_fac_soi_post1_rgn_1 ldp_n_ip_soi_prev1_amp_rgn_1 ldp_n_ip_soi_post1_amp_rgn_1 ldp_n_ip_soi_main2_amp_rgn_1 ldp_n_ip_soi_post1_dif_rgn_1_0_1 ldp_n_ip_soi_prev2_dif_rgn_1_0_1 ldp_n_ip_soi_prev1_dif_rgn_1_0_1 ldp_n_ip_soi_main2_dif_rgn_1_0_1 ldp_n_ip_soi_prev2_dif_rgn_1_0_2 ldp_n_ip_soi_post1_dif_rgn_1_0_2 ldp_n_ip_soi_prev1_dif_rgn_1_0_2 ldp_n_ip_soi_main2_dif_rgn_1_0_2 ldp_n_ip_soi_main2_tgas_rgn_1 ldp_n_ip_soi_prev1_tgas_rgn_1 ldp_n_ip_soi_post1_tgas_rgn_1 ldp_tco_ip_fac_soi_post1_rgn_1 ldp_tco_ip_fac_soi_prev1_rgn_1 ldp_tco_ip_fac_soi_main2_rgn_1 ldp_tgas_ip_fac_soi_main2_rgn_1 ldp_tgas_ip_fac_soi_prev1_rgn_1 ldp_tgas_ip_fac_soi_post1_rgn_1 ldp_tqi_ip_soi_post1_amp_rgn_1 ldp_tqi_ip_soi_prev2_amp_rgn_1 ldp_tqi_ip_soi_prev1_amp_rgn_1 ldp_tqi_ip_soi_main2_amp_rgn_1 ldpm_tqi_ip_soi_prev2_dif_rgn_1 ldpm_tqi_ip_soi_prev2_dif_rgn_2 ldpm_tqi_ip_soi_main2_dif_rgn_1 ldpm_tqi_ip_soi_main2_dif_rgn_2 ldpm_tqi_ip_soi_post1_dif_rgn_1 ldpm_tqi_ip_soi_post1_dif_rgn_2 ldpm_tqi_ip_soi_prev1_dif_rgn_1 ldpm_tqi_ip_soi_prev1_dif_rgn_2 ip_fac_soi_post1_cor_amp_rgn_1 ip_fac_soi_prev2_cor_amp_rgn_1 ip_fac_soi_prev1_cor_amp_rgn_1 ip_fac_soi_main2_cor_amp_rgn_1 ip_fac_soi_post1_cor_tco_rgn_1 ldp_tco_ip_fac_soi_prev2_rgn_1 ip_fac_soi_prev2_cor_tco_rgn_1 ip_fac_soi_prev1_cor_tco_rgn_1 ip_fac_soi_main2_cor_tco_rgn_1 ldp_tgas_ip_fac_soi_prev2_rgn_1 ip_fac_soi_prev2_cor_tgas_rgn_1 ip_fac_soi_main2_cor_tgas_rgn_1 ip_fac_soi_prev1_cor_tgas_rgn_1 ip_fac_soi_post1_cor_tgas_rgn_1 ip_soi_post1_dif_amp_rgn_1 ldp_n_ip_soi_prev2_amp_rgn_1 ip_soi_prev2_dif_amp_rgn_1 ip_soi_prev1_dif_amp_rgn_1 ip_soi_main2_dif_amp_rgn_1 ip_soi_prev2_dif_rgn_1_0_1 ip_soi_main2_dif_rgn_1_0_1 ip_soi_prev1_dif_rgn_1_0_1 ip_soi_post1_dif_rgn_1_0_1 ip_soi_post1_dif_rgn_1_0_2 ip_soi_prev2_dif_rgn_1_0_2 ip_soi_prev1_dif_rgn_1_0_2 ip_soi_main2_dif_rgn_1_0_2 ldp_n_ip_soi_prev2_tgas_rgn_1 ip_soi_prev2_dif_tgas_rgn_1 ip_soi_main2_dif_tgas_rgn_1 ip_soi_prev1_dif_tgas_rgn_1 ip_soi_post1_dif_tgas_rgn_1 ip_soi_prev2_dif_rgn_1_0_0 ip_soi_prev2_dif_rgn_2_0_0 ip_soi_main2_dif_rgn_1_0_0 ip_soi_main2_dif_rgn_2_0_0 ip_soi_post1_dif_rgn_1_0_0 ip_soi_post1_dif_rgn_2_0_0 ip_soi_prev1_dif_rgn_1_0_0 ip_soi_prev1_dif_rgn_2_0_0 ldpm_n_1_ip_soi_prev2_dif_rgn_1 ldpm_n_1_ip_soi_prev2_dif_rgn_2 ldpm_n_1_ip_soi_main2_dif_rgn_1 ldpm_n_1_ip_soi_main2_dif_rgn_2 ldp_tqi_ip_soi_prev2_dif_rgn_1_0_1 ldp_tqi_ip_soi_main2_dif_rgn_1_0_1 ldp_tqi_ip_soi_prev1_dif_rgn_1_0_1 ldp_tqi_ip_soi_post1_dif_rgn_1_0_1 ldp_tqi_ip_soi_prev2_dif_rgn_1_0_2 ldp_tqi_ip_soi_main2_dif_rgn_1_0_2 ldp_tqi_ip_soi_prev1_dif_rgn_1_0_2 ldp_tqi_ip_soi_post1_dif_rgn_1_0_2 ldp_tqi_ip_soi_prev2_tgas_rgn_1 ldp_tqi_ip_soi_main2_tgas_rgn_1 ldp_tqi_ip_soi_prev1_tgas_rgn_1 ldp_tqi_ip_soi_post1_tgas_rgn_1 ldpm_n_1_ip_soi_post1_dif_rgn_1 ldpm_n_1_ip_soi_post1_dif_rgn_2 ldpm_n_1_ip_soi_prev1_dif_rgn_2 ldpm_n_1_ip_soi_prev1_dif_rgn_1 /end DEF_CHARACTERISTIC
 /begin OUT_MEASUREMENT soi_prev1_dif_is_pl_rgn_1 soi_prev2_dif_is_pl_rgn_1 soi_main2_dif_is_pl_rgn_1 soi_post1_dif_is_pl_rgn_1 soi_prev1_dif_is_pl_rgn_2 soi_prev2_dif_is_pl_rgn_2 soi_main2_dif_is_pl_rgn_2 soi_post1_dif_is_pl_rgn_2 /end OUT_MEASUREMENT
/end FUNCTION
/begin FUNCTION SOI_ASOI_TUNE ""
 /begin DEF_CHARACTERISTIC c_fac_soi_prev1_tu lc_soi_prev1_tu_on c_soi_prev1_add_tu c_soi_prev1_add_tu_cyl[0] c_soi_prev1_add_tu_cyl[1] c_soi_prev1_add_tu_cyl[2] c_soi_prev1_add_tu_cyl[3] c_fac_soi_prev2_tu lc_soi_prev2_tu_on c_soi_prev2_add_tu c_soi_prev2_add_tu_cyl[0] c_soi_prev2_add_tu_cyl[1] c_soi_prev2_add_tu_cyl[2] c_soi_prev2_add_tu_cyl[3] c_fac_soi_main1_tu lc_soi_main1_tu_on c_soi_main1_add_tu c_soi_main1_add_tu_cyl[0] c_soi_main1_add_tu_cyl[1] c_soi_main1_add_tu_cyl[2] c_soi_main1_add_tu_cyl[3] c_fac_soi_main2_tu lc_soi_main2_tu_on c_soi_main2_add_tu c_soi_main2_add_tu_cyl[0] c_soi_main2_add_tu_cyl[1] c_soi_main2_add_tu_cyl[2] c_soi_main2_add_tu_cyl[3] c_soi_main1_test_add_tu[0] c_soi_main1_test_add_tu[1] c_soi_main1_test_add_tu[2] c_soi_main1_test_add_tu[3] c_soi_main2_test_add_tu[0] c_soi_main2_test_add_tu[1] c_soi_main2_test_add_tu[2] c_soi_main2_test_add_tu[3] c_soi_prev1_test_add_tu[0] c_soi_prev1_test_add_tu[1] c_soi_prev1_test_add_tu[2] c_soi_prev1_test_add_tu[3] c_soi_prev2_test_add_tu[0] c_soi_prev2_test_add_tu[1] c_soi_prev2_test_add_tu[2] c_soi_prev2_test_add_tu[3] lc_soi_post1_tu_on lc_soi_post2_tu_on c_fac_soi_post1_tu c_fac_soi_post2_tu c_soi_post1_add_tu c_soi_post2_add_tu c_soi_post1_add_tu_cyl[0] c_soi_post1_add_tu_cyl[1] c_soi_post1_add_tu_cyl[2] c_soi_post1_add_tu_cyl[3] c_soi_post2_add_tu_cyl[0] c_soi_post2_add_tu_cyl[1] c_soi_post2_add_tu_cyl[2] c_soi_post2_add_tu_cyl[3] c_soi_post1_test_add_tu[0] c_soi_post1_test_add_tu[1] c_soi_post1_test_add_tu[2] c_soi_post1_test_add_tu[3] c_soi_post2_test_add_tu[0] c_soi_post2_test_add_tu[1] c_soi_post2_test_add_tu[2] c_soi_post2_test_add_tu[3] ldp_n_ip_soi_min_tu_ad_2 ip_soi_min_tu_ad_2_n ip_soi_main1_inj_test_ad ldp_n_ip_soi_main1_inj_test_ad ldp_tqi_sp_ip_soi_main1_inj_test_ad /end DEF_CHARACTERISTIC
 /begin OUT_MEASUREMENT soi_post1_tu soi_post2_tu soi_main1_tu soi_main2_tu soi_prev2_tu soi_prev1_tu /end OUT_MEASUREMENT
/end FUNCTION
/begin FUNCTION SOI_ASOI_MAIN_ST ""
 /begin DEF_CHARACTERISTIC ip_fac_soi_main1_st_cor_amp ip_soi_main1_st ip_soi_main1_st_cor_amp /end DEF_CHARACTERISTIC
 /begin OUT_MEASUREMENT soi_main1_st /end OUT_MEASUREMENT
/end FUNCTION
/begin FUNCTION SOI_ASOI_MAIN ""
 /begin DEF_CHARACTERISTIC ip_fac_soi_main1_amp_0_0 ldp_amp_ip_fac_soi_main1_0_0 ip_fac_soi_main1_amp_1_0 ldp_amp_ip_fac_soi_main1_1_0 ip_fac_soi_main1_amp_2_0 ldp_amp_ip_fac_soi_main1_2_0 ip_fac_soi_main1_amp_3_0 ldp_amp_ip_fac_soi_main1_3_0 ip_fac_soi_main1_amp_4_0 ldp_amp_ip_fac_soi_main1_4_0 ip_fac_soi_main1_tgas_0_0 ldp_tgas_ip_fac_soi_main1_0_0 ip_fac_soi_main1_tgas_1_0 ldp_tgas_ip_fac_soi_main1_1_0 ip_fac_soi_main1_tgas_2_0 ldp_tgas_ip_fac_soi_main1_2_0 ip_fac_soi_main1_tgas_3_0 ldp_tgas_ip_fac_soi_main1_3_0 ip_fac_soi_main1_tgas_4_0 ldp_tgas_ip_fac_soi_main1_4_0 ip_fac_soi_main1_tco_0_0 ldp_tco_ip_fac_soi_main1_0_0 ip_fac_soi_main1_tco_1_0 ldp_tco_ip_fac_soi_main1_1_0 ip_fac_soi_main1_tco_2_0 ldp_tco_ip_fac_soi_main1_2_0 ip_fac_soi_main1_tco_3_0 ldp_tco_ip_fac_soi_main1_3_0 ip_fac_soi_main1_tco_4_0 ldp_tco_ip_fac_soi_main1_4_0 ip_soi_main1_0_0 ldpm_n_1_ip_soi_main1_0_0 ldpm_tqi_sp_1_ip_soi_0_0 ip_soi_main1_0_1 ip_soi_main1_0_2 ip_soi_main1_1_0 ldpm_n_1_ip_soi_main1_1_0 ldpm_tqi_sp_1_ip_soi_1_0 ip_soi_main1_1_1 ip_soi_main1_1_2 ip_soi_main1_2_0 ldpm_n_1_ip_soi_main1_2_0 ldp_n_1_ip_soi_main1_2_0_x ldpm_tqi_sp_1_ip_soi_2_0 ldp_tqi_sp_1_ip_soi_2_0_x ip_soi_main1_2_1 ip_soi_main1_2_2 ip_soi_main1_3_0 ldpm_n_1_ip_soi_main1_3_0 ldp_n_1_ip_soi_main1_3_0_x ldpm_tqi_sp_1_ip_soi_3_0 ldp_tqi_sp_1_ip_soi_3_0_x ip_soi_main1_3_1 ip_soi_main1_3_2 ip_soi_main1_4_0 ldpm_n_1_ip_soi_main1_4_0 ldp_n_1_ip_soi_main1_4_0_x ldpm_tqi_sp_1_ip_soi_4_0 ldp_tqi_sp_1_ip_soi_4_0_x ip_soi_main1_4_1 ip_soi_main1_4_2 ip_soi_main1_amp_0_0 ldp_n_ip_soi_amp_0_0 ldp_tqi_sp_ip_soi_amp_0_0 ip_soi_main1_amp_1_0 ldp_n_ip_soi_amp_1_0 ldp_tqi_sp_ip_soi_amp_1_0 ip_soi_main1_amp_2_0 ldp_n_ip_soi_amp_2_0 ldp_tqi_sp_ip_soi_amp_2_0 ip_soi_main1_amp_3_0 ldp_n_ip_soi_amp_3_0 ldp_tqi_sp_ip_soi_amp_3_0 ip_soi_main1_amp_4_0 ldp_n_ip_soi_amp_4_0 ldp_tqi_sp_ip_soi_amp_4_0 ip_soi_main1_max_n_tqi_sp ldp_n_ip_soi_main1_max ldp_tqi_sp_ip_soi_main1_max ip_soi_main1_min_n_tqi_sp ldp_n_ip_soi_main1_min ldp_tqi_sp_ip_soi_main1_min ip_soi_main1_tgas_0_0 ldp_n_ip_soi_main1_tgas_0_0 ldp_tqi_sp_ip_soi_tgas_0_0 ip_soi_main1_tgas_1_0 ldp_n_ip_soi_main1_tgas_1_0 ldp_tqi_sp_ip_soi_tgas_1_0 ip_soi_main1_tgas_2_0 ldp_n_ip_soi_main1_tgas_2_0 ldp_tqi_sp_ip_soi_tgas_2_0 ip_soi_main1_tgas_3_0 ldp_n_ip_soi_main1_tgas_3_0 ldp_tqi_sp_ip_soi_tgas_3_0 ip_soi_main1_tgas_4_0 ldp_n_ip_soi_main1_tgas_4_0 ldp_tqi_sp_ip_soi_tgas_4_0 /end DEF_CHARACTERISTIC
 /begin OUT_MEASUREMENT soi_main1_is_pl_rgl soi_main1_is_pl_cor_sum_rgl /end OUT_MEASUREMENT
/end FUNCTION
/begin FUNCTION SOI_ASOI_MAIN_TEMP ""
 /begin OUT_MEASUREMENT soi_main1_sel_conf_0 soi_main1_sel_conf_1 soi_main1_sel_conf_2 soi_main1_sel_conf_3 soi_main1_sel_conf_4 /end OUT_MEASUREMENT
/end FUNCTION
/begin FUNCTION SOI_ASOI_MAIN_TRAN "" /begin DEF_CHARACTERISTIC c_t_rgn_trn_soi_main1 /end DEF_CHARACTERISTIC /begin OUT_MEASUREMENT soi_main1_is_pl /end OUT_MEASUREMENT /end FUNCTION
/begin FUNCTION SOI_ASOI_MAIN_RGN ""
 /begin DEF_CHARACTERISTIC ldp_n_ip_soi_main1_amp_rgn_1 ldp_n_ip_soi_main1_tgas_rgn_1 ldp_tco_ip_fac_soi_main1_rgn_1 ldp_tgas_ip_fac_soi_main1_rgn_1 ip_fac_soi_main1_tco_rgn_1 ip_fac_soi_main1_tgas_rgn_1 ip_fac_soi_main1_amp_rgn_1 ldp_amp_ip_fac_mf_rgn_1 ip_soi_main1_rgn_1_0_1 ldp_n_ip_soi_main1_rgn_1_0_1 ldp_tqi_sp_ip_soi_main1_rgn_1_0_1 ip_soi_main1_rgn_1_0_2 ldp_n_ip_soi_main1_rgn_1_0_2 ldp_tqi_sp_ip_soi_main1_rgn_1_0_2 ip_soi_main1_tgas_rgn_1 ip_soi_main1_amp_rgn_1 ldp_tqi_sp_ip_soi_main1_amp_rgn_1 ip_soi_main1_rgn_1_0_0 ldp_n_ip_soi_main1_rgn_1_0_0 ldp_tqi_sp_ip_soi_main1_rgn_1_0_0 ip_soi_main1_rgn_1_1_0 ldp_n_ip_soi_main1_rgn_1_1_0 ldp_tqi_sp_ip_soi_main1_rgn_1_1_0 ip_soi_main1_rgn_1_2_0 ldp_n_ip_soi_main1_rgn_1_2_0 ldp_tqi_sp_ip_soi_main1_rgn_1_2_0 ip_soi_main1_rgn_1_3_0 ldp_n_ip_soi_main1_rgn_1_3_0 ldp_tqi_sp_ip_soi_main1_rgn_1_3_0 ip_soi_main1_rgn_1_4_0 ldp_n_ip_soi_main1_rgn_1_4_0 ldp_tqi_sp_ip_soi_main1_rgn_1_4_0 ip_soi_main1_rgn_2_0_0 ldp_n_ip_soi_main1_rgn_2_0_0 ldp_tqi_sp_ip_soi_main1_rgn_2_0_0 ip_soi_main1_rgn_2_1_0 ldp_n_ip_soi_main1_rgn_2_1_0 ldp_tqi_sp_ip_soi_main1_rgn_2_1_0 ip_soi_main1_rgn_2_2_0 ldp_n_ip_soi_main1_rgn_2_2_0 ldp_tqi_sp_ip_soi_main1_rgn_2_2_0 ip_soi_main1_rgn_2_3_0 ldp_n_ip_soi_main1_rgn_2_3_0 ldp_tqi_sp_ip_soi_main1_rgn_2_3_0 ip_soi_main1_rgn_2_4_0 ldp_n_ip_soi_main1_rgn_2_4_0 ldp_tqi_sp_ip_soi_main1_rgn_2_4_0 /end DEF_CHARACTERISTIC
 /begin OUT_MEASUREMENT soi_main1_is_pl_rgn_1 soi_main1_is_pl_rgn_2 /end OUT_MEASUREMENT
/end FUNCTION
/begin FUNCTION SOI_ASOITRAN ""
 /begin OUT_MEASUREMENT soi_post1 soi_post1_dif soi_post1_bas soi_main2 soi_prev1 soi_prev2 soi_post2 soi_prev1_dif soi_prev2_dif soi_main1 soi_main2_dif soi_main1_bas soi_main2_bas soi_post2_bas soi_prev2_bas soi_prev1_bas /end OUT_MEASUREMENT
/end FUNCTION
/begin FUNCTION C_A_FMY "" /end FUNCTION
/begin FUNCTION C_8_IS ""
 /begin SUB_FUNCTION IS_ATQ_IS IS_ATQSTGEN IS_AIS_PI IS_AIS_CTL IS_ATQI_ST IS_AIS_LIM IS_AIS_PCTL /end SUB_FUNCTION
/end FUNCTION
/begin FUNCTION IS_ATQ_IS ""
 /begin DEF_CHARACTERISTIC lc_is_n_pred c_t1_dt1_is_acin_off c_t1_dt1_is_acin_on c_kr_dt1_is_acin_off c_kr_dt1_is_acin_on c_tqi_dt1_is_min c_tqi_dt1_is_max c_t_dly_dt1_is c_tqi_dt1_is_thd c_kr_dt1_is c_kr_dt1_is_vs_run c_t1_dt1_is c_t1_dt1_is_vs_run c_fac_is_tqi_ini_brake c_fac_is_tqi_ini c_tqi_ini_add_acin lc_is_ini_bls_on id_fac_n_dif_rng_is__dri ldpm_dri_id_isc id_n_dif_rng_is__dri id_tqi_ini__dri ip_n_dif_dt1_is__tco ldp_tco_ip_n_dif_dt1_is ip_tqi_ini__tco ldp_tco_ip_tqi_ini /end DEF_CHARACTERISTIC
 /begin OUT_MEASUREMENT n_dif_is tqi_is_ctl kr_dt1_is tqi_p_is_ctl tqi_is_dt1_acin tqi_is_dt1_n tqi_pi_is_ctl tqi_i_is_ctl tqi_dt1_is_ctl n_dif t1_dt1_is lv_act_dt1_is tqi_is_ini /end OUT_MEASUREMENT
/end FUNCTION
/begin FUNCTION IS_ATQSTGEN ""
 /begin DEF_CHARACTERISTIC ip_dly_ctr_tqi_st ldp_tco_ip_dly_ctr_tq_st ip_tqi_st ldp_n_ip_tqi_st ldp_tco_ip_tqi_st /end DEF_CHARACTERISTIC
 /begin OUT_MEASUREMENT lv_is_ena_st dly_ctr_tqi_st tqi_st /end OUT_MEASUREMENT
/end FUNCTION
/begin FUNCTION IS_AIS_PI ""
 /begin DEF_CHARACTERISTIC c_gain_n_dif_pos_ki c_gain_n_dif_neg_ki c_gain_n_dif_pos_kp c_gain_n_dif_neg_kp c_n_dif_thd_pos_kp c_n_dif_thd_neg_kp c_n_dif_thd_pos_ki c_n_dif_thd_neg_ki c_n_dif_win_pos_ki c_n_dif_win_neg_ki c_n_dif_win_pos_kp c_n_dif_win_neg_kp lc_is_p_ctl_brake c_fac_kr_pi_is_brake id_kr_pi_is__dri ip_ki_pi_neg_is_tco ldp_tco_ip_ki_pi_neg_is ip_ki_pi_pos_is_tco ldp_tco_ip_ki_pi_pos_is ip_kr_pi_neg_is__tco ldp_tco_ip_kr_pi_neg_is ip_kr_pi_pos_is__tco ldp_tco_ip_kr_pi_pos_is id_ki_pi_is_dri /end DEF_CHARACTERISTIC
 /begin OUT_MEASUREMENT ki_pi_is kp_pi_is /end OUT_MEASUREMENT
/end FUNCTION
/end MODULE
/end PROJECT
