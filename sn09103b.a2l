ASAP2_VERSION 1 41
/begin PROJECT SN0 "SIMOS PPD"
/begin HEADER "_default_HeaderComment" PROJECT_NO PRJ_NUM /end HEADER
/begin MODULE _default_ModuleName "_default_ModuleLongIdentifier"
/begin MOD_COMMON "_default_ModCommonComment" DEPOSIT ABSOLUTE BYTE_ORDER MSB_FIRST ALIGNMENT_BYTE 1 ALIGNMENT_WORD 2 ALIGNMENT_LONG 4 ALIGNMENT_FLOAT32_IEEE 4 ALIGNMENT_FLOAT64_IEEE 8 /end MOD_COMMON
/begin AXIS_PTS ldpm_amp_2_inj "fuel mass AMP-correction factor of PREV1, PREV2, MAIN2 & POST1 at ST" 0x843404 amp _REC_AXS_20_u2 5434. _CNV_A_R_LINEAR_____21_CM 4 0. 5434. FORMAT "%6.2" /end AXIS_PTS
/begin AXIS_PTS ldpm_n_3_inj "start fuel mass of injection PREV1, PREV2, MAIN2 & POST1" 0x8438c8 n _REC_AXS_20_u2 6375. _CNV_A_R_LINEAR_____5_CM 7 0. 6375. FORMAT "%4.0" /end AXIS_PTS
/begin AXIS_PTS ldpm_tco_2_inj "start fuel mass of injection PREV1, PREV2, MAIN2 & POST1" 0x843e85 tco _REC_AXS_20_u1 255. _CNV_A_R_LINEAR_____18_CM 12 -50. 205. FORMAT "%3.0" /end AXIS_PTS
/begin AXIS_PTS ldpm_n_4_inj "amp correction of fuel mass of injection PREV1, PREV2, MAIN2 & POST1 at ST" 0x8438d8 n _REC_AXS_20_u2 6375. _CNV_A_R_LINEAR_____5_CM 4 0. 6375. FORMAT "%4.0" /end AXIS_PTS
/begin AXIS_PTS ldpm_tco_3_inj "amp correction of fuel mass of injection PREV1, PREV2, MAIN2 & POST1 at ST" 0x843e92 tco _REC_AXS_20_u1 255. _CNV_A_R_LINEAR_____18_CM 6 -50. 205. FORMAT "%3.0" /end AXIS_PTS
/begin MEASUREMENT lv_mf_slm_act "logical variable for 'smoke limitation active'" UBYTE _CNV_S_2_RANGE______11_CM 1 0. 0. 1. DISPLAY_IDENTIFIER LV_MF_SLM_ACT ECU_ADDRESS 0x7fb641 /end MEASUREMENT
/begin MEASUREMENT mf_slm "fuel mass for smoke limitation" UWORD _CNV_A_R_LINEAR_____43_CM 1 0. 0. 262.14 DISPLAY_IDENTIFIER MF_SLM ECU_ADDRESS 0x7f9c32 BYTE_ORDER MSB_LAST /end MEASUREMENT
/begin MEASUREMENT maf_fil_slm "filtered MAF for smoke limitation" UWORD _CNV_A_R_LINEAR_____23_CM 1 0. 0. 1389. DISPLAY_IDENTIFIER MAF_FIL_SLM ECU_ADDRESS 0x7fa910 BYTE_ORDER MSB_LAST FORMAT "%6.2" /end MEASUREMENT
/begin MEASUREMENT mf_slm_cor_fup "smoke limitation correction from FUP" SWORD _CNV_A_R_LINEAR_____43_CM 1 0. -131.072 131.068 DISPLAY_IDENTIFIER MF_SLM_COR_FUP ECU_ADDRESS 0x7fa912 BYTE_ORDER MSB_LAST /end MEASUREMENT
/begin MEASUREMENT mf_slm_cor_tco "smoke limitation correction from TCO" SWORD _CNV_A_R_LINEAR_____43_CM 1 0. -131.072 131.068 DISPLAY_IDENTIFIER MF_SLM_COR_TCO ECU_ADDRESS 0x7fa914 BYTE_ORDER MSB_LAST /end MEASUREMENT
/begin MEASUREMENT mf_slm_cor_temp_slm "smoke limiation correction from TIA or TBA" SWORD _CNV_A_R_LINEAR_____43_CM 1 0. -131.072 131.068 DISPLAY_IDENTIFIER MF_SLM_COR_TEMP_SLM ECU_ADDRESS 0x7fa916 BYTE_ORDER MSB_LAST /end MEASUREMENT
/begin MEASUREMENT temp_slm "temperature for smoke limitation" UBYTE _CNV_A_R_LINEAR_____18_CM 1 0. -50. 205. DISPLAY_IDENTIFIER TEMP_SLM ECU_ADDRESS 0x7fb642 FORMAT "%3.0" /end MEASUREMENT
/begin CHARACTERISTIC lc_mf_slm_is_act "activation for smoke limitation during IS" VALUE 0x8487ca _REC_VAL_20_u1 1. _CNV_A_R_LINEAR_____0_CM 0. 1. DISPLAY_IDENTIFIER LC_MF_SLM_IS_ACT FORMAT "%1.0" /end CHARACTERISTIC
/begin CHARACTERISTIC c_crlc_maf_slm "correlation constant for MAF for smoke limitation" VALUE 0x84835a _REC_VAL_20_u2 0.9999874 _CNV_A_R_LINEAR_____90_CM 0. 0.9999874 DISPLAY_IDENTIFIER C_CRLC_MAF_SLM FORMAT "%6.5" /end CHARACTERISTIC
/begin CHARACTERISTIC lc_swi_temp_slm "switch for smoke limitation temperature selection" VALUE 0x8487d5 _REC_VAL_20_u1 1. _CNV_A_R_LINEAR_____0_CM 0. 1. DISPLAY_IDENTIFIER LC_SWI_TEMP_SLM FORMAT "%1.0" /end CHARACTERISTIC
/begin CHARACTERISTIC ip_fac_mf_slm__tco "MFSLM: smoke limitation TCO-correction factor" CURVE 0x846b1e _REC_CUR_20_u2_u1 3.99998471 _CNV_A_R_LINEAR_____63_CM 0. 3.99998471 DISPLAY_IDENTIFIER IP_FAC_MF_SLM__TCO FORMAT "%6.5"
 /begin AXIS_DESCR COM_AXIS tco _CNV_A_R_LINEAR_____18_CM 8 -50. 205. FORMAT "%3.0" AXIS_PTS_REF ldp_tco_ip_fac_mf_slm /end AXIS_DESCR
/end CHARACTERISTIC
/begin AXIS_PTS ldp_tco_ip_fac_mf_slm "" 0x84271d tco _REC_AXS_20_u1 255. _CNV_A_R_LINEAR_____18_CM 8 -50. 205. FORMAT "%3.0" /end AXIS_PTS
/begin CHARACTERISTIC ip_fac_mf_slm__amp "MFSLM: smoke limitation AMP-correction factor" CURVE 0x846b0e _REC_CUR_20_u2_u2 3.99998471 _CNV_A_R_LINEAR_____63_CM 0. 3.99998471 DISPLAY_IDENTIFIER IP_FAC_MF_SLM__AMP FORMAT "%6.5"
 /begin AXIS_DESCR COM_AXIS amp _CNV_A_R_LINEAR_____21_CM 8 0. 5434. FORMAT "%6.2" AXIS_PTS_REF ldp_amp_ip_fac_mf_slm /end AXIS_DESCR
/end CHARACTERISTIC
/begin AXIS_PTS ldp_amp_ip_fac_mf_slm "" 0x841220 amp _REC_AXS_20_u2 5434. _CNV_A_R_LINEAR_____21_CM 8 0. 5434. FORMAT "%6.2" /end AXIS_PTS
/begin CHARACTERISTIC ip_fac_mf_slm__temp_slm "MFSLM: smoke limitation TIA- or TBA-correction factor" CURVE 0x846b2e _REC_CUR_20_u2_u1 3.99998471 _CNV_A_R_LINEAR_____63_CM 0. 3.99998471 DISPLAY_IDENTIFIER IP_FAC_MF_SLM__TEMP_SLM FORMAT "%6.5"
 /begin AXIS_DESCR COM_AXIS temp_slm _CNV_A_R_LINEAR_____18_CM 8 -50. 205. FORMAT "%3.0" AXIS_PTS_REF ldp_temp_slm_ip_fac_mf_slm /end AXIS_DESCR
/end CHARACTERISTIC
/begin AXIS_PTS ldp_temp_slm_ip_fac_mf_slm "" 0x8428af temp_slm _REC_AXS_20_u1 255. _CNV_A_R_LINEAR_____18_CM 8 -50. 205. FORMAT "%3.0" /end AXIS_PTS
/begin CHARACTERISTIC ip_mf_slm_bas__n__maf_fil "MFSLM: basic smoke limitation from filtered MAF" MAP 0x846d8c _REC_MAP_20_u2_u2_u2 262.14 _CNV_A_R_LINEAR_____43_CM 0. 262.14 DISPLAY_IDENTIFIER IP_MF_SLM_BAS__N__MAF_FIL
 /begin AXIS_DESCR COM_AXIS n _CNV_A_R_LINEAR_____5_CM 12 0. 6375. FORMAT "%4.0" AXIS_PTS_REF ldpm_n_ip_mf_slm_bas /end AXIS_DESCR
 /begin AXIS_DESCR COM_AXIS maf_fil_slm _CNV_A_R_LINEAR_____23_CM 16 0. 1389. FORMAT "%6.2" AXIS_PTS_REF ldpm_maf_fil_ip_mf_slm_bas /end AXIS_DESCR
/end CHARACTERISTIC
/begin AXIS_PTS ldpm_n_ip_mf_slm_bas "" 0x843c38 n _REC_AXS_20_u2 6375. _CNV_A_R_LINEAR_____5_CM 12 0. 6375. FORMAT "%4.0" /end AXIS_PTS
/begin AXIS_PTS ldpm_maf_fil_ip_mf_slm_bas "" 0x8434cc maf_fil_slm _REC_AXS_20_u2 1389. _CNV_A_R_LINEAR_____23_CM 16 0. 1389. FORMAT "%6.2" /end AXIS_PTS
/begin CHARACTERISTIC ip_mf_slm_cor_amp__n__amp "MFSLM: smoke limitation correction from AMP" MAP 0x84708c _REC_MAP_20_u2_u2_u2 262.14 _CNV_A_R_LINEAR_____133_CM -131.072 131.068 DISPLAY_IDENTIFIER IP_MF_SLM_COR_AMP__N__AMP
 /begin AXIS_DESCR COM_AXIS n _CNV_A_R_LINEAR_____5_CM 6 0. 6375. FORMAT "%4.0" AXIS_PTS_REF ldpm_n_ip_mf_slm /end AXIS_DESCR
 /begin AXIS_DESCR COM_AXIS amp _CNV_A_R_LINEAR_____21_CM 6 0. 5434. FORMAT "%6.2" AXIS_PTS_REF ldp_amp_ip_mf_slm_cor_amp /end AXIS_DESCR
/end CHARACTERISTIC
/begin AXIS_PTS ldpm_n_ip_mf_slm "" 0x843c2a n _REC_AXS_20_u2 6375. _CNV_A_R_LINEAR_____5_CM 6 0. 6375. FORMAT "%4.0" /end AXIS_PTS
/begin AXIS_PTS ldp_amp_ip_mf_slm_cor_amp "" 0x8412fa amp _REC_AXS_20_u2 5434. _CNV_A_R_LINEAR_____21_CM 6 0. 5434. FORMAT "%6.2" /end AXIS_PTS
/begin CHARACTERISTIC ip_mf_slm_tfu_lim__n__tfu "MFSLM: smoke limitation from TFU" MAP 0x8471c4 _REC_MAP_20_u2_u2_u1 262.14 _CNV_A_R_LINEAR_____43_CM 0. 262.14 DISPLAY_IDENTIFIER IP_MF_SLM_TFU_LIM__N__TFU
 /begin AXIS_DESCR COM_AXIS n _CNV_A_R_LINEAR_____5_CM 6 0. 6375. FORMAT "%4.0" AXIS_PTS_REF ldpm_n_ip_mf_slm /end AXIS_DESCR
 /begin AXIS_DESCR COM_AXIS tfu _CNV_A_R_LINEAR_____18_CM 4 -50. 205. FORMAT "%3.0" AXIS_PTS_REF ldp_tfu_ip_mf_slm_tfu_lim /end AXIS_DESCR
/end CHARACTERISTIC
/begin AXIS_PTS ldp_tfu_ip_mf_slm_tfu_lim "" 0x8428d6 tfu _REC_AXS_20_u1 255. _CNV_A_R_LINEAR_____18_CM 4 -50. 205. FORMAT "%3.0" /end AXIS_PTS
/begin CHARACTERISTIC ip_mf_slm_cor_tco__n__maf "MFSLM: smoke limitation correction from TCO" MAP 0x847134 _REC_MAP_20_u2_u2_u2 262.14 _CNV_A_R_LINEAR_____133_CM -131.072 131.068 DISPLAY_IDENTIFIER IP_MF_SLM_COR_TCO__N__MAF
 /begin AXIS_DESCR COM_AXIS n _CNV_A_R_LINEAR_____5_CM 6 0. 6375. FORMAT "%4.0" AXIS_PTS_REF ldpm_n_ip_mf_slm /end AXIS_DESCR
 /begin AXIS_DESCR COM_AXIS maf _CNV_A_R_LINEAR_____23_CM 6 0. 1389. FORMAT "%6.2" AXIS_PTS_REF ldp_maf_ip_mf_slm_cor_tco /end AXIS_DESCR
/end CHARACTERISTIC
/begin AXIS_PTS ldp_maf_ip_mf_slm_cor_tco "" 0x84172c maf _REC_AXS_20_u2 1389. _CNV_A_R_LINEAR_____23_CM 6 0. 1389. FORMAT "%6.2" /end AXIS_PTS
/begin CHARACTERISTIC ip_mf_slm_cor_fup__n__fup_tra_d "MFSLM: smoke limitation correction from FUP" MAP 0x8470d4 _REC_MAP_20_u2_u2_u2 262.14 _CNV_A_R_LINEAR_____133_CM -131.072 131.068 DISPLAY_IDENTIFIER IP_MF_SLM_COR_FUP__N__FUP_TRA_D
 /begin AXIS_DESCR COM_AXIS n _CNV_A_R_LINEAR_____5_CM 6 0. 6375. FORMAT "%4.0" AXIS_PTS_REF ldpm_n_ip_mf_slm /end AXIS_DESCR
 /begin AXIS_DESCR COM_AXIS fup_tra_dif _CNV_A_R_LINEAR_____119_CM 8 -100. 99.99694820000001 FORMAT "%5.3" AXIS_PTS_REF ldp_fup_tra_d_ip_mf_slm_cor_fup /end AXIS_DESCR
/end CHARACTERISTIC
/begin AXIS_PTS ldp_fup_tra_d_ip_mf_slm_cor_fup "" 0x8416e6 fup_tra_dif _REC_AXS_20_u2 199.9969482 _CNV_A_R_LINEAR_____119_CM 8 -100. 99.99694820000001 FORMAT "%5.3" /end AXIS_PTS
/begin CHARACTERISTIC ip_mf_slm_cor_temp_slm__n__maf "MFSLM: smoke limitation correction from TIA or TBA" MAP 0x84717c _REC_MAP_20_u2_u2_u2 262.14 _CNV_A_R_LINEAR_____133_CM -131.072 131.068 DISPLAY_IDENTIFIER IP_MF_SLM_COR_TEMP_SLM__N__MAF
 /begin AXIS_DESCR COM_AXIS n _CNV_A_R_LINEAR_____5_CM 6 0. 6375. FORMAT "%4.0" AXIS_PTS_REF ldpm_n_ip_mf_slm /end AXIS_DESCR
 /begin AXIS_DESCR COM_AXIS maf _CNV_A_R_LINEAR_____23_CM 6 0. 1389. FORMAT "%6.2" AXIS_PTS_REF ldp_maf_ip_mf_slm_cor_temp_slm /end AXIS_DESCR
/end CHARACTERISTIC
/begin AXIS_PTS ldp_maf_ip_mf_slm_cor_temp_slm "" 0x84173a maf _REC_AXS_20_u2 1389. _CNV_A_R_LINEAR_____23_CM 6 0. 1389. FORMAT "%6.2" /end AXIS_PTS
/begin CHARACTERISTIC ip_mf_slm_bas_rgn__n__maf_fil "MFSLM: basic smoke limitation from filtered MAF in regeneration" MAP 0x846f0c _REC_MAP_20_u2_u2_u2 262.14 _CNV_A_R_LINEAR_____43_CM 0. 262.14 DISPLAY_IDENTIFIER IP_MF_SLM_BAS_RGN__N__MAF_FIL
 /begin AXIS_DESCR COM_AXIS n _CNV_A_R_LINEAR_____5_CM 12 0. 6375. FORMAT "%4.0" AXIS_PTS_REF ldpm_n_ip_mf_slm_bas /end AXIS_DESCR
 /begin AXIS_DESCR COM_AXIS maf_fil_slm _CNV_A_R_LINEAR_____23_CM 16 0. 1389. FORMAT "%6.2" AXIS_PTS_REF ldpm_maf_fil_ip_mf_slm_bas /end AXIS_DESCR
/end CHARACTERISTIC
/begin MEASUREMENT lv_byp_on "" UBYTE _CNV_S_2_RANGE__0___88_CM 1 0. 0. 1. DISPLAY_IDENTIFIER LV_BYP_ON ECU_ADDRESS 0x7fcfcf /end MEASUREMENT
/begin CHARACTERISTIC c_byp_lih_cnt_max_A "" VALUE 0x84833c _REC_VAL_20_u1 255. _CNV_A_R_LINEAR_____1_CM 0. 255. DISPLAY_IDENTIFIER C_BYP_LIH_CNT_MAX_A FORMAT "%3.0" /end CHARACTERISTIC
/begin CHARACTERISTIC c_byp_lih_cnt_max_B "" VALUE 0x84833d _REC_VAL_20_u1 255. _CNV_A_R_LINEAR_____1_CM 0. 255. DISPLAY_IDENTIFIER C_BYP_LIH_CNT_MAX_B FORMAT "%3.0" /end CHARACTERISTIC
/begin CHARACTERISTIC c_byp_on "" VALUE 0x84833e _REC_VAL_20_u1 255. _CNV_A_R_LINEAR_____1_CM 0. 255. DISPLAY_IDENTIFIER C_BYP_ON FORMAT "%3.0" /end CHARACTERISTIC
/begin MEASUREMENT byp_cnt_A "" UBYTE _CNV_A_R_LINEAR_____1_CM 1 0. 0. 255. DISPLAY_IDENTIFIER BYP_CNT_A ECU_ADDRESS 0x7fcfcc FORMAT "%3.0" /end MEASUREMENT
/begin MEASUREMENT byp_cnt_B "" UBYTE _CNV_A_R_LINEAR_____1_CM 1 0. 0. 255. DISPLAY_IDENTIFIER BYP_CNT_B ECU_ADDRESS 0x7fcfcd FORMAT "%3.0" /end MEASUREMENT
/begin MEASUREMENT byp_error "" UBYTE _CNV_A_R_LINEAR_____1_CM 1 0. 0. 255. DISPLAY_IDENTIFIER BYP_ERROR ECU_ADDRESS 0x7fcfce FORMAT "%3.0" /end MEASUREMENT
/begin CHARACTERISTIC c_byp_func_A "" VALUE 0x848334 _REC_VAL_20_u2 65535. _CNV_A_R_LINEAR_____1_CM 0. 65535. DISPLAY_IDENTIFIER C_BYP_FUNC_A FORMAT "%5.0" /end CHARACTERISTIC
/begin CHARACTERISTIC c_byp_func_B "" VALUE 0x848338 _REC_VAL_20_u4 4294967295. _CNV_A_R_LINEAR_____1_CM 0. 4294967295. DISPLAY_IDENTIFIER C_BYP_FUNC_B FORMAT "%10.0" /end CHARACTERISTIC
/begin CHARACTERISTIC c_byp_A_ofs_ch1 "" VALUE 0x848305 _REC_VAL_20_u1 255. _CNV_A_R_LINEAR_____1_CM 0. 255. DISPLAY_IDENTIFIER C_BYP_A_OFS_CH1 FORMAT "%3.0" /end CHARACTERISTIC
/begin CHARACTERISTIC c_byp_A_ofs_ch2 "" VALUE 0x84830c _REC_VAL_20_u1 255. _CNV_A_R_LINEAR_____1_CM 0. 255. DISPLAY_IDENTIFIER C_BYP_A_OFS_CH2 FORMAT "%3.0" /end CHARACTERISTIC
/begin CHARACTERISTIC c_byp_A_ofs_ch3 "" VALUE 0x84830d _REC_VAL_20_u1 255. _CNV_A_R_LINEAR_____1_CM 0. 255. DISPLAY_IDENTIFIER C_BYP_A_OFS_CH3 FORMAT "%3.0" /end CHARACTERISTIC
/begin CHARACTERISTIC c_byp_A_ofs_ch4 "" VALUE 0x84830e _REC_VAL_20_u1 255. _CNV_A_R_LINEAR_____1_CM 0. 255. DISPLAY_IDENTIFIER C_BYP_A_OFS_CH4 FORMAT "%3.0" /end CHARACTERISTIC
/begin CHARACTERISTIC c_byp_A_ofs_ch5 "" VALUE 0x84830f _REC_VAL_20_u1 255. _CNV_A_R_LINEAR_____1_CM 0. 255. DISPLAY_IDENTIFIER C_BYP_A_OFS_CH5 FORMAT "%3.0" /end CHARACTERISTIC
/begin CHARACTERISTIC c_byp_A_ofs_ch6 "" VALUE 0x848310 _REC_VAL_20_u1 255. _CNV_A_R_LINEAR_____1_CM 0. 255. DISPLAY_IDENTIFIER C_BYP_A_OFS_CH6 FORMAT "%3.0" /end CHARACTERISTIC
/begin CHARACTERISTIC c_byp_A_ofs_ch7 "" VALUE 0x848311 _REC_VAL_20_u1 255. _CNV_A_R_LINEAR_____1_CM 0. 255. DISPLAY_IDENTIFIER C_BYP_A_OFS_CH7 FORMAT "%3.0" /end CHARACTERISTIC
/begin CHARACTERISTIC c_byp_A_ofs_ch8 "" VALUE 0x848312 _REC_VAL_20_u1 255. _CNV_A_R_LINEAR_____1_CM 0. 255. DISPLAY_IDENTIFIER C_BYP_A_OFS_CH8 FORMAT "%3.0" /end CHARACTERISTIC
/begin CHARACTERISTIC c_byp_A_ofs_ch9 "" VALUE 0x848313 _REC_VAL_20_u1 255. _CNV_A_R_LINEAR_____1_CM 0. 255. DISPLAY_IDENTIFIER C_BYP_A_OFS_CH9 FORMAT "%3.0" /end CHARACTERISTIC
/begin CHARACTERISTIC c_byp_A_ofs_ch10 "" VALUE 0x848306 _REC_VAL_20_u1 255. _CNV_A_R_LINEAR_____1_CM 0. 255. DISPLAY_IDENTIFIER C_BYP_A_OFS_CH10 FORMAT "%3.0" /end CHARACTERISTIC
/begin CHARACTERISTIC c_byp_A_ofs_ch11 "" VALUE 0x848307 _REC_VAL_20_u1 255. _CNV_A_R_LINEAR_____1_CM 0. 255. DISPLAY_IDENTIFIER C_BYP_A_OFS_CH11 FORMAT "%3.0" /end CHARACTERISTIC
/begin CHARACTERISTIC c_byp_A_ofs_ch12 "" VALUE 0x848308 _REC_VAL_20_u1 255. _CNV_A_R_LINEAR_____1_CM 0. 255. DISPLAY_IDENTIFIER C_BYP_A_OFS_CH12 FORMAT "%3.0" /end CHARACTERISTIC
/begin CHARACTERISTIC c_byp_A_ofs_ch13 "" VALUE 0x848309 _REC_VAL_20_u1 255. _CNV_A_R_LINEAR_____1_CM 0. 255. DISPLAY_IDENTIFIER C_BYP_A_OFS_CH13 FORMAT "%3.0" /end CHARACTERISTIC
/begin CHARACTERISTIC c_byp_A_ofs_ch14 "" VALUE 0x84830a _REC_VAL_20_u1 255. _CNV_A_R_LINEAR_____1_CM 0. 255. DISPLAY_IDENTIFIER C_BYP_A_OFS_CH14 FORMAT "%3.0" /end CHARACTERISTIC
/begin CHARACTERISTIC c_byp_A_ofs_ch15 "" VALUE 0x84830b _REC_VAL_20_u1 255. _CNV_A_R_LINEAR_____1_CM 0. 255. DISPLAY_IDENTIFIER C_BYP_A_OFS_CH15 FORMAT "%3.0" /end CHARACTERISTIC
/begin CHARACTERISTIC c_byp_A_ofs_ch0 "" VALUE 0x848304 _REC_VAL_20_u1 255. _CNV_A_R_LINEAR_____1_CM 0. 255. DISPLAY_IDENTIFIER C_BYP_A_OFS_CH0 FORMAT "%3.0" /end CHARACTERISTIC
/begin CHARACTERISTIC c_byp_B_ofs_ch0 "" VALUE 0x848314 _REC_VAL_20_u1 255. _CNV_A_R_LINEAR_____1_CM 0. 255. DISPLAY_IDENTIFIER C_BYP_B_OFS_CH0 FORMAT "%3.0" /end CHARACTERISTIC
/begin CHARACTERISTIC c_byp_B_ofs_ch1 "" VALUE 0x848315 _REC_VAL_20_u1 255. _CNV_A_R_LINEAR_____1_CM 0. 255. DISPLAY_IDENTIFIER C_BYP_B_OFS_CH1 FORMAT "%3.0" /end CHARACTERISTIC
/begin CHARACTERISTIC c_byp_B_ofs_ch2 "" VALUE 0x848320 _REC_VAL_20_u1 255. _CNV_A_R_LINEAR_____1_CM 0. 255. DISPLAY_IDENTIFIER C_BYP_B_OFS_CH2 FORMAT "%3.0" /end CHARACTERISTIC
/begin CHARACTERISTIC c_byp_B_ofs_ch3 "" VALUE 0x84832b _REC_VAL_20_u1 255. _CNV_A_R_LINEAR_____1_CM 0. 255. DISPLAY_IDENTIFIER C_BYP_B_OFS_CH3 FORMAT "%3.0" /end CHARACTERISTIC
/begin CHARACTERISTIC c_byp_B_ofs_ch4 "" VALUE 0x84832e _REC_VAL_20_u1 255. _CNV_A_R_LINEAR_____1_CM 0. 255. DISPLAY_IDENTIFIER C_BYP_B_OFS_CH4 FORMAT "%3.0" /end CHARACTERISTIC
/begin CHARACTERISTIC c_byp_B_ofs_ch5 "" VALUE 0x84832f _REC_VAL_20_u1 255. _CNV_A_R_LINEAR_____1_CM 0. 255. DISPLAY_IDENTIFIER C_BYP_B_OFS_CH5 FORMAT "%3.0" /end CHARACTERISTIC
/begin CHARACTERISTIC c_byp_B_ofs_ch6 "" VALUE 0x848330 _REC_VAL_20_u1 255. _CNV_A_R_LINEAR_____1_CM 0. 255. DISPLAY_IDENTIFIER C_BYP_B_OFS_CH6 FORMAT "%3.0" /end CHARACTERISTIC
/begin CHARACTERISTIC c_byp_B_ofs_ch7 "" VALUE 0x848331 _REC_VAL_20_u1 255. _CNV_A_R_LINEAR_____1_CM 0. 255. DISPLAY_IDENTIFIER C_BYP_B_OFS_CH7 FORMAT "%3.0" /end CHARACTERISTIC
/begin CHARACTERISTIC c_byp_B_ofs_ch8 "" VALUE 0x848332 _REC_VAL_20_u1 255. _CNV_A_R_LINEAR_____1_CM 0. 255. DISPLAY_IDENTIFIER C_BYP_B_OFS_CH8 FORMAT "%3.0" /end CHARACTERISTIC
/begin CHARACTERISTIC c_byp_B_ofs_ch9 "" VALUE 0x848333 _REC_VAL_20_u1 255. _CNV_A_R_LINEAR_____1_CM 0. 255. DISPLAY_IDENTIFIER C_BYP_B_OFS_CH9 FORMAT "%3.0" /end CHARACTERISTIC
/begin CHARACTERISTIC c_byp_B_ofs_ch10 "" VALUE 0x848316 _REC_VAL_20_u1 255. _CNV_A_R_LINEAR_____1_CM 0. 255. DISPLAY_IDENTIFIER C_BYP_B_OFS_CH10 FORMAT "%3.0" /end CHARACTERISTIC
/begin CHARACTERISTIC c_byp_B_ofs_ch11 "" VALUE 0x848317 _REC_VAL_20_u1 255. _CNV_A_R_LINEAR_____1_CM 0. 255. DISPLAY_IDENTIFIER C_BYP_B_OFS_CH11 FORMAT "%3.0" /end CHARACTERISTIC
/begin CHARACTERISTIC c_byp_B_ofs_ch12 "" VALUE 0x848318 _REC_VAL_20_u1 255. _CNV_A_R_LINEAR_____1_CM 0. 255. DISPLAY_IDENTIFIER C_BYP_B_OFS_CH12 FORMAT "%3.0" /end CHARACTERISTIC
/begin CHARACTERISTIC c_byp_B_ofs_ch13 "" VALUE 0x848319 _REC_VAL_20_u1 255. _CNV_A_R_LINEAR_____1_CM 0. 255. DISPLAY_IDENTIFIER C_BYP_B_OFS_CH13 FORMAT "%3.0" /end CHARACTERISTIC
/begin CHARACTERISTIC c_byp_B_ofs_ch14 "" VALUE 0x84831a _REC_VAL_20_u1 255. _CNV_A_R_LINEAR_____1_CM 0. 255. DISPLAY_IDENTIFIER C_BYP_B_OFS_CH14 FORMAT "%3.0" /end CHARACTERISTIC
/begin CHARACTERISTIC c_byp_B_ofs_ch15 "" VALUE 0x84831b _REC_VAL_20_u1 255. _CNV_A_R_LINEAR_____1_CM 0. 255. DISPLAY_IDENTIFIER C_BYP_B_OFS_CH15 FORMAT "%3.0" /end CHARACTERISTIC
/begin CHARACTERISTIC c_byp_B_ofs_ch16 "" VALUE 0x84831c _REC_VAL_20_u1 255. _CNV_A_R_LINEAR_____1_CM 0. 255. DISPLAY_IDENTIFIER C_BYP_B_OFS_CH16 FORMAT "%3.0" /end CHARACTERISTIC
/begin CHARACTERISTIC c_byp_B_ofs_ch17 "" VALUE 0x84831d _REC_VAL_20_u1 255. _CNV_A_R_LINEAR_____1_CM 0. 255. DISPLAY_IDENTIFIER C_BYP_B_OFS_CH17 FORMAT "%3.0" /end CHARACTERISTIC
/begin CHARACTERISTIC c_byp_B_ofs_ch18 "" VALUE 0x84831e _REC_VAL_20_u1 255. _CNV_A_R_LINEAR_____1_CM 0. 255. DISPLAY_IDENTIFIER C_BYP_B_OFS_CH18 FORMAT "%3.0" /end CHARACTERISTIC
/begin CHARACTERISTIC c_byp_B_ofs_ch19 "" VALUE 0x84831f _REC_VAL_20_u1 255. _CNV_A_R_LINEAR_____1_CM 0. 255. DISPLAY_IDENTIFIER C_BYP_B_OFS_CH19 FORMAT "%3.0" /end CHARACTERISTIC
/begin CHARACTERISTIC c_byp_B_ofs_ch20 "" VALUE 0x848321 _REC_VAL_20_u1 255. _CNV_A_R_LINEAR_____1_CM 0. 255. DISPLAY_IDENTIFIER C_BYP_B_OFS_CH20 FORMAT "%3.0" /end CHARACTERISTIC
/begin CHARACTERISTIC c_byp_B_ofs_ch21 "" VALUE 0x848322 _REC_VAL_20_u1 255. _CNV_A_R_LINEAR_____1_CM 0. 255. DISPLAY_IDENTIFIER C_BYP_B_OFS_CH21 FORMAT "%3.0" /end CHARACTERISTIC
/begin CHARACTERISTIC c_byp_B_ofs_ch22 "" VALUE 0x848323 _REC_VAL_20_u1 255. _CNV_A_R_LINEAR_____1_CM 0. 255. DISPLAY_IDENTIFIER C_BYP_B_OFS_CH22 FORMAT "%3.0" /end CHARACTERISTIC
/begin CHARACTERISTIC c_byp_B_ofs_ch23 "" VALUE 0x848324 _REC_VAL_20_u1 255. _CNV_A_R_LINEAR_____1_CM 0. 255. DISPLAY_IDENTIFIER C_BYP_B_OFS_CH23 FORMAT "%3.0" /end CHARACTERISTIC
/begin CHARACTERISTIC c_byp_B_ofs_ch24 "" VALUE 0x848325 _REC_VAL_20_u1 255. _CNV_A_R_LINEAR_____1_CM 0. 255. DISPLAY_IDENTIFIER C_BYP_B_OFS_CH24 FORMAT "%3.0" /end CHARACTERISTIC
/begin CHARACTERISTIC c_byp_B_ofs_ch25 "" VALUE 0x848326 _REC_VAL_20_u1 255. _CNV_A_R_LINEAR_____1_CM 0. 255. DISPLAY_IDENTIFIER C_BYP_B_OFS_CH25 FORMAT "%3.0" /end CHARACTERISTIC
/begin CHARACTERISTIC c_byp_B_ofs_ch26 "" VALUE 0x848327 _REC_VAL_20_u1 255. _CNV_A_R_LINEAR_____1_CM 0. 255. DISPLAY_IDENTIFIER C_BYP_B_OFS_CH26 FORMAT "%3.0" /end CHARACTERISTIC
/begin CHARACTERISTIC c_byp_B_ofs_ch27 "" VALUE 0x848328 _REC_VAL_20_u1 255. _CNV_A_R_LINEAR_____1_CM 0. 255. DISPLAY_IDENTIFIER C_BYP_B_OFS_CH27 FORMAT "%3.0" /end CHARACTERISTIC
/begin CHARACTERISTIC c_byp_B_ofs_ch28 "" VALUE 0x848329 _REC_VAL_20_u1 255. _CNV_A_R_LINEAR_____1_CM 0. 255. DISPLAY_IDENTIFIER C_BYP_B_OFS_CH28 FORMAT "%3.0" /end CHARACTERISTIC
/begin CHARACTERISTIC c_byp_B_ofs_ch29 "" VALUE 0x84832a _REC_VAL_20_u1 255. _CNV_A_R_LINEAR_____1_CM 0. 255. DISPLAY_IDENTIFIER C_BYP_B_OFS_CH29 FORMAT "%3.0" /end CHARACTERISTIC
/begin CHARACTERISTIC c_byp_B_ofs_ch30 "" VALUE 0x84832c _REC_VAL_20_u1 255. _CNV_A_R_LINEAR_____1_CM 0. 255. DISPLAY_IDENTIFIER C_BYP_B_OFS_CH30 FORMAT "%3.0" /end CHARACTERISTIC
/begin CHARACTERISTIC c_byp_B_ofs_ch31 "" VALUE 0x84832d _REC_VAL_20_u1 255. _CNV_A_R_LINEAR_____1_CM 0. 255. DISPLAY_IDENTIFIER C_BYP_B_OFS_CH31 FORMAT "%3.0" /end CHARACTERISTIC
/begin AXIS_PTS ldpm_sf_conf_inj "Injection Region" 0x843e5a act_inj_coded _REC_AXS_20_u1 15. _CNV_A_R_LINEAR_____0_CM 16 0. 15. FORMAT "%2.0" /end AXIS_PTS
/begin MEASUREMENT mf_prev1_cor "fuel mass ambient correction of injection PREV1" SWORD _CNV_A_R_LINEAR_____43_CM 1 0. -131.072 131.068 DISPLAY_IDENTIFIER MF_PREV1_COR ECU_ADDRESS 0x7f9c3a BYTE_ORDER MSB_LAST /end MEASUREMENT
/begin MEASUREMENT mf_prev2_cor "fuel mass ambient correction of injection PREV2" SWORD _CNV_A_R_LINEAR_____43_CM 1 0. -131.072 131.068 DISPLAY_IDENTIFIER MF_PREV2_COR ECU_ADDRESS 0x7f9c48 BYTE_ORDER MSB_LAST /end MEASUREMENT
/begin MEASUREMENT mf_main2_cor "fuel mass ambient correction of injection MAIN2" SWORD _CNV_A_R_LINEAR_____43_CM 1 0. -131.072 131.068 DISPLAY_IDENTIFIER MF_MAIN2_COR ECU_ADDRESS 0x7f9c4a BYTE_ORDER MSB_LAST /end MEASUREMENT
/begin MEASUREMENT mf_post1_cor "fuel mass ambient correction of injection POST1" SWORD _CNV_A_R_LINEAR_____43_CM 1 0. -131.072 131.068 DISPLAY_IDENTIFIER MF_POST1_COR ECU_ADDRESS 0x7f9c46 BYTE_ORDER MSB_LAST /end MEASUREMENT
/begin MEASUREMENT mf_bas_cor_conf_0 "fuel mass correction of injection MAIN_BAS at inj conf 0" SWORD _CNV_A_R_LINEAR_____43_CM 1 0. -131.072 131.068 DISPLAY_IDENTIFIER MF_BAS_COR_CONF_0 ECU_ADDRESS 0x7f9c3c BYTE_ORDER MSB_LAST /end MEASUREMENT
/begin MEASUREMENT mf_bas_cor_conf_1 "fuel mass correction of injection MAIN_BAS at inj conf 1" SWORD _CNV_A_R_LINEAR_____43_CM 1 0. -131.072 131.068 DISPLAY_IDENTIFIER MF_BAS_COR_CONF_1 ECU_ADDRESS 0x7f9c3e BYTE_ORDER MSB_LAST /end MEASUREMENT
/begin MEASUREMENT mf_bas_cor_conf_2 "fuel mass correction of injection MAIN_BAS at inj conf 2" SWORD _CNV_A_R_LINEAR_____43_CM 1 0. -131.072 131.068 DISPLAY_IDENTIFIER MF_BAS_COR_CONF_2 ECU_ADDRESS 0x7f9c40 BYTE_ORDER MSB_LAST /end MEASUREMENT
/begin MEASUREMENT mf_bas_cor_conf_3 "fuel mass correction of injection MAIN_BAS at inj conf 3" SWORD _CNV_A_R_LINEAR_____43_CM 1 0. -131.072 131.068 DISPLAY_IDENTIFIER MF_BAS_COR_CONF_3 ECU_ADDRESS 0x7f9c42 BYTE_ORDER MSB_LAST /end MEASUREMENT
/begin MEASUREMENT mf_bas_cor_conf_4 "fuel mass correction of injection MAIN_BAS at inj conf 4" SWORD _CNV_A_R_LINEAR_____43_CM 1 0. -131.072 131.068 DISPLAY_IDENTIFIER MF_BAS_COR_CONF_4 ECU_ADDRESS 0x7f9c44 BYTE_ORDER MSB_LAST /end MEASUREMENT
/begin MEASUREMENT sf_bas_cor_rgn_1 "enabling correction of main injection at rgn level 1" UBYTE _CNV_A_R_LINEAR_____0_CM 1 0. 0. 2. DISPLAY_IDENTIFIER SF_BAS_COR_RGN_1 ECU_ADDRESS 0x7fb64c FORMAT "%1.0" /end MEASUREMENT
/begin MEASUREMENT sf_bas_cor_rgn_2 "enabling correction of main injection at rgn level 2" UBYTE _CNV_A_R_LINEAR_____0_CM 1 0. 0. 2. DISPLAY_IDENTIFIER SF_BAS_COR_RGN_2 ECU_ADDRESS 0x7fb64d FORMAT "%1.0" /end MEASUREMENT
/begin MEASUREMENT sf_prev1_cor_rgn_1 "enabling correction of minor injection PREV1 at rgn level 1" UBYTE _CNV_A_R_LINEAR_____0_CM 1 0. 0. 2. DISPLAY_IDENTIFIER SF_PREV1_COR_RGN_1 ECU_ADDRESS 0x7fb648 FORMAT "%1.0" /end MEASUREMENT
/begin MEASUREMENT sf_prev2_cor_rgn_1 "enabling correction of minor injection PREV2 at rgn level 1" UBYTE _CNV_A_R_LINEAR_____0_CM 1 0. 0. 2. DISPLAY_IDENTIFIER SF_PREV2_COR_RGN_1 ECU_ADDRESS 0x7fb649 FORMAT "%1.0" /end MEASUREMENT
/begin MEASUREMENT sf_main2_cor_rgn_1 "enabling correction of minor injection MAIN2 at rgn level 1" UBYTE _CNV_A_R_LINEAR_____0_CM 1 0. 0. 2. DISPLAY_IDENTIFIER SF_MAIN2_COR_RGN_1 ECU_ADDRESS 0x7fb64a FORMAT "%1.0" /end MEASUREMENT
/begin MEASUREMENT sf_post1_cor_rgn_1 "enabling correction of minor injection POST1 at rgn level 1" UBYTE _CNV_A_R_LINEAR_____0_CM 1 0. 0. 2. DISPLAY_IDENTIFIER SF_POST1_COR_RGN_1 ECU_ADDRESS 0x7fb64b FORMAT "%1.0" /end MEASUREMENT
/begin MEASUREMENT sf_prev2_cor_rgn_2 "enabling correction of minor injection PREV2 at rgn level 2" UBYTE _CNV_A_R_LINEAR_____0_CM 1 0. 0. 2. DISPLAY_IDENTIFIER SF_PREV2_COR_RGN_2 ECU_ADDRESS 0x7fb644 FORMAT "%1.0" /end MEASUREMENT
/begin MEASUREMENT sf_prev1_cor_rgn_2 "enabling correction of minor injection PREV1 at rgn level 2" UBYTE _CNV_A_R_LINEAR_____0_CM 1 0. 0. 2. DISPLAY_IDENTIFIER SF_PREV1_COR_RGN_2 ECU_ADDRESS 0x7fb645 FORMAT "%1.0" /end MEASUREMENT
/begin MEASUREMENT sf_main2_cor_rgn_2 "enabling correction of minor injection MAIN2 at rgn level 2" UBYTE _CNV_A_R_LINEAR_____0_CM 1 0. 0. 2. DISPLAY_IDENTIFIER SF_MAIN2_COR_RGN_2 ECU_ADDRESS 0x7fb646 FORMAT "%1.0" /end MEASUREMENT
/begin MEASUREMENT sf_post1_cor_rgn_2 "enabling correction of minor injection POST1 at rgn level 2" UBYTE _CNV_A_R_LINEAR_____0_CM 1 0. 0. 2. DISPLAY_IDENTIFIER SF_POST1_COR_RGN_2 ECU_ADDRESS 0x7fb647 FORMAT "%1.0" /end MEASUREMENT
/begin CHARACTERISTIC c_sf_prev2_cor_rgn_1 "enabling correction of minor injection PREV2 at rgn level 1" VALUE 0x85c024 _REC_VAL_20_u1 2. _CNV_A_R_LINEAR_____0_CM 0. 2. DISPLAY_IDENTIFIER C_SF_PREV2_COR_RGN_1 FORMAT "%1.0" /end CHARACTERISTIC
/begin CHARACTERISTIC c_sf_prev2_cor_rgn_2 "enabling correction of minor injection PREV2 at rgn level 2" VALUE 0x85c025 _REC_VAL_20_u1 2. _CNV_A_R_LINEAR_____0_CM 0. 2. DISPLAY_IDENTIFIER C_SF_PREV2_COR_RGN_2 FORMAT "%1.0" /end CHARACTERISTIC
/begin CHARACTERISTIC c_sf_main2_cor_rgn_1 "enabling correction of minor injection MAIN2 at rgn level 1" VALUE 0x85c01e _REC_VAL_20_u1 2. _CNV_A_R_LINEAR_____0_CM 0. 2. DISPLAY_IDENTIFIER C_SF_MAIN2_COR_RGN_1 FORMAT "%1.0" /end CHARACTERISTIC
/begin CHARACTERISTIC c_sf_main2_cor_rgn_2 "enabling correction of minor injection MAIN2 at rgn level 2" VALUE 0x85c01f _REC_VAL_20_u1 2. _CNV_A_R_LINEAR_____0_CM 0. 2. DISPLAY_IDENTIFIER C_SF_MAIN2_COR_RGN_2 FORMAT "%1.0" /end CHARACTERISTIC
/begin CHARACTERISTIC c_sf_post1_cor_rgn_1 "enabling correction of minor injection POST1 at rgn level 1" VALUE 0x85c020 _REC_VAL_20_u1 2. _CNV_A_R_LINEAR_____0_CM 0. 2. DISPLAY_IDENTIFIER C_SF_POST1_COR_RGN_1 FORMAT "%1.0" /end CHARACTERISTIC
/begin CHARACTERISTIC c_sf_post1_cor_rgn_2 "enabling correction of minor injection POST1 at rgn level 2" VALUE 0x85c021 _REC_VAL_20_u1 2. _CNV_A_R_LINEAR_____0_CM 0. 2. DISPLAY_IDENTIFIER C_SF_POST1_COR_RGN_2 FORMAT "%1.0" /end CHARACTERISTIC
/begin CHARACTERISTIC c_sf_bas_cor_rgn_1 "enabling correction of main injection at rgn level 1" VALUE 0x85c01c _REC_VAL_20_u1 2. _CNV_A_R_LINEAR_____0_CM 0. 2. DISPLAY_IDENTIFIER C_SF_BAS_COR_RGN_1 FORMAT "%1.0" /end CHARACTERISTIC
/begin CHARACTERISTIC c_sf_bas_cor_rgn_2 "enabling correction of main injection at rgn level 2" VALUE 0x85c01d _REC_VAL_20_u1 2. _CNV_A_R_LINEAR_____0_CM 0. 2. DISPLAY_IDENTIFIER C_SF_BAS_COR_RGN_2 FORMAT "%1.0" /end CHARACTERISTIC
/begin CHARACTERISTIC c_sf_prev1_cor_rgn_1 "enabling correction of minor injection 1 at rgn level 1" VALUE 0x85c022 _REC_VAL_20_u1 2. _CNV_A_R_LINEAR_____0_CM 0. 2. DISPLAY_IDENTIFIER C_SF_PREV1_COR_RGN_1 FORMAT "%1.0" /end CHARACTERISTIC
/begin CHARACTERISTIC c_sf_prev1_cor_rgn_2 "enabling correction of minor injection 1 at rgn level 2" VALUE 0x85c023 _REC_VAL_20_u1 2. _CNV_A_R_LINEAR_____0_CM 0. 2. DISPLAY_IDENTIFIER C_SF_PREV1_COR_RGN_2 FORMAT "%1.0" /end CHARACTERISTIC
/begin MEASUREMENT mf_prev1_bas_sel "basic fuel mass of minor injections PREV1 after temperature selection" UWORD _CNV_A_R_LINEAR_____43_CM 1 0. 0. 262.14 DISPLAY_IDENTIFIER MF_PREV1_BAS_SEL ECU_ADDRESS 0x7f9c4c BYTE_ORDER MSB_LAST /end MEASUREMENT
/begin MEASUREMENT mf_prev2_bas_sel "basic fuel mass of minor injections PREV2 after temperature selection" UWORD _CNV_A_R_LINEAR_____43_CM 1 0. 0. 262.14 DISPLAY_IDENTIFIER MF_PREV2_BAS_SEL ECU_ADDRESS 0x7f9c4e BYTE_ORDER MSB_LAST /end MEASUREMENT
/begin MEASUREMENT mf_main2_bas_sel "basic fuel mass of minor injections MAIN2 after temperature selection" UWORD _CNV_A_R_LINEAR_____43_CM 1 0. 0. 262.14 DISPLAY_IDENTIFIER MF_MAIN2_BAS_SEL ECU_ADDRESS 0x7f9c50 BYTE_ORDER MSB_LAST /end MEASUREMENT
/begin MEASUREMENT mf_post1_bas_sel "basic fuel mass of minor injections POST1 after temperature selection" UWORD _CNV_A_R_LINEAR_____43_CM 1 0. 0. 262.14 DISPLAY_IDENTIFIER MF_POST1_BAS_SEL ECU_ADDRESS 0x7f9c52 BYTE_ORDER MSB_LAST /end MEASUREMENT
/begin MEASUREMENT lv_temp_inter_sel "Interpolation required" UBYTE _CNV_S_2_RANGE______11_CM 1 0. 0. 1. DISPLAY_IDENTIFIER LV_TEMP_INTER_SEL ECU_ADDRESS 0x7fb64e /end MEASUREMENT
/begin MEASUREMENT lv_act_prev1_inj_bas "basic activation of injection PREV1" UBYTE _CNV_S_2_RANGE______11_CM 1 0. 0. 1. DISPLAY_IDENTIFIER LV_ACT_PREV1_INJ_BAS ECU_ADDRESS 0x7fb64f /end MEASUREMENT
/begin MEASUREMENT lv_act_prev2_inj_bas "basic activation of injection PREV2" UBYTE _CNV_S_2_RANGE______11_CM 1 0. 0. 1. DISPLAY_IDENTIFIER LV_ACT_PREV2_INJ_BAS ECU_ADDRESS 0x7fb650 /end MEASUREMENT
/begin MEASUREMENT lv_act_main2_inj_bas "basic activation of injection MAIN2" UBYTE _CNV_S_2_RANGE______11_CM 1 0. 0. 1. DISPLAY_IDENTIFIER LV_ACT_MAIN2_INJ_BAS ECU_ADDRESS 0x7fb651 /end MEASUREMENT
/begin MEASUREMENT lv_act_post1_inj_bas "basic activation of injection POST1" UBYTE _CNV_S_2_RANGE______11_CM 1 0. 0. 1. DISPLAY_IDENTIFIER LV_ACT_POST1_INJ_BAS ECU_ADDRESS 0x7fb652 /end MEASUREMENT
/begin MEASUREMENT lv_mf_prev1_bas_clc "activation of calculation of basic fuel mass PREV1" UBYTE _CNV_S_2_RANGE______11_CM 1 0. 0. 1. DISPLAY_IDENTIFIER LV_MF_PREV1_BAS_CLC ECU_ADDRESS 0x7fb653 /end MEASUREMENT
/begin MEASUREMENT lv_mf_prev2_bas_clc "activation of calculation of basic fuel mass PREV2" UBYTE _CNV_S_2_RANGE______11_CM 1 0. 0. 1. DISPLAY_IDENTIFIER LV_MF_PREV2_BAS_CLC ECU_ADDRESS 0x7fb654 /end MEASUREMENT
/begin MEASUREMENT lv_mf_main2_bas_clc "activation of calculation of basic fuel mass MAIN2" UBYTE _CNV_S_2_RANGE______11_CM 1 0. 0. 1. DISPLAY_IDENTIFIER LV_MF_MAIN2_BAS_CLC ECU_ADDRESS 0x7fb655 /end MEASUREMENT
/begin MEASUREMENT lv_mf_post1_bas_clc "activation of calculation of basic fuel mass POST1" UBYTE _CNV_S_2_RANGE______11_CM 1 0. 0. 1. DISPLAY_IDENTIFIER LV_MF_POST1_BAS_CLC ECU_ADDRESS 0x7fb656 /end MEASUREMENT
/begin CHARACTERISTIC lc_inj_prev1_on "button to activate injection PREV1" VALUE 0x85c32f _REC_VAL_20_u1 1. _CNV_A_R_LINEAR_____0_CM 0. 1. DISPLAY_IDENTIFIER LC_INJ_PREV1_ON FORMAT "%1.0" /end CHARACTERISTIC
/begin CHARACTERISTIC c_n_32_max_inj_prev1 "maximum engine speed for injection PREV1" VALUE 0x85bf84 _REC_VAL_20_u1 8160. _CNV_A_R_LINEAR_____58_CM 0. 8160. DISPLAY_IDENTIFIER C_N_32_MAX_INJ_PREV1 FORMAT "%4.0" /end CHARACTERISTIC
/begin CHARACTERISTIC lc_inj_prev2_on "button to activate injection PREV2" VALUE 0x85c330 _REC_VAL_20_u1 1. _CNV_A_R_LINEAR_____0_CM 0. 1. DISPLAY_IDENTIFIER LC_INJ_PREV2_ON FORMAT "%1.0" /end CHARACTERISTIC
/begin CHARACTERISTIC c_n_32_max_inj_prev2 "maximum engine speed for injection PREV2" VALUE 0x85bf85 _REC_VAL_20_u1 8160. _CNV_A_R_LINEAR_____58_CM 0. 8160. DISPLAY_IDENTIFIER C_N_32_MAX_INJ_PREV2 FORMAT "%4.0" /end CHARACTERISTIC
/begin CHARACTERISTIC lc_inj_main2_on "button to activate injection MAIN2" VALUE 0x85c32d _REC_VAL_20_u1 1. _CNV_A_R_LINEAR_____0_CM 0. 1. DISPLAY_IDENTIFIER LC_INJ_MAIN2_ON FORMAT "%1.0" /end CHARACTERISTIC
/begin CHARACTERISTIC c_n_32_max_inj_main2 "maximum engine speed for injection MAIN2" VALUE 0x85bf82 _REC_VAL_20_u1 8160. _CNV_A_R_LINEAR_____58_CM 0. 8160. DISPLAY_IDENTIFIER C_N_32_MAX_INJ_MAIN2 FORMAT "%4.0" /end CHARACTERISTIC
/begin CHARACTERISTIC lc_inj_post1_on "button to activate injection POST1" VALUE 0x85c32e _REC_VAL_20_u1 1. _CNV_A_R_LINEAR_____0_CM 0. 1. DISPLAY_IDENTIFIER LC_INJ_POST1_ON FORMAT "%1.0" /end CHARACTERISTIC
/begin CHARACTERISTIC c_n_32_max_inj_post1 "maximum engine speed for injection POST1" VALUE 0x85bf83 _REC_VAL_20_u1 8160. _CNV_A_R_LINEAR_____58_CM 0. 8160. DISPLAY_IDENTIFIER C_N_32_MAX_INJ_POST1 FORMAT "%4.0" /end CHARACTERISTIC
/begin MEASUREMENT mf_prev1_st "fuel mass of injection PREV1 during ST" UWORD _CNV_A_R_LINEAR_____43_CM 1 0. 0. 262.14 DISPLAY_IDENTIFIER MF_PREV1_ST ECU_ADDRESS 0x7f9c54 BYTE_ORDER MSB_LAST /end MEASUREMENT
/begin MEASUREMENT mf_prev2_st "fuel mass of injection PREV2 during ST" UWORD _CNV_A_R_LINEAR_____43_CM 1 0. 0. 262.14 DISPLAY_IDENTIFIER MF_PREV2_ST ECU_ADDRESS 0x7f9c56 BYTE_ORDER MSB_LAST /end MEASUREMENT
/begin MEASUREMENT mf_main2_st "fuel mass of injection MAIN2 during ST" UWORD _CNV_A_R_LINEAR_____43_CM 1 0. 0. 262.14 DISPLAY_IDENTIFIER MF_MAIN2_ST ECU_ADDRESS 0x7f9c58 BYTE_ORDER MSB_LAST /end MEASUREMENT
/begin MEASUREMENT mf_post1_st "fuel mass of injection POST1 during ST" UWORD _CNV_A_R_LINEAR_____43_CM 1 0. 0. 262.14 DISPLAY_IDENTIFIER MF_POST1_ST ECU_ADDRESS 0x7f9c5a BYTE_ORDER MSB_LAST /end MEASUREMENT
/begin CHARACTERISTIC ip_fac_mf_prev1_st_cor_amp "MF: fuel mass AMP-correction factor of PREV1 at ST" CURVE 0x84bf38 _REC_CUR_20_u2_u2 3.99998471 _CNV_A_R_LINEAR_____63_CM 0. 3.99998471 DISPLAY_IDENTIFIER IP_FAC_MF_PREV1_ST_COR_AMP FORMAT "%6.5"
 /begin AXIS_DESCR COM_AXIS amp _CNV_A_R_LINEAR_____21_CM 4 0. 5434. FORMAT "%6.2" AXIS_PTS_REF ldpm_amp_2_inj /end AXIS_DESCR
/end CHARACTERISTIC
/begin CHARACTERISTIC ip_fac_mf_prev1_st_cor_tia "MF: TIA correction factor of fuel masses PREV1 at Start" CURVE 0x84bf40 _REC_CUR_20_u2_u1 3.99998471 _CNV_A_R_LINEAR_____63_CM 0. 3.99998471 DISPLAY_IDENTIFIER IP_FAC_MF_PREV1_ST_COR_TIA FORMAT "%6.5"
 /begin AXIS_DESCR COM_AXIS tia _CNV_A_R_LINEAR_____18_CM 4 -50. 205. FORMAT "%3.0" AXIS_PTS_REF ldpm_tia_2_inj /end AXIS_DESCR
/end CHARACTERISTIC
/begin AXIS_PTS ldpm_tia_2_inj "" 0x843ef8 tia _REC_AXS_20_u1 255. _CNV_A_R_LINEAR_____18_CM 4 -50. 205. FORMAT "%3.0" /end AXIS_PTS
/begin CHARACTERISTIC ip_mf_prev1_st "MF: start fuel mass of injection PREV1" MAP 0x8552a2 _REC_MAP_20_u2_u2_u1 262.14 _CNV_A_R_LINEAR_____43_CM 0. 262.14 DISPLAY_IDENTIFIER IP_MF_PREV1_ST
 /begin AXIS_DESCR COM_AXIS n _CNV_A_R_LINEAR_____5_CM 7 0. 6375. FORMAT "%4.0" AXIS_PTS_REF ldpm_n_3_inj /end AXIS_DESCR
 /begin AXIS_DESCR COM_AXIS tco _CNV_A_R_LINEAR_____18_CM 12 -50. 205. FORMAT "%3.0" AXIS_PTS_REF ldpm_tco_2_inj /end AXIS_DESCR
/end CHARACTERISTIC
/begin CHARACTERISTIC ip_mf_prev1_st_cor_amp "MF: amp correction of fuel mass of injection PREV1 at ST" MAP 0x85534a _REC_MAP_20_u2_u2_u1 262.14 _CNV_A_R_LINEAR_____133_CM -131.072 131.068 DISPLAY_IDENTIFIER IP_MF_PREV1_ST_COR_AMP
 /begin AXIS_DESCR COM_AXIS n _CNV_A_R_LINEAR_____5_CM 4 0. 6375. FORMAT "%4.0" AXIS_PTS_REF ldpm_n_4_inj /end AXIS_DESCR
 /begin AXIS_DESCR COM_AXIS tco _CNV_A_R_LINEAR_____18_CM 6 -50. 205. FORMAT "%3.0" AXIS_PTS_REF ldpm_tco_3_inj /end AXIS_DESCR
/end CHARACTERISTIC
/begin CHARACTERISTIC ip_mf_prev1_st_cor_tia "MF: tia correction of fuel mass of injection PREV1 at ST" MAP 0x85537a _REC_MAP_20_u2_u2_u1 262.14 _CNV_A_R_LINEAR_____133_CM -131.072 131.068 DISPLAY_IDENTIFIER IP_MF_PREV1_ST_COR_TIA
 /begin AXIS_DESCR COM_AXIS n _CNV_A_R_LINEAR_____5_CM 4 0. 6375. FORMAT "%4.0" AXIS_PTS_REF ldpm_n_4_inj /end AXIS_DESCR
 /begin AXIS_DESCR COM_AXIS tco _CNV_A_R_LINEAR_____18_CM 6 -50. 205. FORMAT "%3.0" AXIS_PTS_REF ldpm_tco_3_inj /end AXIS_DESCR
/end CHARACTERISTIC
/begin CHARACTERISTIC ip_fac_mf_prev2_st_cor_amp "MF: fuel mass AMP-correction factor of PREV2 at ST" CURVE 0x84bf54 _REC_CUR_20_u2_u2 3.99998471 _CNV_A_R_LINEAR_____63_CM 0. 3.99998471 DISPLAY_IDENTIFIER IP_FAC_MF_PREV2_ST_COR_AMP FORMAT "%6.5"
 /begin AXIS_DESCR COM_AXIS amp _CNV_A_R_LINEAR_____21_CM 1 0. 5434. FORMAT "%7.3" AXIS_PTS_REF ldp_amp_2_inj_x /end AXIS_DESCR
/end CHARACTERISTIC
/begin CHARACTERISTIC ip_fac_mf_prev2_st_cor_tia "MF: TIA correction factor of fuel masses PREV2 at Start" CURVE 0x84bf56 _REC_CUR_20_u2_u1 3.99998471 _CNV_A_R_LINEAR_____63_CM 0. 3.99998471 DISPLAY_IDENTIFIER IP_FAC_MF_PREV2_ST_COR_TIA FORMAT "%6.5"
 /begin AXIS_DESCR COM_AXIS tia _CNV_A_R_LINEAR_____18_CM 1 -50. 205. FORMAT "%3.0" AXIS_PTS_REF ldp_tia_2_inj_x /end AXIS_DESCR
/end CHARACTERISTIC
/begin CHARACTERISTIC ip_mf_prev2_st "MF: start fuel mass of injection PREV2" MAP 0x8554bc _REC_MAP_20_u2_u2_u1 262.14 _CNV_A_R_LINEAR_____43_CM 0. 262.14 DISPLAY_IDENTIFIER IP_MF_PREV2_ST
 /begin AXIS_DESCR COM_AXIS n _CNV_A_R_LINEAR_____5_CM 1 0. 6375. FORMAT "%4.0" AXIS_PTS_REF ldp_n_3_inj_x /end AXIS_DESCR
 /begin AXIS_DESCR COM_AXIS tco _CNV_A_R_LINEAR_____18_CM 1 -50. 205. FORMAT "%3.0" AXIS_PTS_REF ldp_tco_2_inj_x /end AXIS_DESCR
/end CHARACTERISTIC
/begin CHARACTERISTIC ip_mf_prev2_st_cor_amp "MF: amp correction of fuel mass of injection PREV2 at ST" MAP 0x8554be _REC_MAP_20_u2_u2_u1 262.14 _CNV_A_R_LINEAR_____133_CM -131.072 131.068 DISPLAY_IDENTIFIER IP_MF_PREV2_ST_COR_AMP
 /begin AXIS_DESCR COM_AXIS n _CNV_A_R_LINEAR_____5_CM 1 0. 6375. FORMAT "%4.0" AXIS_PTS_REF ldp_n_4_inj_x /end AXIS_DESCR
 /begin AXIS_DESCR COM_AXIS tco _CNV_A_R_LINEAR_____18_CM 1 -50. 205. FORMAT "%3.0" AXIS_PTS_REF ldp_tco_3_inj_x /end AXIS_DESCR
/end CHARACTERISTIC
/begin CHARACTERISTIC ip_mf_prev2_st_cor_tia "MF: tia correction of fuel mass of injection PREV2 at ST" MAP 0x8554c0 _REC_MAP_20_u2_u2_u1 262.14 _CNV_A_R_LINEAR_____133_CM -131.072 131.068 DISPLAY_IDENTIFIER IP_MF_PREV2_ST_COR_TIA
 /begin AXIS_DESCR COM_AXIS n _CNV_A_R_LINEAR_____5_CM 1 0. 6375. FORMAT "%4.0" AXIS_PTS_REF ldp_n_4_inj_x /end AXIS_DESCR
 /begin AXIS_DESCR COM_AXIS tco _CNV_A_R_LINEAR_____18_CM 1 -50. 205. FORMAT "%3.0" AXIS_PTS_REF ldp_tco_3_inj_x /end AXIS_DESCR
/end CHARACTERISTIC
/begin CHARACTERISTIC ip_fac_mf_main2_st_cor_amp "MF: fuel mass AMP-correction factor of MAIN2 at ST" CURVE 0x84be64 _REC_CUR_20_u2_u2 3.99998471 _CNV_A_R_LINEAR_____63_CM 0. 3.99998471 DISPLAY_IDENTIFIER IP_FAC_MF_MAIN2_ST_COR_AMP FORMAT "%6.5"
 /begin AXIS_DESCR COM_AXIS amp _CNV_A_R_LINEAR_____21_CM 1 0. 5434. FORMAT "%7.3" AXIS_PTS_REF ldp_amp_2_inj_x /end AXIS_DESCR
/end CHARACTERISTIC
/begin CHARACTERISTIC ip_fac_mf_main2_st_cor_tia "MF: TIA correction factor of fuel masses MAIN2 at Start" CURVE 0x84be66 _REC_CUR_20_u2_u1 3.99998471 _CNV_A_R_LINEAR_____63_CM 0. 3.99998471 DISPLAY_IDENTIFIER IP_FAC_MF_MAIN2_ST_COR_TIA FORMAT "%6.5"
 /begin AXIS_DESCR COM_AXIS tia _CNV_A_R_LINEAR_____18_CM 1 -50. 205. FORMAT "%3.0" AXIS_PTS_REF ldp_tia_2_inj_x /end AXIS_DESCR
/end CHARACTERISTIC
/begin CHARACTERISTIC ip_mf_main2_st "MF: start fuel mass of injection MAIN2" MAP 0x853290 _REC_MAP_20_u2_u2_u1 262.14 _CNV_A_R_LINEAR_____43_CM 0. 262.14 DISPLAY_IDENTIFIER IP_MF_MAIN2_ST
 /begin AXIS_DESCR COM_AXIS n _CNV_A_R_LINEAR_____5_CM 1 0. 6375. FORMAT "%4.0" AXIS_PTS_REF ldp_n_3_inj_x /end AXIS_DESCR
 /begin AXIS_DESCR COM_AXIS tco _CNV_A_R_LINEAR_____18_CM 1 -50. 205. FORMAT "%3.0" AXIS_PTS_REF ldp_tco_2_inj_x /end AXIS_DESCR
/end CHARACTERISTIC
/begin CHARACTERISTIC ip_mf_main2_st_cor_amp "MF: amp correction of fuel mass of injection MAIN2 at ST" MAP 0x853292 _REC_MAP_20_u2_u2_u1 262.14 _CNV_A_R_LINEAR_____133_CM -131.072 131.068 DISPLAY_IDENTIFIER IP_MF_MAIN2_ST_COR_AMP
 /begin AXIS_DESCR COM_AXIS n _CNV_A_R_LINEAR_____5_CM 1 0. 6375. FORMAT "%4.0" AXIS_PTS_REF ldp_n_4_inj_x /end AXIS_DESCR
 /begin AXIS_DESCR COM_AXIS tco _CNV_A_R_LINEAR_____18_CM 1 -50. 205. FORMAT "%3.0" AXIS_PTS_REF ldp_tco_3_inj_x /end AXIS_DESCR
/end CHARACTERISTIC
/begin CHARACTERISTIC ip_mf_main2_st_cor_tia "MF: tia correction of fuel mass of injection MAIN2 at ST" MAP 0x853294 _REC_MAP_20_u2_u2_u1 262.14 _CNV_A_R_LINEAR_____133_CM -131.072 131.068 DISPLAY_IDENTIFIER IP_MF_MAIN2_ST_COR_TIA
 /begin AXIS_DESCR COM_AXIS n _CNV_A_R_LINEAR_____5_CM 1 0. 6375. FORMAT "%4.0" AXIS_PTS_REF ldp_n_4_inj_x /end AXIS_DESCR
 /begin AXIS_DESCR COM_AXIS tco _CNV_A_R_LINEAR_____18_CM 1 -50. 205. FORMAT "%3.0" AXIS_PTS_REF ldp_tco_3_inj_x /end AXIS_DESCR
/end CHARACTERISTIC
/begin CHARACTERISTIC ip_fac_mf_post1_st_cor_amp "MF: fuel mass AMP-correction factor of POST1 at ST" CURVE 0x84bec8 _REC_CUR_20_u2_u2 3.99998471 _CNV_A_R_LINEAR_____63_CM 0. 3.99998471 DISPLAY_IDENTIFIER IP_FAC_MF_POST1_ST_COR_AMP FORMAT "%6.5"
 /begin AXIS_DESCR COM_AXIS amp _CNV_A_R_LINEAR_____21_CM 4 0. 5434. FORMAT "%6.2" AXIS_PTS_REF ldpm_amp_2_inj /end AXIS_DESCR
/end CHARACTERISTIC
/begin CHARACTERISTIC ip_fac_mf_post1_st_cor_tia "MF: TIA correction factor of fuel masses POST1 at Start" CURVE 0x84bed0 _REC_CUR_20_u2_u1 3.99998471 _CNV_A_R_LINEAR_____63_CM 0. 3.99998471 DISPLAY_IDENTIFIER IP_FAC_MF_POST1_ST_COR_TIA FORMAT "%6.5"
 /begin AXIS_DESCR COM_AXIS tia _CNV_A_R_LINEAR_____18_CM 4 -50. 205. FORMAT "%3.0" AXIS_PTS_REF ldpm_tia_2_inj /end AXIS_DESCR
/end CHARACTERISTIC
/begin CHARACTERISTIC ip_mf_post1_st "MF: start fuel mass of injection POST1" MAP 0x85419a _REC_MAP_20_u2_u2_u1 262.14 _CNV_A_R_LINEAR_____43_CM 0. 262.14 DISPLAY_IDENTIFIER IP_MF_POST1_ST
 /begin AXIS_DESCR COM_AXIS n _CNV_A_R_LINEAR_____5_CM 7 0. 6375. FORMAT "%4.0" AXIS_PTS_REF ldpm_n_3_inj /end AXIS_DESCR
 /begin AXIS_DESCR COM_AXIS tco _CNV_A_R_LINEAR_____18_CM 12 -50. 205. FORMAT "%3.0" AXIS_PTS_REF ldpm_tco_2_inj /end AXIS_DESCR
/end CHARACTERISTIC
/begin CHARACTERISTIC ip_mf_post1_st_cor_amp "MF: amp correction of fuel mass of injection POST1 at ST" MAP 0x854242 _REC_MAP_20_u2_u2_u1 262.14 _CNV_A_R_LINEAR_____133_CM -131.072 131.068 DISPLAY_IDENTIFIER IP_MF_POST1_ST_COR_AMP
 /begin AXIS_DESCR COM_AXIS n _CNV_A_R_LINEAR_____5_CM 4 0. 6375. FORMAT "%4.0" AXIS_PTS_REF ldpm_n_4_inj /end AXIS_DESCR
 /begin AXIS_DESCR COM_AXIS tco _CNV_A_R_LINEAR_____18_CM 6 -50. 205. FORMAT "%3.0" AXIS_PTS_REF ldpm_tco_3_inj /end AXIS_DESCR
/end CHARACTERISTIC
/begin CHARACTERISTIC ip_mf_post1_st_cor_tia "MF: tia correction of fuel mass of injection POST1 at ST" MAP 0x854272 _REC_MAP_20_u2_u2_u1 262.14 _CNV_A_R_LINEAR_____133_CM -131.072 131.068 DISPLAY_IDENTIFIER IP_MF_POST1_ST_COR_TIA
 /begin AXIS_DESCR COM_AXIS n _CNV_A_R_LINEAR_____5_CM 4 0. 6375. FORMAT "%4.0" AXIS_PTS_REF ldpm_n_4_inj /end AXIS_DESCR
 /begin AXIS_DESCR COM_AXIS tco _CNV_A_R_LINEAR_____18_CM 6 -50. 205. FORMAT "%3.0" AXIS_PTS_REF ldpm_tco_3_inj /end AXIS_DESCR
/end CHARACTERISTIC
/begin AXIS_PTS ldp_amp_2_inj_x "" 0x841082 amp _REC_AXS_20_u2 5434. _CNV_A_R_LINEAR_____21_CM 1 0. 5434. FORMAT "%7.3" /end AXIS_PTS
/begin AXIS_PTS ldp_tia_2_inj_x "" 0x842a14 tia _REC_AXS_20_u1 255. _CNV_A_R_LINEAR_____18_CM 1 -50. 205. FORMAT "%3.0" /end AXIS_PTS
/begin AXIS_PTS ldp_n_3_inj_x "" 0x841910 n _REC_AXS_20_u2 6375. _CNV_A_R_LINEAR_____5_CM 1 0. 6375. FORMAT "%4.0" /end AXIS_PTS
/begin AXIS_PTS ldp_tco_2_inj_x "" 0x842696 tco _REC_AXS_20_u1 255. _CNV_A_R_LINEAR_____18_CM 1 -50. 205. FORMAT "%3.0" /end AXIS_PTS
/begin AXIS_PTS ldp_n_4_inj_x "" 0x841914 n _REC_AXS_20_u2 6375. _CNV_A_R_LINEAR_____5_CM 1 0. 6375. FORMAT "%4.0" /end AXIS_PTS
/begin AXIS_PTS ldp_tco_3_inj_x "" 0x842698 tco _REC_AXS_20_u1 255. _CNV_A_R_LINEAR_____18_CM 1 -50. 205. FORMAT "%3.0" /end AXIS_PTS
/begin MEASUREMENT mf_prev1_is_pl_rgl "fuel mass of injection PREV1 during IS/PL" UWORD _CNV_A_R_LINEAR_____43_CM 1 0. 0. 262.14 DISPLAY_IDENTIFIER MF_PREV1_IS_PL_RGL ECU_ADDRESS 0x7f9c5c BYTE_ORDER MSB_LAST /end MEASUREMENT
/begin MEASUREMENT mf_prev2_is_pl_rgl "fuel mass of injection PREV2 during IS/PL" UWORD _CNV_A_R_LINEAR_____43_CM 1 0. 0. 262.14 DISPLAY_IDENTIFIER MF_PREV2_IS_PL_RGL ECU_ADDRESS 0x7f9c5e BYTE_ORDER MSB_LAST /end MEASUREMENT
/begin MEASUREMENT mf_main2_is_pl_rgl "fuel mass of injection MAIN2 during IS/PL" UWORD _CNV_A_R_LINEAR_____43_CM 1 0. 0. 262.14 DISPLAY_IDENTIFIER MF_MAIN2_IS_PL_RGL ECU_ADDRESS 0x7f9c60 BYTE_ORDER MSB_LAST /end MEASUREMENT
/begin MEASUREMENT mf_post1_is_pl_rgl "fuel mass of injection POST1 during IS/PL" UWORD _CNV_A_R_LINEAR_____43_CM 1 0. 0. 262.14 DISPLAY_IDENTIFIER MF_POST1_IS_PL_RGL ECU_ADDRESS 0x7f9c62 BYTE_ORDER MSB_LAST /end MEASUREMENT
/begin MEASUREMENT mf_prev1_cor_rgl "sum of fuel mass correction of injection PREV1 during IS/PL" SWORD _CNV_A_R_LINEAR_____43_CM 1 0. -131.072 131.068 DISPLAY_IDENTIFIER MF_PREV1_COR_RGL ECU_ADDRESS 0x7f9c64 BYTE_ORDER MSB_LAST /end MEASUREMENT
/begin MEASUREMENT mf_prev2_cor_rgl "sum of fuel mass correction of injection PREV2 during IS/PL" SWORD _CNV_A_R_LINEAR_____43_CM 1 0. -131.072 131.068 DISPLAY_IDENTIFIER MF_PREV2_COR_RGL ECU_ADDRESS 0x7f9c66 BYTE_ORDER MSB_LAST /end MEASUREMENT
/begin MEASUREMENT mf_main2_cor_rgl "sum of fuel mass correction of injection MAIN2 during IS/PL" SWORD _CNV_A_R_LINEAR_____43_CM 1 0. -131.072 131.068 DISPLAY_IDENTIFIER MF_MAIN2_COR_RGL ECU_ADDRESS 0x7f9c68 BYTE_ORDER MSB_LAST /end MEASUREMENT
/begin MEASUREMENT mf_post1_cor_rgl "sum of fuel mass correction of injection POST1 during IS/PL" SWORD _CNV_A_R_LINEAR_____43_CM 1 0. -131.072 131.068 DISPLAY_IDENTIFIER MF_POST1_COR_RGL ECU_ADDRESS 0x7f9c6a BYTE_ORDER MSB_LAST /end MEASUREMENT
/begin CHARACTERISTIC c_mf_prev1_max "maximal fuel mass of minor injection prev1" VALUE 0x85bf68 _REC_VAL_20_u2 262.14 _CNV_A_R_LINEAR_____43_CM 0. 262.14 DISPLAY_IDENTIFIER C_MF_PREV1_MAX /end CHARACTERISTIC
/begin CHARACTERISTIC ip_fac_mf_prev1_cor_tco "MF: fuel mass interpolation prev1 dependent on TCO" CURVE 0x84bef8 _REC_CUR_20_u2_u1 1.9999696 _CNV_A_R_LINEAR_____53_CM 0. 1.9999696 DISPLAY_IDENTIFIER IP_FAC_MF_PREV1_COR_TCO FORMAT "%6.5"
 /begin AXIS_DESCR COM_AXIS tco _CNV_A_R_LINEAR_____18_CM 8 -50. 205. FORMAT "%3.0" AXIS_PTS_REF ldp_tco_ip_fac_mf_prev1_cor /end AXIS_DESCR
/end CHARACTERISTIC
/begin AXIS_PTS ldp_tco_ip_fac_mf_prev1_cor "" 0x842707 tco _REC_AXS_20_u1 255. _CNV_A_R_LINEAR_____18_CM 8 -50. 205. FORMAT "%3.0" /end AXIS_PTS
/begin CHARACTERISTIC ip_fac_mf_prev1_cor_amp "MF: amp correction factor for fuel mass of minor injections prev1" CURVE 0x84bed8 _REC_CUR_20_u2_u2 0.9999847412109381 _CNV_A_R_LINEAR_____14_CM 0. 0.9999847412109381 DISPLAY_IDENTIFIER IP_FAC_MF_PREV1_COR_AMP FORMAT "%6.5"
 /begin AXIS_DESCR COM_AXIS amp _CNV_A_R_LINEAR_____21_CM 8 0. 5434. FORMAT "%6.2" AXIS_PTS_REF ldp_amp_ip_fac_mf_prev1_cor /end AXIS_DESCR
/end CHARACTERISTIC
/begin AXIS_PTS ldp_amp_ip_fac_mf_prev1_cor "" 0x8411e2 amp _REC_AXS_20_u2 5434. _CNV_A_R_LINEAR_____21_CM 8 0. 5434. FORMAT "%6.2" /end AXIS_PTS
/begin CHARACTERISTIC ip_fac_mf_prev1_cor_tgas "MF: fuel mass correction prev1 dependent on TGAS" CURVE 0x84bf18 _REC_CUR_20_u2_u1 0.9999847412109381 _CNV_A_R_LINEAR_____14_CM 0. 0.9999847412109381 DISPLAY_IDENTIFIER IP_FAC_MF_PREV1_COR_TGAS FORMAT "%6.5"
 /begin AXIS_DESCR COM_AXIS tgas _CNV_A_R_LINEAR_____18_CM 8 -50. 205. FORMAT "%3.0" AXIS_PTS_REF ldp_tgas_ip_fac_mf_prev1_cor /end AXIS_DESCR
/end CHARACTERISTIC
/begin AXIS_PTS ldp_tgas_ip_fac_mf_prev1_cor "" 0x84298d tgas _REC_AXS_20_u1 255. _CNV_A_R_LINEAR_____18_CM 8 -50. 205. FORMAT "%3.0" /end AXIS_PTS
/begin CHARACTERISTIC ip_mf_prev1_0_0 "MF: basic fuel mass of minor injection prev1 at temperature level 0" MAP 0x8543a2 _REC_MAP_20_u2_u2_u2 262.14 _CNV_A_R_LINEAR_____43_CM 0. 262.14 DISPLAY_IDENTIFIER IP_MF_PREV1_0_0
 /begin AXIS_DESCR COM_AXIS n _CNV_A_R_LINEAR_____5_CM 16 0. 6375. FORMAT "%4.0" AXIS_PTS_REF ldpm_n_1_ip_mf_prev1 /end AXIS_DESCR
 /begin AXIS_DESCR COM_AXIS tqi_sp _CNV_A_R_LINEAR_____89_CM 16 -1024. 1023.96875 FORMAT "%6.2" AXIS_PTS_REF ldpm_tqi_sp_1_ip_mf_prev1 /end AXIS_DESCR
/end CHARACTERISTIC
/begin AXIS_PTS ldpm_n_1_ip_mf_prev1 "" 0x8436c2 n _REC_AXS_20_u2 6375. _CNV_A_R_LINEAR_____5_CM 16 0. 6375. FORMAT "%4.0" /end AXIS_PTS
/begin AXIS_PTS ldpm_tqi_sp_1_ip_mf_prev1 "" 0x8442f4 tqi_sp _REC_AXS_20_u2 2047.96875 _CNV_A_R_LINEAR_____89_CM 16 -1024. 1023.96875 FORMAT "%6.2" /end AXIS_PTS
/begin CHARACTERISTIC ip_mf_prev1_0_1 "MF: basic fuel mass of minor injection prev1 at temperature level 1" MAP 0x8545a2 _REC_MAP_20_u2_u2_u2 262.14 _CNV_A_R_LINEAR_____43_CM 0. 262.14 DISPLAY_IDENTIFIER IP_MF_PREV1_0_1
 /begin AXIS_DESCR COM_AXIS n _CNV_A_R_LINEAR_____5_CM 16 0. 6375. FORMAT "%4.0" AXIS_PTS_REF ldpm_n_1_ip_mf_prev1 /end AXIS_DESCR
 /begin AXIS_DESCR COM_AXIS tqi_sp _CNV_A_R_LINEAR_____89_CM 16 -1024. 1023.96875 FORMAT "%6.2" AXIS_PTS_REF ldpm_tqi_sp_1_ip_mf_prev1 /end AXIS_DESCR
/end CHARACTERISTIC
/begin CHARACTERISTIC ip_mf_prev1_0_2 "MF: basic fuel mass of minor injection prev1 at temperature level 2" MAP 0x8547a2 _REC_MAP_20_u2_u2_u2 262.14 _CNV_A_R_LINEAR_____43_CM 0. 262.14 DISPLAY_IDENTIFIER IP_MF_PREV1_0_2
 /begin AXIS_DESCR COM_AXIS n _CNV_A_R_LINEAR_____5_CM 16 0. 6375. FORMAT "%4.0" AXIS_PTS_REF ldpm_n_1_ip_mf_prev1 /end AXIS_DESCR
 /begin AXIS_DESCR COM_AXIS tqi_sp _CNV_A_R_LINEAR_____89_CM 16 -1024. 1023.96875 FORMAT "%6.2" AXIS_PTS_REF ldpm_tqi_sp_1_ip_mf_prev1 /end AXIS_DESCR
/end CHARACTERISTIC
/begin CHARACTERISTIC ip_mf_prev1_amp "MF: ambient pressure temperature correction of fuel mass for minor injections prev1" MAP 0x8549a2 _REC_MAP_20_u2_u2_u2 262.14 _CNV_A_R_LINEAR_____133_CM -131.072 131.068 DISPLAY_IDENTIFIER IP_MF_PREV1_AMP
 /begin AXIS_DESCR COM_AXIS n _CNV_A_R_LINEAR_____5_CM 8 0. 6375. FORMAT "%4.0" AXIS_PTS_REF ldp_n_ip_mf_prev1_amp /end AXIS_DESCR
 /begin AXIS_DESCR COM_AXIS tqi_sp _CNV_A_R_LINEAR_____89_CM 8 -1024. 1023.96875 FORMAT "%6.2" AXIS_PTS_REF ldp_tqi_sp_ip_mf_prev1_amp /end AXIS_DESCR
/end CHARACTERISTIC
/begin AXIS_PTS ldp_n_ip_mf_prev1_amp "" 0x841e46 n _REC_AXS_20_u2 6375. _CNV_A_R_LINEAR_____5_CM 8 0. 6375. FORMAT "%4.0" /end AXIS_PTS
/begin AXIS_PTS ldp_tqi_sp_ip_mf_prev1_amp "" 0x842fce tqi_sp _REC_AXS_20_u2 2047.96875 _CNV_A_R_LINEAR_____89_CM 8 -1024. 1023.96875 FORMAT "%6.2" /end AXIS_PTS
/begin CHARACTERISTIC ip_mf_prev1_tgas "MF: air charge temperature correction of minor injections prev1" MAP 0x8553aa _REC_MAP_20_u2_u2_u2 262.14 _CNV_A_R_LINEAR_____133_CM -131.072 131.068 DISPLAY_IDENTIFIER IP_MF_PREV1_TGAS
 /begin AXIS_DESCR COM_AXIS n _CNV_A_R_LINEAR_____5_CM 8 0. 6375. FORMAT "%4.0" AXIS_PTS_REF ldp_n_ip_mf_prev1_tgas /end AXIS_DESCR
 /begin AXIS_DESCR COM_AXIS tqi_sp _CNV_A_R_LINEAR_____89_CM 8 -1024. 1023.96875 FORMAT "%6.2" AXIS_PTS_REF ldp_tqi_sp_ip_mf_prev1_tgas /end AXIS_DESCR
/end CHARACTERISTIC
/begin AXIS_PTS ldp_n_ip_mf_prev1_tgas "" 0x841eae n _REC_AXS_20_u2 6375. _CNV_A_R_LINEAR_____5_CM 8 0. 6375. FORMAT "%4.0" /end AXIS_PTS
/begin AXIS_PTS ldp_tqi_sp_ip_mf_prev1_tgas "" 0x843024 tqi_sp _REC_AXS_20_u2 2047.96875 _CNV_A_R_LINEAR_____89_CM 8 -1024. 1023.96875 FORMAT "%6.2" /end AXIS_PTS
/begin CHARACTERISTIC c_mf_prev2_max "maximal fuel mass of minor injection prev2" VALUE 0x85bf6a _REC_VAL_20_u2 262.14 _CNV_A_R_LINEAR_____43_CM 0. 262.14 DISPLAY_IDENTIFIER C_MF_PREV2_MAX /end CHARACTERISTIC
/begin CHARACTERISTIC ip_fac_mf_prev2_cor_tco "MF: fuel mass interpolation prev2 dependent on TCO" CURVE 0x84bf4c _REC_CUR_20_u2_u1 1.9999696 _CNV_A_R_LINEAR_____53_CM 0. 1.9999696 DISPLAY_IDENTIFIER IP_FAC_MF_PREV2_COR_TCO FORMAT "%6.5"
 /begin AXIS_DESCR COM_AXIS tco _CNV_A_R_LINEAR_____18_CM 1 -50. 205. FORMAT "%3.0" AXIS_PTS_REF ldp_tco_ip_fac_mf_prev2_cor /end AXIS_DESCR
/end CHARACTERISTIC
/begin AXIS_PTS ldp_tco_ip_fac_mf_prev2_cor "" 0x842719 tco _REC_AXS_20_u1 255. _CNV_A_R_LINEAR_____18_CM 1 -50. 205. FORMAT "%3.0" /end AXIS_PTS
/begin CHARACTERISTIC ip_fac_mf_prev2_cor_amp "MF: amp correction factor for fuel mass of minor injections prev2" CURVE 0x84bf48 _REC_CUR_20_u2_u2 0.9999847412109381 _CNV_A_R_LINEAR_____14_CM 0. 0.9999847412109381 DISPLAY_IDENTIFIER IP_FAC_MF_PREV2_COR_AMP FORMAT "%6.5"
 /begin AXIS_DESCR COM_AXIS amp _CNV_A_R_LINEAR_____21_CM 1 0. 5434. FORMAT "%6.2" AXIS_PTS_REF ldp_amp_ip_fac_mf_prev2_cor /end AXIS_DESCR
/end CHARACTERISTIC
/begin AXIS_PTS ldp_amp_ip_fac_mf_prev2_cor "" 0x841206 amp _REC_AXS_20_u2 5434. _CNV_A_R_LINEAR_____21_CM 1 0. 5434. FORMAT "%6.2" /end AXIS_PTS
/begin CHARACTERISTIC ip_fac_mf_prev2_cor_tgas "MF: fuel mass correction prev2 dependent on TGAS" CURVE 0x84bf50 _REC_CUR_20_u2_u1 0.9999847412109381 _CNV_A_R_LINEAR_____14_CM 0. 0.9999847412109381 DISPLAY_IDENTIFIER IP_FAC_MF_PREV2_COR_TGAS FORMAT "%6.5"
 /begin AXIS_DESCR COM_AXIS tgas _CNV_A_R_LINEAR_____18_CM 1 -50. 205. FORMAT "%3.0" AXIS_PTS_REF ldp_tgas_ip_fac_mf_prev2_cor /end AXIS_DESCR
/end CHARACTERISTIC
/begin AXIS_PTS ldp_tgas_ip_fac_mf_prev2_cor "" 0x84299f tgas _REC_AXS_20_u1 255. _CNV_A_R_LINEAR_____18_CM 1 -50. 205. FORMAT "%3.0" /end AXIS_PTS
/begin CHARACTERISTIC ip_mf_prev2_0_0 "MF: basic fuel mass of minor injection prev2 at temperature level 0" MAP 0x8554aa _REC_MAP_20_u2_u2_u2 262.14 _CNV_A_R_LINEAR_____43_CM 0. 262.14 DISPLAY_IDENTIFIER IP_MF_PREV2_0_0
 /begin AXIS_DESCR COM_AXIS n _CNV_A_R_LINEAR_____5_CM 1 0. 6375. FORMAT "%4.0" AXIS_PTS_REF ldpm_n_1_ip_mf_prev2 /end AXIS_DESCR
 /begin AXIS_DESCR COM_AXIS tqi_sp _CNV_A_R_LINEAR_____89_CM 1 -1024. 1023.96875 FORMAT "%6.2" AXIS_PTS_REF ldpm_tqi_sp_1_ip_mf_prev2 /end AXIS_DESCR
/end CHARACTERISTIC
/begin AXIS_PTS ldpm_n_1_ip_mf_prev2 "" 0x843728 n _REC_AXS_20_u2 6375. _CNV_A_R_LINEAR_____5_CM 1 0. 6375. FORMAT "%4.0" /end AXIS_PTS
/begin AXIS_PTS ldpm_tqi_sp_1_ip_mf_prev2 "" 0x844316 tqi_sp _REC_AXS_20_u2 2047.96875 _CNV_A_R_LINEAR_____89_CM 1 -1024. 1023.96875 FORMAT "%6.2" /end AXIS_PTS
/begin CHARACTERISTIC ip_mf_prev2_0_1 "MF: basic fuel mass of minor injection prev2 at temperature level 1" MAP 0x8554ac _REC_MAP_20_u2_u2_u2 262.14 _CNV_A_R_LINEAR_____43_CM 0. 262.14 DISPLAY_IDENTIFIER IP_MF_PREV2_0_1
 /begin AXIS_DESCR COM_AXIS n _CNV_A_R_LINEAR_____5_CM 1 0. 6375. FORMAT "%4.0" AXIS_PTS_REF ldpm_n_1_ip_mf_prev2 /end AXIS_DESCR
 /begin AXIS_DESCR COM_AXIS tqi_sp _CNV_A_R_LINEAR_____89_CM 1 -1024. 1023.96875 FORMAT "%6.2" AXIS_PTS_REF ldpm_tqi_sp_1_ip_mf_prev2 /end AXIS_DESCR
/end CHARACTERISTIC
/begin CHARACTERISTIC ip_mf_prev2_0_2 "MF: basic fuel mass of minor injection prev2 at temperature level 2" MAP 0x8554ae _REC_MAP_20_u2_u2_u2 262.14 _CNV_A_R_LINEAR_____43_CM 0. 262.14 DISPLAY_IDENTIFIER IP_MF_PREV2_0_2
 /begin AXIS_DESCR COM_AXIS n _CNV_A_R_LINEAR_____5_CM 1 0. 6375. FORMAT "%4.0" AXIS_PTS_REF ldpm_n_1_ip_mf_prev2 /end AXIS_DESCR
 /begin AXIS_DESCR COM_AXIS tqi_sp _CNV_A_R_LINEAR_____89_CM 1 -1024. 1023.96875 FORMAT "%6.2" AXIS_PTS_REF ldpm_tqi_sp_1_ip_mf_prev2 /end AXIS_DESCR
/end CHARACTERISTIC
/begin CHARACTERISTIC ip_mf_prev2_amp "MF: ambient pressure temperature correction of fuel mass for minor injections prev2" MAP 0x8554b0 _REC_MAP_20_u2_u2_u2 262.14 _CNV_A_R_LINEAR_____133_CM -131.072 131.068 DISPLAY_IDENTIFIER IP_MF_PREV2_AMP
 /begin AXIS_DESCR COM_AXIS n _CNV_A_R_LINEAR_____5_CM 1 0. 6375. FORMAT "%4.0" AXIS_PTS_REF ldp_n_ip_mf_prev2_amp /end AXIS_DESCR
 /begin AXIS_DESCR COM_AXIS tqi_sp _CNV_A_R_LINEAR_____89_CM 1 -1024. 1023.96875 FORMAT "%6.2" AXIS_PTS_REF ldp_tqi_sp_ip_mf_prev2_amp /end AXIS_DESCR
/end CHARACTERISTIC
/begin AXIS_PTS ldp_n_ip_mf_prev2_amp "" 0x841ed2 n _REC_AXS_20_u2 6375. _CNV_A_R_LINEAR_____5_CM 1 0. 6375. FORMAT "%4.0" /end AXIS_PTS
/begin AXIS_PTS ldp_tqi_sp_ip_mf_prev2_amp "" 0x843036 tqi_sp _REC_AXS_20_u2 2047.96875 _CNV_A_R_LINEAR_____89_CM 1 -1024. 1023.96875 FORMAT "%6.2" /end AXIS_PTS
/begin CHARACTERISTIC ip_mf_prev2_tgas "MF: air charge temperature correction of minor injections prev2" MAP 0x8554c2 _REC_MAP_20_u2_u2_u2 262.14 _CNV_A_R_LINEAR_____133_CM -131.072 131.068 DISPLAY_IDENTIFIER IP_MF_PREV2_TGAS
 /begin AXIS_DESCR COM_AXIS n _CNV_A_R_LINEAR_____5_CM 1 0. 6375. FORMAT "%4.0" AXIS_PTS_REF ldp_n_ip_mf_prev2_tgas /end AXIS_DESCR
 /begin AXIS_DESCR COM_AXIS tqi_sp _CNV_A_R_LINEAR_____89_CM 1 -1024. 1023.96875 FORMAT "%6.2" AXIS_PTS_REF ldp_tqi_sp_ip_mf_prev2_tgas /end AXIS_DESCR
/end CHARACTERISTIC
/begin AXIS_PTS ldp_n_ip_mf_prev2_tgas "" 0x841ee2 n _REC_AXS_20_u2 6375. _CNV_A_R_LINEAR_____5_CM 1 0. 6375. FORMAT "%4.0" /end AXIS_PTS
/begin AXIS_PTS ldp_tqi_sp_ip_mf_prev2_tgas "" 0x843042 tqi_sp _REC_AXS_20_u2 2047.96875 _CNV_A_R_LINEAR_____89_CM 1 -1024. 1023.96875 FORMAT "%6.2" /end AXIS_PTS
/begin CHARACTERISTIC c_mf_main2_max "maximal fuel mass of minor injection main2" VALUE 0x85bf5e _REC_VAL_20_u2 262.14 _CNV_A_R_LINEAR_____43_CM 0. 262.14 DISPLAY_IDENTIFIER C_MF_MAIN2_MAX /end CHARACTERISTIC
/begin CHARACTERISTIC ip_fac_mf_main2_cor_tco "MF: fuel mass interpolation main2 dependent on TCO" CURVE 0x84be5c _REC_CUR_20_u2_u1 1.9999696 _CNV_A_R_LINEAR_____53_CM 0. 1.9999696 DISPLAY_IDENTIFIER IP_FAC_MF_MAIN2_COR_TCO FORMAT "%6.5"
 /begin AXIS_DESCR COM_AXIS tco _CNV_A_R_LINEAR_____18_CM 1 -50. 205. FORMAT "%3.0" AXIS_PTS_REF ldp_tco_ip_fac_mf_main2_cor /end AXIS_DESCR
/end CHARACTERISTIC
/begin AXIS_PTS ldp_tco_ip_fac_mf_main2_cor "" 0x8426f1 tco _REC_AXS_20_u1 255. _CNV_A_R_LINEAR_____18_CM 1 -50. 205. FORMAT "%3.0" /end AXIS_PTS
/begin CHARACTERISTIC ip_fac_mf_main2_cor_amp "MF: amp correction factor for fuel mass of minor injections main2" CURVE 0x84be58 _REC_CUR_20_u2_u2 0.9999847412109381 _CNV_A_R_LINEAR_____14_CM 0. 0.9999847412109381 DISPLAY_IDENTIFIER IP_FAC_MF_MAIN2_COR_AMP FORMAT "%6.5"
 /begin AXIS_DESCR COM_AXIS amp _CNV_A_R_LINEAR_____21_CM 1 0. 5434. FORMAT "%6.2" AXIS_PTS_REF ldp_amp_ip_fac_mf_main2_cor /end AXIS_DESCR
/end CHARACTERISTIC
/begin AXIS_PTS ldp_amp_ip_fac_mf_main2_cor "" 0x8411b6 amp _REC_AXS_20_u2 5434. _CNV_A_R_LINEAR_____21_CM 1 0. 5434. FORMAT "%6.2" /end AXIS_PTS
/begin CHARACTERISTIC ip_fac_mf_main2_cor_tgas "MF: fuel mass correction main2 dependent on TGAS" CURVE 0x84be60 _REC_CUR_20_u2_u1 0.9999847412109381 _CNV_A_R_LINEAR_____14_CM 0. 0.9999847412109381 DISPLAY_IDENTIFIER IP_FAC_MF_MAIN2_COR_TGAS FORMAT "%6.5"
 /begin AXIS_DESCR COM_AXIS tgas _CNV_A_R_LINEAR_____18_CM 1 -50. 205. FORMAT "%3.0" AXIS_PTS_REF ldp_tgas_ip_fac_mf_main2_cor /end AXIS_DESCR
/end CHARACTERISTIC
/begin AXIS_PTS ldp_tgas_ip_fac_mf_main2_cor "" 0x842977 tgas _REC_AXS_20_u1 255. _CNV_A_R_LINEAR_____18_CM 1 -50. 205. FORMAT "%3.0" /end AXIS_PTS
/begin CHARACTERISTIC ip_mf_main2_0_0 "MF: basic fuel mass of minor injection main2 at temperature level 0" MAP 0x85327e _REC_MAP_20_u2_u2_u2 262.14 _CNV_A_R_LINEAR_____43_CM 0. 262.14 DISPLAY_IDENTIFIER IP_MF_MAIN2_0_0
 /begin AXIS_DESCR COM_AXIS n _CNV_A_R_LINEAR_____5_CM 1 0. 6375. FORMAT "%4.0" AXIS_PTS_REF ldpm_n_1_ip_mf_main2 /end AXIS_DESCR
 /begin AXIS_DESCR COM_AXIS tqi_sp _CNV_A_R_LINEAR_____89_CM 1 -1024. 1023.96875 FORMAT "%6.2" AXIS_PTS_REF ldpm_tqi_sp_1_ip_mf_main2 /end AXIS_DESCR
/end CHARACTERISTIC
/begin AXIS_PTS ldpm_n_1_ip_mf_main2 "" 0x843650 n _REC_AXS_20_u2 6375. _CNV_A_R_LINEAR_____5_CM 1 0. 6375. FORMAT "%4.0" /end AXIS_PTS
/begin AXIS_PTS ldpm_tqi_sp_1_ip_mf_main2 "" 0x8442ce tqi_sp _REC_AXS_20_u2 2047.96875 _CNV_A_R_LINEAR_____89_CM 1 -1024. 1023.96875 FORMAT "%6.2" /end AXIS_PTS
/begin CHARACTERISTIC ip_mf_main2_0_1 "MF: basic fuel mass of minor injection main2 at temperature level 1" MAP 0x853280 _REC_MAP_20_u2_u2_u2 262.14 _CNV_A_R_LINEAR_____43_CM 0. 262.14 DISPLAY_IDENTIFIER IP_MF_MAIN2_0_1
 /begin AXIS_DESCR COM_AXIS n _CNV_A_R_LINEAR_____5_CM 1 0. 6375. FORMAT "%4.0" AXIS_PTS_REF ldpm_n_1_ip_mf_main2 /end AXIS_DESCR
 /begin AXIS_DESCR COM_AXIS tqi_sp _CNV_A_R_LINEAR_____89_CM 1 -1024. 1023.96875 FORMAT "%6.2" AXIS_PTS_REF ldpm_tqi_sp_1_ip_mf_main2 /end AXIS_DESCR
/end CHARACTERISTIC
/begin CHARACTERISTIC ip_mf_main2_0_2 "MF: basic fuel mass of minor injection main2 at temperature level 2" MAP 0x853282 _REC_MAP_20_u2_u2_u2 262.14 _CNV_A_R_LINEAR_____43_CM 0. 262.14 DISPLAY_IDENTIFIER IP_MF_MAIN2_0_2
 /begin AXIS_DESCR COM_AXIS n _CNV_A_R_LINEAR_____5_CM 1 0. 6375. FORMAT "%4.0" AXIS_PTS_REF ldpm_n_1_ip_mf_main2 /end AXIS_DESCR
 /begin AXIS_DESCR COM_AXIS tqi_sp _CNV_A_R_LINEAR_____89_CM 1 -1024. 1023.96875 FORMAT "%6.2" AXIS_PTS_REF ldpm_tqi_sp_1_ip_mf_main2 /end AXIS_DESCR
/end CHARACTERISTIC
/begin CHARACTERISTIC ip_mf_main2_amp "MF: ambient pressure temperature correction of fuel mass for minor injections main2" MAP 0x853284 _REC_MAP_20_u2_u2_u2 262.14 _CNV_A_R_LINEAR_____133_CM -131.072 131.068 DISPLAY_IDENTIFIER IP_MF_MAIN2_AMP
 /begin AXIS_DESCR COM_AXIS n _CNV_A_R_LINEAR_____5_CM 1 0. 6375. FORMAT "%4.0" AXIS_PTS_REF ldp_n_ip_mf_main2_amp /end AXIS_DESCR
 /begin AXIS_DESCR COM_AXIS tqi_sp _CNV_A_R_LINEAR_____89_CM 1 -1024. 1023.96875 FORMAT "%6.2" AXIS_PTS_REF ldp_tqi_sp_ip_mf_main2_amp /end AXIS_DESCR
/end CHARACTERISTIC
/begin AXIS_PTS ldp_n_ip_mf_main2_amp "" 0x841da2 n _REC_AXS_20_u2 6375. _CNV_A_R_LINEAR_____5_CM 1 0. 6375. FORMAT "%4.0" /end AXIS_PTS
/begin AXIS_PTS ldp_tqi_sp_ip_mf_main2_amp "" 0x842f56 tqi_sp _REC_AXS_20_u2 2047.96875 _CNV_A_R_LINEAR_____89_CM 1 -1024. 1023.96875 FORMAT "%6.2" /end AXIS_PTS
/begin CHARACTERISTIC ip_mf_main2_tgas "MF: air charge temperature correction of minor injections main2" MAP 0x853296 _REC_MAP_20_u2_u2_u2 262.14 _CNV_A_R_LINEAR_____133_CM -131.072 131.068 DISPLAY_IDENTIFIER IP_MF_MAIN2_TGAS
 /begin AXIS_DESCR COM_AXIS n _CNV_A_R_LINEAR_____5_CM 1 0. 6375. FORMAT "%4.0" AXIS_PTS_REF ldp_n_ip_mf_main2_tgas /end AXIS_DESCR
 /begin AXIS_DESCR COM_AXIS tqi_sp _CNV_A_R_LINEAR_____89_CM 1 -1024. 1023.96875 FORMAT "%6.2" AXIS_PTS_REF ldp_tqi_sp_ip_mf_main2_tgas /end AXIS_DESCR
/end CHARACTERISTIC
/begin AXIS_PTS ldp_n_ip_mf_main2_tgas "" 0x841db2 n _REC_AXS_20_u2 6375. _CNV_A_R_LINEAR_____5_CM 1 0. 6375. FORMAT "%4.0" /end AXIS_PTS
/begin AXIS_PTS ldp_tqi_sp_ip_mf_main2_tgas "" 0x842f62 tqi_sp _REC_AXS_20_u2 2047.96875 _CNV_A_R_LINEAR_____89_CM 1 -1024. 1023.96875 FORMAT "%6.2" /end AXIS_PTS
/begin CHARACTERISTIC c_mf_post1_max "maximal fuel mass of minor injection post1" VALUE 0x85bf66 _REC_VAL_20_u2 262.14 _CNV_A_R_LINEAR_____43_CM 0. 262.14 DISPLAY_IDENTIFIER C_MF_POST1_MAX /end CHARACTERISTIC
/begin CHARACTERISTIC ip_fac_mf_post1_cor_tco "MF: fuel mass interpolation post1 dependent on TCO" CURVE 0x84be88 _REC_CUR_20_u2_u1 1.9999696 _CNV_A_R_LINEAR_____53_CM 0. 1.9999696 DISPLAY_IDENTIFIER IP_FAC_MF_POST1_COR_TCO FORMAT "%6.5"
 /begin AXIS_DESCR COM_AXIS tco _CNV_A_R_LINEAR_____18_CM 8 -50. 205. FORMAT "%3.0" AXIS_PTS_REF ldp_tco_ip_fac_mf_post1_cor /end AXIS_DESCR
/end CHARACTERISTIC
/begin AXIS_PTS ldp_tco_ip_fac_mf_post1_cor "" 0x8426f5 tco _REC_AXS_20_u1 255. _CNV_A_R_LINEAR_____18_CM 8 -50. 205. FORMAT "%3.0" /end AXIS_PTS
/begin CHARACTERISTIC ip_fac_mf_post1_cor_amp "MF: amp correction factor for fuel mass of minor injections post1" CURVE 0x84be68 _REC_CUR_20_u2_u2 0.9999847412109381 _CNV_A_R_LINEAR_____14_CM 0. 0.9999847412109381 DISPLAY_IDENTIFIER IP_FAC_MF_POST1_COR_AMP FORMAT "%6.5"
 /begin AXIS_DESCR COM_AXIS amp _CNV_A_R_LINEAR_____21_CM 8 0. 5434. FORMAT "%6.2" AXIS_PTS_REF ldp_amp_ip_fac_mf_post1_cor /end AXIS_DESCR
/end CHARACTERISTIC
/begin AXIS_PTS ldp_amp_ip_fac_mf_post1_cor "" 0x8411be amp _REC_AXS_20_u2 5434. _CNV_A_R_LINEAR_____21_CM 8 0. 5434. FORMAT "%6.2" /end AXIS_PTS
/begin CHARACTERISTIC ip_fac_mf_post1_cor_tgas "MF: fuel mass correction post1 dependent on TGAS" CURVE 0x84bea8 _REC_CUR_20_u2_u1 0.9999847412109381 _CNV_A_R_LINEAR_____14_CM 0. 0.9999847412109381 DISPLAY_IDENTIFIER IP_FAC_MF_POST1_COR_TGAS FORMAT "%6.5"
 /begin AXIS_DESCR COM_AXIS tgas _CNV_A_R_LINEAR_____18_CM 8 -50. 205. FORMAT "%3.0" AXIS_PTS_REF ldp_tgas_ip_fac_mf_post1_cor /end AXIS_DESCR
/end CHARACTERISTIC
/begin AXIS_PTS ldp_tgas_ip_fac_mf_post1_cor "" 0x84297b tgas _REC_AXS_20_u1 255. _CNV_A_R_LINEAR_____18_CM 8 -50. 205. FORMAT "%3.0" /end AXIS_PTS
/begin CHARACTERISTIC ip_mf_post1_0_0 "MF: basic fuel mass of minor injection post1 at temperature level 0" MAP 0x85329a _REC_MAP_20_u2_u2_u2 262.14 _CNV_A_R_LINEAR_____43_CM 0. 262.14 DISPLAY_IDENTIFIER IP_MF_POST1_0_0
 /begin AXIS_DESCR COM_AXIS n _CNV_A_R_LINEAR_____5_CM 16 0. 6375. FORMAT "%4.0" AXIS_PTS_REF ldpm_n_1_ip_mf_post1 /end AXIS_DESCR
 /begin AXIS_DESCR COM_AXIS tqi_sp _CNV_A_R_LINEAR_____89_CM 16 -1024. 1023.96875 FORMAT "%6.2" AXIS_PTS_REF ldpm_tqi_sp_1_ip_mf_post1 /end AXIS_DESCR
/end CHARACTERISTIC
/begin AXIS_PTS ldpm_n_1_ip_mf_post1 "" 0x84365c n _REC_AXS_20_u2 6375. _CNV_A_R_LINEAR_____5_CM 16 0. 6375. FORMAT "%4.0" /end AXIS_PTS
/begin AXIS_PTS ldpm_tqi_sp_1_ip_mf_post1 "" 0x8442d2 tqi_sp _REC_AXS_20_u2 2047.96875 _CNV_A_R_LINEAR_____89_CM 16 -1024. 1023.96875 FORMAT "%6.2" /end AXIS_PTS
/begin CHARACTERISTIC ip_mf_post1_0_1 "MF: basic fuel mass of minor injection post1 at temperature level 1" MAP 0x85349a _REC_MAP_20_u2_u2_u2 262.14 _CNV_A_R_LINEAR_____43_CM 0. 262.14 DISPLAY_IDENTIFIER IP_MF_POST1_0_1
 /begin AXIS_DESCR COM_AXIS n _CNV_A_R_LINEAR_____5_CM 16 0. 6375. FORMAT "%4.0" AXIS_PTS_REF ldpm_n_1_ip_mf_post1 /end AXIS_DESCR
 /begin AXIS_DESCR COM_AXIS tqi_sp _CNV_A_R_LINEAR_____89_CM 16 -1024. 1023.96875 FORMAT "%6.2" AXIS_PTS_REF ldpm_tqi_sp_1_ip_mf_post1 /end AXIS_DESCR
/end CHARACTERISTIC
/begin CHARACTERISTIC ip_mf_post1_0_2 "MF: basic fuel mass of minor injection post1 at temperature level 2" MAP 0x85369a _REC_MAP_20_u2_u2_u2 262.14 _CNV_A_R_LINEAR_____43_CM 0. 262.14 DISPLAY_IDENTIFIER IP_MF_POST1_0_2
 /begin AXIS_DESCR COM_AXIS n _CNV_A_R_LINEAR_____5_CM 16 0. 6375. FORMAT "%4.0" AXIS_PTS_REF ldpm_n_1_ip_mf_post1 /end AXIS_DESCR
 /begin AXIS_DESCR COM_AXIS tqi_sp _CNV_A_R_LINEAR_____89_CM 16 -1024. 1023.96875 FORMAT "%6.2" AXIS_PTS_REF ldpm_tqi_sp_1_ip_mf_post1 /end AXIS_DESCR
/end CHARACTERISTIC
/begin CHARACTERISTIC ip_mf_post1_amp "MF: ambient pressure temperature correction of fuel mass for minor injections post1" MAP 0x85389a _REC_MAP_20_u2_u2_u2 262.14 _CNV_A_R_LINEAR_____133_CM -131.072 131.068 DISPLAY_IDENTIFIER IP_MF_POST1_AMP
 /begin AXIS_DESCR COM_AXIS n _CNV_A_R_LINEAR_____5_CM 8 0. 6375. FORMAT "%4.0" AXIS_PTS_REF ldp_n_ip_mf_post1_amp /end AXIS_DESCR
 /begin AXIS_DESCR COM_AXIS tqi_sp _CNV_A_R_LINEAR_____89_CM 8 -1024. 1023.96875 FORMAT "%6.2" AXIS_PTS_REF ldp_tqi_sp_ip_mf_post1_amp /end AXIS_DESCR
/end CHARACTERISTIC
/begin AXIS_PTS ldp_n_ip_mf_post1_amp "" 0x841dba n _REC_AXS_20_u2 6375. _CNV_A_R_LINEAR_____5_CM 8 0. 6375. FORMAT "%4.0" /end AXIS_PTS
/begin AXIS_PTS ldp_tqi_sp_ip_mf_post1_amp "" 0x842f66 tqi_sp _REC_AXS_20_u2 2047.96875 _CNV_A_R_LINEAR_____89_CM 8 -1024. 1023.96875 FORMAT "%6.2" /end AXIS_PTS
/begin CHARACTERISTIC ip_mf_post1_tgas "MF: air charge temperature correction of minor injections post1" MAP 0x8542a2 _REC_MAP_20_u2_u2_u2 262.14 _CNV_A_R_LINEAR_____133_CM -131.072 131.068 DISPLAY_IDENTIFIER IP_MF_POST1_TGAS
 /begin AXIS_DESCR COM_AXIS n _CNV_A_R_LINEAR_____5_CM 8 0. 6375. FORMAT "%4.0" AXIS_PTS_REF ldp_n_ip_mf_post1_tgas /end AXIS_DESCR
 /begin AXIS_DESCR COM_AXIS tqi_sp _CNV_A_R_LINEAR_____89_CM 8 -1024. 1023.96875 FORMAT "%6.2" AXIS_PTS_REF ldp_tqi_sp_ip_mf_post1_tgas /end AXIS_DESCR
/end CHARACTERISTIC
/begin AXIS_PTS ldp_n_ip_mf_post1_tgas "" 0x841e22 n _REC_AXS_20_u2 6375. _CNV_A_R_LINEAR_____5_CM 8 0. 6375. FORMAT "%4.0" /end AXIS_PTS
/begin AXIS_PTS ldp_tqi_sp_ip_mf_post1_tgas "" 0x842fbc tqi_sp _REC_AXS_20_u2 2047.96875 _CNV_A_R_LINEAR_____89_CM 8 -1024. 1023.96875 FORMAT "%6.2" /end AXIS_PTS
/begin MEASUREMENT mf_inj_min "minimal injection fuel mass" UWORD _CNV_A_R_LINEAR_____43_CM 1 0. 0. 262.14 DISPLAY_IDENTIFIER MF_INJ_MIN ECU_ADDRESS 0x7f9c84 BYTE_ORDER MSB_LAST /end MEASUREMENT
/begin CHARACTERISTIC c_mf_inj_min "" VALUE 0x85bf58 _REC_VAL_20_u2 262.14 _CNV_A_R_LINEAR_____43_CM 0. 262.14 DISPLAY_IDENTIFIER C_MF_INJ_MIN FORMAT "%5.2" /end CHARACTERISTIC
/begin MEASUREMENT mf_prev1_req "requested fuel mass of injection PREV1" UWORD _CNV_A_R_LINEAR_____43_CM 1 0. 0. 262.14 DISPLAY_IDENTIFIER MF_PREV1_REQ ECU_ADDRESS 0x7fa938 BYTE_ORDER MSB_LAST /end MEASUREMENT
/begin MEASUREMENT mf_prev2_req "requested fuel mass of injection PREV2" UWORD _CNV_A_R_LINEAR_____43_CM 1 0. 0. 262.14 DISPLAY_IDENTIFIER MF_PREV2_REQ ECU_ADDRESS 0x7fa93a BYTE_ORDER MSB_LAST /end MEASUREMENT
/begin MEASUREMENT mf_main2_req "requested fuel mass of injection MAIN2" UWORD _CNV_A_R_LINEAR_____43_CM 1 0. 0. 262.14 DISPLAY_IDENTIFIER MF_MAIN2_REQ ECU_ADDRESS 0x7fa93c BYTE_ORDER MSB_LAST /end MEASUREMENT
/begin MEASUREMENT mf_post1_req "requested fuel mass of injection POST1" UWORD _CNV_A_R_LINEAR_____43_CM 1 0. 0. 262.14 DISPLAY_IDENTIFIER MF_POST1_REQ ECU_ADDRESS 0x7fa93e BYTE_ORDER MSB_LAST /end MEASUREMENT
/begin MEASUREMENT ctr_tran_st_is_inter "intermediate counter for transition ST-IS" UBYTE _CNV_A_R_LINEAR_____0_CM 1 0. 0. 255. DISPLAY_IDENTIFIER CTR_TRAN_ST_IS_INTER ECU_ADDRESS 0x7fb657 FORMAT "%3.0" /end MEASUREMENT
/begin MEASUREMENT lv_act_prev1_inj "activation of injection PREV1" UBYTE _CNV_S_2_RANGE______11_CM 1 0. 0. 1. DISPLAY_IDENTIFIER LV_ACT_PREV1_INJ ECU_ADDRESS 0x7fb658 /end MEASUREMENT
/begin MEASUREMENT lv_act_prev2_inj "activation of injection PREV2" UBYTE _CNV_S_2_RANGE______11_CM 1 0. 0. 1. DISPLAY_IDENTIFIER LV_ACT_PREV2_INJ ECU_ADDRESS 0x7fb659 /end MEASUREMENT
/begin MEASUREMENT lv_act_main2_inj "activation of injection MAIN2" UBYTE _CNV_S_2_RANGE______11_CM 1 0. 0. 1. DISPLAY_IDENTIFIER LV_ACT_MAIN2_INJ ECU_ADDRESS 0x7fb65a /end MEASUREMENT
/begin MEASUREMENT lv_act_post1_inj "activation of injection POST1" UBYTE _CNV_S_2_RANGE______11_CM 1 0. 0. 1. DISPLAY_IDENTIFIER LV_ACT_POST1_INJ ECU_ADDRESS 0x7fb65b /end MEASUREMENT
/begin MEASUREMENT mf_post2_hys "fuel mass of injection POST2 after Hysteresis" UWORD _CNV_A_R_LINEAR_____43_CM 1 0. 0. 262.14 DISPLAY_IDENTIFIER MF_POST2_HYS ECU_ADDRESS 0x7f9c86 BYTE_ORDER MSB_LAST /end MEASUREMENT
/begin MEASUREMENT mf_prev1_hys "fuel mass of injection PREV1 after Hysteresis" UWORD _CNV_A_R_LINEAR_____43_CM 1 0. 0. 262.14 DISPLAY_IDENTIFIER MF_PREV1_HYS ECU_ADDRESS 0x7f9c88 BYTE_ORDER MSB_LAST /end MEASUREMENT
/begin MEASUREMENT mf_prev2_hys "fuel mass of injection PREV2 after Hysteresis" UWORD _CNV_A_R_LINEAR_____43_CM 1 0. 0. 262.14 DISPLAY_IDENTIFIER MF_PREV2_HYS ECU_ADDRESS 0x7f9c8a BYTE_ORDER MSB_LAST /end MEASUREMENT
/begin MEASUREMENT mf_main2_hys "fuel mass of injection MAIN2 after Hysteresis" UWORD _CNV_A_R_LINEAR_____43_CM 1 0. 0. 262.14 DISPLAY_IDENTIFIER MF_MAIN2_HYS ECU_ADDRESS 0x7f9c8c BYTE_ORDER MSB_LAST /end MEASUREMENT
/begin MEASUREMENT mf_post1_hys "fuel mass of injection POST1 after Hysteresis" UWORD _CNV_A_R_LINEAR_____43_CM 1 0. 0. 262.14 DISPLAY_IDENTIFIER MF_POST1_HYS ECU_ADDRESS 0x7f9c8e BYTE_ORDER MSB_LAST /end MEASUREMENT
/begin MEASUREMENT lv_act_prev_inj "activation of injection PREV1 or PREV2" UBYTE _CNV_S_2_RANGE______11_CM 1 0. 0. 1. DISPLAY_IDENTIFIER LV_ACT_PREV_INJ ECU_ADDRESS 0x7fb65c /end MEASUREMENT
/begin CHARACTERISTIC c_max_thd_hys "maximal threshold for minor injections fuel mass hysteresis" VALUE 0x85bf50 _REC_VAL_20_u1 0.99609375 _CNV_A_R_LINEAR_____34_CM 0. 0.99609375 DISPLAY_IDENTIFIER C_MAX_THD_HYS FORMAT "%4.3" /end CHARACTERISTIC
/begin CHARACTERISTIC c_min_thd_hys "minimal threshold for minor injections fuel mass hysteresis" VALUE 0x85bf78 _REC_VAL_20_u1 0.99609375 _CNV_A_R_LINEAR_____34_CM 0. 0.99609375 DISPLAY_IDENTIFIER C_MIN_THD_HYS FORMAT "%4.3" /end CHARACTERISTIC
/begin MEASUREMENT mf_prev2_is_pl_rgn_1 "fuel mass of injection PREV2 during IS/PL at rgn level 1" UWORD _CNV_A_R_LINEAR_____43_CM 1 0. 0. 262.14 DISPLAY_IDENTIFIER MF_PREV2_IS_PL_RGN_1 ECU_ADDRESS 0x7f9c6e BYTE_ORDER MSB_LAST /end MEASUREMENT
/begin MEASUREMENT mf_main2_is_pl_rgn_1 "fuel mass of injection MAIN2 during IS/PL at rgn level 1" UWORD _CNV_A_R_LINEAR_____43_CM 1 0. 0. 262.14 DISPLAY_IDENTIFIER MF_MAIN2_IS_PL_RGN_1 ECU_ADDRESS 0x7f9c70 BYTE_ORDER MSB_LAST /end MEASUREMENT
/begin MEASUREMENT mf_post1_is_pl_rgn_1 "fuel mass of injection POST1 during IS/PL at rgn level 1" UWORD _CNV_A_R_LINEAR_____43_CM 1 0. 0. 262.14 DISPLAY_IDENTIFIER MF_POST1_IS_PL_RGN_1 ECU_ADDRESS 0x7f9c72 BYTE_ORDER MSB_LAST /end MEASUREMENT
/begin MEASUREMENT mf_prev1_is_pl_rgn_2 "fuel mass of injection PREV1 during IS/PL at rgn level 2" UWORD _CNV_A_R_LINEAR_____43_CM 1 0. 0. 262.14 DISPLAY_IDENTIFIER MF_PREV1_IS_PL_RGN_2 ECU_ADDRESS 0x7f9c74 BYTE_ORDER MSB_LAST /end MEASUREMENT
/begin MEASUREMENT mf_prev2_is_pl_rgn_2 "fuel mass of injection PREV2 during IS/PL at rgn level 2" UWORD _CNV_A_R_LINEAR_____43_CM 1 0. 0. 262.14 DISPLAY_IDENTIFIER MF_PREV2_IS_PL_RGN_2 ECU_ADDRESS 0x7f9c76 BYTE_ORDER MSB_LAST /end MEASUREMENT
/begin MEASUREMENT mf_main2_is_pl_rgn_2 "fuel mass of injection MAIN2 during IS/PL at rgn level 2" UWORD _CNV_A_R_LINEAR_____43_CM 1 0. 0. 262.14 DISPLAY_IDENTIFIER MF_MAIN2_IS_PL_RGN_2 ECU_ADDRESS 0x7f9c78 BYTE_ORDER MSB_LAST /end MEASUREMENT
/begin MEASUREMENT mf_post1_is_pl_rgn_2 "fuel mass of injection POST1 during IS/PL at rgn level 2" UWORD _CNV_A_R_LINEAR_____43_CM 1 0. 0. 262.14 DISPLAY_IDENTIFIER MF_POST1_IS_PL_RGN_2 ECU_ADDRESS 0x7f9c7a BYTE_ORDER MSB_LAST /end MEASUREMENT
/begin AXIS_PTS ldp_tgas_ip_fac_mf_main2_rgn_1 "TGAS correction of mf MAIN2 during regeneration" 0x842979 tgas _REC_AXS_20_u1 255. _CNV_A_R_LINEAR_____18_CM 1 -50. 205. FORMAT "%3.0" /end AXIS_PTS
/begin AXIS_PTS ldp_tco_ip_fac_mf_main2_cor_rgn_1 "TCO interpolation of minor injection fuel mass MAIN2 during regeneration" 0x8426f3 tco _REC_AXS_20_u1 255. _CNV_A_R_LINEAR_____18_CM 1 -50. 205. FORMAT "%3.0" /end AXIS_PTS
/begin AXIS_PTS ldp_amp_ip_fac_mf_main2_rgn_1 "amp correction factor for minor injection mf MAIN2 during regeneration" 0x8411ba amp _REC_AXS_20_u2 5434. _CNV_A_R_LINEAR_____21_CM 1 0. 5434. FORMAT "%6.2" /end AXIS_PTS
/begin AXIS_PTS ldpm_n_1_ip_mf_main2_rgn_1 "basic mf of minor injection MAIN2 at regeneration level 1 and at temperature level 0" 0x843654 n _REC_AXS_20_u2 6375. _CNV_A_R_LINEAR_____5_CM 1 0. 6375. FORMAT "%4.0" /end AXIS_PTS
/begin AXIS_PTS ldpm_tqi_ip_mf_main2_rgn_1 "basic mf of minor injection MAIN2 at regeneration level 1 and at temperature level 0" 0x8440f4 tqi_sp _REC_AXS_20_u2 2047.96875 _CNV_A_R_LINEAR_____89_CM 1 -1024. 1023.96875 FORMAT "%6.2" /end AXIS_PTS
/begin AXIS_PTS ldp_n_ip_mf_main2_rgn_1_0_1 "basic mf of minor injection MAIN2 at temperature level 1 during regeneration" 0x841daa n _REC_AXS_20_u2 6375. _CNV_A_R_LINEAR_____5_CM 1 0. 6375. FORMAT "%4.0" /end AXIS_PTS
/begin AXIS_PTS ldp_n_ip_mf_main2_rgn_1_0_2 "basic mf of minor injection j at temperature level 2 during regeneration" 0x841dae n _REC_AXS_20_u2 6375. _CNV_A_R_LINEAR_____5_CM 1 0. 6375. FORMAT "%4.0" /end AXIS_PTS
/begin AXIS_PTS ldp_n_ip_mf_main2_amp_rgn_1 "amp correction of minor injection mf MAIN2 during regeneration" 0x841da6 n _REC_AXS_20_u2 6375. _CNV_A_R_LINEAR_____5_CM 1 0. 6375. FORMAT "%4.0" /end AXIS_PTS
/begin AXIS_PTS ldp_tqi_sp_ip_mf_main2_rgn_1_0_1 "basic mf of minor injection MAIN2 at temperature level 1 during regeneration" 0x842f5a tqi_sp _REC_AXS_20_u2 2047.96875 _CNV_A_R_LINEAR_____89_CM 1 -1024. 1023.96875 FORMAT "%6.2" /end AXIS_PTS
/begin AXIS_PTS ldp_tqi_sp_ip_mf_main2_rgn_1_0_2 "basic mf of minor injection MAIN2 at temperature level 2 during regeneration" 0x842f5e tqi_sp _REC_AXS_20_u2 2047.96875 _CNV_A_R_LINEAR_____89_CM 1 -1024. 1023.96875 FORMAT "%6.2" /end AXIS_PTS
/begin AXIS_PTS ldp_tqi_ip_mf_main2_tgas_rgn_1 "air charge temperature correction of minor injection MAIN2 during regeneration" 0x842c28 tqi_sp _REC_AXS_20_u2 2047.96875 _CNV_A_R_LINEAR_____89_CM 1 -1024. 1023.96875 FORMAT "%6.2" /end AXIS_PTS
/begin AXIS_PTS ldp_tqi_ip_mf_main2_amp_rgn_1 "amp correction of minor injection mf MAIN2 during regeneration" 0x842c24 tqi_sp _REC_AXS_20_u2 2047.96875 _CNV_A_R_LINEAR_____89_CM 1 -1024. 1023.96875 FORMAT "%6.2" /end AXIS_PTS
/begin CHARACTERISTIC ip_fac_mf_main2_cor_tco_rgn_1 "MF_AMF_MINOR_RGN : TCO interpolation of minor injection fuel mass MAIN2 during regeneration" CURVE 0x84be5e _REC_CUR_20_u2_u1 1.9999696 _CNV_A_R_LINEAR_____53_CM 0. 1.9999696 DISPLAY_IDENTIFIER IP_FAC_MF_MAIN2_COR_TCO_RGN_1 FORMAT "%6.5"
 /begin AXIS_DESCR COM_AXIS tco _CNV_A_R_LINEAR_____18_CM 1 -50. 205. FORMAT "%3.0" AXIS_PTS_REF ldp_tco_ip_fac_mf_main2_cor_rgn_1 /end AXIS_DESCR
/end CHARACTERISTIC
/begin CHARACTERISTIC ip_fac_mf_main2_cor_tgas_rgn_1 "MF_AMF_MINOR_RGN : TGAS correction of mf MAIN2 during regeneration" CURVE 0x84be62 _REC_CUR_20_u2_u1 0.9999847412109381 _CNV_A_R_LINEAR_____14_CM 0. 0.9999847412109381 DISPLAY_IDENTIFIER IP_FAC_MF_MAIN2_COR_TGAS_RGN_1 FORMAT "%6.5"
 /begin AXIS_DESCR COM_AXIS tgas _CNV_A_R_LINEAR_____18_CM 1 -50. 205. FORMAT "%3.0" AXIS_PTS_REF ldp_tgas_ip_fac_mf_main2_rgn_1 /end AXIS_DESCR
/end CHARACTERISTIC
/begin CHARACTERISTIC ip_fac_mf_main2_cor_amp_rgn_1 "MF_AMF_MINOR_RGN : amp correction factor for minor injection mf MAIN2 during regeneration" CURVE 0x84be5a _REC_CUR_20_u2_u2 0.9999847412109381 _CNV_A_R_LINEAR_____14_CM 0. 0.9999847412109381 DISPLAY_IDENTIFIER IP_FAC_MF_MAIN2_COR_AMP_RGN_1 FORMAT "%6.5"
 /begin AXIS_DESCR COM_AXIS amp _CNV_A_R_LINEAR_____21_CM 1 0. 5434. FORMAT "%6.2" AXIS_PTS_REF ldp_amp_ip_fac_mf_main2_rgn_1 /end AXIS_DESCR
/end CHARACTERISTIC
/begin CHARACTERISTIC ip_mf_main2_rgn_1_0_0 "MF_AMF_MINOR_RGN : basic mf of minor injection MAIN2 at regeneration level 1 and at temperature level 0" MAP 0x853288 _REC_MAP_20_u2_u2_u2 262.14 _CNV_A_R_LINEAR_____43_CM 0. 262.14 DISPLAY_IDENTIFIER IP_MF_MAIN2_RGN_1_0_0
 /begin AXIS_DESCR COM_AXIS n _CNV_A_R_LINEAR_____5_CM 1 0. 6375. FORMAT "%4.0" AXIS_PTS_REF ldpm_n_1_ip_mf_main2_rgn_1 /end AXIS_DESCR
 /begin AXIS_DESCR COM_AXIS tqi_sp _CNV_A_R_LINEAR_____89_CM 1 -1024. 1023.96875 FORMAT "%6.2" AXIS_PTS_REF ldpm_tqi_ip_mf_main2_rgn_1 /end AXIS_DESCR
/end CHARACTERISTIC
/begin CHARACTERISTIC ip_mf_main2_rgn_1_0_1 "MF_AMF_MINOR_RGN : basic mf of minor injection MAIN2 at temperature level 1 during regeneration" MAP 0x85328a _REC_MAP_20_u2_u2_u2 262.14 _CNV_A_R_LINEAR_____43_CM 0. 262.14 DISPLAY_IDENTIFIER IP_MF_MAIN2_RGN_1_0_1
 /begin AXIS_DESCR COM_AXIS n _CNV_A_R_LINEAR_____5_CM 1 0. 6375. FORMAT "%4.0" AXIS_PTS_REF ldp_n_ip_mf_main2_rgn_1_0_1 /end AXIS_DESCR
 /begin AXIS_DESCR COM_AXIS tqi_sp _CNV_A_R_LINEAR_____89_CM 1 -1024. 1023.96875 FORMAT "%6.2" AXIS_PTS_REF ldp_tqi_sp_ip_mf_main2_rgn_1_0_1 /end AXIS_DESCR
/end CHARACTERISTIC
/begin CHARACTERISTIC ip_mf_main2_rgn_1_0_2 "MF_AMF_MINOR_RGN : basic mf of minor injection MAIN2 at temperature level 2 during regeneration" MAP 0x85328c _REC_MAP_20_u2_u2_u2 262.14 _CNV_A_R_LINEAR_____43_CM 0. 262.14 DISPLAY_IDENTIFIER IP_MF_MAIN2_RGN_1_0_2
 /begin AXIS_DESCR COM_AXIS n _CNV_A_R_LINEAR_____5_CM 1 0. 6375. FORMAT "%4.0" AXIS_PTS_REF ldp_n_ip_mf_main2_rgn_1_0_2 /end AXIS_DESCR
 /begin AXIS_DESCR COM_AXIS tqi_sp _CNV_A_R_LINEAR_____89_CM 1 -1024. 1023.96875 FORMAT "%6.2" AXIS_PTS_REF ldp_tqi_sp_ip_mf_main2_rgn_1_0_2 /end AXIS_DESCR
/end CHARACTERISTIC
/begin CHARACTERISTIC ip_mf_main2_amp_rgn_1 "MF_AMF_MINOR_RGN : amp correction of minor injection mf MAIN2 during regeneration" MAP 0x853286 _REC_MAP_20_u2_u2_u2 262.14 _CNV_A_R_LINEAR_____133_CM -131.072 131.068 DISPLAY_IDENTIFIER IP_MF_MAIN2_AMP_RGN_1
 /begin AXIS_DESCR COM_AXIS n _CNV_A_R_LINEAR_____5_CM 1 0. 6375. FORMAT "%4.0" AXIS_PTS_REF ldp_n_ip_mf_main2_amp_rgn_1 /end AXIS_DESCR
 /begin AXIS_DESCR COM_AXIS tqi_sp _CNV_A_R_LINEAR_____89_CM 1 -1024. 1023.96875 FORMAT "%6.2" AXIS_PTS_REF ldp_tqi_ip_mf_main2_amp_rgn_1 /end AXIS_DESCR
/end CHARACTERISTIC
/begin AXIS_PTS ldp_n_ip_mf_main2_tgas_rgn_1 "air charge temperature correction of minor injection MAIN2 during regeneration" 0x841db6 n _REC_AXS_20_u2 6375. _CNV_A_R_LINEAR_____5_CM 1 0. 6375. FORMAT "%4.0" /end AXIS_PTS
/begin AXIS_PTS ldp_tco_ip_fac_mf_prev1_cor_rgn_1 "TCO interpolation of minor injection fuel mass PREV1 during regeneration" 0x842710 tco _REC_AXS_20_u1 255. _CNV_A_R_LINEAR_____18_CM 8 -50. 205. FORMAT "%3.0" /end AXIS_PTS
/begin AXIS_PTS ldp_tco_ip_fac_mf_prev2_cor_rgn_1 "TCO interpolation of minor injection fuel mass PREV2 during regeneration" 0x84271b tco _REC_AXS_20_u1 255. _CNV_A_R_LINEAR_____18_CM 1 -50. 205. FORMAT "%3.0" /end AXIS_PTS
/begin AXIS_PTS ldp_tco_ip_fac_mf_post1_cor_rgn_1 "TCO interpolation of minor injection fuel mass POST1 during regeneration" 0x8426fe tco _REC_AXS_20_u1 255. _CNV_A_R_LINEAR_____18_CM 8 -50. 205. FORMAT "%3.0" /end AXIS_PTS
/begin AXIS_PTS ldp_tgas_ip_fac_mf_prev1_rgn_1 "TGAS correction of mf PREV1 during regeneration" 0x842996 tgas _REC_AXS_20_u1 255. _CNV_A_R_LINEAR_____18_CM 8 -50. 205. FORMAT "%3.0" /end AXIS_PTS
/begin AXIS_PTS ldp_tgas_ip_fac_mf_prev2_rgn_1 "TGAS correction of mf PREV2 during regeneration" 0x8429a1 tgas _REC_AXS_20_u1 255. _CNV_A_R_LINEAR_____18_CM 1 -50. 205. FORMAT "%3.0" /end AXIS_PTS
/begin AXIS_PTS ldp_tgas_ip_fac_mf_post1_rgn_1 "TGAS correction of mf POST1 during regeneration" 0x842984 tgas _REC_AXS_20_u1 255. _CNV_A_R_LINEAR_____18_CM 8 -50. 205. FORMAT "%3.0" /end AXIS_PTS
/begin AXIS_PTS ldp_amp_ip_fac_mf_prev1_rgn_1 "amp correction factor for minor injection mf PREV1 during regeneration" 0x8411f4 amp _REC_AXS_20_u2 5434. _CNV_A_R_LINEAR_____21_CM 8 0. 5434. FORMAT "%6.2" /end AXIS_PTS
/begin AXIS_PTS ldp_amp_ip_fac_mf_prev2_rgn_1 "amp correction factor for minor injection mf PREV2 during regeneration" 0x84120a amp _REC_AXS_20_u2 5434. _CNV_A_R_LINEAR_____21_CM 1 0. 5434. FORMAT "%6.2" /end AXIS_PTS
/begin AXIS_PTS ldp_amp_ip_fac_mf_post1_rgn_1 "amp correction factor for minor injection mf POST1 during regeneration" 0x8411d0 amp _REC_AXS_20_u2 5434. _CNV_A_R_LINEAR_____21_CM 8 0. 5434. FORMAT "%6.2" /end AXIS_PTS
/begin AXIS_PTS ldpm_n_1_ip_mf_main2_rgn_2 "basic mf of minor injection MAIN2 at regeneration level 2 and at temperature level 0" 0x843658 n _REC_AXS_20_u2 6375. _CNV_A_R_LINEAR_____5_CM 1 0. 6375. FORMAT "%4.0" /end AXIS_PTS
/begin AXIS_PTS ldpm_tqi_ip_mf_main2_rgn_2 "basic mf of minor injection MAIN2 at regeneration level 2 and at temperature level 0" 0x8440f8 tqi_sp _REC_AXS_20_u2 2047.96875 _CNV_A_R_LINEAR_____89_CM 1 -1024. 1023.96875 FORMAT "%6.2" /end AXIS_PTS
/begin AXIS_PTS ldpm_n_1_ip_mf_prev1_rgn_1 "basic mf of minor injection PREV1 at regeneration level 1 and at temperature level 0" 0x8436e4 n _REC_AXS_20_u2 6375. _CNV_A_R_LINEAR_____5_CM 16 0. 6375. FORMAT "%4.0" /end AXIS_PTS
/begin AXIS_PTS ldpm_tqi_ip_mf_prev1_rgn_1 "basic mf of minor injection PREV1 at regeneration level 1 and at temperature level 0" 0x844140 tqi_sp _REC_AXS_20_u2 2047.96875 _CNV_A_R_LINEAR_____89_CM 16 -1024. 1023.96875 FORMAT "%6.2" /end AXIS_PTS
/begin AXIS_PTS ldpm_n_1_ip_mf_prev1_rgn_2 "basic mf of minor injection PREV1 at regeneration level 2 and at temperature level 0" 0x843706 n _REC_AXS_20_u2 6375. _CNV_A_R_LINEAR_____5_CM 16 0. 6375. FORMAT "%4.0" /end AXIS_PTS
/begin AXIS_PTS ldpm_tqi_ip_mf_prev1_rgn_2 "basic mf of minor injection PREV1 at regeneration level 2 and at temperature level 0" 0x844162 tqi_sp _REC_AXS_20_u2 2047.96875 _CNV_A_R_LINEAR_____89_CM 16 -1024. 1023.96875 FORMAT "%6.2" /end AXIS_PTS
/begin AXIS_PTS ldpm_n_1_ip_mf_prev2_rgn_1 "basic mf of minor injection PREV2 at regeneration level 1 and at temperature level 0" 0x84372c n _REC_AXS_20_u2 6375. _CNV_A_R_LINEAR_____5_CM 1 0. 6375. FORMAT "%4.0" /end AXIS_PTS
/begin AXIS_PTS ldpm_tqi_ip_mf_prev2_rgn_1 "basic mf of minor injection PREV2 at regeneration level 1 and at temperature level 0" 0x844184 tqi_sp _REC_AXS_20_u2 2047.96875 _CNV_A_R_LINEAR_____89_CM 1 -1024. 1023.96875 FORMAT "%6.2" /end AXIS_PTS
/begin AXIS_PTS ldpm_n_1_ip_mf_prev2_rgn_2 "basic mf of minor injection PREV2 at regeneration level 2 and at temperature level 0" 0x843730 n _REC_AXS_20_u2 6375. _CNV_A_R_LINEAR_____5_CM 1 0. 6375. FORMAT "%4.0" /end AXIS_PTS
/begin AXIS_PTS ldpm_tqi_ip_mf_prev2_rgn_2 "basic mf of minor injection PREV2 at regeneration level 2 and at temperature level 0" 0x844188 tqi_sp _REC_AXS_20_u2 2047.96875 _CNV_A_R_LINEAR_____89_CM 1 -1024. 1023.96875 FORMAT "%6.2" /end AXIS_PTS
/begin AXIS_PTS ldpm_n_1_ip_mf_post1_rgn_1 "basic mf of minor injection POST1 at regeneration level 1 and at temperature level 0" 0x84367e n _REC_AXS_20_u2 6375. _CNV_A_R_LINEAR_____5_CM 16 0. 6375. FORMAT "%4.0" /end AXIS_PTS
/begin AXIS_PTS ldpm_tqi_ip_mf_post1_rgn_1 "basic mf of minor injection POST1 at regeneration level 1 and at temperature level 0" 0x8440fc tqi_sp _REC_AXS_20_u2 2047.96875 _CNV_A_R_LINEAR_____89_CM 16 -1024. 1023.96875 FORMAT "%6.2" /end AXIS_PTS
/begin AXIS_PTS ldpm_n_1_ip_mf_post1_rgn_2 "basic mf of minor injection POST1 at regeneration level 2 and at temperature level 0" 0x8436a0 n _REC_AXS_20_u2 6375. _CNV_A_R_LINEAR_____5_CM 16 0. 6375. FORMAT "%4.0" /end AXIS_PTS
/begin AXIS_PTS ldpm_tqi_ip_mf_post1_rgn_2 "basic mf of minor injection POST1 at regeneration level 2 and at temperature level 0" 0x84411e tqi_sp _REC_AXS_20_u2 2047.96875 _CNV_A_R_LINEAR_____89_CM 16 -1024. 1023.96875 FORMAT "%6.2" /end AXIS_PTS
/begin AXIS_PTS ldp_n_ip_mf_prev1_rgn_1_0_1 "basic mf of minor injection PREV1 at temperature level 1 during regeneration" 0x841e6a n _REC_AXS_20_u2 6375. _CNV_A_R_LINEAR_____5_CM 16 0. 6375. FORMAT "%4.0" /end AXIS_PTS
/begin AXIS_PTS ldp_tqi_sp_ip_mf_prev1_rgn_1_0_1 "basic mf of minor injection PREV1 at temperature level 1 during regeneration" 0x842fe0 tqi_sp _REC_AXS_20_u2 2047.96875 _CNV_A_R_LINEAR_____89_CM 16 -1024. 1023.96875 FORMAT "%6.2" /end AXIS_PTS
/begin AXIS_PTS ldp_n_ip_mf_prev2_rgn_1_0_1 "basic mf of minor injection PREV2 at temperature level 1 during regeneration" 0x841eda n _REC_AXS_20_u2 6375. _CNV_A_R_LINEAR_____5_CM 1 0. 6375. FORMAT "%4.0" /end AXIS_PTS
/begin AXIS_PTS ldp_tqi_sp_ip_mf_prev2_rgn_1_0_1 "basic mf of minor injection PREV2 at temperature level 1 during regeneration" 0x84303a tqi_sp _REC_AXS_20_u2 2047.96875 _CNV_A_R_LINEAR_____89_CM 1 -1024. 1023.96875 FORMAT "%6.2" /end AXIS_PTS
/begin AXIS_PTS ldp_n_ip_mf_post1_rgn_1_0_1 "basic mf of minor injection POST1 at temperature level 1 during regeneration" 0x841dde n _REC_AXS_20_u2 6375. _CNV_A_R_LINEAR_____5_CM 16 0. 6375. FORMAT "%4.0" /end AXIS_PTS
/begin AXIS_PTS ldp_tqi_sp_ip_mf_post1_rgn_1_0_1 "basic mf of minor injection POST1 at temperature level 1 during regeneration" 0x842f78 tqi_sp _REC_AXS_20_u2 2047.96875 _CNV_A_R_LINEAR_____89_CM 16 -1024. 1023.96875 FORMAT "%6.2" /end AXIS_PTS
/begin AXIS_PTS ldp_n_ip_mf_prev1_rgn_1_0_2 "basic mf of minor injection PREV1 at temperature level 2 during regeneration" 0x841e8c n _REC_AXS_20_u2 6375. _CNV_A_R_LINEAR_____5_CM 16 0. 6375. FORMAT "%4.0" /end AXIS_PTS
/begin AXIS_PTS ldp_tqi_sp_ip_mf_prev1_rgn_1_0_2 "basic mf of minor injection PREV1 at temperature level 2 during regeneration" 0x843002 tqi_sp _REC_AXS_20_u2 2047.96875 _CNV_A_R_LINEAR_____89_CM 16 -1024. 1023.96875 FORMAT "%6.2" /end AXIS_PTS
/begin AXIS_PTS ldp_n_ip_mf_prev2_rgn_1_0_2 "basic mf of minor injection PREV2 at temperature level 2 during regeneration" 0x841ede n _REC_AXS_20_u2 6375. _CNV_A_R_LINEAR_____5_CM 1 0. 6375. FORMAT "%4.0" /end AXIS_PTS
/begin AXIS_PTS ldp_tqi_sp_ip_mf_prev2_rgn_1_0_2 "basic mf of minor injection PREV2 at temperature level 2 during regeneration" 0x84303e tqi_sp _REC_AXS_20_u2 2047.96875 _CNV_A_R_LINEAR_____89_CM 1 -1024. 1023.96875 FORMAT "%6.2" /end AXIS_PTS
/begin AXIS_PTS ldp_n_ip_mf_post1_rgn_1_0_2 "basic mf of minor injection POST1 at temperature level 2 during regeneration" 0x841e00 n _REC_AXS_20_u2 6375. _CNV_A_R_LINEAR_____5_CM 16 0. 6375. FORMAT "%4.0" /end AXIS_PTS
/begin AXIS_PTS ldp_tqi_sp_ip_mf_post1_rgn_1_0_2 "basic mf of minor injection POST1 at temperature level 2 during regeneration" 0x842f9a tqi_sp _REC_AXS_20_u2 2047.96875 _CNV_A_R_LINEAR_____89_CM 16 -1024. 1023.96875 FORMAT "%6.2" /end AXIS_PTS
/begin AXIS_PTS ldp_n_ip_mf_prev1_tgas_rgn_1 "air charge temperature correction of minor injection PREV1 during regeneration" 0x841ec0 n _REC_AXS_20_u2 6375. _CNV_A_R_LINEAR_____5_CM 8 0. 6375. FORMAT "%4.0" /end AXIS_PTS
/begin AXIS_PTS ldp_tqi_ip_mf_prev1_tgas_rgn_1 "air charge temperature correction of minor injection PREV1 during regeneration" 0x842c62 tqi_sp _REC_AXS_20_u2 2047.96875 _CNV_A_R_LINEAR_____89_CM 8 -1024. 1023.96875 FORMAT "%6.2" /end AXIS_PTS
/begin AXIS_PTS ldp_n_ip_mf_prev2_tgas_rgn_1 "air charge temperature correction of minor injection PREV2 during regeneration" 0x841ee6 n _REC_AXS_20_u2 6375. _CNV_A_R_LINEAR_____5_CM 1 0. 6375. FORMAT "%4.0" /end AXIS_PTS
/begin AXIS_PTS ldp_tqi_ip_mf_prev2_tgas_rgn_1 "air charge temperature correction of minor injection PREV2 during regeneration" 0x842c78 tqi_sp _REC_AXS_20_u2 2047.96875 _CNV_A_R_LINEAR_____89_CM 1 -1024. 1023.96875 FORMAT "%6.2" /end AXIS_PTS
/begin AXIS_PTS ldp_n_ip_mf_post1_tgas_rgn_1 "air charge temperature correction of minor injection POST1 during regeneration" 0x841e34 n _REC_AXS_20_u2 6375. _CNV_A_R_LINEAR_____5_CM 8 0. 6375. FORMAT "%4.0" /end AXIS_PTS
/begin AXIS_PTS ldp_tqi_ip_mf_post1_tgas_rgn_1 "air charge temperature correction of minor injection POST1 during regeneration" 0x842c3e tqi_sp _REC_AXS_20_u2 2047.96875 _CNV_A_R_LINEAR_____89_CM 8 -1024. 1023.96875 FORMAT "%6.2" /end AXIS_PTS
/begin AXIS_PTS ldp_n_ip_mf_prev1_amp_rgn_1 "amp correction of minor injection mf PREV1 during regeneration" 0x841e58 n _REC_AXS_20_u2 6375. _CNV_A_R_LINEAR_____5_CM 8 0. 6375. FORMAT "%4.0" /end AXIS_PTS
/begin AXIS_PTS ldp_tqi_ip_mf_prev1_amp_rgn_1 "amp correction of minor injection mf PREV1 during regeneration" 0x842c50 tqi_sp _REC_AXS_20_u2 2047.96875 _CNV_A_R_LINEAR_____89_CM 8 -1024. 1023.96875 FORMAT "%6.2" /end AXIS_PTS
/begin AXIS_PTS ldp_n_ip_mf_prev2_amp_rgn_1 "amp correction of minor injection mf PREV2 during regeneration" 0x841ed6 n _REC_AXS_20_u2 6375. _CNV_A_R_LINEAR_____5_CM 1 0. 6375. FORMAT "%4.0" /end AXIS_PTS
/begin AXIS_PTS ldp_tqi_ip_mf_prev2_amp_rgn_1 "amp correction of minor injection mf PREV2 during regeneration" 0x842c74 tqi_sp _REC_AXS_20_u2 2047.96875 _CNV_A_R_LINEAR_____89_CM 1 -1024. 1023.96875 FORMAT "%6.2" /end AXIS_PTS
/begin AXIS_PTS ldp_n_ip_mf_post1_amp_rgn_1 "amp correction of minor injection mf POST1 during regeneration" 0x841dcc n _REC_AXS_20_u2 6375. _CNV_A_R_LINEAR_____5_CM 8 0. 6375. FORMAT "%4.0" /end AXIS_PTS
/begin AXIS_PTS ldp_tqi_ip_mf_post1_amp_rgn_1 "amp correction of minor injection mf POST1 during regeneration" 0x842c2c tqi_sp _REC_AXS_20_u2 2047.96875 _CNV_A_R_LINEAR_____89_CM 8 -1024. 1023.96875 FORMAT "%6.2" /end AXIS_PTS
/begin CHARACTERISTIC ip_fac_mf_post1_cor_tco_rgn_1 "MF_AMF_MINOR_RGN : TCO interpolation of minor injection fuel mass POST1 during regeneration" CURVE 0x84be98 _REC_CUR_20_u2_u1 1.9999696 _CNV_A_R_LINEAR_____53_CM 0. 1.9999696 DISPLAY_IDENTIFIER IP_FAC_MF_POST1_COR_TCO_RGN_1 FORMAT "%6.5"
 /begin AXIS_DESCR COM_AXIS tco _CNV_A_R_LINEAR_____18_CM 8 -50. 205. FORMAT "%3.0" AXIS_PTS_REF ldp_tco_ip_fac_mf_post1_cor_rgn_1 /end AXIS_DESCR
/end CHARACTERISTIC
/begin CHARACTERISTIC ip_fac_mf_prev1_cor_tco_rgn_1 "MF_AMF_MINOR_RGN : TCO interpolation of minor injection fuel mass PREV1 during regeneration" CURVE 0x84bf08 _REC_CUR_20_u2_u1 1.9999696 _CNV_A_R_LINEAR_____53_CM 0. 1.9999696 DISPLAY_IDENTIFIER IP_FAC_MF_PREV1_COR_TCO_RGN_1 FORMAT "%6.5"
 /begin AXIS_DESCR COM_AXIS tco _CNV_A_R_LINEAR_____18_CM 8 -50. 205. FORMAT "%3.0" AXIS_PTS_REF ldp_tco_ip_fac_mf_prev1_cor_rgn_1 /end AXIS_DESCR
/end CHARACTERISTIC
/begin CHARACTERISTIC ip_fac_mf_post1_cor_tgas_rgn_1 "MF_AMF_MINOR_RGN : TGAS correction of mf POST1 during regeneration" CURVE 0x84beb8 _REC_CUR_20_u2_u1 0.9999847412109381 _CNV_A_R_LINEAR_____14_CM 0. 0.9999847412109381 DISPLAY_IDENTIFIER IP_FAC_MF_POST1_COR_TGAS_RGN_1 FORMAT "%6.5"
 /begin AXIS_DESCR COM_AXIS tgas _CNV_A_R_LINEAR_____18_CM 8 -50. 205. FORMAT "%3.0" AXIS_PTS_REF ldp_tgas_ip_fac_mf_post1_rgn_1 /end AXIS_DESCR
/end CHARACTERISTIC
/begin CHARACTERISTIC ip_fac_mf_prev1_cor_tgas_rgn_1 "MF_AMF_MINOR_RGN : TGAS correction of mf PREV1 during regeneration" CURVE 0x84bf28 _REC_CUR_20_u2_u1 0.9999847412109381 _CNV_A_R_LINEAR_____14_CM 0. 0.9999847412109381 DISPLAY_IDENTIFIER IP_FAC_MF_PREV1_COR_TGAS_RGN_1 FORMAT "%6.5"
 /begin AXIS_DESCR COM_AXIS tgas _CNV_A_R_LINEAR_____18_CM 8 -50. 205. FORMAT "%3.0" AXIS_PTS_REF ldp_tgas_ip_fac_mf_prev1_rgn_1 /end AXIS_DESCR
/end CHARACTERISTIC
/begin CHARACTERISTIC ip_fac_mf_prev2_cor_tgas_rgn_1 "MF_AMF_MINOR_RGN : TGAS correction of mf PREV2 during regeneration" CURVE 0x84bf52 _REC_CUR_20_u2_u1 0.9999847412109381 _CNV_A_R_LINEAR_____14_CM 0. 0.9999847412109381 DISPLAY_IDENTIFIER IP_FAC_MF_PREV2_COR_TGAS_RGN_1 FORMAT "%6.5"
 /begin AXIS_DESCR COM_AXIS tgas _CNV_A_R_LINEAR_____18_CM 1 -50. 205. FORMAT "%3.0" AXIS_PTS_REF ldp_tgas_ip_fac_mf_prev2_rgn_1 /end AXIS_DESCR
/end CHARACTERISTIC
/begin CHARACTERISTIC ip_fac_mf_post1_cor_amp_rgn_1 "MF_AMF_MINOR_RGN : amp correction factor for minor injection mf POST1 during regeneration" CURVE 0x84be78 _REC_CUR_20_u2_u2 0.9999847412109381 _CNV_A_R_LINEAR_____14_CM 0. 0.9999847412109381 DISPLAY_IDENTIFIER IP_FAC_MF_POST1_COR_AMP_RGN_1 FORMAT "%6.5"
 /begin AXIS_DESCR COM_AXIS amp _CNV_A_R_LINEAR_____21_CM 8 0. 5434. FORMAT "%6.2" AXIS_PTS_REF ldp_amp_ip_fac_mf_post1_rgn_1 /end AXIS_DESCR
/end CHARACTERISTIC
/begin CHARACTERISTIC ip_fac_mf_prev1_cor_amp_rgn_1 "MF_AMF_MINOR_RGN : amp correction factor for minor injection mf PREV1 during regeneration" CURVE 0x84bee8 _REC_CUR_20_u2_u2 0.9999847412109381 _CNV_A_R_LINEAR_____14_CM 0. 0.9999847412109381 DISPLAY_IDENTIFIER IP_FAC_MF_PREV1_COR_AMP_RGN_1 FORMAT "%6.5"
 /begin AXIS_DESCR COM_AXIS amp _CNV_A_R_LINEAR_____21_CM 8 0. 5434. FORMAT "%6.2" AXIS_PTS_REF ldp_amp_ip_fac_mf_prev1_rgn_1 /end AXIS_DESCR
/end CHARACTERISTIC
/begin CHARACTERISTIC ip_fac_mf_prev2_cor_amp_rgn_1 "MF_AMF_MINOR_RGN : amp correction factor for minor injection mf PREV2 during regeneration" CURVE 0x84bf4a _REC_CUR_20_u2_u2 0.9999847412109381 _CNV_A_R_LINEAR_____14_CM 0. 0.9999847412109381 DISPLAY_IDENTIFIER IP_FAC_MF_PREV2_COR_AMP_RGN_1 FORMAT "%6.5"
 /begin AXIS_DESCR COM_AXIS amp _CNV_A_R_LINEAR_____21_CM 1 0. 5434. FORMAT "%6.2" AXIS_PTS_REF ldp_amp_ip_fac_mf_prev2_rgn_1 /end AXIS_DESCR
/end CHARACTERISTIC
/begin CHARACTERISTIC ip_mf_post1_rgn_1_0_0 "MF_AMF_MINOR_RGN : basic mf of minor injection POST1 at regeneration level 1 and at temperature level 0" MAP 0x85399a _REC_MAP_20_u2_u2_u2 262.14 _CNV_A_R_LINEAR_____43_CM 0. 262.14 DISPLAY_IDENTIFIER IP_MF_POST1_RGN_1_0_0
 /begin AXIS_DESCR COM_AXIS n _CNV_A_R_LINEAR_____5_CM 16 0. 6375. FORMAT "%4.0" AXIS_PTS_REF ldpm_n_1_ip_mf_post1_rgn_1 /end AXIS_DESCR
 /begin AXIS_DESCR COM_AXIS tqi_sp _CNV_A_R_LINEAR_____89_CM 16 -1024. 1023.96875 FORMAT "%6.2" AXIS_PTS_REF ldpm_tqi_ip_mf_post1_rgn_1 /end AXIS_DESCR
/end CHARACTERISTIC
/begin CHARACTERISTIC ip_mf_prev1_rgn_1_0_0 "MF_AMF_MINOR_RGN : basic mf of minor injection PREV1 at regeneration level 1 and at temperature level 0" MAP 0x854aa2 _REC_MAP_20_u2_u2_u2 262.14 _CNV_A_R_LINEAR_____43_CM 0. 262.14 DISPLAY_IDENTIFIER IP_MF_PREV1_RGN_1_0_0
 /begin AXIS_DESCR COM_AXIS n _CNV_A_R_LINEAR_____5_CM 16 0. 6375. FORMAT "%4.0" AXIS_PTS_REF ldpm_n_1_ip_mf_prev1_rgn_1 /end AXIS_DESCR
 /begin AXIS_DESCR COM_AXIS tqi_sp _CNV_A_R_LINEAR_____89_CM 16 -1024. 1023.96875 FORMAT "%6.2" AXIS_PTS_REF ldpm_tqi_ip_mf_prev1_rgn_1 /end AXIS_DESCR
/end CHARACTERISTIC
/begin CHARACTERISTIC ip_mf_prev2_rgn_1_0_0 "MF_AMF_MINOR_RGN : basic mf of minor injection PREV2 at regeneration level 1 and at temperature level 0" MAP 0x8554b4 _REC_MAP_20_u2_u2_u2 262.14 _CNV_A_R_LINEAR_____43_CM 0. 262.14 DISPLAY_IDENTIFIER IP_MF_PREV2_RGN_1_0_0
 /begin AXIS_DESCR COM_AXIS n _CNV_A_R_LINEAR_____5_CM 1 0. 6375. FORMAT "%4.0" AXIS_PTS_REF ldpm_n_1_ip_mf_prev2_rgn_1 /end AXIS_DESCR
 /begin AXIS_DESCR COM_AXIS tqi_sp _CNV_A_R_LINEAR_____89_CM 1 -1024. 1023.96875 FORMAT "%6.2" AXIS_PTS_REF ldpm_tqi_ip_mf_prev2_rgn_1 /end AXIS_DESCR
/end CHARACTERISTIC
/begin CHARACTERISTIC ip_mf_main2_rgn_2_0_0 "MF_AMF_MINOR_RGN : basic mf of minor injection MAIN2 at regeneration level 2 and at temperature level 0" MAP 0x85328e _REC_MAP_20_u2_u2_u2 262.14 _CNV_A_R_LINEAR_____43_CM 0. 262.14 DISPLAY_IDENTIFIER IP_MF_MAIN2_RGN_2_0_0
 /begin AXIS_DESCR COM_AXIS n _CNV_A_R_LINEAR_____5_CM 1 0. 6375. FORMAT "%4.0" AXIS_PTS_REF ldpm_n_1_ip_mf_main2_rgn_2 /end AXIS_DESCR
 /begin AXIS_DESCR COM_AXIS tqi_sp _CNV_A_R_LINEAR_____89_CM 1 -1024. 1023.96875 FORMAT "%6.2" AXIS_PTS_REF ldpm_tqi_ip_mf_main2_rgn_2 /end AXIS_DESCR
/end CHARACTERISTIC
/begin CHARACTERISTIC ip_mf_post1_rgn_2_0_0 "MF_AMF_MINOR_RGN : basic mf of minor injection POST1 at regeneration level 2 and at temperature level 0" MAP 0x853f9a _REC_MAP_20_u2_u2_u2 262.14 _CNV_A_R_LINEAR_____43_CM 0. 262.14 DISPLAY_IDENTIFIER IP_MF_POST1_RGN_2_0_0
 /begin AXIS_DESCR COM_AXIS n _CNV_A_R_LINEAR_____5_CM 16 0. 6375. FORMAT "%4.0" AXIS_PTS_REF ldpm_n_1_ip_mf_post1_rgn_2 /end AXIS_DESCR
 /begin AXIS_DESCR COM_AXIS tqi_sp _CNV_A_R_LINEAR_____89_CM 16 -1024. 1023.96875 FORMAT "%6.2" AXIS_PTS_REF ldpm_tqi_ip_mf_post1_rgn_2 /end AXIS_DESCR
/end CHARACTERISTIC
/begin CHARACTERISTIC ip_mf_prev1_rgn_2_0_0 "MF_AMF_MINOR_RGN : basic mf of minor injection PREV1 at regeneration level 2 and at temperature level 0" MAP 0x8550a2 _REC_MAP_20_u2_u2_u2 262.14 _CNV_A_R_LINEAR_____43_CM 0. 262.14 DISPLAY_IDENTIFIER IP_MF_PREV1_RGN_2_0_0
 /begin AXIS_DESCR COM_AXIS n _CNV_A_R_LINEAR_____5_CM 16 0. 6375. FORMAT "%4.0" AXIS_PTS_REF ldpm_n_1_ip_mf_prev1_rgn_2 /end AXIS_DESCR
 /begin AXIS_DESCR COM_AXIS tqi_sp _CNV_A_R_LINEAR_____89_CM 16 -1024. 1023.96875 FORMAT "%6.2" AXIS_PTS_REF ldpm_tqi_ip_mf_prev1_rgn_2 /end AXIS_DESCR
/end CHARACTERISTIC
/begin CHARACTERISTIC ip_mf_prev2_rgn_2_0_0 "MF_AMF_MINOR_RGN : basic mf of minor injection PREV2 at regeneration level 2 and at temperature level 0" MAP 0x8554ba _REC_MAP_20_u2_u2_u2 262.14 _CNV_A_R_LINEAR_____43_CM 0. 262.14 DISPLAY_IDENTIFIER IP_MF_PREV2_RGN_2_0_0
 /begin AXIS_DESCR COM_AXIS n _CNV_A_R_LINEAR_____5_CM 1 0. 6375. FORMAT "%4.0" AXIS_PTS_REF ldpm_n_1_ip_mf_prev2_rgn_2 /end AXIS_DESCR
 /begin AXIS_DESCR COM_AXIS tqi_sp _CNV_A_R_LINEAR_____89_CM 1 -1024. 1023.96875 FORMAT "%6.2" AXIS_PTS_REF ldpm_tqi_ip_mf_prev2_rgn_2 /end AXIS_DESCR
/end CHARACTERISTIC
/begin CHARACTERISTIC ip_mf_post1_rgn_1_0_1 "MF_AMF_MINOR_RGN : basic mf of minor injection POST1 at temperature level 1 during regeneration" MAP 0x853b9a _REC_MAP_20_u2_u2_u2 262.14 _CNV_A_R_LINEAR_____43_CM 0. 262.14 DISPLAY_IDENTIFIER IP_MF_POST1_RGN_1_0_1
 /begin AXIS_DESCR COM_AXIS n _CNV_A_R_LINEAR_____5_CM 16 0. 6375. FORMAT "%4.0" AXIS_PTS_REF ldp_n_ip_mf_post1_rgn_1_0_1 /end AXIS_DESCR
 /begin AXIS_DESCR COM_AXIS tqi_sp _CNV_A_R_LINEAR_____89_CM 16 -1024. 1023.96875 FORMAT "%6.2" AXIS_PTS_REF ldp_tqi_sp_ip_mf_post1_rgn_1_0_1 /end AXIS_DESCR
/end CHARACTERISTIC
/begin CHARACTERISTIC ip_mf_prev1_rgn_1_0_1 "MF_AMF_MINOR_RGN : basic mf of minor injection PREV1 at temperature level 1 during regeneration" MAP 0x854ca2 _REC_MAP_20_u2_u2_u2 262.14 _CNV_A_R_LINEAR_____43_CM 0. 262.14 DISPLAY_IDENTIFIER IP_MF_PREV1_RGN_1_0_1
 /begin AXIS_DESCR COM_AXIS n _CNV_A_R_LINEAR_____5_CM 16 0. 6375. FORMAT "%4.0" AXIS_PTS_REF ldp_n_ip_mf_prev1_rgn_1_0_1 /end AXIS_DESCR
 /begin AXIS_DESCR COM_AXIS tqi_sp _CNV_A_R_LINEAR_____89_CM 16 -1024. 1023.96875 FORMAT "%6.2" AXIS_PTS_REF ldp_tqi_sp_ip_mf_prev1_rgn_1_0_1 /end AXIS_DESCR
/end CHARACTERISTIC
/begin CHARACTERISTIC ip_mf_prev2_rgn_1_0_1 "MF_AMF_MINOR_RGN : basic mf of minor injection PREV2 at temperature level 1 during regeneration" MAP 0x8554b6 _REC_MAP_20_u2_u2_u2 262.14 _CNV_A_R_LINEAR_____43_CM 0. 262.14 DISPLAY_IDENTIFIER IP_MF_PREV2_RGN_1_0_1
 /begin AXIS_DESCR COM_AXIS n _CNV_A_R_LINEAR_____5_CM 1 0. 6375. FORMAT "%4.0" AXIS_PTS_REF ldp_n_ip_mf_prev2_rgn_1_0_1 /end AXIS_DESCR
 /begin AXIS_DESCR COM_AXIS tqi_sp _CNV_A_R_LINEAR_____89_CM 1 -1024. 1023.96875 FORMAT "%6.2" AXIS_PTS_REF ldp_tqi_sp_ip_mf_prev2_rgn_1_0_1 /end AXIS_DESCR
/end CHARACTERISTIC
/begin CHARACTERISTIC ip_mf_post1_rgn_1_0_2 "MF_AMF_MINOR_RGN : basic mf of minor injection POST1 at temperature level 2 during regeneration" MAP 0x853d9a _REC_MAP_20_u2_u2_u2 262.14 _CNV_A_R_LINEAR_____43_CM 0. 262.14 DISPLAY_IDENTIFIER IP_MF_POST1_RGN_1_0_2
 /begin AXIS_DESCR COM_AXIS n _CNV_A_R_LINEAR_____5_CM 16 0. 6375. FORMAT "%4.0" AXIS_PTS_REF ldp_n_ip_mf_post1_rgn_1_0_2 /end AXIS_DESCR
 /begin AXIS_DESCR COM_AXIS tqi_sp _CNV_A_R_LINEAR_____89_CM 16 -1024. 1023.96875 FORMAT "%6.2" AXIS_PTS_REF ldp_tqi_sp_ip_mf_post1_rgn_1_0_2 /end AXIS_DESCR
/end CHARACTERISTIC
/begin CHARACTERISTIC ip_mf_prev1_rgn_1_0_2 "MF_AMF_MINOR_RGN : basic mf of minor injection PREV1 at temperature level 2 during regeneration" MAP 0x854ea2 _REC_MAP_20_u2_u2_u2 262.14 _CNV_A_R_LINEAR_____43_CM 0. 262.14 DISPLAY_IDENTIFIER IP_MF_PREV1_RGN_1_0_2
 /begin AXIS_DESCR COM_AXIS n _CNV_A_R_LINEAR_____5_CM 16 0. 6375. FORMAT "%4.0" AXIS_PTS_REF ldp_n_ip_mf_prev1_rgn_1_0_2 /end AXIS_DESCR
 /begin AXIS_DESCR COM_AXIS tqi_sp _CNV_A_R_LINEAR_____89_CM 16 -1024. 1023.96875 FORMAT "%6.2" AXIS_PTS_REF ldp_tqi_sp_ip_mf_prev1_rgn_1_0_2 /end AXIS_DESCR
/end CHARACTERISTIC
/begin CHARACTERISTIC ip_mf_prev2_rgn_1_0_2 "MF_AMF_MINOR_RGN : basic mf of minor injection PREV2 at temperature level 2 during regeneration" MAP 0x8554b8 _REC_MAP_20_u2_u2_u2 262.14 _CNV_A_R_LINEAR_____43_CM 0. 262.14 DISPLAY_IDENTIFIER IP_MF_PREV2_RGN_1_0_2
 /begin AXIS_DESCR COM_AXIS n _CNV_A_R_LINEAR_____5_CM 1 0. 6375. FORMAT "%4.0" AXIS_PTS_REF ldp_n_ip_mf_prev2_rgn_1_0_2 /end AXIS_DESCR
 /begin AXIS_DESCR COM_AXIS tqi_sp _CNV_A_R_LINEAR_____89_CM 1 -1024. 1023.96875 FORMAT "%6.2" AXIS_PTS_REF ldp_tqi_sp_ip_mf_prev2_rgn_1_0_2 /end AXIS_DESCR
/end CHARACTERISTIC
/begin CHARACTERISTIC ip_mf_main2_tgas_rgn_1 "MF_AMF_MINOR_RGN : air charge temperature correction of minor injection MAIN2 during regeneration" MAP 0x853298 _REC_MAP_20_u2_u2_u2 262.14 _CNV_A_R_LINEAR_____133_CM -131.072 131.068 DISPLAY_IDENTIFIER IP_MF_MAIN2_TGAS_RGN_1
 /begin AXIS_DESCR COM_AXIS n _CNV_A_R_LINEAR_____5_CM 1 0. 6375. FORMAT "%4.0" AXIS_PTS_REF ldp_n_ip_mf_main2_tgas_rgn_1 /end AXIS_DESCR
 /begin AXIS_DESCR COM_AXIS tqi_sp _CNV_A_R_LINEAR_____89_CM 1 -1024. 1023.96875 FORMAT "%6.2" AXIS_PTS_REF ldp_tqi_ip_mf_main2_tgas_rgn_1 /end AXIS_DESCR
/end CHARACTERISTIC
/begin CHARACTERISTIC ip_mf_post1_tgas_rgn_1 "MF_AMF_MINOR_RGN : air charge temperature correction of minor injection POST1 during regeneration" MAP 0x854322 _REC_MAP_20_u2_u2_u2 262.14 _CNV_A_R_LINEAR_____133_CM -131.072 131.068 DISPLAY_IDENTIFIER IP_MF_POST1_TGAS_RGN_1
 /begin AXIS_DESCR COM_AXIS n _CNV_A_R_LINEAR_____5_CM 8 0. 6375. FORMAT "%4.0" AXIS_PTS_REF ldp_n_ip_mf_post1_tgas_rgn_1 /end AXIS_DESCR
 /begin AXIS_DESCR COM_AXIS tqi_sp _CNV_A_R_LINEAR_____89_CM 8 -1024. 1023.96875 FORMAT "%6.2" AXIS_PTS_REF ldp_tqi_ip_mf_post1_tgas_rgn_1 /end AXIS_DESCR
/end CHARACTERISTIC
/begin CHARACTERISTIC ip_mf_prev1_tgas_rgn_1 "MF_AMF_MINOR_RGN : air charge temperature correction of minor injection PREV1 during regeneration" MAP 0x85542a _REC_MAP_20_u2_u2_u2 262.14 _CNV_A_R_LINEAR_____133_CM -131.072 131.068 DISPLAY_IDENTIFIER IP_MF_PREV1_TGAS_RGN_1
 /begin AXIS_DESCR COM_AXIS n _CNV_A_R_LINEAR_____5_CM 8 0. 6375. FORMAT "%4.0" AXIS_PTS_REF ldp_n_ip_mf_prev1_tgas_rgn_1 /end AXIS_DESCR
 /begin AXIS_DESCR COM_AXIS tqi_sp _CNV_A_R_LINEAR_____89_CM 8 -1024. 1023.96875 FORMAT "%6.2" AXIS_PTS_REF ldp_tqi_ip_mf_prev1_tgas_rgn_1 /end AXIS_DESCR
/end CHARACTERISTIC
/begin CHARACTERISTIC ip_mf_prev2_tgas_rgn_1 "MF_AMF_MINOR_RGN : air charge temperature correction of minor injection PREV2 during regeneration" MAP 0x8554c4 _REC_MAP_20_u2_u2_u2 262.14 _CNV_A_R_LINEAR_____133_CM -131.072 131.068 DISPLAY_IDENTIFIER IP_MF_PREV2_TGAS_RGN_1
 /begin AXIS_DESCR COM_AXIS n _CNV_A_R_LINEAR_____5_CM 1 0. 6375. FORMAT "%4.0" AXIS_PTS_REF ldp_n_ip_mf_prev2_tgas_rgn_1 /end AXIS_DESCR
 /begin AXIS_DESCR COM_AXIS tqi_sp _CNV_A_R_LINEAR_____89_CM 1 -1024. 1023.96875 FORMAT "%6.2" AXIS_PTS_REF ldp_tqi_ip_mf_prev2_tgas_rgn_1 /end AXIS_DESCR
/end CHARACTERISTIC
/begin CHARACTERISTIC ip_mf_post1_amp_rgn_1 "MF_AMF_MINOR_RGN : amp correction of minor injection mf POST1 during regeneration" MAP 0x85391a _REC_MAP_20_u2_u2_u2 262.14 _CNV_A_R_LINEAR_____133_CM -131.072 131.068 DISPLAY_IDENTIFIER IP_MF_POST1_AMP_RGN_1
 /begin AXIS_DESCR COM_AXIS n _CNV_A_R_LINEAR_____5_CM 8 0. 6375. FORMAT "%4.0" AXIS_PTS_REF ldp_n_ip_mf_post1_amp_rgn_1 /end AXIS_DESCR
 /begin AXIS_DESCR COM_AXIS tqi_sp _CNV_A_R_LINEAR_____89_CM 8 -1024. 1023.96875 FORMAT "%6.2" AXIS_PTS_REF ldp_tqi_ip_mf_post1_amp_rgn_1 /end AXIS_DESCR
/end CHARACTERISTIC
/begin CHARACTERISTIC ip_mf_prev1_amp_rgn_1 "MF_AMF_MINOR_RGN : amp correction of minor injection mf PREV1 during regeneration" MAP 0x854a22 _REC_MAP_20_u2_u2_u2 262.14 _CNV_A_R_LINEAR_____133_CM -131.072 131.068 DISPLAY_IDENTIFIER IP_MF_PREV1_AMP_RGN_1
 /begin AXIS_DESCR COM_AXIS n _CNV_A_R_LINEAR_____5_CM 8 0. 6375. FORMAT "%4.0" AXIS_PTS_REF ldp_n_ip_mf_prev1_amp_rgn_1 /end AXIS_DESCR
 /begin AXIS_DESCR COM_AXIS tqi_sp _CNV_A_R_LINEAR_____89_CM 8 -1024. 1023.96875 FORMAT "%6.2" AXIS_PTS_REF ldp_tqi_ip_mf_prev1_amp_rgn_1 /end AXIS_DESCR
/end CHARACTERISTIC
/begin CHARACTERISTIC ip_mf_prev2_amp_rgn_1 "MF_AMF_MINOR_RGN : amp correction of minor injection mf PREV2 during regeneration" MAP 0x8554b2 _REC_MAP_20_u2_u2_u2 262.14 _CNV_A_R_LINEAR_____133_CM -131.072 131.068 DISPLAY_IDENTIFIER IP_MF_PREV2_AMP_RGN_1
 /begin AXIS_DESCR COM_AXIS n _CNV_A_R_LINEAR_____5_CM 1 0. 6375. FORMAT "%4.0" AXIS_PTS_REF ldp_n_ip_mf_prev2_amp_rgn_1 /end AXIS_DESCR
 /begin AXIS_DESCR COM_AXIS tqi_sp _CNV_A_R_LINEAR_____89_CM 1 -1024. 1023.96875 FORMAT "%6.2" AXIS_PTS_REF ldp_tqi_ip_mf_prev2_amp_rgn_1 /end AXIS_DESCR
/end CHARACTERISTIC
/begin MEASUREMENT mf_prev1_is_pl_rgn_1 "fuel mass of injection PREV1 during IS/PL at rgn level 1" UWORD _CNV_A_R_LINEAR_____43_CM 1 0. 0. 262.14 DISPLAY_IDENTIFIER MF_PREV1_IS_PL_RGN_1 ECU_ADDRESS 0x7f9c6c BYTE_ORDER MSB_LAST /end MEASUREMENT
/begin MEASUREMENT mf_prev1_is_pl "fuel mass of injection PREV1 during IS/PL" UWORD _CNV_A_R_LINEAR_____43_CM 1 0. 0. 262.14 DISPLAY_IDENTIFIER MF_PREV1_IS_PL ECU_ADDRESS 0x7f9c7c BYTE_ORDER MSB_LAST /end MEASUREMENT
/begin MEASUREMENT mf_prev2_is_pl "fuel mass of injection PREV2 during IS/PL" UWORD _CNV_A_R_LINEAR_____43_CM 1 0. 0. 262.14 DISPLAY_IDENTIFIER MF_PREV2_IS_PL ECU_ADDRESS 0x7f9c7e BYTE_ORDER MSB_LAST /end MEASUREMENT
/begin MEASUREMENT mf_main2_is_pl "fuel mass of injection MAIN2 during IS/PL" UWORD _CNV_A_R_LINEAR_____43_CM 1 0. 0. 262.14 DISPLAY_IDENTIFIER MF_MAIN2_IS_PL ECU_ADDRESS 0x7f9c80 BYTE_ORDER MSB_LAST /end MEASUREMENT
/begin MEASUREMENT mf_post1_is_pl "fuel mass of injection POST1 during IS/PL" UWORD _CNV_A_R_LINEAR_____43_CM 1 0. 0. 262.14 DISPLAY_IDENTIFIER MF_POST1_IS_PL ECU_ADDRESS 0x7f9c82 BYTE_ORDER MSB_LAST /end MEASUREMENT
/begin CHARACTERISTIC c_t_rgn_trn_mf_prev1 "time constant of rgn transition of mf PREV1" VALUE 0x85c122 _REC_VAL_20_u2 4.19424 _CNV_A_R_LINEAR_____67_CM 0. 4.19424 DISPLAY_IDENTIFIER C_T_RGN_TRN_MF_PREV1 FORMAT "%6.5" /end CHARACTERISTIC
/begin CHARACTERISTIC c_t_rgn_trn_mf_prev2 "time constant of rgn transition of mf PREV2" VALUE 0x85c124 _REC_VAL_20_u2 4.19424 _CNV_A_R_LINEAR_____67_CM 0. 4.19424 DISPLAY_IDENTIFIER C_T_RGN_TRN_MF_PREV2 FORMAT "%6.5" /end CHARACTERISTIC
/begin CHARACTERISTIC c_t_rgn_trn_mf_main2 "time constant of rgn transition of mf MAIN2" VALUE 0x85c11e _REC_VAL_20_u2 4.19424 _CNV_A_R_LINEAR_____67_CM 0. 4.19424 DISPLAY_IDENTIFIER C_T_RGN_TRN_MF_MAIN2 FORMAT "%6.5" /end CHARACTERISTIC
/begin CHARACTERISTIC c_t_rgn_trn_mf_post1 "time constant of rgn transition of mf POST1" VALUE 0x85c120 _REC_VAL_20_u2 4.19424 _CNV_A_R_LINEAR_____67_CM 0. 4.19424 DISPLAY_IDENTIFIER C_T_RGN_TRN_MF_POST1 FORMAT "%6.5" /end CHARACTERISTIC
/begin MEASUREMENT mf_bas_rgl "basic fuel mass after injection configuration selection during IS/PL" UWORD _CNV_A_R_LINEAR_____396_CM 1 0. -20. 242.14 DISPLAY_IDENTIFIER MF_BAS_RGL ECU_ADDRESS 0x7f9c9a BYTE_ORDER MSB_LAST /end MEASUREMENT
/begin MEASUREMENT mf_bas_cor_sum_rgl "sum of basic fuel mass correction after injection configuration selection during IS/PL" SWORD _CNV_A_R_LINEAR_____43_CM 1 0. -131.072 131.068 DISPLAY_IDENTIFIER MF_BAS_COR_SUM_RGL ECU_ADDRESS 0x7f9c9c BYTE_ORDER MSB_LAST /end MEASUREMENT
/begin CHARACTERISTIC ip_fac_mf_bas_cor_tgas_0_0 "MF: tgas correction factor of mf_bas at inj conf 0" CURVE 0x84be22 _REC_CUR_20_u2_u1 0.9999847412109381 _CNV_A_R_LINEAR_____14_CM 0. 0.9999847412109381 DISPLAY_IDENTIFIER IP_FAC_MF_BAS_COR_TGAS_0_0 FORMAT "%6.5"
 /begin AXIS_DESCR COM_AXIS tgas _CNV_A_R_LINEAR_____18_CM 8 -50. 205. FORMAT "%3.0" AXIS_PTS_REF ldp_tgas_ip_fac_mf_bas_cor_0_0 /end AXIS_DESCR
/end CHARACTERISTIC
/begin AXIS_PTS ldp_tgas_ip_fac_mf_bas_cor_0_0 "" 0x842956 tgas _REC_AXS_20_u1 255. _CNV_A_R_LINEAR_____18_CM 8 -50. 205. FORMAT "%3.0" /end AXIS_PTS
/begin CHARACTERISTIC ip_fac_mf_bas_cor_tgas_1_0 "MF: tgas correction factor of mf_bas at inj conf 1" CURVE 0x84be32 _REC_CUR_20_u2_u1 0.9999847412109381 _CNV_A_R_LINEAR_____14_CM 0. 0.9999847412109381 DISPLAY_IDENTIFIER IP_FAC_MF_BAS_COR_TGAS_1_0 FORMAT "%6.5"
 /begin AXIS_DESCR COM_AXIS tgas _CNV_A_R_LINEAR_____18_CM 8 -50. 205. FORMAT "%3.0" AXIS_PTS_REF ldp_tgas_ip_fac_mf_bas_cor_1_0 /end AXIS_DESCR
/end CHARACTERISTIC
/begin AXIS_PTS ldp_tgas_ip_fac_mf_bas_cor_1_0 "" 0x84295f tgas _REC_AXS_20_u1 255. _CNV_A_R_LINEAR_____18_CM 8 -50. 205. FORMAT "%3.0" /end AXIS_PTS
/begin CHARACTERISTIC ip_fac_mf_bas_cor_tgas_2_0 "MF: tgas correction factor of mf_bas at inj conf 2" CURVE 0x84be42 _REC_CUR_20_u2_u1 0.9999847412109381 _CNV_A_R_LINEAR_____14_CM 0. 0.9999847412109381 DISPLAY_IDENTIFIER IP_FAC_MF_BAS_COR_TGAS_2_0 FORMAT "%6.5"
 /begin AXIS_DESCR COM_AXIS tgas _CNV_A_R_LINEAR_____18_CM 1 -50. 205. FORMAT "%3.0" AXIS_PTS_REF ldp_tgas_ip_fac_mf_bas_cor_2_0 /end AXIS_DESCR
/end CHARACTERISTIC
/begin AXIS_PTS ldp_tgas_ip_fac_mf_bas_cor_2_0 "" 0x842968 tgas _REC_AXS_20_u1 255. _CNV_A_R_LINEAR_____18_CM 1 -50. 205. FORMAT "%3.0" /end AXIS_PTS
/begin CHARACTERISTIC ip_fac_mf_bas_cor_tgas_3_0 "MF: tgas correction factor of mf_bas at inj conf 3" CURVE 0x84be44 _REC_CUR_20_u2_u1 0.9999847412109381 _CNV_A_R_LINEAR_____14_CM 0. 0.9999847412109381 DISPLAY_IDENTIFIER IP_FAC_MF_BAS_COR_TGAS_3_0 FORMAT "%6.5"
 /begin AXIS_DESCR COM_AXIS tgas _CNV_A_R_LINEAR_____18_CM 1 -50. 205. FORMAT "%3.0" AXIS_PTS_REF ldp_tgas_ip_fac_mf_bas_cor_3_0 /end AXIS_DESCR
/end CHARACTERISTIC
/begin AXIS_PTS ldp_tgas_ip_fac_mf_bas_cor_3_0 "" 0x84296a tgas _REC_AXS_20_u1 255. _CNV_A_R_LINEAR_____18_CM 1 -50. 205. FORMAT "%3.0" /end AXIS_PTS
/begin CHARACTERISTIC ip_fac_mf_bas_cor_tgas_4_0 "MF: tgas correction factor of mf_bas at inj conf 4" CURVE 0x84be46 _REC_CUR_20_u2_u1 0.9999847412109381 _CNV_A_R_LINEAR_____14_CM 0. 0.9999847412109381 DISPLAY_IDENTIFIER IP_FAC_MF_BAS_COR_TGAS_4_0 FORMAT "%6.5"
 /begin AXIS_DESCR COM_AXIS tgas _CNV_A_R_LINEAR_____18_CM 1 -50. 205. FORMAT "%3.0" AXIS_PTS_REF ldp_tgas_ip_fac_mf_bas_cor_4_0 /end AXIS_DESCR
/end CHARACTERISTIC
/begin AXIS_PTS ldp_tgas_ip_fac_mf_bas_cor_4_0 "" 0x84296c tgas _REC_AXS_20_u1 255. _CNV_A_R_LINEAR_____18_CM 1 -50. 205. FORMAT "%3.0" /end AXIS_PTS
/begin CHARACTERISTIC ip_fac_mf_bas_cor_amp_0_0 "MF: amp correction factor of mf_bas at inj conf 0" CURVE 0x84bdb6 _REC_CUR_20_u2_u2 0.9999847412109381 _CNV_A_R_LINEAR_____14_CM 0. 0.9999847412109381 DISPLAY_IDENTIFIER IP_FAC_MF_BAS_COR_AMP_0_0 FORMAT "%6.5"
 /begin AXIS_DESCR COM_AXIS amp _CNV_A_R_LINEAR_____21_CM 8 0. 5434. FORMAT "%6.2" AXIS_PTS_REF ldp_amp_ip_fac_mf_cor_0_0 /end AXIS_DESCR
/end CHARACTERISTIC
/begin AXIS_PTS ldp_amp_ip_fac_mf_cor_0_0 "" 0x841174 amp _REC_AXS_20_u2 5434. _CNV_A_R_LINEAR_____21_CM 8 0. 5434. FORMAT "%6.2" /end AXIS_PTS
/begin CHARACTERISTIC ip_fac_mf_bas_cor_amp_1_0 "MF: amp correction factor of mf_bas at inj conf 1" CURVE 0x84bdc6 _REC_CUR_20_u2_u2 0.9999847412109381 _CNV_A_R_LINEAR_____14_CM 0. 0.9999847412109381 DISPLAY_IDENTIFIER IP_FAC_MF_BAS_COR_AMP_1_0 FORMAT "%6.5"
 /begin AXIS_DESCR COM_AXIS amp _CNV_A_R_LINEAR_____21_CM 8 0. 5434. FORMAT "%6.2" AXIS_PTS_REF ldp_amp_ip_fac_mf_cor_1_0 /end AXIS_DESCR
/end CHARACTERISTIC
/begin AXIS_PTS ldp_amp_ip_fac_mf_cor_1_0 "" 0x841186 amp _REC_AXS_20_u2 5434. _CNV_A_R_LINEAR_____21_CM 8 0. 5434. FORMAT "%6.2" /end AXIS_PTS
/begin CHARACTERISTIC ip_fac_mf_bas_cor_amp_2_0 "MF: amp correction factor of mf_bas at inj conf 2" CURVE 0x84bdd6 _REC_CUR_20_u2_u2 0.9999847412109381 _CNV_A_R_LINEAR_____14_CM 0. 0.9999847412109381 DISPLAY_IDENTIFIER IP_FAC_MF_BAS_COR_AMP_2_0 FORMAT "%6.5"
 /begin AXIS_DESCR COM_AXIS amp _CNV_A_R_LINEAR_____21_CM 1 0. 5434. FORMAT "%6.2" AXIS_PTS_REF ldp_amp_ip_fac_mf_cor_2_0 /end AXIS_DESCR
/end CHARACTERISTIC
/begin AXIS_PTS ldp_amp_ip_fac_mf_cor_2_0 "" 0x841198 amp _REC_AXS_20_u2 5434. _CNV_A_R_LINEAR_____21_CM 1 0. 5434. FORMAT "%6.2" /end AXIS_PTS
/begin CHARACTERISTIC ip_fac_mf_bas_cor_amp_3_0 "MF: amp correction factor of mf_bas at inj conf 3" CURVE 0x84bdd8 _REC_CUR_20_u2_u2 0.9999847412109381 _CNV_A_R_LINEAR_____14_CM 0. 0.9999847412109381 DISPLAY_IDENTIFIER IP_FAC_MF_BAS_COR_AMP_3_0 FORMAT "%6.5"
 /begin AXIS_DESCR COM_AXIS amp _CNV_A_R_LINEAR_____21_CM 1 0. 5434. FORMAT "%6.2" AXIS_PTS_REF ldp_amp_ip_fac_mf_cor_3_0 /end AXIS_DESCR
/end CHARACTERISTIC
/begin AXIS_PTS ldp_amp_ip_fac_mf_cor_3_0 "" 0x84119c amp _REC_AXS_20_u2 5434. _CNV_A_R_LINEAR_____21_CM 1 0. 5434. FORMAT "%6.2" /end AXIS_PTS
/begin CHARACTERISTIC ip_fac_mf_bas_cor_amp_4_0 "MF: amp correction factor of mf_bas at inj conf 4" CURVE 0x84bdda _REC_CUR_20_u2_u2 0.9999847412109381 _CNV_A_R_LINEAR_____14_CM 0. 0.9999847412109381 DISPLAY_IDENTIFIER IP_FAC_MF_BAS_COR_AMP_4_0 FORMAT "%6.5"
 /begin AXIS_DESCR COM_AXIS amp _CNV_A_R_LINEAR_____21_CM 1 0. 5434. FORMAT "%6.2" AXIS_PTS_REF ldp_amp_ip_fac_mf_cor_4_0 /end AXIS_DESCR
/end CHARACTERISTIC
/begin AXIS_PTS ldp_amp_ip_fac_mf_cor_4_0 "" 0x8411a0 amp _REC_AXS_20_u2 5434. _CNV_A_R_LINEAR_____21_CM 1 0. 5434. FORMAT "%6.2" /end AXIS_PTS
/begin CHARACTERISTIC ip_fac_mf_bas_cor_tco_0_0 "MF: mf_bas interpolation dependent on TCO for inj conf 0" CURVE 0x84bdec _REC_CUR_20_u2_u1 1.9999696 _CNV_A_R_LINEAR_____53_CM 0. 1.9999696 DISPLAY_IDENTIFIER IP_FAC_MF_BAS_COR_TCO_0_0 FORMAT "%6.5"
 /begin AXIS_DESCR COM_AXIS tco _CNV_A_R_LINEAR_____18_CM 8 -50. 205. FORMAT "%3.0" AXIS_PTS_REF ldp_tco_ip_fac_mf_cor_tco_0_0 /end AXIS_DESCR
/end CHARACTERISTIC
/begin AXIS_PTS ldp_tco_ip_fac_mf_cor_tco_0_0 "" 0x8426d9 tco _REC_AXS_20_u1 255. _CNV_A_R_LINEAR_____18_CM 8 -50. 205. FORMAT "%3.0" /end AXIS_PTS
/begin CHARACTERISTIC ip_fac_mf_bas_cor_tco_1_0 "MF: mf_bas interpolation dependent on TCO for inj conf 1" CURVE 0x84bdfc _REC_CUR_20_u2_u1 1.9999696 _CNV_A_R_LINEAR_____53_CM 0. 1.9999696 DISPLAY_IDENTIFIER IP_FAC_MF_BAS_COR_TCO_1_0 FORMAT "%6.5"
 /begin AXIS_DESCR COM_AXIS tco _CNV_A_R_LINEAR_____18_CM 8 -50. 205. FORMAT "%3.0" AXIS_PTS_REF ldp_tco_ip_fac_mf_cor_tco_1_0 /end AXIS_DESCR
/end CHARACTERISTIC
/begin AXIS_PTS ldp_tco_ip_fac_mf_cor_tco_1_0 "" 0x8426e2 tco _REC_AXS_20_u1 255. _CNV_A_R_LINEAR_____18_CM 8 -50. 205. FORMAT "%3.0" /end AXIS_PTS
/begin CHARACTERISTIC ip_fac_mf_bas_cor_tco_2_0 "MF: mf_bas interpolation dependent on TCO for inj conf 2" CURVE 0x84be0c _REC_CUR_20_u2_u1 1.9999696 _CNV_A_R_LINEAR_____53_CM 0. 1.9999696 DISPLAY_IDENTIFIER IP_FAC_MF_BAS_COR_TCO_2_0 FORMAT "%6.5"
 /begin AXIS_DESCR COM_AXIS tco _CNV_A_R_LINEAR_____18_CM 1 -50. 205. FORMAT "%3.0" AXIS_PTS_REF ldp_tco_ip_fac_mf_cor_tco_2_0 /end AXIS_DESCR
/end CHARACTERISTIC
/begin AXIS_PTS ldp_tco_ip_fac_mf_cor_tco_2_0 "" 0x8426eb tco _REC_AXS_20_u1 255. _CNV_A_R_LINEAR_____18_CM 1 -50. 205. FORMAT "%3.0" /end AXIS_PTS
/begin CHARACTERISTIC ip_fac_mf_bas_cor_tco_3_0 "MF: mf_bas interpolation dependent on TCO for inj conf 3" CURVE 0x84be0e _REC_CUR_20_u2_u1 1.9999696 _CNV_A_R_LINEAR_____53_CM 0. 1.9999696 DISPLAY_IDENTIFIER IP_FAC_MF_BAS_COR_TCO_3_0 FORMAT "%6.5"
 /begin AXIS_DESCR COM_AXIS tco _CNV_A_R_LINEAR_____18_CM 1 -50. 205. FORMAT "%3.0" AXIS_PTS_REF ldp_tco_ip_fac_mf_cor_tco_3_0 /end AXIS_DESCR
/end CHARACTERISTIC
/begin AXIS_PTS ldp_tco_ip_fac_mf_cor_tco_3_0 "" 0x8426ed tco _REC_AXS_20_u1 255. _CNV_A_R_LINEAR_____18_CM 1 -50. 205. FORMAT "%3.0" /end AXIS_PTS
/begin CHARACTERISTIC ip_fac_mf_bas_cor_tco_4_0 "MF: mf_bas interpolation dependent on TCO for inj conf 4" CURVE 0x84be10 _REC_CUR_20_u2_u1 1.9999696 _CNV_A_R_LINEAR_____53_CM 0. 1.9999696 DISPLAY_IDENTIFIER IP_FAC_MF_BAS_COR_TCO_4_0 FORMAT "%6.5"
 /begin AXIS_DESCR COM_AXIS tco _CNV_A_R_LINEAR_____18_CM 1 -50. 205. FORMAT "%3.0" AXIS_PTS_REF ldp_tco_ip_fac_mf_cor_tco_4_0 /end AXIS_DESCR
/end CHARACTERISTIC
/begin AXIS_PTS ldp_tco_ip_fac_mf_cor_tco_4_0 "" 0x8426ef tco _REC_AXS_20_u1 255. _CNV_A_R_LINEAR_____18_CM 1 -50. 205. FORMAT "%3.0" /end AXIS_PTS
/begin CHARACTERISTIC ip_mf_bas_tgas_0_0 "MF: tgas correction of mf_bas at inj conf 0" MAP 0x852ef8 _REC_MAP_20_u2_u2_u2 262.14 _CNV_A_R_LINEAR_____133_CM -131.072 131.068 DISPLAY_IDENTIFIER IP_MF_BAS_TGAS_0_0
 /begin AXIS_DESCR COM_AXIS n _CNV_A_R_LINEAR_____5_CM 8 0. 6375. FORMAT "%4.0" AXIS_PTS_REF ldp_n_ip_mf_bas_tgas_0_0 /end AXIS_DESCR
 /begin AXIS_DESCR COM_AXIS tqi_sp _CNV_A_R_LINEAR_____89_CM 8 -1024. 1023.96875 FORMAT "%6.2" AXIS_PTS_REF ldp_tqi_sp_ip_mf_tgas_0_0 /end AXIS_DESCR
/end CHARACTERISTIC
/begin AXIS_PTS ldp_n_ip_mf_bas_tgas_0_0 "" 0x841d3e n _REC_AXS_20_u2 6375. _CNV_A_R_LINEAR_____5_CM 8 0. 6375. FORMAT "%4.0" /end AXIS_PTS
/begin AXIS_PTS ldp_tqi_sp_ip_mf_tgas_0_0 "" 0x843046 tqi_sp _REC_AXS_20_u2 2047.96875 _CNV_A_R_LINEAR_____89_CM 8 -1024. 1023.96875 FORMAT "%6.2" /end AXIS_PTS
/begin CHARACTERISTIC ip_mf_bas_tgas_1_0 "MF: tgas correction of mf_bas at inj conf 1" MAP 0x852f78 _REC_MAP_20_u2_u2_u2 262.14 _CNV_A_R_LINEAR_____133_CM -131.072 131.068 DISPLAY_IDENTIFIER IP_MF_BAS_TGAS_1_0
 /begin AXIS_DESCR COM_AXIS n _CNV_A_R_LINEAR_____5_CM 8 0. 6375. FORMAT "%4.0" AXIS_PTS_REF ldp_n_ip_mf_bas_tgas_1_0 /end AXIS_DESCR
 /begin AXIS_DESCR COM_AXIS tqi_sp _CNV_A_R_LINEAR_____89_CM 8 -1024. 1023.96875 FORMAT "%6.2" AXIS_PTS_REF ldp_tqi_sp_ip_mf_tgas_1_0 /end AXIS_DESCR
/end CHARACTERISTIC
/begin AXIS_PTS ldp_n_ip_mf_bas_tgas_1_0 "" 0x841d50 n _REC_AXS_20_u2 6375. _CNV_A_R_LINEAR_____5_CM 8 0. 6375. FORMAT "%4.0" /end AXIS_PTS
/begin AXIS_PTS ldp_tqi_sp_ip_mf_tgas_1_0 "" 0x843058 tqi_sp _REC_AXS_20_u2 2047.96875 _CNV_A_R_LINEAR_____89_CM 8 -1024. 1023.96875 FORMAT "%6.2" /end AXIS_PTS
/begin CHARACTERISTIC ip_mf_bas_tgas_2_0 "MF: tgas correction of mf_bas at inj conf 2" MAP 0x852ff8 _REC_MAP_20_u2_u2_u2 262.14 _CNV_A_R_LINEAR_____133_CM -131.072 131.068 DISPLAY_IDENTIFIER IP_MF_BAS_TGAS_2_0
 /begin AXIS_DESCR COM_AXIS n _CNV_A_R_LINEAR_____5_CM 1 0. 6375. FORMAT "%4.0" AXIS_PTS_REF ldp_n_ip_mf_bas_tgas_2_0 /end AXIS_DESCR
 /begin AXIS_DESCR COM_AXIS tqi_sp _CNV_A_R_LINEAR_____89_CM 1 -1024. 1023.96875 FORMAT "%6.2" AXIS_PTS_REF ldp_tqi_sp_ip_mf_tgas_2_0 /end AXIS_DESCR
/end CHARACTERISTIC
/begin AXIS_PTS ldp_n_ip_mf_bas_tgas_2_0 "" 0x841d62 n _REC_AXS_20_u2 6375. _CNV_A_R_LINEAR_____5_CM 1 0. 6375. FORMAT "%4.0" /end AXIS_PTS
/begin AXIS_PTS ldp_tqi_sp_ip_mf_tgas_2_0 "" 0x84306a tqi_sp _REC_AXS_20_u2 2047.96875 _CNV_A_R_LINEAR_____89_CM 1 -1024. 1023.96875 FORMAT "%6.2" /end AXIS_PTS
/begin CHARACTERISTIC ip_mf_bas_tgas_3_0 "MF: tgas correction of mf_bas at inj conf 3" MAP 0x852ffa _REC_MAP_20_u2_u2_u2 262.14 _CNV_A_R_LINEAR_____133_CM -131.072 131.068 DISPLAY_IDENTIFIER IP_MF_BAS_TGAS_3_0
 /begin AXIS_DESCR COM_AXIS n _CNV_A_R_LINEAR_____5_CM 1 0. 6375. FORMAT "%4.0" AXIS_PTS_REF ldp_n_ip_mf_bas_tgas_3_0 /end AXIS_DESCR
 /begin AXIS_DESCR COM_AXIS tqi_sp _CNV_A_R_LINEAR_____89_CM 1 -1024. 1023.96875 FORMAT "%6.2" AXIS_PTS_REF ldp_tqi_sp_ip_mf_tgas_3_0 /end AXIS_DESCR
/end CHARACTERISTIC
/begin AXIS_PTS ldp_n_ip_mf_bas_tgas_3_0 "" 0x841d66 n _REC_AXS_20_u2 6375. _CNV_A_R_LINEAR_____5_CM 1 0. 6375. FORMAT "%4.0" /end AXIS_PTS
/begin AXIS_PTS ldp_tqi_sp_ip_mf_tgas_3_0 "" 0x84306e tqi_sp _REC_AXS_20_u2 2047.96875 _CNV_A_R_LINEAR_____89_CM 1 -1024. 1023.96875 FORMAT "%6.2" /end AXIS_PTS
/begin CHARACTERISTIC ip_mf_bas_tgas_4_0 "MF: tgas correction of mf_bas at inj conf 4" MAP 0x852ffc _REC_MAP_20_u2_u2_u2 262.14 _CNV_A_R_LINEAR_____133_CM -131.072 131.068 DISPLAY_IDENTIFIER IP_MF_BAS_TGAS_4_0
 /begin AXIS_DESCR COM_AXIS n _CNV_A_R_LINEAR_____5_CM 1 0. 6375. FORMAT "%4.0" AXIS_PTS_REF ldp_n_ip_mf_bas_tgas_4_0 /end AXIS_DESCR
 /begin AXIS_DESCR COM_AXIS tqi_sp _CNV_A_R_LINEAR_____89_CM 1 -1024. 1023.96875 FORMAT "%6.2" AXIS_PTS_REF ldp_tqi_sp_ip_mf_tgas_4_0 /end AXIS_DESCR
/end CHARACTERISTIC
/begin AXIS_PTS ldp_n_ip_mf_bas_tgas_4_0 "" 0x841d6a n _REC_AXS_20_u2 6375. _CNV_A_R_LINEAR_____5_CM 1 0. 6375. FORMAT "%4.0" /end AXIS_PTS
/begin AXIS_PTS ldp_tqi_sp_ip_mf_tgas_4_0 "" 0x843072 tqi_sp _REC_AXS_20_u2 2047.96875 _CNV_A_R_LINEAR_____89_CM 1 -1024. 1023.96875 FORMAT "%6.2" /end AXIS_PTS
/begin CHARACTERISTIC ip_mf_bas_amp_0_0 "MF: amp correction of mf_bas at inj conf 0" MAP 0x851bea _REC_MAP_20_u2_u2_u2 262.14 _CNV_A_R_LINEAR_____133_CM -131.072 131.068 DISPLAY_IDENTIFIER IP_MF_BAS_AMP_0_0
 /begin AXIS_DESCR COM_AXIS n _CNV_A_R_LINEAR_____5_CM 8 0. 6375. FORMAT "%4.0" AXIS_PTS_REF ldp_n_ip_mf_bas_amp_0_0 /end AXIS_DESCR
 /begin AXIS_DESCR COM_AXIS tqi_sp _CNV_A_R_LINEAR_____89_CM 16 -1024. 1023.96875 FORMAT "%6.2" AXIS_PTS_REF ldp_tqi_sp_ip_mf_bas_amp_0_0 /end AXIS_DESCR
/end CHARACTERISTIC
/begin AXIS_PTS ldp_n_ip_mf_bas_amp_0_0 "" 0x841bdc n _REC_AXS_20_u2 6375. _CNV_A_R_LINEAR_____5_CM 8 0. 6375. FORMAT "%4.0" /end AXIS_PTS
/begin AXIS_PTS ldp_tqi_sp_ip_mf_bas_amp_0_0 "" 0x842da2 tqi_sp _REC_AXS_20_u2 2047.96875 _CNV_A_R_LINEAR_____89_CM 16 -1024. 1023.96875 FORMAT "%6.2" /end AXIS_PTS
/begin CHARACTERISTIC ip_mf_bas_amp_1_0 "MF: amp correction of mf_bas at inj conf 1" MAP 0x851cea _REC_MAP_20_u2_u2_u2 262.14 _CNV_A_R_LINEAR_____133_CM -131.072 131.068 DISPLAY_IDENTIFIER IP_MF_BAS_AMP_1_0
 /begin AXIS_DESCR COM_AXIS n _CNV_A_R_LINEAR_____5_CM 8 0. 6375. FORMAT "%4.0" AXIS_PTS_REF ldp_n_ip_mf_bas_amp_1_0 /end AXIS_DESCR
 /begin AXIS_DESCR COM_AXIS tqi_sp _CNV_A_R_LINEAR_____89_CM 16 -1024. 1023.96875 FORMAT "%6.2" AXIS_PTS_REF ldp_tqi_sp_ip_mf_bas_amp_1_0 /end AXIS_DESCR
/end CHARACTERISTIC
/begin AXIS_PTS ldp_n_ip_mf_bas_amp_1_0 "" 0x841bee n _REC_AXS_20_u2 6375. _CNV_A_R_LINEAR_____5_CM 8 0. 6375. FORMAT "%4.0" /end AXIS_PTS
/begin AXIS_PTS ldp_tqi_sp_ip_mf_bas_amp_1_0 "" 0x842dc4 tqi_sp _REC_AXS_20_u2 2047.96875 _CNV_A_R_LINEAR_____89_CM 16 -1024. 1023.96875 FORMAT "%6.2" /end AXIS_PTS
/begin CHARACTERISTIC ip_mf_bas_amp_2_0 "MF: amp correction of mf_bas at inj conf 2" MAP 0x851dea _REC_MAP_20_u2_u2_u2 262.14 _CNV_A_R_LINEAR_____133_CM -131.072 131.068 DISPLAY_IDENTIFIER IP_MF_BAS_AMP_2_0
 /begin AXIS_DESCR COM_AXIS n _CNV_A_R_LINEAR_____5_CM 1 0. 6375. FORMAT "%4.0" AXIS_PTS_REF ldp_n_ip_mf_bas_amp_2_0 /end AXIS_DESCR
 /begin AXIS_DESCR COM_AXIS tqi_sp _CNV_A_R_LINEAR_____89_CM 1 -1024. 1023.96875 FORMAT "%6.2" AXIS_PTS_REF ldp_tqi_sp_ip_mf_bas_amp_2_0 /end AXIS_DESCR
/end CHARACTERISTIC
/begin AXIS_PTS ldp_n_ip_mf_bas_amp_2_0 "" 0x841c00 n _REC_AXS_20_u2 6375. _CNV_A_R_LINEAR_____5_CM 1 0. 6375. FORMAT "%4.0" /end AXIS_PTS
/begin AXIS_PTS ldp_tqi_sp_ip_mf_bas_amp_2_0 "" 0x842de6 tqi_sp _REC_AXS_20_u2 2047.96875 _CNV_A_R_LINEAR_____89_CM 1 -1024. 1023.96875 FORMAT "%6.2" /end AXIS_PTS
/begin CHARACTERISTIC ip_mf_bas_amp_3_0 "MF: amp correction of mf_bas at inj conf 3" MAP 0x851dec _REC_MAP_20_u2_u2_u2 262.14 _CNV_A_R_LINEAR_____133_CM -131.072 131.068 DISPLAY_IDENTIFIER IP_MF_BAS_AMP_3_0
 /begin AXIS_DESCR COM_AXIS n _CNV_A_R_LINEAR_____5_CM 1 0. 6375. FORMAT "%4.0" AXIS_PTS_REF ldp_n_ip_mf_bas_amp_3_0 /end AXIS_DESCR
 /begin AXIS_DESCR COM_AXIS tqi_sp _CNV_A_R_LINEAR_____89_CM 1 -1024. 1023.96875 FORMAT "%6.2" AXIS_PTS_REF ldp_tqi_sp_ip_mf_bas_amp_3_0 /end AXIS_DESCR
/end CHARACTERISTIC
/begin AXIS_PTS ldp_n_ip_mf_bas_amp_3_0 "" 0x841c04 n _REC_AXS_20_u2 6375. _CNV_A_R_LINEAR_____5_CM 1 0. 6375. FORMAT "%4.0" /end AXIS_PTS
/begin AXIS_PTS ldp_tqi_sp_ip_mf_bas_amp_3_0 "" 0x842dea tqi_sp _REC_AXS_20_u2 2047.96875 _CNV_A_R_LINEAR_____89_CM 1 -1024. 1023.96875 FORMAT "%6.2" /end AXIS_PTS
/begin CHARACTERISTIC ip_mf_bas_amp_4_0 "MF: amp correction of mf_bas at inj conf 4" MAP 0x851dee _REC_MAP_20_u2_u2_u2 262.14 _CNV_A_R_LINEAR_____133_CM -131.072 131.068 DISPLAY_IDENTIFIER IP_MF_BAS_AMP_4_0
 /begin AXIS_DESCR COM_AXIS n _CNV_A_R_LINEAR_____5_CM 1 0. 6375. FORMAT "%4.0" AXIS_PTS_REF ldp_n_ip_mf_bas_amp_4_0 /end AXIS_DESCR
 /begin AXIS_DESCR COM_AXIS tqi_sp _CNV_A_R_LINEAR_____89_CM 1 -1024. 1023.96875 FORMAT "%6.2" AXIS_PTS_REF ldp_tqi_sp_ip_mf_bas_amp_4_0 /end AXIS_DESCR
/end CHARACTERISTIC
/begin AXIS_PTS ldp_n_ip_mf_bas_amp_4_0 "" 0x841c08 n _REC_AXS_20_u2 6375. _CNV_A_R_LINEAR_____5_CM 1 0. 6375. FORMAT "%4.0" /end AXIS_PTS
/begin AXIS_PTS ldp_tqi_sp_ip_mf_bas_amp_4_0 "" 0x842dee tqi_sp _REC_AXS_20_u2 2047.96875 _CNV_A_R_LINEAR_____89_CM 1 -1024. 1023.96875 FORMAT "%6.2" /end AXIS_PTS
/begin CHARACTERISTIC ip_mf_bas_0_0 "MF: mf_bas at inj conf 0 and temp level 0" MAP 0x8503e4 _REC_MAP_20_u2_u2_u2 262.14 _CNV_A_R_LINEAR_____396_CM -20. 242.14 DISPLAY_IDENTIFIER IP_MF_BAS_0_0
 /begin AXIS_DESCR COM_AXIS n _CNV_A_R_LINEAR_____5_CM 16 0. 6375. FORMAT "%4.0" AXIS_PTS_REF ldpm_n_1_ip_mf_bas_0_0 /end AXIS_DESCR
 /begin AXIS_DESCR COM_AXIS tqi_sp _CNV_A_R_LINEAR_____89_CM 16 -1024. 1023.96875 FORMAT "%6.2" AXIS_PTS_REF ldpm_tqi_sp_1_ip_mf_bas_0_0 /end AXIS_DESCR
/end CHARACTERISTIC
/begin CHARACTERISTIC ip_mf_bas_0_1 "MF: mf_bas at inj conf 0 and temp level 1" MAP 0x8505e4 _REC_MAP_20_u2_u2_u2 262.14 _CNV_A_R_LINEAR_____396_CM -20. 242.14 DISPLAY_IDENTIFIER IP_MF_BAS_0_1
 /begin AXIS_DESCR COM_AXIS n _CNV_A_R_LINEAR_____5_CM 16 0. 6375. FORMAT "%4.0" AXIS_PTS_REF ldpm_n_1_ip_mf_bas_0_0 /end AXIS_DESCR
 /begin AXIS_DESCR COM_AXIS tqi_sp _CNV_A_R_LINEAR_____89_CM 16 -1024. 1023.96875 FORMAT "%6.2" AXIS_PTS_REF ldpm_tqi_sp_1_ip_mf_bas_0_0 /end AXIS_DESCR
/end CHARACTERISTIC
/begin CHARACTERISTIC ip_mf_bas_0_2 "MF: mf_bas at inj conf 0 and temp level 2" MAP 0x8507e4 _REC_MAP_20_u2_u2_u2 262.14 _CNV_A_R_LINEAR_____396_CM -20. 242.14 DISPLAY_IDENTIFIER IP_MF_BAS_0_2
 /begin AXIS_DESCR COM_AXIS n _CNV_A_R_LINEAR_____5_CM 16 0. 6375. FORMAT "%4.0" AXIS_PTS_REF ldpm_n_1_ip_mf_bas_0_0 /end AXIS_DESCR
 /begin AXIS_DESCR COM_AXIS tqi_sp _CNV_A_R_LINEAR_____89_CM 16 -1024. 1023.96875 FORMAT "%6.2" AXIS_PTS_REF ldpm_tqi_sp_1_ip_mf_bas_0_0 /end AXIS_DESCR
/end CHARACTERISTIC
/begin CHARACTERISTIC ip_mf_bas_1_0 "MF: mf_bas at inj conf 1 and temp level 0" MAP 0x8509e4 _REC_MAP_20_u2_u2_u2 262.14 _CNV_A_R_LINEAR_____396_CM -20. 242.14 DISPLAY_IDENTIFIER IP_MF_BAS_1_0
 /begin AXIS_DESCR COM_AXIS n _CNV_A_R_LINEAR_____5_CM 16 0. 6375. FORMAT "%4.0" AXIS_PTS_REF ldpm_n_1_ip_mf_bas_1_0 /end AXIS_DESCR
 /begin AXIS_DESCR COM_AXIS tqi_sp _CNV_A_R_LINEAR_____89_CM 16 -1024. 1023.96875 FORMAT "%6.2" AXIS_PTS_REF ldpm_tqi_sp_1_ip_mf_bas_1_0 /end AXIS_DESCR
/end CHARACTERISTIC
/begin CHARACTERISTIC ip_mf_bas_1_1 "MF: mf_bas at inj conf 1 and temp level 1" MAP 0x850be4 _REC_MAP_20_u2_u2_u2 262.14 _CNV_A_R_LINEAR_____396_CM -20. 242.14 DISPLAY_IDENTIFIER IP_MF_BAS_1_1
 /begin AXIS_DESCR COM_AXIS n _CNV_A_R_LINEAR_____5_CM 16 0. 6375. FORMAT "%4.0" AXIS_PTS_REF ldpm_n_1_ip_mf_bas_1_0 /end AXIS_DESCR
 /begin AXIS_DESCR COM_AXIS tqi_sp _CNV_A_R_LINEAR_____89_CM 16 -1024. 1023.96875 FORMAT "%6.2" AXIS_PTS_REF ldpm_tqi_sp_1_ip_mf_bas_1_0 /end AXIS_DESCR
/end CHARACTERISTIC
/begin CHARACTERISTIC ip_mf_bas_1_2 "MF: mf_bas at inj conf 1 and temp level 2" MAP 0x850de4 _REC_MAP_20_u2_u2_u2 262.14 _CNV_A_R_LINEAR_____396_CM -20. 242.14 DISPLAY_IDENTIFIER IP_MF_BAS_1_2
 /begin AXIS_DESCR COM_AXIS n _CNV_A_R_LINEAR_____5_CM 16 0. 6375. FORMAT "%4.0" AXIS_PTS_REF ldpm_n_1_ip_mf_bas_1_0 /end AXIS_DESCR
 /begin AXIS_DESCR COM_AXIS tqi_sp _CNV_A_R_LINEAR_____89_CM 16 -1024. 1023.96875 FORMAT "%6.2" AXIS_PTS_REF ldpm_tqi_sp_1_ip_mf_bas_1_0 /end AXIS_DESCR
/end CHARACTERISTIC
/begin CHARACTERISTIC ip_mf_bas_2_0 "MF: mf_bas at inj conf 2 and temp level 0" MAP 0x850fe4 _REC_MAP_20_u2_u2_u2 262.14 _CNV_A_R_LINEAR_____396_CM -20. 242.14 DISPLAY_IDENTIFIER IP_MF_BAS_2_0
 /begin AXIS_DESCR COM_AXIS n _CNV_A_R_LINEAR_____5_CM 16 0. 6375. FORMAT "%4.0" AXIS_PTS_REF ldpm_n_1_ip_mf_bas_2_0 /end AXIS_DESCR
 /begin AXIS_DESCR COM_AXIS tqi_sp _CNV_A_R_LINEAR_____89_CM 16 -1024. 1023.96875 FORMAT "%6.2" AXIS_PTS_REF ldpm_tqi_sp_1_ip_mf_bas_2_0 /end AXIS_DESCR
/end CHARACTERISTIC
/begin CHARACTERISTIC ip_mf_bas_2_1 "MF: mf_bas at inj conf 2 and temp level 1" MAP 0x8511e4 _REC_MAP_20_u2_u2_u2 262.14 _CNV_A_R_LINEAR_____396_CM -20. 242.14 DISPLAY_IDENTIFIER IP_MF_BAS_2_1
 /begin AXIS_DESCR COM_AXIS n _CNV_A_R_LINEAR_____5_CM 16 0. 6375. FORMAT "%4.0" AXIS_PTS_REF ldpm_n_1_ip_mf_bas_2_0 /end AXIS_DESCR
 /begin AXIS_DESCR COM_AXIS tqi_sp _CNV_A_R_LINEAR_____89_CM 16 -1024. 1023.96875 FORMAT "%6.2" AXIS_PTS_REF ldpm_tqi_sp_1_ip_mf_bas_2_0 /end AXIS_DESCR
/end CHARACTERISTIC
/begin CHARACTERISTIC ip_mf_bas_2_2 "MF: mf_bas at inj conf 2 and temp level 2" MAP 0x8513e4 _REC_MAP_20_u2_u2_u2 262.14 _CNV_A_R_LINEAR_____396_CM -20. 242.14 DISPLAY_IDENTIFIER IP_MF_BAS_2_2
 /begin AXIS_DESCR COM_AXIS n _CNV_A_R_LINEAR_____5_CM 1 0. 6375. FORMAT "%4.0" AXIS_PTS_REF ldp_n_1_ip_mf_bas_2_0_x /end AXIS_DESCR
 /begin AXIS_DESCR COM_AXIS tqi_sp _CNV_A_R_LINEAR_____89_CM 1 -1024. 1023.96875 FORMAT "%6.2" AXIS_PTS_REF ldp_tqi_sp_1_ip_mf_bas_2_0_x /end AXIS_DESCR
/end CHARACTERISTIC
/begin CHARACTERISTIC ip_mf_bas_3_0 "MF: mf_bas at inj conf 3 and temp level 0" MAP 0x8513e6 _REC_MAP_20_u2_u2_u2 262.14 _CNV_A_R_LINEAR_____396_CM -20. 242.14 DISPLAY_IDENTIFIER IP_MF_BAS_3_0
 /begin AXIS_DESCR COM_AXIS n _CNV_A_R_LINEAR_____5_CM 16 0. 6375. FORMAT "%4.0" AXIS_PTS_REF ldpm_n_1_ip_mf_bas_3_0 /end AXIS_DESCR
 /begin AXIS_DESCR COM_AXIS tqi_sp _CNV_A_R_LINEAR_____89_CM 16 -1024. 1023.96875 FORMAT "%6.2" AXIS_PTS_REF ldpm_tqi_sp_1_ip_mf_bas_3_0 /end AXIS_DESCR
/end CHARACTERISTIC
/begin CHARACTERISTIC ip_mf_bas_3_1 "MF: mf_bas at inj conf 3 and temp level 1" MAP 0x8515e6 _REC_MAP_20_u2_u2_u2 262.14 _CNV_A_R_LINEAR_____396_CM -20. 242.14 DISPLAY_IDENTIFIER IP_MF_BAS_3_1
 /begin AXIS_DESCR COM_AXIS n _CNV_A_R_LINEAR_____5_CM 16 0. 6375. FORMAT "%4.0" AXIS_PTS_REF ldpm_n_1_ip_mf_bas_3_0 /end AXIS_DESCR
 /begin AXIS_DESCR COM_AXIS tqi_sp _CNV_A_R_LINEAR_____89_CM 16 -1024. 1023.96875 FORMAT "%6.2" AXIS_PTS_REF ldpm_tqi_sp_1_ip_mf_bas_3_0 /end AXIS_DESCR
/end CHARACTERISTIC
/begin CHARACTERISTIC ip_mf_bas_3_2 "MF: mf_bas at inj conf 3 and temp level 2" MAP 0x8517e6 _REC_MAP_20_u2_u2_u2 262.14 _CNV_A_R_LINEAR_____396_CM -20. 242.14 DISPLAY_IDENTIFIER IP_MF_BAS_3_2
 /begin AXIS_DESCR COM_AXIS n _CNV_A_R_LINEAR_____5_CM 1 0. 6375. FORMAT "%4.0" AXIS_PTS_REF ldp_n_1_ip_mf_bas_3_0_x /end AXIS_DESCR
 /begin AXIS_DESCR COM_AXIS tqi_sp _CNV_A_R_LINEAR_____89_CM 1 -1024. 1023.96875 FORMAT "%6.2" AXIS_PTS_REF ldp_tqi_sp_1_ip_mf_bas_3_0_x /end AXIS_DESCR
/end CHARACTERISTIC
/begin CHARACTERISTIC ip_mf_bas_4_0 "MF: mf_bas at inj conf 4 and temp level 0" MAP 0x8517e8 _REC_MAP_20_u2_u2_u2 262.14 _CNV_A_R_LINEAR_____396_CM -20. 242.14 DISPLAY_IDENTIFIER IP_MF_BAS_4_0
 /begin AXIS_DESCR COM_AXIS n _CNV_A_R_LINEAR_____5_CM 16 0. 6375. FORMAT "%4.0" AXIS_PTS_REF ldpm_n_1_ip_mf_bas_4_0 /end AXIS_DESCR
 /begin AXIS_DESCR COM_AXIS tqi_sp _CNV_A_R_LINEAR_____89_CM 16 -1024. 1023.96875 FORMAT "%6.2" AXIS_PTS_REF ldpm_tqi_sp_1_ip_mf_bas_4_0 /end AXIS_DESCR
/end CHARACTERISTIC
/begin CHARACTERISTIC ip_mf_bas_4_1 "MF: mf_bas at inj conf 4 and temp level 1" MAP 0x8519e8 _REC_MAP_20_u2_u2_u2 262.14 _CNV_A_R_LINEAR_____396_CM -20. 242.14 DISPLAY_IDENTIFIER IP_MF_BAS_4_1
 /begin AXIS_DESCR COM_AXIS n _CNV_A_R_LINEAR_____5_CM 16 0. 6375. FORMAT "%4.0" AXIS_PTS_REF ldpm_n_1_ip_mf_bas_4_0 /end AXIS_DESCR
 /begin AXIS_DESCR COM_AXIS tqi_sp _CNV_A_R_LINEAR_____89_CM 16 -1024. 1023.96875 FORMAT "%6.2" AXIS_PTS_REF ldpm_tqi_sp_1_ip_mf_bas_4_0 /end AXIS_DESCR
/end CHARACTERISTIC
/begin CHARACTERISTIC ip_mf_bas_4_2 "MF: mf_bas at inj conf 4 and temp level 2" MAP 0x851be8 _REC_MAP_20_u2_u2_u2 262.14 _CNV_A_R_LINEAR_____396_CM -20. 242.14 DISPLAY_IDENTIFIER IP_MF_BAS_4_2
 /begin AXIS_DESCR COM_AXIS n _CNV_A_R_LINEAR_____5_CM 1 0. 6375. FORMAT "%4.0" AXIS_PTS_REF ldp_n_1_ip_mf_bas_4_0_x /end AXIS_DESCR
 /begin AXIS_DESCR COM_AXIS tqi_sp _CNV_A_R_LINEAR_____89_CM 1 -1024. 1023.96875 FORMAT "%6.2" AXIS_PTS_REF ldp_tqi_sp_1_ip_mf_bas_4_0_x /end AXIS_DESCR
/end CHARACTERISTIC
/begin AXIS_PTS ldpm_n_1_ip_mf_bas_0_0 "" 0x8435a6 n _REC_AXS_20_u2 6375. _CNV_A_R_LINEAR_____5_CM 16 0. 6375. FORMAT "%4.0" /end AXIS_PTS
/begin AXIS_PTS ldpm_tqi_sp_1_ip_mf_bas_0_0 "" 0x844224 tqi_sp _REC_AXS_20_u2 2047.96875 _CNV_A_R_LINEAR_____89_CM 16 -1024. 1023.96875 FORMAT "%6.2" /end AXIS_PTS
/begin AXIS_PTS ldpm_n_1_ip_mf_bas_1_0 "" 0x8435c8 n _REC_AXS_20_u2 6375. _CNV_A_R_LINEAR_____5_CM 16 0. 6375. FORMAT "%4.0" /end AXIS_PTS
/begin AXIS_PTS ldpm_tqi_sp_1_ip_mf_bas_1_0 "" 0x844246 tqi_sp _REC_AXS_20_u2 2047.96875 _CNV_A_R_LINEAR_____89_CM 16 -1024. 1023.96875 FORMAT "%6.2" /end AXIS_PTS
/begin AXIS_PTS ldpm_n_1_ip_mf_bas_2_0 "" 0x8435ea n _REC_AXS_20_u2 6375. _CNV_A_R_LINEAR_____5_CM 16 0. 6375. FORMAT "%4.0" /end AXIS_PTS
/begin AXIS_PTS ldp_n_1_ip_mf_bas_2_0_x "" 0x8418d2 n _REC_AXS_20_u2 6375. _CNV_A_R_LINEAR_____5_CM 1 0. 6375. FORMAT "%4.0" /end AXIS_PTS
/begin AXIS_PTS ldpm_tqi_sp_1_ip_mf_bas_2_0 "" 0x844268 tqi_sp _REC_AXS_20_u2 2047.96875 _CNV_A_R_LINEAR_____89_CM 16 -1024. 1023.96875 FORMAT "%6.2" /end AXIS_PTS
/begin AXIS_PTS ldp_tqi_sp_1_ip_mf_bas_2_0_x "" 0x842d78 tqi_sp _REC_AXS_20_u2 2047.96875 _CNV_A_R_LINEAR_____89_CM 1 -1024. 1023.96875 FORMAT "%6.2" /end AXIS_PTS
/begin AXIS_PTS ldpm_n_1_ip_mf_bas_3_0 "" 0x84360c n _REC_AXS_20_u2 6375. _CNV_A_R_LINEAR_____5_CM 16 0. 6375. FORMAT "%4.0" /end AXIS_PTS
/begin AXIS_PTS ldp_n_1_ip_mf_bas_3_0_x "" 0x8418d6 n _REC_AXS_20_u2 6375. _CNV_A_R_LINEAR_____5_CM 1 0. 6375. FORMAT "%4.0" /end AXIS_PTS
/begin AXIS_PTS ldpm_tqi_sp_1_ip_mf_bas_3_0 "" 0x84428a tqi_sp _REC_AXS_20_u2 2047.96875 _CNV_A_R_LINEAR_____89_CM 16 -1024. 1023.96875 FORMAT "%6.2" /end AXIS_PTS
/begin AXIS_PTS ldp_tqi_sp_1_ip_mf_bas_3_0_x "" 0x842d7c tqi_sp _REC_AXS_20_u2 2047.96875 _CNV_A_R_LINEAR_____89_CM 1 -1024. 1023.96875 FORMAT "%6.2" /end AXIS_PTS
/begin AXIS_PTS ldpm_n_1_ip_mf_bas_4_0 "" 0x84362e n _REC_AXS_20_u2 6375. _CNV_A_R_LINEAR_____5_CM 16 0. 6375. FORMAT "%4.0" /end AXIS_PTS
/begin AXIS_PTS ldp_n_1_ip_mf_bas_4_0_x "" 0x8418da n _REC_AXS_20_u2 6375. _CNV_A_R_LINEAR_____5_CM 1 0. 6375. FORMAT "%4.0" /end AXIS_PTS
/begin AXIS_PTS ldpm_tqi_sp_1_ip_mf_bas_4_0 "" 0x8442ac tqi_sp _REC_AXS_20_u2 2047.96875 _CNV_A_R_LINEAR_____89_CM 16 -1024. 1023.96875 FORMAT "%6.2" /end AXIS_PTS
/begin AXIS_PTS ldp_tqi_sp_1_ip_mf_bas_4_0_x "" 0x842d80 tqi_sp _REC_AXS_20_u2 2047.96875 _CNV_A_R_LINEAR_____89_CM 1 -1024. 1023.96875 FORMAT "%6.2" /end AXIS_PTS
/begin MEASUREMENT mf_bas_is_pl_rgn_1 "basic fuel mass at rgn level 1 after injection configuration selection" UWORD _CNV_A_R_LINEAR_____396_CM 1 0. -20. 242.14 DISPLAY_IDENTIFIER MF_BAS_IS_PL_RGN_1 ECU_ADDRESS 0x7f9c9e BYTE_ORDER MSB_LAST /end MEASUREMENT
/begin MEASUREMENT mf_bas_is_pl_rgn_2 "basic fuel mass at rgn level 2 after injection configuration selection" UWORD _CNV_A_R_LINEAR_____396_CM 1 0. -20. 242.14 DISPLAY_IDENTIFIER MF_BAS_IS_PL_RGN_2 ECU_ADDRESS 0x7f9ca0 BYTE_ORDER MSB_LAST /end MEASUREMENT
/begin CHARACTERISTIC ip_fac_mf_bas_cor_tco_rgn_1 "Mf Rgn calibrations: TCO interpolation of mf_bas during regeneration" CURVE 0x84be12 _REC_CUR_20_u2_u1 1.9999696 _CNV_A_R_LINEAR_____53_CM 0. 1.9999696 DISPLAY_IDENTIFIER IP_FAC_MF_BAS_COR_TCO_RGN_1 FORMAT "%6.5"
 /begin AXIS_DESCR COM_AXIS tco _CNV_A_R_LINEAR_____18_CM 8 -50. 205. FORMAT "%3.0" AXIS_PTS_REF ldp_tco_ip_fac_mf_bas_cor_rgn_1 /end AXIS_DESCR
/end CHARACTERISTIC
/begin AXIS_PTS ldp_tco_ip_fac_mf_bas_cor_rgn_1 "TCO interpolation of mf_bas during regeneration" 0x8426d0 tco _REC_AXS_20_u1 255. _CNV_A_R_LINEAR_____18_CM 8 -50. 205. FORMAT "%3.0" /end AXIS_PTS
/begin CHARACTERISTIC ip_fac_mf_bas_cor_tgas_rgn_1 "Mf Rgn calibrations: tgas correction factor of mf_bas during regeneration" CURVE 0x84be48 _REC_CUR_20_u2_u1 0.9999847412109381 _CNV_A_R_LINEAR_____14_CM 0. 0.9999847412109381 DISPLAY_IDENTIFIER IP_FAC_MF_BAS_COR_TGAS_RGN_1 FORMAT "%6.5"
 /begin AXIS_DESCR COM_AXIS tgas _CNV_A_R_LINEAR_____18_CM 8 -50. 205. FORMAT "%3.0" AXIS_PTS_REF ldp_tgas_ip_fac_mf_bas_rgn_1 /end AXIS_DESCR
/end CHARACTERISTIC
/begin AXIS_PTS ldp_tgas_ip_fac_mf_bas_rgn_1 "tgas correction factor of mf_bas during regeneration" 0x84296e tgas _REC_AXS_20_u1 255. _CNV_A_R_LINEAR_____18_CM 8 -50. 205. FORMAT "%3.0" /end AXIS_PTS
/begin CHARACTERISTIC ip_fac_mf_bas_cor_amp_rgn_1 "Mf Rgn calibrations: amp correction factor of mf_bas during regeneration" CURVE 0x84bddc _REC_CUR_20_u2_u2 0.9999847412109381 _CNV_A_R_LINEAR_____14_CM 0. 0.9999847412109381 DISPLAY_IDENTIFIER IP_FAC_MF_BAS_COR_AMP_RGN_1 FORMAT "%6.5"
 /begin AXIS_DESCR COM_AXIS amp _CNV_A_R_LINEAR_____21_CM 8 0. 5434. FORMAT "%6.2" AXIS_PTS_REF ldp_amp_ip_fac_mf_cor_rgn_1 /end AXIS_DESCR
/end CHARACTERISTIC
/begin AXIS_PTS ldp_amp_ip_fac_mf_cor_rgn_1 "amp correction factor of mf_bas during regeneration" 0x8411a4 amp _REC_AXS_20_u2 5434. _CNV_A_R_LINEAR_____21_CM 8 0. 5434. FORMAT "%6.2" /end AXIS_PTS
/begin CHARACTERISTIC ip_mf_bas_rgn_1_0_1 "Mf Rgn calibrations: mf_bas during regeneration at temp level 1" MAP 0x8520f0 _REC_MAP_20_u2_u2_u2 262.14 _CNV_A_R_LINEAR_____396_CM -20. 242.14 DISPLAY_IDENTIFIER IP_MF_BAS_RGN_1_0_1
 /begin AXIS_DESCR COM_AXIS n _CNV_A_R_LINEAR_____5_CM 16 0. 6375. FORMAT "%4.0" AXIS_PTS_REF ldp_n_ip_mf_bas_rgn_1_0_1 /end AXIS_DESCR
 /begin AXIS_DESCR COM_AXIS tqi_sp _CNV_A_R_LINEAR_____89_CM 16 -1024. 1023.96875 FORMAT "%6.2" AXIS_PTS_REF ldp_tqi_sp_ip_mf_bas_rgn_1_0_1 /end AXIS_DESCR
/end CHARACTERISTIC
/begin AXIS_PTS ldp_n_ip_mf_bas_rgn_1_0_1 "mf_bas during regeneration at temp level 1" 0x841c40 n _REC_AXS_20_u2 6375. _CNV_A_R_LINEAR_____5_CM 16 0. 6375. FORMAT "%4.0" /end AXIS_PTS
/begin AXIS_PTS ldp_tqi_sp_ip_mf_bas_rgn_1_0_1 "mf_bas during regeneration at temp level 1" 0x842e36 tqi_sp _REC_AXS_20_u2 2047.96875 _CNV_A_R_LINEAR_____89_CM 16 -1024. 1023.96875 FORMAT "%6.2" /end AXIS_PTS
/begin CHARACTERISTIC ip_mf_bas_rgn_1_0_2 "Mf Rgn calibrations: mf_bas during regeneration at temp level 2" MAP 0x8522f0 _REC_MAP_20_u2_u2_u2 262.14 _CNV_A_R_LINEAR_____396_CM -20. 242.14 DISPLAY_IDENTIFIER IP_MF_BAS_RGN_1_0_2
 /begin AXIS_DESCR COM_AXIS n _CNV_A_R_LINEAR_____5_CM 1 0. 6375. FORMAT "%4.0" AXIS_PTS_REF ldp_n_ip_mf_bas_rgn_1_0_2 /end AXIS_DESCR
 /begin AXIS_DESCR COM_AXIS tqi_sp _CNV_A_R_LINEAR_____89_CM 1 -1024. 1023.96875 FORMAT "%6.2" AXIS_PTS_REF ldp_tqi_sp_ip_mf_bas_rgn_1_0_2 /end AXIS_DESCR
/end CHARACTERISTIC
/begin AXIS_PTS ldp_n_ip_mf_bas_rgn_1_0_2 "mf_bas during regeneration at temp level 2" 0x841c62 n _REC_AXS_20_u2 6375. _CNV_A_R_LINEAR_____5_CM 1 0. 6375. FORMAT "%4.0" /end AXIS_PTS
/begin AXIS_PTS ldp_tqi_sp_ip_mf_bas_rgn_1_0_2 "mf_bas during regeneration at temp level 2" 0x842e58 tqi_sp _REC_AXS_20_u2 2047.96875 _CNV_A_R_LINEAR_____89_CM 1 -1024. 1023.96875 FORMAT "%6.2" /end AXIS_PTS
/begin CHARACTERISTIC ip_mf_bas_tgas_rgn_1 "Mf Rgn calibrations: tgas correction of mf_bas during regeneration" MAP 0x852ffe _REC_MAP_20_u2_u2_u2 262.14 _CNV_A_R_LINEAR_____133_CM -131.072 131.068 DISPLAY_IDENTIFIER IP_MF_BAS_TGAS_RGN_1
 /begin AXIS_DESCR COM_AXIS n _CNV_A_R_LINEAR_____5_CM 8 0. 6375. FORMAT "%4.0" AXIS_PTS_REF ldp_n_ip_mf_bas_tgas_rgn_1 /end AXIS_DESCR
 /begin AXIS_DESCR COM_AXIS tqi_sp _CNV_A_R_LINEAR_____89_CM 8 -1024. 1023.96875 FORMAT "%6.2" AXIS_PTS_REF ldp_tqi_sp_ip_mf_tgas_rgn_1 /end AXIS_DESCR
/end CHARACTERISTIC
/begin AXIS_PTS ldp_n_ip_mf_bas_tgas_rgn_1 "tgas correction of mf_bas during regeneration" 0x841d6e n _REC_AXS_20_u2 6375. _CNV_A_R_LINEAR_____5_CM 8 0. 6375. FORMAT "%4.0" /end AXIS_PTS
/begin AXIS_PTS ldp_tqi_sp_ip_mf_tgas_rgn_1 "tgas correction of mf_bas during regeneration" 0x843076 tqi_sp _REC_AXS_20_u2 2047.96875 _CNV_A_R_LINEAR_____89_CM 8 -1024. 1023.96875 FORMAT "%6.2" /end AXIS_PTS
/begin CHARACTERISTIC ip_mf_bas_amp_rgn_1 "Mf Rgn calibrations: amp correction of mf_bas during regeneration" MAP 0x851df0 _REC_MAP_20_u2_u2_u2 262.14 _CNV_A_R_LINEAR_____133_CM -131.072 131.068 DISPLAY_IDENTIFIER IP_MF_BAS_AMP_RGN_1
 /begin AXIS_DESCR COM_AXIS n _CNV_A_R_LINEAR_____5_CM 8 0. 6375. FORMAT "%4.0" AXIS_PTS_REF ldp_n_ip_mf_bas_amp_rgn_1 /end AXIS_DESCR
 /begin AXIS_DESCR COM_AXIS tqi_sp _CNV_A_R_LINEAR_____89_CM 16 -1024. 1023.96875 FORMAT "%6.2" AXIS_PTS_REF ldp_tqi_sp_ip_mf_bas_amp_rgn_1 /end AXIS_DESCR
/end CHARACTERISTIC
/begin AXIS_PTS ldp_n_ip_mf_bas_amp_rgn_1 "amp correction of mf_bas during regeneration" 0x841c0c n _REC_AXS_20_u2 6375. _CNV_A_R_LINEAR_____5_CM 8 0. 6375. FORMAT "%4.0" /end AXIS_PTS
/begin AXIS_PTS ldp_tqi_sp_ip_mf_bas_amp_rgn_1 "amp correction of mf_bas during regeneration" 0x842df2 tqi_sp _REC_AXS_20_u2 2047.96875 _CNV_A_R_LINEAR_____89_CM 16 -1024. 1023.96875 FORMAT "%6.2" /end AXIS_PTS
/begin CHARACTERISTIC ip_mf_bas_rgn_1_0_0 "Mf Rgn calibrations: mf_bas at rgn level 1, inj conf 0 and temp level 0" MAP 0x851ef0 _REC_MAP_20_u2_u2_u2 262.14 _CNV_A_R_LINEAR_____396_CM -20. 242.14 DISPLAY_IDENTIFIER IP_MF_BAS_RGN_1_0_0
 /begin AXIS_DESCR COM_AXIS n _CNV_A_R_LINEAR_____5_CM 16 0. 6375. FORMAT "%4.0" AXIS_PTS_REF ldp_n_ip_mf_bas_rgn_1_0_0 /end AXIS_DESCR
 /begin AXIS_DESCR COM_AXIS tqi_sp _CNV_A_R_LINEAR_____89_CM 16 -1024. 1023.96875 FORMAT "%6.2" AXIS_PTS_REF ldp_tqi_sp_ip_mf_bas_rgn_1_0_0 /end AXIS_DESCR
/end CHARACTERISTIC
/begin AXIS_PTS ldp_n_ip_mf_bas_rgn_1_0_0 "mf_bas at rgn level 1, inj conf 0 and temp level 0" 0x841c1e n _REC_AXS_20_u2 6375. _CNV_A_R_LINEAR_____5_CM 16 0. 6375. FORMAT "%4.0" /end AXIS_PTS
/begin AXIS_PTS ldp_tqi_sp_ip_mf_bas_rgn_1_0_0 "mf_bas at rgn level 1, inj conf 0 and temp level 0" 0x842e14 tqi_sp _REC_AXS_20_u2 2047.96875 _CNV_A_R_LINEAR_____89_CM 16 -1024. 1023.96875 FORMAT "%6.2" /end AXIS_PTS
/begin CHARACTERISTIC ip_mf_bas_rgn_1_1_0 "Mf Rgn calibrations: mf_bas at rgn level 1, inj conf 1 and temp level 0" MAP 0x8522f2 _REC_MAP_20_u2_u2_u2 262.14 _CNV_A_R_LINEAR_____396_CM -20. 242.14 DISPLAY_IDENTIFIER IP_MF_BAS_RGN_1_1_0
 /begin AXIS_DESCR COM_AXIS n _CNV_A_R_LINEAR_____5_CM 16 0. 6375. FORMAT "%4.0" AXIS_PTS_REF ldp_n_ip_mf_bas_rgn_1_1_0 /end AXIS_DESCR
 /begin AXIS_DESCR COM_AXIS tqi_sp _CNV_A_R_LINEAR_____89_CM 16 -1024. 1023.96875 FORMAT "%6.2" AXIS_PTS_REF ldp_tqi_sp_ip_mf_bas_rgn_1_1_0 /end AXIS_DESCR
/end CHARACTERISTIC
/begin AXIS_PTS ldp_n_ip_mf_bas_rgn_1_1_0 "mf_bas at rgn level 1, inj conf 1 and temp level 0" 0x841c66 n _REC_AXS_20_u2 6375. _CNV_A_R_LINEAR_____5_CM 16 0. 6375. FORMAT "%4.0" /end AXIS_PTS
/begin AXIS_PTS ldp_tqi_sp_ip_mf_bas_rgn_1_1_0 "mf_bas at rgn level 1, inj conf 1 and temp level 0" 0x842e5c tqi_sp _REC_AXS_20_u2 2047.96875 _CNV_A_R_LINEAR_____89_CM 16 -1024. 1023.96875 FORMAT "%6.2" /end AXIS_PTS
/begin CHARACTERISTIC ip_mf_bas_rgn_1_2_0 "Mf Rgn calibrations: mf_bas at rgn level 1, inj conf 2 and temp level 0" MAP 0x8524f2 _REC_MAP_20_u2_u2_u2 262.14 _CNV_A_R_LINEAR_____396_CM -20. 242.14 DISPLAY_IDENTIFIER IP_MF_BAS_RGN_1_2_0
 /begin AXIS_DESCR COM_AXIS n _CNV_A_R_LINEAR_____5_CM 16 0. 6375. FORMAT "%4.0" AXIS_PTS_REF ldp_n_ip_mf_bas_rgn_1_2_0 /end AXIS_DESCR
 /begin AXIS_DESCR COM_AXIS tqi_sp _CNV_A_R_LINEAR_____89_CM 16 -1024. 1023.96875 FORMAT "%6.2" AXIS_PTS_REF ldp_tqi_sp_ip_mf_bas_rgn_1_2_0 /end AXIS_DESCR
/end CHARACTERISTIC
/begin AXIS_PTS ldp_n_ip_mf_bas_rgn_1_2_0 "mf_bas at rgn level 1, inj conf 2 and temp level 0" 0x841c88 n _REC_AXS_20_u2 6375. _CNV_A_R_LINEAR_____5_CM 16 0. 6375. FORMAT "%4.0" /end AXIS_PTS
/begin AXIS_PTS ldp_tqi_sp_ip_mf_bas_rgn_1_2_0 "mf_bas at rgn level 1, inj conf 2 and temp level 0" 0x842e7e tqi_sp _REC_AXS_20_u2 2047.96875 _CNV_A_R_LINEAR_____89_CM 16 -1024. 1023.96875 FORMAT "%6.2" /end AXIS_PTS
/begin CHARACTERISTIC ip_mf_bas_rgn_1_3_0 "Mf Rgn calibrations: mf_bas at rgn level 1, inj conf 3 and temp level 0" MAP 0x8526f2 _REC_MAP_20_u2_u2_u2 262.14 _CNV_A_R_LINEAR_____396_CM -20. 242.14 DISPLAY_IDENTIFIER IP_MF_BAS_RGN_1_3_0
 /begin AXIS_DESCR COM_AXIS n _CNV_A_R_LINEAR_____5_CM 16 0. 6375. FORMAT "%4.0" AXIS_PTS_REF ldp_n_ip_mf_bas_rgn_1_3_0 /end AXIS_DESCR
 /begin AXIS_DESCR COM_AXIS tqi_sp _CNV_A_R_LINEAR_____89_CM 16 -1024. 1023.96875 FORMAT "%6.2" AXIS_PTS_REF ldp_tqi_sp_ip_mf_bas_rgn_1_3_0 /end AXIS_DESCR
/end CHARACTERISTIC
/begin AXIS_PTS ldp_n_ip_mf_bas_rgn_1_3_0 "mf_bas at rgn level 1, inj conf 3 and temp level 0" 0x841caa n _REC_AXS_20_u2 6375. _CNV_A_R_LINEAR_____5_CM 16 0. 6375. FORMAT "%4.0" /end AXIS_PTS
/begin AXIS_PTS ldp_tqi_sp_ip_mf_bas_rgn_1_3_0 "mf_bas at rgn level 1, inj conf 3 and temp level 0" 0x842ea0 tqi_sp _REC_AXS_20_u2 2047.96875 _CNV_A_R_LINEAR_____89_CM 16 -1024. 1023.96875 FORMAT "%6.2" /end AXIS_PTS
/begin CHARACTERISTIC ip_mf_bas_rgn_1_4_0 "Mf Rgn calibrations: mf_bas at rgn level 1, inj conf 4 and temp level 0" MAP 0x8528f2 _REC_MAP_20_u2_u2_u2 262.14 _CNV_A_R_LINEAR_____396_CM -20. 242.14 DISPLAY_IDENTIFIER IP_MF_BAS_RGN_1_4_0
 /begin AXIS_DESCR COM_AXIS n _CNV_A_R_LINEAR_____5_CM 16 0. 6375. FORMAT "%4.0" AXIS_PTS_REF ldp_n_ip_mf_bas_rgn_1_4_0 /end AXIS_DESCR
 /begin AXIS_DESCR COM_AXIS tqi_sp _CNV_A_R_LINEAR_____89_CM 16 -1024. 1023.96875 FORMAT "%6.2" AXIS_PTS_REF ldp_tqi_sp_ip_mf_bas_rgn_1_4_0 /end AXIS_DESCR
/end CHARACTERISTIC
/begin AXIS_PTS ldp_n_ip_mf_bas_rgn_1_4_0 "mf_bas at rgn level 1, inj conf 4 and temp level 0" 0x841ccc n _REC_AXS_20_u2 6375. _CNV_A_R_LINEAR_____5_CM 16 0. 6375. FORMAT "%4.0" /end AXIS_PTS
/begin AXIS_PTS ldp_tqi_sp_ip_mf_bas_rgn_1_4_0 "mf_bas at rgn level 1, inj conf 4 and temp level 0" 0x842ec2 tqi_sp _REC_AXS_20_u2 2047.96875 _CNV_A_R_LINEAR_____89_CM 16 -1024. 1023.96875 FORMAT "%6.2" /end AXIS_PTS
/begin CHARACTERISTIC ip_mf_bas_rgn_2_0_0 "Mf Rgn calibrations: mf_bas at rgn level 2, inj conf 0 and temp level 0" MAP 0x852af2 _REC_MAP_20_u2_u2_u2 262.14 _CNV_A_R_LINEAR_____396_CM -20. 242.14 DISPLAY_IDENTIFIER IP_MF_BAS_RGN_2_0_0
 /begin AXIS_DESCR COM_AXIS n _CNV_A_R_LINEAR_____5_CM 16 0. 6375. FORMAT "%4.0" AXIS_PTS_REF ldp_n_ip_mf_bas_rgn_2_0_0 /end AXIS_DESCR
 /begin AXIS_DESCR COM_AXIS tqi_sp _CNV_A_R_LINEAR_____89_CM 16 -1024. 1023.96875 FORMAT "%6.2" AXIS_PTS_REF ldp_tqi_sp_ip_mf_bas_rgn_2_0_0 /end AXIS_DESCR
/end CHARACTERISTIC
/begin AXIS_PTS ldp_n_ip_mf_bas_rgn_2_0_0 "mf_bas at rgn level 2, inj conf 0 and temp level 0" 0x841cee n _REC_AXS_20_u2 6375. _CNV_A_R_LINEAR_____5_CM 16 0. 6375. FORMAT "%4.0" /end AXIS_PTS
/begin AXIS_PTS ldp_tqi_sp_ip_mf_bas_rgn_2_0_0 "mf_bas at rgn level 2, inj conf 0 and temp level 0" 0x842ee4 tqi_sp _REC_AXS_20_u2 2047.96875 _CNV_A_R_LINEAR_____89_CM 16 -1024. 1023.96875 FORMAT "%6.2" /end AXIS_PTS
/begin CHARACTERISTIC ip_mf_bas_rgn_2_1_0 "Mf Rgn calibrations: mf_bas at rgn level 2, inj conf 1 and temp level 0" MAP 0x852cf2 _REC_MAP_20_u2_u2_u2 262.14 _CNV_A_R_LINEAR_____396_CM -20. 242.14 DISPLAY_IDENTIFIER IP_MF_BAS_RGN_2_1_0
 /begin AXIS_DESCR COM_AXIS n _CNV_A_R_LINEAR_____5_CM 16 0. 6375. FORMAT "%4.0" AXIS_PTS_REF ldp_n_ip_mf_bas_rgn_2_1_0 /end AXIS_DESCR
 /begin AXIS_DESCR COM_AXIS tqi_sp _CNV_A_R_LINEAR_____89_CM 16 -1024. 1023.96875 FORMAT "%6.2" AXIS_PTS_REF ldp_tqi_sp_ip_mf_bas_rgn_2_1_0 /end AXIS_DESCR
/end CHARACTERISTIC
/begin AXIS_PTS ldp_n_ip_mf_bas_rgn_2_1_0 "mf_bas at rgn level 2, inj conf 1 and temp level 0" 0x841d10 n _REC_AXS_20_u2 6375. _CNV_A_R_LINEAR_____5_CM 16 0. 6375. FORMAT "%4.0" /end AXIS_PTS
/begin AXIS_PTS ldp_tqi_sp_ip_mf_bas_rgn_2_1_0 "mf_bas at rgn level 2, inj conf 1 and temp level 0" 0x842f06 tqi_sp _REC_AXS_20_u2 2047.96875 _CNV_A_R_LINEAR_____89_CM 16 -1024. 1023.96875 FORMAT "%6.2" /end AXIS_PTS
/begin CHARACTERISTIC ip_mf_bas_rgn_2_2_0 "Mf Rgn calibrations: mf_bas at rgn level 2, inj conf 2 and temp level 0" MAP 0x852ef2 _REC_MAP_20_u2_u2_u2 262.14 _CNV_A_R_LINEAR_____396_CM -20. 242.14 DISPLAY_IDENTIFIER IP_MF_BAS_RGN_2_2_0
 /begin AXIS_DESCR COM_AXIS n _CNV_A_R_LINEAR_____5_CM 1 0. 6375. FORMAT "%4.0" AXIS_PTS_REF ldp_n_ip_mf_bas_rgn_2_2_0 /end AXIS_DESCR
 /begin AXIS_DESCR COM_AXIS tqi_sp _CNV_A_R_LINEAR_____89_CM 1 -1024. 1023.96875 FORMAT "%6.2" AXIS_PTS_REF ldp_tqi_sp_ip_mf_bas_rgn_2_2_0 /end AXIS_DESCR
/end CHARACTERISTIC
/begin AXIS_PTS ldp_n_ip_mf_bas_rgn_2_2_0 "mf_bas at rgn level 2, inj conf 2 and temp level 0" 0x841d32 n _REC_AXS_20_u2 6375. _CNV_A_R_LINEAR_____5_CM 1 0. 6375. FORMAT "%4.0" /end AXIS_PTS
/begin AXIS_PTS ldp_tqi_sp_ip_mf_bas_rgn_2_2_0 "mf_bas at rgn level 2, inj conf 2 and temp level 0" 0x842f28 tqi_sp _REC_AXS_20_u2 2047.96875 _CNV_A_R_LINEAR_____89_CM 1 -1024. 1023.96875 FORMAT "%6.2" /end AXIS_PTS
/begin CHARACTERISTIC ip_mf_bas_rgn_2_3_0 "Mf Rgn calibrations: mf_bas at rgn level 2, inj conf 3 and temp level 0" MAP 0x852ef4 _REC_MAP_20_u2_u2_u2 262.14 _CNV_A_R_LINEAR_____396_CM -20. 242.14 DISPLAY_IDENTIFIER IP_MF_BAS_RGN_2_3_0
 /begin AXIS_DESCR COM_AXIS n _CNV_A_R_LINEAR_____5_CM 1 0. 6375. FORMAT "%4.0" AXIS_PTS_REF ldp_n_ip_mf_bas_rgn_2_3_0 /end AXIS_DESCR
 /begin AXIS_DESCR COM_AXIS tqi_sp _CNV_A_R_LINEAR_____89_CM 1 -1024. 1023.96875 FORMAT "%6.2" AXIS_PTS_REF ldp_tqi_sp_ip_mf_bas_rgn_2_3_0 /end AXIS_DESCR
/end CHARACTERISTIC
/begin AXIS_PTS ldp_n_ip_mf_bas_rgn_2_3_0 "mf_bas at rgn level 2, inj conf 3 and temp level 0" 0x841d36 n _REC_AXS_20_u2 6375. _CNV_A_R_LINEAR_____5_CM 1 0. 6375. FORMAT "%4.0" /end AXIS_PTS
/begin AXIS_PTS ldp_tqi_sp_ip_mf_bas_rgn_2_3_0 "mf_bas at rgn level 2, inj conf 3 and temp level 0" 0x842f2c tqi_sp _REC_AXS_20_u2 2047.96875 _CNV_A_R_LINEAR_____89_CM 1 -1024. 1023.96875 FORMAT "%6.2" /end AXIS_PTS
/begin CHARACTERISTIC ip_mf_bas_rgn_2_4_0 "Mf Rgn calibrations: mf_bas at rgn level 2, inj conf 4 and temp level 0" MAP 0x852ef6 _REC_MAP_20_u2_u2_u2 262.14 _CNV_A_R_LINEAR_____396_CM -20. 242.14 DISPLAY_IDENTIFIER IP_MF_BAS_RGN_2_4_0
 /begin AXIS_DESCR COM_AXIS n _CNV_A_R_LINEAR_____5_CM 1 0. 6375. FORMAT "%4.0" AXIS_PTS_REF ldp_n_ip_mf_bas_rgn_2_4_0 /end AXIS_DESCR
 /begin AXIS_DESCR COM_AXIS tqi_sp _CNV_A_R_LINEAR_____89_CM 1 -1024. 1023.96875 FORMAT "%6.2" AXIS_PTS_REF ldp_tqi_sp_ip_mf_bas_rgn_2_4_0 /end AXIS_DESCR
/end CHARACTERISTIC
/begin AXIS_PTS ldp_n_ip_mf_bas_rgn_2_4_0 "mf_bas at rgn level 2, inj conf 4 and temp level 0" 0x841d3a n _REC_AXS_20_u2 6375. _CNV_A_R_LINEAR_____5_CM 1 0. 6375. FORMAT "%4.0" /end AXIS_PTS
/begin AXIS_PTS ldp_tqi_sp_ip_mf_bas_rgn_2_4_0 "mf_bas at rgn level 2, inj conf 4 and temp level 0" 0x842f30 tqi_sp _REC_AXS_20_u2 2047.96875 _CNV_A_R_LINEAR_____89_CM 1 -1024. 1023.96875 FORMAT "%6.2" /end AXIS_PTS
/begin MEASUREMENT mf_bas_sel_conf_0 "basic fuel mass at injection configuration 0 after temperature selection" UWORD _CNV_A_R_LINEAR_____43_CM 1 0. 0. 262.14 DISPLAY_IDENTIFIER MF_BAS_SEL_CONF_0 ECU_ADDRESS 0x7f9c90 BYTE_ORDER MSB_LAST /end MEASUREMENT
/begin MEASUREMENT mf_bas_sel_conf_1 "basic fuel mass at injection configuration 1 after temperature selection" UWORD _CNV_A_R_LINEAR_____43_CM 1 0. 0. 262.14 DISPLAY_IDENTIFIER MF_BAS_SEL_CONF_1 ECU_ADDRESS 0x7f9c92 BYTE_ORDER MSB_LAST /end MEASUREMENT
/begin MEASUREMENT mf_bas_sel_conf_2 "basic fuel mass at injection configuration 2 after temperature selection" UWORD _CNV_A_R_LINEAR_____43_CM 1 0. 0. 262.14 DISPLAY_IDENTIFIER MF_BAS_SEL_CONF_2 ECU_ADDRESS 0x7f9c94 BYTE_ORDER MSB_LAST /end MEASUREMENT
/begin MEASUREMENT mf_bas_sel_conf_3 "basic fuel mass at injection configuration 3 after temperature selection" UWORD _CNV_A_R_LINEAR_____43_CM 1 0. 0. 262.14 DISPLAY_IDENTIFIER MF_BAS_SEL_CONF_3 ECU_ADDRESS 0x7f9c96 BYTE_ORDER MSB_LAST /end MEASUREMENT
/begin MEASUREMENT mf_bas_sel_conf_4 "basic fuel mass at injection configuration 4 after temperature selection" UWORD _CNV_A_R_LINEAR_____43_CM 1 0. 0. 262.14 DISPLAY_IDENTIFIER MF_BAS_SEL_CONF_4 ECU_ADDRESS 0x7f9c98 BYTE_ORDER MSB_LAST /end MEASUREMENT
/begin MEASUREMENT mf_bas_conf "basic fuel mass, after injection configuration selection" UWORD _CNV_A_R_LINEAR_____396_CM 1 0. -20. 242.14 DISPLAY_IDENTIFIER MF_BAS_CONF ECU_ADDRESS 0x7f9ca2 BYTE_ORDER MSB_LAST /end MEASUREMENT
/begin CHARACTERISTIC c_t_rgn_trn_mf_bas "time constant of rgn transition of mf_bas" VALUE 0x85c11c _REC_VAL_20_u2 4.19424 _CNV_A_R_LINEAR_____67_CM 0. 4.19424 DISPLAY_IDENTIFIER C_T_RGN_TRN_MF_BAS FORMAT "%6.5" /end CHARACTERISTIC
/begin MEASUREMENT sf_inj_psn_move "flag that indicates regeneration during fuel cutoff" UBYTE _CNV_A_R_LINEAR_____0_CM 1 0. 0. 3. DISPLAY_IDENTIFIER SF_INJ_PSN_MOVE ECU_ADDRESS 0x7fb65d FORMAT "%1.0" /end MEASUREMENT
/begin MEASUREMENT lv_act_post_puc "active post injection in PUC" UBYTE _CNV_S_2_RANGE______11_CM 1 0. 0. 1. DISPLAY_IDENTIFIER LV_ACT_POST_PUC ECU_ADDRESS 0x7fb65e /end MEASUREMENT
/begin MEASUREMENT mf_main1 "" UWORD _CNV_A_R_LINEAR_____43_CM 1 0. 0. 262.14 DISPLAY_IDENTIFIER MF_MAIN1 ECU_ADDRESS 0x7f9cb0 BYTE_ORDER MSB_LAST FORMAT "%4.1" /end MEASUREMENT
/begin MEASUREMENT mf_main2 "" UWORD _CNV_A_R_LINEAR_____43_CM 1 0. 0. 262.14 DISPLAY_IDENTIFIER MF_MAIN2 ECU_ADDRESS 0x7f9cba BYTE_ORDER MSB_LAST FORMAT "%4.1" /end MEASUREMENT
/begin MEASUREMENT mf_post1 "" UWORD _CNV_A_R_LINEAR_____43_CM 1 0. 0. 262.14 DISPLAY_IDENTIFIER MF_POST1 ECU_ADDRESS 0x7f9cb2 BYTE_ORDER MSB_LAST FORMAT "%4.1" /end MEASUREMENT
/begin MEASUREMENT mf_post2 "" UWORD _CNV_A_R_LINEAR_____43_CM 1 0. 0. 262.14 DISPLAY_IDENTIFIER MF_POST2 ECU_ADDRESS 0x7f9cb4 BYTE_ORDER MSB_LAST FORMAT "%4.1" /end MEASUREMENT
/begin MEASUREMENT mf_prev1 "" UWORD _CNV_A_R_LINEAR_____43_CM 1 0. 0. 262.14 DISPLAY_IDENTIFIER MF_PREV1 ECU_ADDRESS 0x7f9cb6 BYTE_ORDER MSB_LAST FORMAT "%4.1" /end MEASUREMENT
/begin MEASUREMENT mf_prev2 "" UWORD _CNV_A_R_LINEAR_____43_CM 1 0. 0. 262.14 DISPLAY_IDENTIFIER MF_PREV2 ECU_ADDRESS 0x7f9cb8 BYTE_ORDER MSB_LAST FORMAT "%4.1" /end MEASUREMENT
/begin MEASUREMENT mf_main1_chk "fuel mass of injection MAIN1 after check" UWORD _CNV_A_R_LINEAR_____43_CM 1 0. 0. 262.14 DISPLAY_IDENTIFIER MF_MAIN1_CHK ECU_ADDRESS 0x7f9ca8 BYTE_ORDER MSB_LAST /end MEASUREMENT
/begin MEASUREMENT mf_prev1_chk "fuel mass of injection PREV1 after check" UWORD _CNV_A_R_LINEAR_____43_CM 1 0. 0. 262.14 DISPLAY_IDENTIFIER MF_PREV1_CHK ECU_ADDRESS 0x7f9ca4 BYTE_ORDER MSB_LAST /end MEASUREMENT
/begin MEASUREMENT mf_main2_chk "fuel mass of injection MAIN2 after check" UWORD _CNV_A_R_LINEAR_____43_CM 1 0. 0. 262.14 DISPLAY_IDENTIFIER MF_MAIN2_CHK ECU_ADDRESS 0x7f9caa BYTE_ORDER MSB_LAST /end MEASUREMENT
/begin MEASUREMENT mf_prev2_chk "fuel mass of injection PREV2 after check" UWORD _CNV_A_R_LINEAR_____43_CM 1 0. 0. 262.14 DISPLAY_IDENTIFIER MF_PREV2_CHK ECU_ADDRESS 0x7f9ca6 BYTE_ORDER MSB_LAST /end MEASUREMENT
/begin MEASUREMENT mf_post1_chk "fuel mass of injection POST1 after check" UWORD _CNV_A_R_LINEAR_____43_CM 1 0. 0. 262.14 DISPLAY_IDENTIFIER MF_POST1_CHK ECU_ADDRESS 0x7f9cac BYTE_ORDER MSB_LAST /end MEASUREMENT
/begin MEASUREMENT mf_post2_chk "fuel mass of injection POST2 after check" UWORD _CNV_A_R_LINEAR_____43_CM 1 0. 0. 262.14 DISPLAY_IDENTIFIER MF_POST2_CHK ECU_ADDRESS 0x7f9cae BYTE_ORDER MSB_LAST /end MEASUREMENT
/begin MEASUREMENT lv_soi_prev1_act_st "activation of SOI PREV1 calculation at ST" UBYTE _CNV_A_R_LINEAR_____0_CM 1 0. 0. 1. DISPLAY_IDENTIFIER LV_SOI_PREV1_ACT_ST ECU_ADDRESS 0x7fb71e FORMAT "%1.0" /end MEASUREMENT
/begin MEASUREMENT lv_soi_prev2_act_st "activation of SOI PREV2 calculation at ST" UBYTE _CNV_A_R_LINEAR_____0_CM 1 0. 0. 1. DISPLAY_IDENTIFIER LV_SOI_PREV2_ACT_ST ECU_ADDRESS 0x7fb71f FORMAT "%1.0" /end MEASUREMENT
/begin MEASUREMENT lv_soi_main2_act_is_pl "activation of SOI MAIN2 calculation at IS/PL" UBYTE _CNV_A_R_LINEAR_____0_CM 1 0. 0. 1. DISPLAY_IDENTIFIER LV_SOI_MAIN2_ACT_IS_PL ECU_ADDRESS 0x7fb722 FORMAT "%1.0" /end MEASUREMENT
/begin MEASUREMENT lv_soi_prev1_act_is_pl "activation of SOI PREV1 calculation at IS/PL" UBYTE _CNV_A_R_LINEAR_____0_CM 1 0. 0. 1. DISPLAY_IDENTIFIER LV_SOI_PREV1_ACT_IS_PL ECU_ADDRESS 0x7fb723 FORMAT "%1.0" /end MEASUREMENT
/begin MEASUREMENT lv_soi_prev2_act_is_pl "activation of SOI PREV2 calculation at IS/PL" UBYTE _CNV_A_R_LINEAR_____0_CM 1 0. 0. 1. DISPLAY_IDENTIFIER LV_SOI_PREV2_ACT_IS_PL ECU_ADDRESS 0x7fb724 FORMAT "%1.0" /end MEASUREMENT
/begin MEASUREMENT lv_soi_post1_act_is_pl "activation of SOI POST1 calculation at IS/PL" UBYTE _CNV_A_R_LINEAR_____0_CM 1 0. 0. 1. DISPLAY_IDENTIFIER LV_SOI_POST1_ACT_IS_PL ECU_ADDRESS 0x7fb725 FORMAT "%1.0" /end MEASUREMENT
/begin MEASUREMENT lv_soi_post1_act_st "activation of SOI POST1 calculation at ST" UBYTE _CNV_A_R_LINEAR_____0_CM 1 0. 0. 1. DISPLAY_IDENTIFIER LV_SOI_POST1_ACT_ST ECU_ADDRESS 0x7fb721 FORMAT "%1.0" /end MEASUREMENT
/begin MEASUREMENT lv_soi_main2_act_st "activation of SOI MAIN2 calculation at ST" UBYTE _CNV_A_R_LINEAR_____0_CM 1 0. 0. 1. DISPLAY_IDENTIFIER LV_SOI_MAIN2_ACT_ST ECU_ADDRESS 0x7fb720 FORMAT "%1.0" /end MEASUREMENT
/begin MEASUREMENT lv_conf_inj_ges "flag indicating the injection configuration for the gas exchange system" UBYTE _CNV_A_R_LINEAR_____0_CM 1 0. 0. 1. DISPLAY_IDENTIFIER LV_CONF_INJ_GES ECU_ADDRESS 0x7fb71d FORMAT "%1.0" /end MEASUREMENT
/begin MEASUREMENT sf_conf_inj_soi_rgl "injection configuration region at regular conditions" UBYTE _CNV_A_R_LINEAR_____0_CM 1 0. 0. 4. DISPLAY_IDENTIFIER SF_CONF_INJ_SOI_RGL ECU_ADDRESS 0x7fb71a FORMAT "%1.0" /end MEASUREMENT
/begin MEASUREMENT sf_conf_inj_soi_rgn_1 "injection configuration region at rgn level 1" UBYTE _CNV_A_R_LINEAR_____0_CM 1 0. 0. 4. DISPLAY_IDENTIFIER SF_CONF_INJ_SOI_RGN_1 ECU_ADDRESS 0x7fb71b FORMAT "%1.0" /end MEASUREMENT
/begin MEASUREMENT sf_conf_inj_soi_rgn_2 "injection configuration region at rgn level 2" UBYTE _CNV_A_R_LINEAR_____0_CM 1 0. 0. 4. DISPLAY_IDENTIFIER SF_CONF_INJ_SOI_RGN_2 ECU_ADDRESS 0x7fb71c FORMAT "%1.0" /end MEASUREMENT
/begin CHARACTERISTIC id_conf_inj_ges "SOI: Injection Region for Gas Exchange System" CURVE 0x848908 _REC_CUR_20_u1_u1 1. _CNV_A_R_LINEAR_____0_CM 0. 1. DISPLAY_IDENTIFIER ID_CONF_INJ_GES FORMAT "%1.0"
 /begin AXIS_DESCR COM_AXIS act_inj_coded _CNV_A_R_LINEAR_____0_CM 16 0. 15. FORMAT "%2.0" AXIS_PTS_REF ldpm_sf_conf_inj /end AXIS_DESCR
/end CHARACTERISTIC
/begin CHARACTERISTIC c_rpt_ena[0] "" VALUE 0x8485ae _REC_VAL_20_u1 4. _CNV_S_5_ABYP_RANGE_426_CM 0. 4. DISPLAY_IDENTIFIER C_RPT_ENA_0_ /end CHARACTERISTIC
/begin CHARACTERISTIC c_rpt_ena[1] "" VALUE 0x8485af _REC_VAL_20_u1 4. _CNV_S_5_ABYP_RANGE_426_CM 0. 4. DISPLAY_IDENTIFIER C_RPT_ENA_1_ /end CHARACTERISTIC
/begin CHARACTERISTIC c_rpt_ena[2] "" VALUE 0x8485b0 _REC_VAL_20_u1 4. _CNV_S_5_ABYP_RANGE_426_CM 0. 4. DISPLAY_IDENTIFIER C_RPT_ENA_2_ /end CHARACTERISTIC
/begin CHARACTERISTIC c_rpt_ena[3] "" VALUE 0x8485b1 _REC_VAL_20_u1 4. _CNV_S_5_ABYP_RANGE_426_CM 0. 4. DISPLAY_IDENTIFIER C_RPT_ENA_3_ /end CHARACTERISTIC
/begin CHARACTERISTIC c_rpt_ena[4] "" VALUE 0x8485b2 _REC_VAL_20_u1 4. _CNV_S_5_ABYP_RANGE_426_CM 0. 4. DISPLAY_IDENTIFIER C_RPT_ENA_4_ /end CHARACTERISTIC
/begin CHARACTERISTIC c_rpt_ena[5] "" VALUE 0x8485b3 _REC_VAL_20_u1 4. _CNV_S_5_ABYP_RANGE_426_CM 0. 4. DISPLAY_IDENTIFIER C_RPT_ENA_5_ /end CHARACTERISTIC
/begin CHARACTERISTIC c_rpt_ena[6] "" VALUE 0x8485b4 _REC_VAL_20_u1 4. _CNV_S_5_ABYP_RANGE_426_CM 0. 4. DISPLAY_IDENTIFIER C_RPT_ENA_6_ /end CHARACTERISTIC
/begin CHARACTERISTIC c_rpt_ena[7] "" VALUE 0x8485b5 _REC_VAL_20_u1 4. _CNV_S_5_ABYP_RANGE_426_CM 0. 4. DISPLAY_IDENTIFIER C_RPT_ENA_7_ /end CHARACTERISTIC
/begin CHARACTERISTIC c_rpt_ena[8] "" VALUE 0x8485b6 _REC_VAL_20_u1 4. _CNV_S_5_ABYP_RANGE_426_CM 0. 4. DISPLAY_IDENTIFIER C_RPT_ENA_8_ /end CHARACTERISTIC
/begin CHARACTERISTIC c_rpt_ena[9] "" VALUE 0x8485b7 _REC_VAL_20_u1 4. _CNV_S_5_ABYP_RANGE_426_CM 0. 4. DISPLAY_IDENTIFIER C_RPT_ENA_9_ /end CHARACTERISTIC
/begin CHARACTERISTIC c_rpt_ena[10] "" VALUE 0x8485b8 _REC_VAL_20_u1 4. _CNV_S_5_ABYP_RANGE_426_CM 0. 4. DISPLAY_IDENTIFIER C_RPT_ENA_10_ /end CHARACTERISTIC
/begin CHARACTERISTIC c_rpt_ena[11] "" VALUE 0x8485b9 _REC_VAL_20_u1 4. _CNV_S_5_ABYP_RANGE_426_CM 0. 4. DISPLAY_IDENTIFIER C_RPT_ENA_11_ /end CHARACTERISTIC
/begin CHARACTERISTIC c_rpt_ena[12] "" VALUE 0x8485ba _REC_VAL_20_u1 4. _CNV_S_5_ABYP_RANGE_426_CM 0. 4. DISPLAY_IDENTIFIER C_RPT_ENA_12_ /end CHARACTERISTIC
/begin CHARACTERISTIC c_rpt_ena[13] "" VALUE 0x8485bb _REC_VAL_20_u1 4. _CNV_S_5_ABYP_RANGE_426_CM 0. 4. DISPLAY_IDENTIFIER C_RPT_ENA_13_ /end CHARACTERISTIC
/begin MEASUREMENT rpt_ena[0] "" UBYTE _CNV_S_5_ABYP_RANGE_426_CM 1 0. 0. 4. DISPLAY_IDENTIFIER RPT_ENA_0_ ECU_ADDRESS 0x7fb703 /end MEASUREMENT
/begin MEASUREMENT rpt_ena[1] "" UBYTE _CNV_S_5_ABYP_RANGE_426_CM 1 0. 0. 4. DISPLAY_IDENTIFIER RPT_ENA_1_ ECU_ADDRESS 0x7fb704 /end MEASUREMENT
/begin COMPU_METHOD _CNV_A_R_LINEAR_____0_CM "" RAT_FUNC "%6.3" "[-]" COEFFS 0 1. 0. 0 0 1 /end COMPU_METHOD
/begin COMPU_METHOD _CNV_A_R_LINEAR_____1_CM "" RAT_FUNC "%6.3" "-" COEFFS 0 1. 0. 0 0 1 /end COMPU_METHOD
/begin COMPU_METHOD _CNV_A_R_LINEAR_____5_CM "" RAT_FUNC "%6.3" "[rpm]" COEFFS 0 1. 0. 0 0 1 /end COMPU_METHOD
/begin COMPU_METHOD _CNV_S_2_RANGE______11_CM "" TAB_VERB "%6.3" "[-]" COMPU_TAB_REF _CNV_S_2_RANGE______11 /end COMPU_METHOD
/begin COMPU_VTAB _CNV_S_2_RANGE______11 "" TAB_VERB 2 0 "0" 1 "1" /end COMPU_VTAB
/begin COMPU_METHOD _CNV_A_R_LINEAR_____14_CM "" RAT_FUNC "%6.3" "[-]" COEFFS 0 65535.99999999996 0. 0 0 1 /end COMPU_METHOD
/begin COMPU_METHOD _CNV_A_R_LINEAR_____18_CM "" RAT_FUNC "%6.3" "[°C]" COEFFS 0 1. 50. 0 0 1 /end COMPU_METHOD
/begin COMPU_METHOD _CNV_A_R_LINEAR_____21_CM "" RAT_FUNC "%6.3" "[hPa]" COEFFS 0 12.06017666543982 0. 0 0 1 /end COMPU_METHOD
/begin COMPU_METHOD _CNV_A_R_LINEAR_____23_CM "" RAT_FUNC "%6.3" "[mg/stk]" COEFFS 0 47.18142548596112 0. 0 0 1 /end COMPU_METHOD
/begin COMPU_METHOD _CNV_A_R_LINEAR_____34_CM "" RAT_FUNC "%6.3" "[-]" COEFFS 0 256. 0. 0 0 1 /end COMPU_METHOD
/begin COMPU_METHOD _CNV_A_R_LINEAR_____43_CM "" RAT_FUNC "%6.3" "[mg/stk]" COEFFS 0 250. 0. 0 0 1 /end COMPU_METHOD
/begin COMPU_METHOD _CNV_A_R_LINEAR_____53_CM "" RAT_FUNC "%6.3" "[-]" COEFFS 0 32767.99807357072 0. 0 0 1 /end COMPU_METHOD
/begin COMPU_METHOD _CNV_A_R_LINEAR_____58_CM "" RAT_FUNC "%6.3" "[rpm]" COEFFS 0 3.125e-002 0. 0 0 1 /end COMPU_METHOD
/begin COMPU_METHOD _CNV_A_R_LINEAR_____63_CM "" RAT_FUNC "%6.3" "[-]" COEFFS 0 16383.81262712377 0. 0 0 1 /end COMPU_METHOD
/begin COMPU_METHOD _CNV_A_R_LINEAR_____67_CM "" RAT_FUNC "%6.3" "[s]" COEFFS 0 15625. 0. 0 0 1 /end COMPU_METHOD
/begin COMPU_METHOD _CNV_S_2_RANGE__0___88_CM "" TAB_VERB "%6.3" "-" COMPU_TAB_REF _CNV_S_2_RANGE__0___88 /end COMPU_METHOD
/begin COMPU_VTAB _CNV_S_2_RANGE__0___88 "" TAB_VERB 2 0 "0" 1 "1" /end COMPU_VTAB
/begin COMPU_METHOD _CNV_A_R_LINEAR_____89_CM "" RAT_FUNC "%6.3" "[Nm]" COEFFS 0 32. 32768. 0 0 1 /end COMPU_METHOD
/begin COMPU_METHOD _CNV_A_R_LINEAR_____90_CM "" RAT_FUNC "%6.3" "[-]" COEFFS 0 65535.82575140447 0. 0 0 1 /end COMPU_METHOD
/begin COMPU_METHOD _CNV_A_R_LINEAR_____119_CM "" RAT_FUNC "%6.3" "[MPa]" COEFFS 0 327.680000069121 32768.0000069121 0 0 1 /end COMPU_METHOD
/begin COMPU_METHOD _CNV_A_R_LINEAR_____133_CM "" RAT_FUNC "%6.3" "[mg/stk]" COEFFS 0 250. 32768. 0 0 1 /end COMPU_METHOD
/begin COMPU_METHOD _CNV_A_R_LINEAR_____396_CM "" RAT_FUNC "%6.3" "[mg/stk]" COEFFS 0 250. 5000. 0 0 1 /end COMPU_METHOD
/begin COMPU_METHOD _CNV_S_5_ABYP_RANGE_426_CM "" TAB_VERB "%6.3" "-" COMPU_TAB_REF _CNV_S_5_ABYP_RANGE_426 /end COMPU_METHOD
/begin COMPU_VTAB _CNV_S_5_ABYP_RANGE_426 "" TAB_VERB 5 0 "BYP_TYP_OFF" 1 "BYP_TYP_EXT_INCL" 2 "BYP_TYP_EXT_EXCL" 3 "BYP_TYP_IT_INCL" 4 "BYP_TYP_IT_EXCL" /end COMPU_VTAB
/begin RECORD_LAYOUT _REC_VAL_20_u1 FNC_VALUES 1 UBYTE COLUMN_DIR DIRECT /end RECORD_LAYOUT
/begin RECORD_LAYOUT _REC_AXS_20_u2 NO_AXIS_PTS_X 1 UWORD AXIS_PTS_X 2 UWORD INDEX_INCR DIRECT /end RECORD_LAYOUT
/begin RECORD_LAYOUT _REC_MAP_20_u2_u2_u2 FNC_VALUES 1 UWORD COLUMN_DIR DIRECT /end RECORD_LAYOUT
/begin RECORD_LAYOUT _REC_VAL_20_u2 FNC_VALUES 1 UWORD COLUMN_DIR DIRECT /end RECORD_LAYOUT
/begin RECORD_LAYOUT _REC_AXS_20_u1 NO_AXIS_PTS_X 1 UBYTE AXIS_PTS_X 2 UBYTE INDEX_INCR DIRECT /end RECORD_LAYOUT
/begin RECORD_LAYOUT _REC_CUR_20_u2_u2 FNC_VALUES 1 UWORD COLUMN_DIR DIRECT /end RECORD_LAYOUT
/begin RECORD_LAYOUT _REC_CUR_20_u2_u1 FNC_VALUES 1 UWORD COLUMN_DIR DIRECT /end RECORD_LAYOUT
/begin RECORD_LAYOUT _REC_MAP_20_u2_u2_u1 FNC_VALUES 1 UWORD COLUMN_DIR DIRECT /end RECORD_LAYOUT
/begin RECORD_LAYOUT _REC_CUR_20_u1_u1 FNC_VALUES 1 UBYTE COLUMN_DIR DIRECT /end RECORD_LAYOUT
/begin RECORD_LAYOUT _REC_VAL_20_u4 FNC_VALUES 1 ULONG COLUMN_DIR DIRECT /end RECORD_LAYOUT
/begin FUNCTION MF_AMFSLM "Smoke limitation (fuel mass)"
 /begin DEF_CHARACTERISTIC lc_mf_slm_is_act c_crlc_maf_slm lc_swi_temp_slm ip_fac_mf_slm__tco ldp_tco_ip_fac_mf_slm ip_fac_mf_slm__amp ldp_amp_ip_fac_mf_slm ip_fac_mf_slm__temp_slm ldp_temp_slm_ip_fac_mf_slm ip_mf_slm_bas__n__maf_fil ldpm_n_ip_mf_slm_bas ldpm_maf_fil_ip_mf_slm_bas ip_mf_slm_cor_amp__n__amp ldpm_n_ip_mf_slm ldp_amp_ip_mf_slm_cor_amp ip_mf_slm_tfu_lim__n__tfu ldp_tfu_ip_mf_slm_tfu_lim ip_mf_slm_cor_tco__n__maf ldp_maf_ip_mf_slm_cor_tco ip_mf_slm_cor_fup__n__fup_tra_d ldp_fup_tra_d_ip_mf_slm_cor_fup ip_mf_slm_cor_temp_slm__n__maf ldp_maf_ip_mf_slm_cor_temp_slm ip_mf_slm_bas_rgn__n__maf_fil /end DEF_CHARACTERISTIC
 /begin OUT_MEASUREMENT lv_mf_slm_act mf_slm maf_fil_slm mf_slm_cor_fup mf_slm_cor_tco mf_slm_cor_temp_slm temp_slm /end OUT_MEASUREMENT
/end FUNCTION
/begin FUNCTION MF_AMF_INJCOR ""
 /begin DEF_CHARACTERISTIC c_sf_prev2_cor_rgn_1 c_sf_prev2_cor_rgn_2 c_sf_main2_cor_rgn_1 c_sf_main2_cor_rgn_2 c_sf_post1_cor_rgn_1 c_sf_post1_cor_rgn_2 c_sf_bas_cor_rgn_1 c_sf_bas_cor_rgn_2 c_sf_prev1_cor_rgn_1 c_sf_prev1_cor_rgn_2 /end DEF_CHARACTERISTIC
 /begin OUT_MEASUREMENT mf_prev1_cor mf_prev2_cor mf_main2_cor mf_post1_cor mf_bas_cor_conf_0 mf_bas_cor_conf_1 mf_bas_cor_conf_2 mf_bas_cor_conf_3 mf_bas_cor_conf_4 sf_bas_cor_rgn_1 sf_bas_cor_rgn_2 sf_prev1_cor_rgn_1 sf_prev2_cor_rgn_1 sf_main2_cor_rgn_1 sf_post1_cor_rgn_1 sf_prev2_cor_rgn_2 sf_prev1_cor_rgn_2 sf_main2_cor_rgn_2 sf_post1_cor_rgn_2 /end OUT_MEASUREMENT
/end FUNCTION
/begin FUNCTION MF_AMF_MINOR_TEMP ""
 /begin OUT_MEASUREMENT mf_prev1_bas_sel mf_prev2_bas_sel mf_main2_bas_sel mf_post1_bas_sel /end OUT_MEASUREMENT
/end FUNCTION
/begin FUNCTION MF_AMF_TEMP_LEVEL "" /begin OUT_MEASUREMENT lv_temp_inter_sel /end OUT_MEASUREMENT /end FUNCTION
/begin FUNCTION MF_AMF_MINOR_ACT ""
 /begin DEF_CHARACTERISTIC lc_inj_prev1_on c_n_32_max_inj_prev1 lc_inj_prev2_on c_n_32_max_inj_prev2 lc_inj_main2_on c_n_32_max_inj_main2 lc_inj_post1_on c_n_32_max_inj_post1 /end DEF_CHARACTERISTIC
 /begin OUT_MEASUREMENT lv_act_prev1_inj_bas lv_act_prev2_inj_bas lv_act_main2_inj_bas lv_act_post1_inj_bas lv_mf_prev1_bas_clc lv_mf_prev2_bas_clc lv_mf_main2_bas_clc lv_mf_post1_bas_clc /end OUT_MEASUREMENT
/end FUNCTION
/begin FUNCTION MF_AMF_MINOR_ST "Fuel Mass of Minor Injections at ST"
 /begin DEF_CHARACTERISTIC ldpm_amp_2_inj ldpm_n_3_inj ldpm_tco_2_inj ldpm_n_4_inj ldpm_tco_3_inj ip_fac_mf_prev1_st_cor_amp ip_fac_mf_prev1_st_cor_tia ldpm_tia_2_inj ip_mf_prev1_st ip_mf_prev1_st_cor_amp ip_mf_prev1_st_cor_tia ip_fac_mf_prev2_st_cor_amp ip_fac_mf_prev2_st_cor_tia ip_mf_prev2_st ip_mf_prev2_st_cor_amp ip_mf_prev2_st_cor_tia ip_fac_mf_main2_st_cor_amp ip_fac_mf_main2_st_cor_tia ip_mf_main2_st ip_mf_main2_st_cor_amp ip_mf_main2_st_cor_tia ip_fac_mf_post1_st_cor_amp ip_fac_mf_post1_st_cor_tia ip_mf_post1_st ip_mf_post1_st_cor_amp ip_mf_post1_st_cor_tia ldp_tia_2_inj_x /end DEF_CHARACTERISTIC
 /begin OUT_MEASUREMENT mf_prev1_st mf_prev2_st mf_main2_st mf_post1_st /end OUT_MEASUREMENT
/end FUNCTION
/begin FUNCTION MF_AMF_MINOR ""
 /begin DEF_CHARACTERISTIC c_mf_prev1_max ip_fac_mf_prev1_cor_tco ldp_tco_ip_fac_mf_prev1_cor ip_fac_mf_prev1_cor_amp ldp_amp_ip_fac_mf_prev1_cor ip_fac_mf_prev1_cor_tgas ldp_tgas_ip_fac_mf_prev1_cor ip_mf_prev1_0_0 ldpm_n_1_ip_mf_prev1 ldpm_tqi_sp_1_ip_mf_prev1 ip_mf_prev1_0_1 ip_mf_prev1_0_2 ip_mf_prev1_amp ldp_n_ip_mf_prev1_amp ldp_tqi_sp_ip_mf_prev1_amp ip_mf_prev1_tgas ldp_n_ip_mf_prev1_tgas ldp_tqi_sp_ip_mf_prev1_tgas c_mf_prev2_max ip_fac_mf_prev2_cor_tco ldp_tco_ip_fac_mf_prev2_cor ip_fac_mf_prev2_cor_amp ldp_amp_ip_fac_mf_prev2_cor ip_fac_mf_prev2_cor_tgas ldp_tgas_ip_fac_mf_prev2_cor ip_mf_prev2_0_0 ldpm_n_1_ip_mf_prev2 ldpm_tqi_sp_1_ip_mf_prev2 ip_mf_prev2_0_1 ip_mf_prev2_0_2 ip_mf_prev2_amp ldp_n_ip_mf_prev2_amp ldp_tqi_sp_ip_mf_prev2_amp ip_mf_prev2_tgas ldp_n_ip_mf_prev2_tgas ldp_tqi_sp_ip_mf_prev2_tgas c_mf_main2_max ip_fac_mf_main2_cor_tco ldp_tco_ip_fac_mf_main2_cor ip_fac_mf_main2_cor_amp ldp_amp_ip_fac_mf_main2_cor ip_fac_mf_main2_cor_tgas ldp_tgas_ip_fac_mf_main2_cor ip_mf_main2_0_0 ldpm_n_1_ip_mf_main2 ldpm_tqi_sp_1_ip_mf_main2 ip_mf_main2_0_1 ip_mf_main2_0_2 ip_mf_main2_amp ldp_n_ip_mf_main2_amp ldp_tqi_sp_ip_mf_main2_amp ip_mf_main2_tgas ldp_n_ip_mf_main2_tgas ldp_tqi_sp_ip_mf_main2_tgas c_mf_post1_max ip_fac_mf_post1_cor_tco ldp_tco_ip_fac_mf_post1_cor ip_fac_mf_post1_cor_amp ldp_amp_ip_fac_mf_post1_cor ip_fac_mf_post1_cor_tgas ldp_tgas_ip_fac_mf_post1_cor ip_mf_post1_0_0 ldpm_n_1_ip_mf_post1 ldpm_tqi_sp_1_ip_mf_post1 ip_mf_post1_0_1 ip_mf_post1_0_2 ip_mf_post1_amp ldp_n_ip_mf_post1_amp ldp_tqi_sp_ip_mf_post1_amp ip_mf_post1_tgas ldp_n_ip_mf_post1_tgas ldp_tqi_sp_ip_mf_post1_tgas /end DEF_CHARACTERISTIC
 /begin OUT_MEASUREMENT mf_prev1_is_pl_rgl mf_prev2_is_pl_rgl mf_main2_is_pl_rgl mf_post1_is_pl_rgl mf_prev1_cor_rgl mf_prev2_cor_rgl mf_main2_cor_rgl mf_post1_cor_rgl /end OUT_MEASUREMENT
/end FUNCTION
/begin FUNCTION MF_AMF_INJMIN "Minimal Injection Fuel Mass" /begin DEF_CHARACTERISTIC c_mf_inj_min /end DEF_CHARACTERISTIC /begin OUT_MEASUREMENT mf_inj_min /end OUT_MEASUREMENT /end FUNCTION
/begin FUNCTION MF_AMFSTBAS "" /begin DEF_CHARACTERISTIC c_max_thd_hys c_min_thd_hys /end DEF_CHARACTERISTIC
 /begin OUT_MEASUREMENT mf_prev1_req mf_prev2_req mf_main2_req mf_post1_req ctr_tran_st_is_inter lv_act_prev1_inj lv_act_prev2_inj lv_act_main2_inj lv_act_post1_inj mf_post2_hys mf_prev1_hys mf_prev2_hys mf_main2_hys mf_post1_hys lv_act_prev_inj /end OUT_MEASUREMENT
/end FUNCTION
/begin FUNCTION MF_AMF_MINOR_RGN ""
 /begin DEF_CHARACTERISTIC ldp_tgas_ip_fac_mf_main2_rgn_1 ldp_tco_ip_fac_mf_main2_cor_rgn_1 ldp_amp_ip_fac_mf_main2_rgn_1 ldpm_n_1_ip_mf_main2_rgn_1 ldpm_tqi_ip_mf_main2_rgn_1 ldp_n_ip_mf_main2_rgn_1_0_1 ldp_n_ip_mf_main2_rgn_1_0_2 ldp_n_ip_mf_main2_amp_rgn_1 ldp_tqi_sp_ip_mf_main2_rgn_1_0_1 ldp_tqi_sp_ip_mf_main2_rgn_1_0_2 ldp_tqi_ip_mf_main2_tgas_rgn_1 ldp_tqi_ip_mf_main2_amp_rgn_1 ip_fac_mf_main2_cor_tco_rgn_1 ip_fac_mf_main2_cor_tgas_rgn_1 ip_fac_mf_main2_cor_amp_rgn_1 ip_mf_main2_rgn_1_0_0 ip_mf_main2_rgn_1_0_1 ip_mf_main2_rgn_1_0_2 ip_mf_main2_amp_rgn_1 ldp_n_ip_mf_main2_tgas_rgn_1 ldp_tco_ip_fac_mf_prev1_cor_rgn_1 ldp_tco_ip_fac_mf_prev2_cor_rgn_1 ldp_tco_ip_fac_mf_post1_cor_rgn_1 ldp_tgas_ip_fac_mf_prev1_rgn_1 ldp_tgas_ip_fac_mf_prev2_rgn_1 ldp_tgas_ip_fac_mf_post1_rgn_1 ldp_amp_ip_fac_mf_prev1_rgn_1 ldp_amp_ip_fac_mf_prev2_rgn_1 ldp_amp_ip_fac_mf_post1_rgn_1 ldpm_n_1_ip_mf_main2_rgn_2 ldpm_tqi_ip_mf_main2_rgn_2 ldpm_n_1_ip_mf_prev1_rgn_1 ldpm_tqi_ip_mf_prev1_rgn_1 ldpm_n_1_ip_mf_prev1_rgn_2 ldpm_tqi_ip_mf_prev1_rgn_2 ldpm_n_1_ip_mf_prev2_rgn_1 ldpm_tqi_ip_mf_prev2_rgn_1 ldpm_n_1_ip_mf_prev2_rgn_2 ldpm_tqi_ip_mf_prev2_rgn_2 ldpm_n_1_ip_mf_post1_rgn_1 ldpm_tqi_ip_mf_post1_rgn_1 ldpm_n_1_ip_mf_post1_rgn_2 ldpm_tqi_ip_mf_post1_rgn_2 ldp_n_ip_mf_prev1_rgn_1_0_1 ldp_tqi_sp_ip_mf_prev1_rgn_1_0_1 ldp_n_ip_mf_prev2_rgn_1_0_1 ldp_tqi_sp_ip_mf_prev2_rgn_1_0_1 ldp_n_ip_mf_post1_rgn_1_0_1 ldp_tqi_sp_ip_mf_post1_rgn_1_0_1 ldp_n_ip_mf_prev1_rgn_1_0_2 ldp_tqi_sp_ip_mf_prev1_rgn_1_0_2 ldp_n_ip_mf_prev2_rgn_1_0_2 ldp_tqi_sp_ip_mf_prev2_rgn_1_0_2 ldp_n_ip_mf_post1_rgn_1_0_2 ldp_tqi_sp_ip_mf_post1_rgn_1_0_2 ldp_n_ip_mf_prev1_tgas_rgn_1 ldp_tqi_ip_mf_prev1_tgas_rgn_1 ldp_n_ip_mf_prev2_tgas_rgn_1 ldp_tqi_ip_mf_prev2_tgas_rgn_1 ldp_n_ip_mf_post1_tgas_rgn_1 ldp_tqi_ip_mf_post1_tgas_rgn_1 ldp_n_ip_mf_prev1_amp_rgn_1 ldp_tqi_ip_mf_prev1_amp_rgn_1 ldp_n_ip_mf_prev2_amp_rgn_1 ldp_tqi_ip_mf_prev2_amp_rgn_1 ldp_n_ip_mf_post1_amp_rgn_1 ldp_tqi_ip_mf_post1_amp_rgn_1 ip_fac_mf_post1_cor_tco_rgn_1 ip_fac_mf_prev1_cor_tco_rgn_1 ip_fac_mf_post1_cor_tgas_rgn_1 ip_fac_mf_prev1_cor_tgas_rgn_1 ip_fac_mf_prev2_cor_tgas_rgn_1 ip_fac_mf_post1_cor_amp_rgn_1 ip_fac_mf_prev1_cor_amp_rgn_1 ip_fac_mf_prev2_cor_amp_rgn_1 ip_mf_post1_rgn_1_0_0 ip_mf_prev1_rgn_1_0_0 ip_mf_prev2_rgn_1_0_0 ip_mf_main2_rgn_2_0_0 ip_mf_post1_rgn_2_0_0 ip_mf_prev1_rgn_2_0_0 ip_mf_prev2_rgn_2_0_0 ip_mf_post1_rgn_1_0_1 ip_mf_prev1_rgn_1_0_1 ip_mf_prev2_rgn_1_0_1 ip_mf_post1_rgn_1_0_2 ip_mf_prev1_rgn_1_0_2 ip_mf_prev2_rgn_1_0_2 ip_mf_main2_tgas_rgn_1 ip_mf_post1_tgas_rgn_1 ip_mf_prev1_tgas_rgn_1 ip_mf_prev2_tgas_rgn_1 ip_mf_post1_amp_rgn_1 ip_mf_prev1_amp_rgn_1 ip_mf_prev2_amp_rgn_1 /end DEF_CHARACTERISTIC
 /begin OUT_MEASUREMENT mf_prev2_is_pl_rgn_1 mf_main2_is_pl_rgn_1 mf_post1_is_pl_rgn_1 mf_prev1_is_pl_rgn_2 mf_prev2_is_pl_rgn_2 mf_main2_is_pl_rgn_2 mf_post1_is_pl_rgn_2 mf_prev1_is_pl_rgn_1 /end OUT_MEASUREMENT
/end FUNCTION
/begin FUNCTION MF_AMF_MINOR_TRAN ""
 /begin DEF_CHARACTERISTIC c_t_rgn_trn_mf_prev1 c_t_rgn_trn_mf_prev2 c_t_rgn_trn_mf_main2 c_t_rgn_trn_mf_post1 /end DEF_CHARACTERISTIC
 /begin OUT_MEASUREMENT mf_prev1_is_pl mf_prev2_is_pl mf_main2_is_pl mf_post1_is_pl /end OUT_MEASUREMENT
/end FUNCTION
/begin FUNCTION MF_AMF_MAIN ""
 /begin DEF_CHARACTERISTIC ip_fac_mf_bas_cor_tgas_0_0 ldp_tgas_ip_fac_mf_bas_cor_0_0 ip_fac_mf_bas_cor_tgas_1_0 ldp_tgas_ip_fac_mf_bas_cor_1_0 ip_fac_mf_bas_cor_tgas_2_0 ldp_tgas_ip_fac_mf_bas_cor_2_0 ip_fac_mf_bas_cor_tgas_3_0 ldp_tgas_ip_fac_mf_bas_cor_3_0 ip_fac_mf_bas_cor_tgas_4_0 ldp_tgas_ip_fac_mf_bas_cor_4_0 ip_fac_mf_bas_cor_amp_0_0 ldp_amp_ip_fac_mf_cor_0_0 ip_fac_mf_bas_cor_amp_1_0 ldp_amp_ip_fac_mf_cor_1_0 ip_fac_mf_bas_cor_amp_2_0 ldp_amp_ip_fac_mf_cor_2_0 ip_fac_mf_bas_cor_amp_3_0 ldp_amp_ip_fac_mf_cor_3_0 ip_fac_mf_bas_cor_amp_4_0 ldp_amp_ip_fac_mf_cor_4_0 ip_fac_mf_bas_cor_tco_0_0 ldp_tco_ip_fac_mf_cor_tco_0_0 ip_fac_mf_bas_cor_tco_1_0 ldp_tco_ip_fac_mf_cor_tco_1_0 ip_fac_mf_bas_cor_tco_2_0 ldp_tco_ip_fac_mf_cor_tco_2_0 ip_fac_mf_bas_cor_tco_3_0 ldp_tco_ip_fac_mf_cor_tco_3_0 ip_fac_mf_bas_cor_tco_4_0 ldp_tco_ip_fac_mf_cor_tco_4_0 ip_mf_bas_tgas_0_0 ldp_n_ip_mf_bas_tgas_0_0 ldp_tqi_sp_ip_mf_tgas_0_0 ip_mf_bas_tgas_1_0 ldp_n_ip_mf_bas_tgas_1_0 ldp_tqi_sp_ip_mf_tgas_1_0 ip_mf_bas_tgas_2_0 ldp_n_ip_mf_bas_tgas_2_0 ldp_tqi_sp_ip_mf_tgas_2_0 ip_mf_bas_tgas_3_0 ldp_n_ip_mf_bas_tgas_3_0 ldp_tqi_sp_ip_mf_tgas_3_0 ip_mf_bas_tgas_4_0 ldp_n_ip_mf_bas_tgas_4_0 ldp_tqi_sp_ip_mf_tgas_4_0 ip_mf_bas_amp_0_0 ldp_n_ip_mf_bas_amp_0_0 ldp_tqi_sp_ip_mf_bas_amp_0_0 ip_mf_bas_amp_1_0 ldp_n_ip_mf_bas_amp_1_0 ldp_tqi_sp_ip_mf_bas_amp_1_0 ip_mf_bas_amp_2_0 ldp_n_ip_mf_bas_amp_2_0 ldp_tqi_sp_ip_mf_bas_amp_2_0 ip_mf_bas_amp_3_0 ldp_n_ip_mf_bas_amp_3_0 ldp_tqi_sp_ip_mf_bas_amp_3_0 ip_mf_bas_amp_4_0 ldp_n_ip_mf_bas_amp_4_0 ldp_tqi_sp_ip_mf_bas_amp_4_0 ip_mf_bas_0_0 ip_mf_bas_0_1 ip_mf_bas_0_2 ip_mf_bas_1_0 ip_mf_bas_1_1 ip_mf_bas_1_2 ip_mf_bas_2_0 ip_mf_bas_2_1 ip_mf_bas_2_2 ip_mf_bas_3_0 ip_mf_bas_3_1 ip_mf_bas_3_2 ip_mf_bas_4_0 ip_mf_bas_4_1 ip_mf_bas_4_2 ldpm_n_1_ip_mf_bas_0_0 ldpm_tqi_sp_1_ip_mf_bas_0_0 ldpm_n_1_ip_mf_bas_1_0 ldpm_tqi_sp_1_ip_mf_bas_1_0 ldpm_n_1_ip_mf_bas_2_0 ldp_n_1_ip_mf_bas_2_0_x ldpm_tqi_sp_1_ip_mf_bas_2_0 ldp_tqi_sp_1_ip_mf_bas_2_0_x ldpm_n_1_ip_mf_bas_3_0 ldp_n_1_ip_mf_bas_3_0_x ldpm_tqi_sp_1_ip_mf_bas_3_0 ldp_tqi_sp_1_ip_mf_bas_3_0_x ldpm_n_1_ip_mf_bas_4_0 ldp_n_1_ip_mf_bas_4_0_x ldpm_tqi_sp_1_ip_mf_bas_4_0 ldp_tqi_sp_1_ip_mf_bas_4_0_x /end DEF_CHARACTERISTIC
 /begin OUT_MEASUREMENT mf_bas_rgl mf_bas_cor_sum_rgl /end OUT_MEASUREMENT
/end FUNCTION
/begin FUNCTION MF_AMF_MAIN_RGN ""
 /begin DEF_CHARACTERISTIC ip_fac_mf_bas_cor_tco_rgn_1 ldp_tco_ip_fac_mf_bas_cor_rgn_1 ip_fac_mf_bas_cor_tgas_rgn_1 ldp_tgas_ip_fac_mf_bas_rgn_1 ip_fac_mf_bas_cor_amp_rgn_1 ldp_amp_ip_fac_mf_cor_rgn_1 ip_mf_bas_rgn_1_0_1 ldp_n_ip_mf_bas_rgn_1_0_1 ldp_tqi_sp_ip_mf_bas_rgn_1_0_1 ip_mf_bas_rgn_1_0_2 ldp_n_ip_mf_bas_rgn_1_0_2 ldp_tqi_sp_ip_mf_bas_rgn_1_0_2 ip_mf_bas_tgas_rgn_1 ldp_n_ip_mf_bas_tgas_rgn_1 ldp_tqi_sp_ip_mf_tgas_rgn_1 ip_mf_bas_amp_rgn_1 ldp_n_ip_mf_bas_amp_rgn_1 ldp_tqi_sp_ip_mf_bas_amp_rgn_1 ip_mf_bas_rgn_1_0_0 ldp_n_ip_mf_bas_rgn_1_0_0 ldp_tqi_sp_ip_mf_bas_rgn_1_0_0 ip_mf_bas_rgn_1_1_0 ldp_n_ip_mf_bas_rgn_1_1_0 ldp_tqi_sp_ip_mf_bas_rgn_1_1_0 ip_mf_bas_rgn_1_2_0 ldp_n_ip_mf_bas_rgn_1_2_0 ldp_tqi_sp_ip_mf_bas_rgn_1_2_0 ip_mf_bas_rgn_1_3_0 ldp_n_ip_mf_bas_rgn_1_3_0 ldp_tqi_sp_ip_mf_bas_rgn_1_3_0 ip_mf_bas_rgn_1_4_0 ldp_n_ip_mf_bas_rgn_1_4_0 ldp_tqi_sp_ip_mf_bas_rgn_1_4_0 ip_mf_bas_rgn_2_0_0 ldp_n_ip_mf_bas_rgn_2_0_0 ldp_tqi_sp_ip_mf_bas_rgn_2_0_0 ip_mf_bas_rgn_2_1_0 ldp_n_ip_mf_bas_rgn_2_1_0 ldp_tqi_sp_ip_mf_bas_rgn_2_1_0 ip_mf_bas_rgn_2_2_0 ldp_n_ip_mf_bas_rgn_2_2_0 ldp_tqi_sp_ip_mf_bas_rgn_2_2_0 ip_mf_bas_rgn_2_3_0 ldp_n_ip_mf_bas_rgn_2_3_0 ldp_tqi_sp_ip_mf_bas_rgn_2_3_0 ip_mf_bas_rgn_2_4_0 ldp_n_ip_mf_bas_rgn_2_4_0 ldp_tqi_sp_ip_mf_bas_rgn_2_4_0 /end DEF_CHARACTERISTIC
 /begin OUT_MEASUREMENT mf_bas_is_pl_rgn_1 mf_bas_is_pl_rgn_2 /end OUT_MEASUREMENT
/end FUNCTION
/begin FUNCTION MF_AMF_MAIN_TEMP ""
 /begin OUT_MEASUREMENT mf_bas_sel_conf_0 mf_bas_sel_conf_1 mf_bas_sel_conf_2 mf_bas_sel_conf_3 mf_bas_sel_conf_4 /end OUT_MEASUREMENT
/end FUNCTION
/begin FUNCTION MF_AMF_MAIN_TRAN "" /begin DEF_CHARACTERISTIC c_t_rgn_trn_mf_bas /end DEF_CHARACTERISTIC /begin OUT_MEASUREMENT mf_bas_conf /end OUT_MEASUREMENT /end FUNCTION
/begin FUNCTION MF_AMF_TRAN ""
 /begin OUT_MEASUREMENT sf_inj_psn_move lv_act_post_puc mf_main1 mf_main2 mf_post1 mf_post2 mf_prev1 mf_prev2 /end OUT_MEASUREMENT
/end FUNCTION
/begin FUNCTION MF_AMFSPLIT ""
 /begin OUT_MEASUREMENT mf_main1_chk mf_prev1_chk mf_main2_chk mf_prev2_chk mf_post1_chk mf_post2_chk /end OUT_MEASUREMENT
/end FUNCTION
/begin FUNCTION C_Y_Byp_Sim "C_Y_Byp_Sim" /begin SUB_FUNCTION Bypass_Simulation /end SUB_FUNCTION /end FUNCTION
/begin FUNCTION Bypass_Simulation ""
 /begin DEF_CHARACTERISTIC c_byp_lih_cnt_max_A c_byp_lih_cnt_max_B c_byp_on c_byp_func_A c_byp_func_B c_byp_A_ofs_ch1 c_byp_A_ofs_ch2 c_byp_A_ofs_ch3 c_byp_A_ofs_ch4 c_byp_A_ofs_ch5 c_byp_A_ofs_ch6 c_byp_A_ofs_ch7 c_byp_A_ofs_ch8 c_byp_A_ofs_ch9 c_byp_A_ofs_ch10 c_byp_A_ofs_ch11 c_byp_A_ofs_ch12 c_byp_A_ofs_ch13 c_byp_A_ofs_ch14 c_byp_A_ofs_ch15 c_byp_A_ofs_ch0 c_byp_B_ofs_ch0 c_byp_B_ofs_ch1 c_byp_B_ofs_ch2 c_byp_B_ofs_ch3 c_byp_B_ofs_ch4 c_byp_B_ofs_ch5 c_byp_B_ofs_ch6 c_byp_B_ofs_ch7 c_byp_B_ofs_ch8 c_byp_B_ofs_ch9 c_byp_B_ofs_ch10 c_byp_B_ofs_ch11 c_byp_B_ofs_ch12 c_byp_B_ofs_ch13 c_byp_B_ofs_ch14 c_byp_B_ofs_ch15 c_byp_B_ofs_ch16 c_byp_B_ofs_ch17 c_byp_B_ofs_ch18 c_byp_B_ofs_ch19 c_byp_B_ofs_ch20 c_byp_B_ofs_ch21 c_byp_B_ofs_ch22 c_byp_B_ofs_ch23 c_byp_B_ofs_ch24 c_byp_B_ofs_ch25 c_byp_B_ofs_ch26 c_byp_B_ofs_ch27 c_byp_B_ofs_ch28 c_byp_B_ofs_ch29 c_byp_B_ofs_ch30 c_byp_B_ofs_ch31 c_rpt_ena[0] c_rpt_ena[1] c_rpt_ena[2] c_rpt_ena[3] c_rpt_ena[4] c_rpt_ena[5] c_rpt_ena[6] c_rpt_ena[7] c_rpt_ena[8] c_rpt_ena[9] c_rpt_ena[10] c_rpt_ena[11] c_rpt_ena[12] c_rpt_ena[13] /end DEF_CHARACTERISTIC
 /begin OUT_MEASUREMENT lv_byp_on byp_cnt_A byp_cnt_B byp_error rpt_ena[0] rpt_ena[1] /end OUT_MEASUREMENT
/end FUNCTION
/begin FUNCTION C_Z_SOI ""
 /begin SUB_FUNCTION SOI_ASOI_MINOR_ACT SOI_ASOI_MINOR SOI_ASOI_MINOR_ST SOI_ASOICOR SOI_ASOI_MINOR_TRAN SOI_ASOI_MINOR_TEMP SOI_ASOI_MINOR_RGN SOI_ASOI_TUNE SOI_ASOI_MAIN_ST SOI_ASOI_MAIN SOI_ASOI_MAIN_TEMP SOI_ASOI_MAIN_TRAN SOI_ASOI_MAIN_RGN SOI_ASOITRAN /end SUB_FUNCTION
/end FUNCTION
/begin FUNCTION SOI_ASOI_MINOR_ACT "" /begin DEF_CHARACTERISTIC id_conf_inj_ges /end DEF_CHARACTERISTIC
 /begin OUT_MEASUREMENT lv_soi_prev1_act_st lv_soi_prev2_act_st lv_soi_main2_act_is_pl lv_soi_prev1_act_is_pl lv_soi_prev2_act_is_pl lv_soi_post1_act_is_pl lv_soi_post1_act_st lv_soi_main2_act_st lv_conf_inj_ges sf_conf_inj_soi_rgl sf_conf_inj_soi_rgn_1 sf_conf_inj_soi_rgn_2 /end OUT_MEASUREMENT
/end FUNCTION
/end MODULE
/end PROJECT
