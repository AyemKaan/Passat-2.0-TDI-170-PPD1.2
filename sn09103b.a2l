ASAP2_VERSION 1 41
/begin PROJECT SN0 "SIMOS PPD"
/begin HEADER "_default_HeaderComment" PROJECT_NO PRJ_NUM /end HEADER
/begin MODULE _default_ModuleName "_default_ModuleLongIdentifier"
/begin MOD_COMMON "_default_ModCommonComment" DEPOSIT ABSOLUTE BYTE_ORDER MSB_FIRST ALIGNMENT_BYTE 1 ALIGNMENT_WORD 2 ALIGNMENT_LONG 4 ALIGNMENT_FLOAT32_IEEE 4 ALIGNMENT_FLOAT64_IEEE 8 /end MOD_COMMON
/begin MEASUREMENT n_sp_is_add_comp "additive idle speed setpoint correction for components" UWORD _CNV_A_R_LINEAR_____5_CM 1 0. 0. 6375. DISPLAY_IDENTIFIER N_SP_IS_ADD_COMP ECU_ADDRESS 0x7f9c10 BYTE_ORDER MSB_LAST FORMAT "%4.0" /end MEASUREMENT
/begin MEASUREMENT lv_req_n_sp_is_min "Requirement of minimum idle speed setpoint " UBYTE _CNV_S_2_RANGE______11_CM 1 0. 0. 1. DISPLAY_IDENTIFIER LV_REQ_N_SP_IS_MIN ECU_ADDRESS 0x7fb63c /end MEASUREMENT
/begin MEASUREMENT n_sp_is_min "Minimum Idle Speed Required" UWORD _CNV_A_R_LINEAR_____5_CM 1 0. 0. 6375. DISPLAY_IDENTIFIER N_SP_IS_MIN ECU_ADDRESS 0x7f9c12 BYTE_ORDER MSB_LAST FORMAT "%4.0" /end MEASUREMENT
/begin CHARACTERISTIC c_n_sp_is_add_acin "additive idle speed setpoint aircondition" VALUE 0x85bfc8 _REC_VAL_20_u2 6375. _CNV_A_R_LINEAR_____5_CM 0. 6375. DISPLAY_IDENTIFIER C_N_SP_IS_ADD_ACIN FORMAT "%4.0" /end CHARACTERISTIC
/begin CHARACTERISTIC c_n_sp_is_min_heat "Minimum Idle Speed Required" VALUE 0x85bfcc _REC_VAL_20_u2 6375. _CNV_A_R_LINEAR_____5_CM 0. 6375. DISPLAY_IDENTIFIER C_N_SP_IS_MIN_HEAT FORMAT "%4.0" /end CHARACTERISTIC
/begin CHARACTERISTIC c_n_sp_is_min "maximum idle speed setpoint" VALUE 0x85bfca _REC_VAL_20_u2 6375. _CNV_A_R_LINEAR_____5_CM 0. 6375. DISPLAY_IDENTIFIER C_N_SP_IS_MIN FORMAT "%4.0" /end CHARACTERISTIC
/begin MEASUREMENT lv_efp_rly "" UBYTE _CNV_A_R_LINEAR_____0_CM 1 0. 0. 1. DISPLAY_IDENTIFIER LV_EFP_RLY ECU_ADDRESS 0x7fb728 FORMAT "%1.0" /end MEASUREMENT
/begin MEASUREMENT lv_efp_reset "" UBYTE _CNV_A_R_LINEAR_____0_CM 1 0. 0. 1. DISPLAY_IDENTIFIER LV_EFP_RESET ECU_ADDRESS 0x7fbb47 FORMAT "%1.0" /end MEASUREMENT
/begin MEASUREMENT lv_efp_reset_st "" UBYTE _CNV_A_R_LINEAR_____0_CM 1 0. 0. 1. DISPLAY_IDENTIFIER LV_EFP_RESET_ST ECU_ADDRESS 0x7fbb48 FORMAT "%1.0" /end MEASUREMENT
/begin MEASUREMENT lv_efp_reset_es "" UBYTE _CNV_A_R_LINEAR_____0_CM 1 0. 0. 1. DISPLAY_IDENTIFIER LV_EFP_RESET_ES ECU_ADDRESS 0x7fbb49 FORMAT "%1.0" /end MEASUREMENT
/begin MEASUREMENT lv_cs "" UBYTE _CNV_S_2_RANGE______11_CM 1 0. 0. 1. DISPLAY_IDENTIFIER LV_CS ECU_ADDRESS 0x7fca93 /end MEASUREMENT
/begin MEASUREMENT lv_get_cs "" UBYTE _CNV_S_2_RANGE______11_CM 1 0. 0. 1. DISPLAY_IDENTIFIER LV_GET_CS ECU_ADDRESS 0x7fca94 /end MEASUREMENT
/begin MEASUREMENT lv_cs_raw "" UBYTE _CNV_S_2_RANGE______11_CM 1 0. 0. 1. DISPLAY_IDENTIFIER LV_CS_RAW ECU_ADDRESS 0x7fca95 /end MEASUREMENT
/begin MEASUREMENT lv_cs_fil "" UBYTE _CNV_S_2_RANGE______11_CM 1 0. 0. 1. DISPLAY_IDENTIFIER LV_CS_FIL ECU_ADDRESS 0x7fca96 /end MEASUREMENT
/begin MEASUREMENT t_cs_fil "" UWORD _CNV_A_R_LINEAR_____59_CM 1 0. 0. 655.35 DISPLAY_IDENTIFIER T_CS_FIL ECU_ADDRESS 0x7fc9d4 BYTE_ORDER MSB_LAST FORMAT "%5.2" /end MEASUREMENT
/begin MEASUREMENT sf_clu "" UBYTE _CNV_A_R_LINEAR_____0_CM 1 0. 0. 255. DISPLAY_IDENTIFIER SF_CLU ECU_ADDRESS 0x7fca97 FORMAT "%1.0" /end MEASUREMENT
/begin CHARACTERISTIC c_vs_cs "" VALUE 0x85c2d1 _REC_VAL_20_u1 255. _CNV_A_R_LINEAR_____39_CM 0. 255. DISPLAY_IDENTIFIER C_VS_CS FORMAT "%3.0" /end CHARACTERISTIC
/begin CHARACTERISTIC c_t_max_cs_fil "" VALUE 0x85c0f0 _REC_VAL_20_u2 655.35 _CNV_A_R_LINEAR_____59_CM 0. 655.35 DISPLAY_IDENTIFIER C_T_MAX_CS_FIL FORMAT "%5.2" /end CHARACTERISTIC
/begin CHARACTERISTIC lc_conf_cs "" VALUE 0x85c304 _REC_VAL_20_u1 1. _CNV_A_R_LINEAR_____0_CM 0. 1. DISPLAY_IDENTIFIER LC_CONF_CS FORMAT "%1.0" /end CHARACTERISTIC
/begin CHARACTERISTIC c_cs_sub_diag "" VALUE 0x85bd6a _REC_VAL_20_u1 1. _CNV_A_R_LINEAR_____0_CM 0. 1. DISPLAY_IDENTIFIER C_CS_SUB_DIAG FORMAT "%1.0" /end CHARACTERISTIC
/begin CHARACTERISTIC lc_bts_det_on "" VALUE 0x85c2fe _REC_VAL_20_u1 1. _CNV_A_R_LINEAR_____0_CM 0. 1. DISPLAY_IDENTIFIER LC_BTS_DET_ON FORMAT "%1.0" /end CHARACTERISTIC
/begin CHARACTERISTIC lc_bls_can "" VALUE 0x85c2f3 _REC_VAL_20_u1 1. _CNV_A_R_LINEAR_____0_CM 0. 1. DISPLAY_IDENTIFIER LC_BLS_CAN FORMAT "%2.0" /end CHARACTERISTIC
/begin MEASUREMENT lv_bls "" UBYTE _CNV_S_2_RANGE______11_CM 1 0. 0. 1. DISPLAY_IDENTIFIER LV_BLS ECU_ADDRESS 0x7fb763 /end MEASUREMENT
/begin MEASUREMENT lv_get_bls "" UBYTE _CNV_S_2_RANGE______11_CM 1 0. 0. 1. DISPLAY_IDENTIFIER LV_GET_BLS ECU_ADDRESS 0x7fb766 /end MEASUREMENT
/begin MEASUREMENT lv_get_bts "" UBYTE _CNV_S_2_RANGE______11_CM 1 0. 0. 1. DISPLAY_IDENTIFIER LV_GET_BTS ECU_ADDRESS 0x7fb765 /end MEASUREMENT
/begin MEASUREMENT lv_bts "" UBYTE _CNV_S_2_RANGE______11_CM 1 0. 0. 1. DISPLAY_IDENTIFIER LV_BTS ECU_ADDRESS 0x7fb764 /end MEASUREMENT
/begin MEASUREMENT lv_var_sap "Sekundärluftpumpe verbaut (dsk_byte_0 bit 4)" UBYTE _CNV_S_2_RANGE__0___88_CM 1 0. 0. 1. DISPLAY_IDENTIFIER LV_VAR_SAP ECU_ADDRESS 0x7fb663 BIT_MASK 0x1 /end MEASUREMENT
/begin MEASUREMENT lv_var_sav "ansteuerbares Sekundärluftventil verbaut (dsk_byte_0 bit 5)" UBYTE _CNV_S_2_RANGE__0___88_CM 1 0. 0. 1. DISPLAY_IDENTIFIER LV_VAR_SAV ECU_ADDRESS 0x7fb664 BIT_MASK 0x1 /end MEASUREMENT
/begin MEASUREMENT lv_var_egr "EGR-Ventil verbaut (dsk_byte_0 bit 6)" UBYTE _CNV_S_2_RANGE__0___88_CM 1 0. 0. 1. DISPLAY_IDENTIFIER LV_VAR_EGR ECU_ADDRESS 0x7fb665 BIT_MASK 0x1 /end MEASUREMENT
/begin MEASUREMENT lv_var_knks_2 "2 Klopfsensoren verbaut (dsk_byte_1 bit 5)" UBYTE _CNV_S_2_RANGE__0___88_CM 1 0. 0. 1. DISPLAY_IDENTIFIER LV_VAR_KNKS_2 ECU_ADDRESS 0x7fb66d BIT_MASK 0x1 /end MEASUREMENT
/begin MEASUREMENT lv_var_mil "MIL aktiv (dsk_byte_1 bit 6)" UBYTE _CNV_S_2_RANGE__0___88_CM 1 0. 0. 1. DISPLAY_IDENTIFIER LV_VAR_MIL ECU_ADDRESS 0x7fb66e BIT_MASK 0x1 /end MEASUREMENT
/begin MEASUREMENT lv_var_pwl "Hauptrelais verbaut, d.h. ECF-Diagnose im Nachlauf aktiv (dsk_byte_1 bit 7)" UBYTE _CNV_S_2_RANGE__0___88_CM 1 0. 0. 1. DISPLAY_IDENTIFIER LV_VAR_PWL ECU_ADDRESS 0x7fb66f BIT_MASK 0x1 /end MEASUREMENT
/begin MEASUREMENT lv_var_cps "Tankentlüftungsventil verbaut (dsk_byte_3 bit 3)" UBYTE _CNV_S_2_RANGE__0___88_CM 1 0. 0. 1. DISPLAY_IDENTIFIER LV_VAR_CPS ECU_ADDRESS 0x7fb674 BIT_MASK 0x1 /end MEASUREMENT
/begin MEASUREMENT lv_var_cs "Kupplungsschalter verbaut (dsk_byte_3 bit 4)" UBYTE _CNV_S_2_RANGE__0___88_CM 1 0. 0. 1. DISPLAY_IDENTIFIER LV_VAR_CS ECU_ADDRESS 0x7fb675 BIT_MASK 0x1 /end MEASUREMENT
/begin MEASUREMENT lv_var_can "CAN aktiv (dsk_byte_4 bit 0)" UBYTE _CNV_S_2_RANGE__0___88_CM 1 0. 0. 1. DISPLAY_IDENTIFIER LV_VAR_CAN ECU_ADDRESS 0x7fb679 BIT_MASK 0x1 /end MEASUREMENT
/begin MEASUREMENT lv_var_can_vecu "Bordnetzsteuergerät vorhanden (dsk_byte_4 bit 3)" UBYTE _CNV_S_2_RANGE__0___88_CM 1 0. 0. 1. DISPLAY_IDENTIFIER LV_VAR_CAN_VECU ECU_ADDRESS 0x7fb67c BIT_MASK 0x1 /end MEASUREMENT
/begin MEASUREMENT lv_var_rr_sw "SW Algorithmus zur RR Detektierung verwenden (dsk_byte_4 bit 4)" UBYTE _CNV_S_2_RANGE__0___88_CM 1 0. 0. 1. DISPLAY_IDENTIFIER LV_VAR_RR_SW ECU_ADDRESS 0x7fb67d BIT_MASK 0x1 /end MEASUREMENT
/begin MEASUREMENT lv_var_ac "Klimaanlage verbaut (dsk_byte_0 bit 0)" UBYTE _CNV_S_2_RANGE__0___88_CM 1 0. 0. 1. DISPLAY_IDENTIFIER LV_VAR_AC ECU_ADDRESS 0x7fb660 BIT_MASK 0x1 /end MEASUREMENT
/begin MEASUREMENT lv_var_syn "syncro codiert" UBYTE _CNV_S_2_RANGE__0___88_CM 1 0. 0. 1. DISPLAY_IDENTIFIER LV_VAR_SYN ECU_ADDRESS 0x7fb681 BIT_MASK 0x1 /end MEASUREMENT
/begin MEASUREMENT lv_var_climatronic "Klimatronic codiert" UBYTE _CNV_S_2_RANGE__0___88_CM 1 0. 0. 1. DISPLAY_IDENTIFIER LV_VAR_CLIMATRONIC ECU_ADDRESS 0x7fb682 BIT_MASK 0x1 /end MEASUREMENT
/begin MEASUREMENT lv_var_can_tcs "TCS (traction control) via CAN codiert" UBYTE _CNV_S_2_RANGE__0___88_CM 1 0. 0. 1. DISPLAY_IDENTIFIER LV_VAR_CAN_TCS ECU_ADDRESS 0x7fb683 BIT_MASK 0x1 /end MEASUREMENT
/begin MEASUREMENT lv_var_can_acu "CAN Airbag codiert" UBYTE _CNV_S_2_RANGE__0___88_CM 1 0. 0. 1. DISPLAY_IDENTIFIER LV_VAR_CAN_ACU ECU_ADDRESS 0x7fb686 BIT_MASK 0x1 /end MEASUREMENT
/begin MEASUREMENT lv_var_can_ccu "CAN Klima codiert" UBYTE _CNV_S_2_RANGE__0___88_CM 1 0. 0. 1. DISPLAY_IDENTIFIER LV_VAR_CAN_CCU ECU_ADDRESS 0x7fb687 BIT_MASK 0x1 /end MEASUREMENT
/begin MEASUREMENT lv_var_can_tcu "CAN TCU (transmission control) codiert, d.h.  AT codiert" UBYTE _CNV_S_2_RANGE__0___88_CM 1 0. 0. 1. DISPLAY_IDENTIFIER LV_VAR_CAN_TCU ECU_ADDRESS 0x7fb688 BIT_MASK 0x1 /end MEASUREMENT
/begin MEASUREMENT lv_at "= LV_VAR_CAN_TCU; d.h. AT codiert" UBYTE _CNV_S_2_RANGE__0___88_CM 1 0. 0. 1. DISPLAY_IDENTIFIER LV_AT ECU_ADDRESS 0x7fb689 BIT_MASK 0x1 /end MEASUREMENT
/begin MEASUREMENT lv_var_asr "Traktionskontrolle verbaut" UBYTE _CNV_S_2_RANGE__0___88_CM 1 0. 0. 1. DISPLAY_IDENTIFIER LV_VAR_ASR ECU_ADDRESS 0x7fb684 BIT_MASK 0x1 /end MEASUREMENT
/begin CHARACTERISTIC c_dsk_byte_1 "Datensatzkennung Byte 1" VALUE 0x8483e1 _REC_VAL_20_u1 255. _CNV_A_R_LINEAR_____1_CM 0. 255. DISPLAY_IDENTIFIER C_DSK_BYTE_1 FORMAT "%3.0" /end CHARACTERISTIC
/begin CHARACTERISTIC c_dsk_byte_2 "Datensatzkennung Byte 2" VALUE 0x8483e2 _REC_VAL_20_u1 255. _CNV_A_R_LINEAR_____1_CM 0. 255. DISPLAY_IDENTIFIER C_DSK_BYTE_2 FORMAT "%3.0" /end CHARACTERISTIC
/begin CHARACTERISTIC c_dsk_byte_3 "Datensatzkennung Byte 3" VALUE 0x8483e3 _REC_VAL_20_u1 255. _CNV_A_R_LINEAR_____1_CM 0. 255. DISPLAY_IDENTIFIER C_DSK_BYTE_3 FORMAT "%3.0" /end CHARACTERISTIC
/begin CHARACTERISTIC c_dsk_byte_4 "Datensatzkennung Byte 4" VALUE 0x8483e4 _REC_VAL_20_u1 255. _CNV_A_R_LINEAR_____1_CM 0. 255. DISPLAY_IDENTIFIER C_DSK_BYTE_4 FORMAT "%3.0" /end CHARACTERISTIC
/begin CHARACTERISTIC c_dsk_byte_0 "Datensatzkennung Byte 0" VALUE 0x8483e0 _REC_VAL_20_u1 255. _CNV_A_R_LINEAR_____1_CM 0. 255. DISPLAY_IDENTIFIER C_DSK_BYTE_0 FORMAT "%3.0" /end CHARACTERISTIC
/begin CHARACTERISTIC c_var_code_2 "vorgesehene Variantencodiermöglichkeit über VAG-Tester" VALUE 0x848760 _REC_VAL_20_u2 32767. _CNV_A_R_LINEAR_____0_CM 0. 32767. DISPLAY_IDENTIFIER C_VAR_CODE_2 FORMAT "%5.0" /end CHARACTERISTIC
/begin CHARACTERISTIC c_var_code_3 "vorgesehene Variantencodiermöglichkeit über VAG-Tester" VALUE 0x848762 _REC_VAL_20_u2 32767. _CNV_A_R_LINEAR_____0_CM 0. 32767. DISPLAY_IDENTIFIER C_VAR_CODE_3 FORMAT "%5.0" /end CHARACTERISTIC
/begin CHARACTERISTIC c_var_code_5 "vorgesehene Variantencodiermöglichkeit über VAG-Tester" VALUE 0x848766 _REC_VAL_20_u2 32767. _CNV_A_R_LINEAR_____0_CM 0. 32767. DISPLAY_IDENTIFIER C_VAR_CODE_5 FORMAT "%5.0" /end CHARACTERISTIC
/begin CHARACTERISTIC c_var_code_6 "vorgesehene Variantencodiermöglichkeit über VAG-Tester" VALUE 0x848768 _REC_VAL_20_u2 32767. _CNV_A_R_LINEAR_____0_CM 0. 32767. DISPLAY_IDENTIFIER C_VAR_CODE_6 FORMAT "%5.0" /end CHARACTERISTIC
/begin CHARACTERISTIC c_var_code_7 "vorgesehene Variantencodiermöglichkeit über VAG-Tester" VALUE 0x84876a _REC_VAL_20_u2 32767. _CNV_A_R_LINEAR_____0_CM 0. 32767. DISPLAY_IDENTIFIER C_VAR_CODE_7 FORMAT "%5.0" /end CHARACTERISTIC
/begin CHARACTERISTIC c_var_code_8 "vorgesehene Variantencodiermöglichkeit über VAG-Tester" VALUE 0x84876c _REC_VAL_20_u2 32767. _CNV_A_R_LINEAR_____0_CM 0. 32767. DISPLAY_IDENTIFIER C_VAR_CODE_8 FORMAT "%5.0" /end CHARACTERISTIC
/begin CHARACTERISTIC c_var_code_9 "vorgesehene Variantencodiermöglichkeit über VAG-Tester" VALUE 0x84876e _REC_VAL_20_u2 32767. _CNV_A_R_LINEAR_____0_CM 0. 32767. DISPLAY_IDENTIFIER C_VAR_CODE_9 FORMAT "%5.0" /end CHARACTERISTIC
/begin CHARACTERISTIC c_var_code_10 "vorgesehene Variantencodiermöglichkeit über VAG-Tester" VALUE 0x848752 _REC_VAL_20_u2 32767. _CNV_A_R_LINEAR_____0_CM 0. 32767. DISPLAY_IDENTIFIER C_VAR_CODE_10 FORMAT "%5.0" /end CHARACTERISTIC
/begin CHARACTERISTIC c_var_code_11 "vorgesehene Variantencodiermöglichkeit über VAG-Tester" VALUE 0x848754 _REC_VAL_20_u2 32767. _CNV_A_R_LINEAR_____0_CM 0. 32767. DISPLAY_IDENTIFIER C_VAR_CODE_11 FORMAT "%5.0" /end CHARACTERISTIC
/begin CHARACTERISTIC c_var_code_12 "vorgesehene Variantencodiermöglichkeit über VAG-Tester" VALUE 0x848756 _REC_VAL_20_u2 32767. _CNV_A_R_LINEAR_____0_CM 0. 32767. DISPLAY_IDENTIFIER C_VAR_CODE_12 FORMAT "%5.0" /end CHARACTERISTIC
/begin CHARACTERISTIC c_var_code_13 "vorgesehene Variantencodiermöglichkeit über VAG-Tester" VALUE 0x848758 _REC_VAL_20_u2 32767. _CNV_A_R_LINEAR_____0_CM 0. 32767. DISPLAY_IDENTIFIER C_VAR_CODE_13 FORMAT "%5.0" /end CHARACTERISTIC
/begin CHARACTERISTIC c_var_code_14 "vorgesehene Variantencodiermöglichkeit über VAG-Tester" VALUE 0x84875a _REC_VAL_20_u2 32767. _CNV_A_R_LINEAR_____0_CM 0. 32767. DISPLAY_IDENTIFIER C_VAR_CODE_14 FORMAT "%5.0" /end CHARACTERISTIC
/begin CHARACTERISTIC c_var_code_15 "vorgesehene Variantencodiermöglichkeit über VAG-Tester" VALUE 0x84875c _REC_VAL_20_u2 32767. _CNV_A_R_LINEAR_____0_CM 0. 32767. DISPLAY_IDENTIFIER C_VAR_CODE_15 FORMAT "%5.0" /end CHARACTERISTIC
/begin CHARACTERISTIC c_var_code_1 "vorgesehene Variantencodiermöglichkeit über VAG-Tester" VALUE 0x848750 _REC_VAL_20_u2 32767. _CNV_A_R_LINEAR_____0_CM 0. 32767. DISPLAY_IDENTIFIER C_VAR_CODE_1 FORMAT "%5.0" /end CHARACTERISTIC
/begin CHARACTERISTIC c_var_code_16 "vorgesehene Variantencodiermöglichkeit über VAG-Tester" VALUE 0x84875e _REC_VAL_20_u2 32767. _CNV_A_R_LINEAR_____0_CM 0. 32767. DISPLAY_IDENTIFIER C_VAR_CODE_16 FORMAT "%5.0" /end CHARACTERISTIC
/begin CHARACTERISTIC c_var_code_4 "vorgesehene Variantencodiermöglichkeit über VAG-Tester" VALUE 0x848764 _REC_VAL_20_u2 32767. _CNV_A_R_LINEAR_____0_CM 0. 32767. DISPLAY_IDENTIFIER C_VAR_CODE_4 FORMAT "%5.0" /end CHARACTERISTIC
/begin MEASUREMENT lv_var_ect "elektrisch geschaltetes Thermostat verbaut (dsk_byte_0 bit 3)" UBYTE _CNV_S_2_RANGE__0___88_CM 1 0. 0. 1. DISPLAY_IDENTIFIER LV_VAR_ECT ECU_ADDRESS 0x7fb662 BIT_MASK 0x1 /end MEASUREMENT
/begin MEASUREMENT lv_var_can_bem "CAN-Energiemanager verbaut (dsk_byte_4 bit 6)" UBYTE _CNV_S_2_RANGE__0___88_CM 1 0. 0. 1. DISPLAY_IDENTIFIER LV_VAR_CAN_BEM ECU_ADDRESS 0x7fb67f BIT_MASK 0x1 /end MEASUREMENT
/begin MEASUREMENT lv_var_vim "Schaltsaugrohr verbaut (dsk_byte_0 bit 7)" UBYTE _CNV_S_2_RANGE__0___88_CM 1 0. 0. 1. DISPLAY_IDENTIFIER LV_VAR_VIM ECU_ADDRESS 0x7fb666 BIT_MASK 0x1 /end MEASUREMENT
/begin MEASUREMENT lv_var_vim_1 "Schaltsaugrohr 1 verbaut (dsk_byte_3 bit 6)" UBYTE _CNV_S_2_RANGE__0___88_CM 1 0. 0. 1. DISPLAY_IDENTIFIER LV_VAR_VIM_1 ECU_ADDRESS 0x7fb677 BIT_MASK 0x1 /end MEASUREMENT
/begin MEASUREMENT lv_var_vim_2 "Schaltsaugrohr 2 verbaut (dsk_byte_3 bit 6)" UBYTE _CNV_S_2_RANGE__0___88_CM 1 0. 0. 1. DISPLAY_IDENTIFIER LV_VAR_VIM_2 ECU_ADDRESS 0x7fb678 BIT_MASK 0x1 /end MEASUREMENT
/begin MEASUREMENT lv_var_ecfpwm "PWM-gesteuerter Kühlerlüfter verbaut (dsk_byte_0 bit 2)" UBYTE _CNV_S_2_RANGE__0___88_CM 1 0. 0. 1. DISPLAY_IDENTIFIER LV_VAR_ECFPWM ECU_ADDRESS 0x7fb661 BIT_MASK 0x1 /end MEASUREMENT
/begin MEASUREMENT lv_var_ecfpwm_1 "erster PWM-Kühlerlüfter verbaut (dsk_byte_1 bit 0)" UBYTE _CNV_S_2_RANGE__0___88_CM 1 0. 0. 1. DISPLAY_IDENTIFIER LV_VAR_ECFPWM_1 ECU_ADDRESS 0x7fb667 BIT_MASK 0x1 /end MEASUREMENT
/begin MEASUREMENT lv_var_ecfpwm_2 "zweiter PWM-Kühlerlüfter verbaut (dsk_byte_1 bit 0)" UBYTE _CNV_S_2_RANGE__0___88_CM 1 0. 0. 1. DISPLAY_IDENTIFIER LV_VAR_ECFPWM_2 ECU_ADDRESS 0x7fb668 BIT_MASK 0x1 /end MEASUREMENT
/begin MEASUREMENT lv_dct "Doppelkupplungsgetriebe verbaut" UBYTE _CNV_S_2_RANGE__0___88_CM 1 0. 0. 1. DISPLAY_IDENTIFIER LV_DCT ECU_ADDRESS 0x7fb68a BIT_MASK 0x1 /end MEASUREMENT
/begin MEASUREMENT lv_cvt "CVT-Getriebe verbaut" UBYTE _CNV_S_2_RANGE__0___88_CM 1 0. 0. 1. DISPLAY_IDENTIFIER LV_CVT ECU_ADDRESS 0x7fb68b BIT_MASK 0x1 /end MEASUREMENT
/begin MEASUREMENT lv_var_msr "MSR Funktion vorhanden" UBYTE _CNV_S_2_RANGE__0___88_CM 1 0. 0. 1. DISPLAY_IDENTIFIER LV_VAR_MSR ECU_ADDRESS 0x7fb685 BIT_MASK 0x1 /end MEASUREMENT
/begin MEASUREMENT lv_var_vim_fb "VIM_FB  built in " UBYTE _CNV_S_2_RANGE__0___88_CM 1 0. 0. 1. DISPLAY_IDENTIFIER LV_VAR_VIM_FB ECU_ADDRESS 0x7fb676 BIT_MASK 0x1 /end MEASUREMENT
/begin MEASUREMENT lv_var_can_tog "" UBYTE _CNV_S_2_RANGE__0___88_CM 1 0. 0. 1. DISPLAY_IDENTIFIER LV_VAR_CAN_TOG ECU_ADDRESS 0x7fb680 BIT_MASK 0x1 /end MEASUREMENT
/begin MEASUREMENT lv_var_can_stans "Lenkwinkelsensor vorhanden (dsk_byte_4 bit 2)" UBYTE _CNV_S_2_RANGE__0___88_CM 1 0. 0. 1. DISPLAY_IDENTIFIER LV_VAR_CAN_STANS ECU_ADDRESS 0x7fb67b BIT_MASK 0x1 /end MEASUREMENT
/begin MEASUREMENT lv_var_vcv "Mengensteuerventil verbaut (dsk_byte_1 bit 1)" UBYTE _CNV_S_2_RANGE__0___88_CM 1 0. 0. 1. DISPLAY_IDENTIFIER LV_VAR_VCV ECU_ADDRESS 0x7fb669 BIT_MASK 0x1 /end MEASUREMENT
/begin MEASUREMENT lv_var_port "Ladungsbewegungsklappe verbaut (dsk_byte_1 bit 2)" UBYTE _CNV_S_2_RANGE__0___88_CM 1 0. 0. 1. DISPLAY_IDENTIFIER LV_VAR_PORT ECU_ADDRESS 0x7fb66a BIT_MASK 0x1 /end MEASUREMENT
/begin MEASUREMENT lv_var_cwp "Kühlmittelnachlaufpumpe verbaut (dsk_byte_1 bit 3)" UBYTE _CNV_S_2_RANGE__0___88_CM 1 0. 0. 1. DISPLAY_IDENTIFIER LV_VAR_CWP ECU_ADDRESS 0x7fb66b BIT_MASK 0x1 /end MEASUREMENT
/begin MEASUREMENT lv_var_aeb "aktive Motorlager verbaut (dsk_byte_1 bit 4)" UBYTE _CNV_S_2_RANGE__0___88_CM 1 0. 0. 1. DISPLAY_IDENTIFIER LV_VAR_AEB ECU_ADDRESS 0x7fb66c BIT_MASK 0x1 /end MEASUREMENT
/begin MEASUREMENT lv_var_tldp "Tankleckage-Diagnosepumpe verbaut (dsk_byte_3 bit 0)" UBYTE _CNV_S_2_RANGE__0___88_CM 1 0. 0. 1. DISPLAY_IDENTIFIER LV_VAR_TLDP ECU_ADDRESS 0x7fb673 BIT_MASK 0x1 /end MEASUREMENT
/begin MEASUREMENT lv_var_can_if_cft "CAN-Gateway-Komfort verbaut (dsk_byte_4 bit 1)" UBYTE _CNV_S_2_RANGE__0___88_CM 1 0. 0. 1. DISPLAY_IDENTIFIER LV_VAR_CAN_IF_CFT ECU_ADDRESS 0x7fb67a BIT_MASK 0x1 /end MEASUREMENT
/begin MEASUREMENT lv_var_can_dt_ccp "CAN-Applikation auf Antriebstrang-CAN (dsk_byte_2 bit 0)" UBYTE _CNV_S_2_RANGE__0___88_CM 1 0. 0. 1. DISPLAY_IDENTIFIER LV_VAR_CAN_DT_CCP ECU_ADDRESS 0x7fb670 BIT_MASK 0x1 /end MEASUREMENT
/begin MEASUREMENT lv_var_can_ccp "CAN-Applikation auf Sensor-CAN (dsk_byte_2 bit 1)" UBYTE _CNV_S_2_RANGE__0___88_CM 1 0. 0. 1. DISPLAY_IDENTIFIER LV_VAR_CAN_CCP ECU_ADDRESS 0x7fb671 BIT_MASK 0x1 /end MEASUREMENT
/begin MEASUREMENT lv_var_can_icl "CAN-Kombiinstrument verbaut (dsk_byte_4 bit 5)" UBYTE _CNV_S_2_RANGE__0___88_CM 1 0. 0. 1. DISPLAY_IDENTIFIER LV_VAR_CAN_ICL ECU_ADDRESS 0x7fb67e BIT_MASK 0x1 /end MEASUREMENT
/begin MEASUREMENT lv_var_can_eilu "CAN-Zündanlaßschloß verbaut (dsk_byte_2 bit 2)" UBYTE _CNV_S_2_RANGE__0___88_CM 1 0. 0. 1. DISPLAY_IDENTIFIER LV_VAR_CAN_EILU ECU_ADDRESS 0x7fb672 BIT_MASK 0x1 /end MEASUREMENT
/begin MEASUREMENT tco_sub "TCO substitute value" UBYTE _CNV_A_R_LINEAR_____18_CM 1 0. -50. 205. DISPLAY_IDENTIFIER TCO_SUB ECU_ADDRESS 0x7fb76f FORMAT "%3.0" /end MEASUREMENT
/begin MEASUREMENT tco_1_sub "TCO substitute values for individual sensor j" UBYTE _CNV_A_R_LINEAR_____18_CM 1 0. -50. 205. DISPLAY_IDENTIFIER TCO_1_SUB ECU_ADDRESS 0x7fb770 FORMAT "%3.0" /end MEASUREMENT
/begin MEASUREMENT tco_2_sub "TCO substitute values for individual sensor j" UBYTE _CNV_A_R_LINEAR_____18_CM 1 0. -50. 205. DISPLAY_IDENTIFIER TCO_2_SUB ECU_ADDRESS 0x7fb771 FORMAT "%3.0" /end MEASUREMENT
/begin CHARACTERISTIC c_tco_sub_ini "universal initialization value for TCO_SUB as long as no measured substitutional value is available" VALUE 0x85c158 _REC_VAL_20_u1 255. _CNV_A_R_LINEAR_____18_CM -50. 205. DISPLAY_IDENTIFIER C_TCO_SUB_INI FORMAT "%3.0" /end CHARACTERISTIC
/begin CHARACTERISTIC c_tco_sub_grd "gradient for the calculation of the coolant temperature substitutional value" VALUE 0x85c156 _REC_VAL_20_u2 255.99609375 _CNV_A_R_LINEAR_____137_CM 0. 255.99609375 DISPLAY_IDENTIFIER C_TCO_SUB_GRD /end CHARACTERISTIC
/begin CHARACTERISTIC c_tco_sub_tol "maximal limit for the coolant temperature substitutional value" VALUE 0x85c159 _REC_VAL_20_u1 255. _CNV_A_R_LINEAR_____18_CM -50. 205. DISPLAY_IDENTIFIER C_TCO_SUB_TOL FORMAT "%3.0" /end CHARACTERISTIC
/begin CHARACTERISTIC c_tco_2_dif_sub "offset between TCO and TCO_2_SUB" VALUE 0x85c13b _REC_VAL_20_u1 255. _CNV_A_R_LINEAR_____18_CM -50. 205. DISPLAY_IDENTIFIER C_TCO_2_DIF_SUB FORMAT "%3.0" /end CHARACTERISTIC
/begin MEASUREMENT tco "coolant temperature TCO" UBYTE _CNV_A_R_LINEAR_____18_CM 1 0. -50. 205. DISPLAY_IDENTIFIER TCO ECU_ADDRESS 0x7fca76 FORMAT "%3.0" /end MEASUREMENT
/begin MEASUREMENT tco_mes "measured coolant temperature TCO_MES" UBYTE _CNV_A_R_LINEAR_____18_CM 1 0. -50. 205. DISPLAY_IDENTIFIER TCO_MES ECU_ADDRESS 0x7fca77 FORMAT "%3.0" /end MEASUREMENT
/begin MEASUREMENT tco_st "coolant temperature at start TCO_ST" UBYTE _CNV_A_R_LINEAR_____18_CM 1 0. -50. 205. DISPLAY_IDENTIFIER TCO_ST ECU_ADDRESS 0x7fca78 FORMAT "%3.0" /end MEASUREMENT
/begin MEASUREMENT tco_1 "coolant temperature of individual sensor j: j = ( 1 .. NC_TCO_NR )" UBYTE _CNV_A_R_LINEAR_____18_CM 1 0. -50. 205. DISPLAY_IDENTIFIER TCO_1 ECU_ADDRESS 0x7fca79 FORMAT "%3.0" /end MEASUREMENT
/begin MEASUREMENT tco_2 "coolant temperature of individual sensor j: j = ( 1 .. NC_TCO_NR )" UBYTE _CNV_A_R_LINEAR_____18_CM 1 0. -50. 205. DISPLAY_IDENTIFIER TCO_2 ECU_ADDRESS 0x7fca7b FORMAT "%3.0" /end MEASUREMENT
/begin MEASUREMENT tco_1_mes "measured coolant temperature of individual sensor j: j = ( 1 .. NC_TCO_NR )" UBYTE _CNV_A_R_LINEAR_____18_CM 1 0. -50. 205. DISPLAY_IDENTIFIER TCO_1_MES ECU_ADDRESS 0x7fca7a FORMAT "%3.0" /end MEASUREMENT
/begin MEASUREMENT tco_2_mes "measured coolant temperature of individual sensor j: j = ( 1 .. NC_TCO_NR )" UBYTE _CNV_A_R_LINEAR_____18_CM 1 0. -50. 205. DISPLAY_IDENTIFIER TCO_2_MES ECU_ADDRESS 0x7fca7c FORMAT "%3.0" /end MEASUREMENT
/begin MEASUREMENT v_tco_1 "voltage of individual coolant temperature sensor j: j = ( 1 .. NC_TCO_NR )" UWORD _CNV_A_R_LINEAR_____33_CM 1 0. 0. 4.9951171875 DISPLAY_IDENTIFIER V_TCO_1 ECU_ADDRESS 0x7fc998 BYTE_ORDER MSB_LAST FORMAT "%4.3" /end MEASUREMENT
/begin MEASUREMENT v_tco_2 "voltage of individual coolant temperature sensor j: j = ( 1 .. NC_TCO_NR )" UWORD _CNV_A_R_LINEAR_____33_CM 1 0. 0. 4.9951171875 DISPLAY_IDENTIFIER V_TCO_2 ECU_ADDRESS 0x7fc99a BYTE_ORDER MSB_LAST FORMAT "%4.3" /end MEASUREMENT
/begin CHARACTERISTIC c_tco_grd_max "temperature gradient maximum" VALUE 0x85c146 _REC_VAL_20_u1 255. _CNV_A_R_LINEAR_____17_CM 0. 255. DISPLAY_IDENTIFIER C_TCO_GRD_MAX FORMAT "%3.0" /end CHARACTERISTIC
/begin CHARACTERISTIC ip_tco_1_mes__v_tco_1 "SYS_VAR: TCO_1_MES sensor map" CURVE 0x85ab48 _REC_CUR_20_u1_u2 255. _CNV_A_R_LINEAR_____18_CM -50. 205. DISPLAY_IDENTIFIER IP_TCO_1_MES__V_TCO_1 FORMAT "%3.0"
 /begin AXIS_DESCR COM_AXIS tco_1_mes _CNV_A_R_LINEAR_____33_CM 16 0. 4.9951171875 FORMAT "%4.3" AXIS_PTS_REF ldpm_v_tco__ip_tco_1_mes /end AXIS_DESCR
/end CHARACTERISTIC
/begin CHARACTERISTIC ip_tco_2_mes__v_tco_2 "SYS_VAR: TCO_2_MES sensor map" CURVE 0x85ab58 _REC_CUR_20_u1_u2 255. _CNV_A_R_LINEAR_____18_CM -50. 205. DISPLAY_IDENTIFIER IP_TCO_2_MES__V_TCO_2 FORMAT "%3.0"
 /begin AXIS_DESCR COM_AXIS tco_2_mes _CNV_A_R_LINEAR_____33_CM 16 0. 4.9951171875 FORMAT "%4.3" AXIS_PTS_REF ldpm_v_tco__ip_tco_2_mes /end AXIS_DESCR
/end CHARACTERISTIC
/begin AXIS_PTS ldpm_v_tco__ip_tco_1_mes "TCO_1_MES sensor map" 0x844446 tco_1_mes _REC_AXS_20_u2 4.9951171875 _CNV_A_R_LINEAR_____33_CM 16 0. 4.9951171875 FORMAT "%4.3" /end AXIS_PTS
/begin AXIS_PTS ldpm_v_tco__ip_tco_2_mes "TCO_2_MES sensor map" 0x844468 tco_2_mes _REC_AXS_20_u2 4.9951171875 _CNV_A_R_LINEAR_____33_CM 16 0. 4.9951171875 FORMAT "%4.3" /end AXIS_PTS
/begin MEASUREMENT ducy_acp_pwm "air conditioning pressure" UBYTE _CNV_A_R_LINEAR_____44_CM 1 0. 0. 100. DISPLAY_IDENTIFIER DUCY_ACP_PWM ECU_ADDRESS 0x7fbbe0 FORMAT "%4.0" /end MEASUREMENT
/begin MEASUREMENT acp "air conditioning pressure" UBYTE _CNV_A_R_LINEAR_____206_CM 1 0. 0. 3100. DISPLAY_IDENTIFIER ACP ECU_ADDRESS 0x7fb80c FORMAT "%4.0" /end MEASUREMENT
/begin MEASUREMENT acp_mes "measured air conditioning pressure" UBYTE _CNV_A_R_LINEAR_____206_CM 1 0. 0. 3100. DISPLAY_IDENTIFIER ACP_MES ECU_ADDRESS 0x7fb80d FORMAT "%4.0" /end MEASUREMENT
/begin MEASUREMENT tq_loss_acc_inp "Torque Loss of ACC (only CAN)" SWORD _CNV_A_R_LINEAR_____62_CM 1 0. -1024. 1023.96875 DISPLAY_IDENTIFIER TQ_LOSS_ACC_INP ECU_ADDRESS 0x7fa274 BYTE_ORDER MSB_LAST FORMAT "%6.2" /end MEASUREMENT
/begin MEASUREMENT lv_acp_orng "ACP pressure invalid" UBYTE _CNV_S_2_RANGE______11_CM 1 0. 0. 1. DISPLAY_IDENTIFIER LV_ACP_ORNG ECU_ADDRESS 0x7fb80e /end MEASUREMENT
/begin MEASUREMENT lv_tq_loss_acc_inp_orng "Torque Loss invalid" UBYTE _CNV_S_2_RANGE______11_CM 1 0. 0. 1. DISPLAY_IDENTIFIER LV_TQ_LOSS_ACC_INP_ORNG ECU_ADDRESS 0x7fb80f /end MEASUREMENT
/begin CHARACTERISTIC lc_tq_acc_can_use "Switch to activate the demand of Torque of the air conditioning ECU" VALUE 0x85c371 _REC_VAL_20_u1 1. _CNV_A_R_LINEAR_____0_CM 0. 1. DISPLAY_IDENTIFIER LC_TQ_ACC_CAN_USE FORMAT "%1.0" /end CHARACTERISTIC
/begin CHARACTERISTIC ip_acp_mes__ducy_acp_pwm "SYS_VAR: ACP_MES sensor map" CURVE 0x848f80 _REC_CUR_20_u1_u1 3100. _CNV_A_R_LINEAR_____206_CM 0. 3100. DISPLAY_IDENTIFIER IP_ACP_MES__DUCY_ACP_PWM FORMAT "%4.0"
 /begin AXIS_DESCR COM_AXIS ducy_acp_pwm _CNV_A_R_LINEAR_____207_CM 16 0. 100. FORMAT "%3.1" AXIS_PTS_REF ldp_ducy_acp_pwm_ip_acp_mes /end AXIS_DESCR
/end CHARACTERISTIC
/begin AXIS_PTS ldp_ducy_acp_pwm_ip_acp_mes "ACP_MES sensor map" 0x841602 ducy_acp_pwm _REC_AXS_20_u1 100. _CNV_A_R_LINEAR_____207_CM 16 0. 100. FORMAT "%3.1" /end AXIS_PTS
/begin CHARACTERISTIC c_acp_sub_diag "Subsitute value for air conditioning pressure " VALUE 0x85bcb5 _REC_VAL_20_u1 3100. _CNV_A_R_LINEAR_____206_CM 0. 3100. DISPLAY_IDENTIFIER C_ACP_SUB_DIAG FORMAT "%4.0" /end CHARACTERISTIC
/begin MEASUREMENT lv_can_ena "" UBYTE _CNV_S_2_RANGE__0___88_CM 1 0. 0. 1. DISPLAY_IDENTIFIER LV_CAN_ENA ECU_ADDRESS 0x7fb881 BIT_MASK 0x1 /end MEASUREMENT
/begin MEASUREMENT lv_slp_idc_update "" UBYTE _CNV_S_2_RANGE__0___88_CM 1 0. 0. 1. DISPLAY_IDENTIFIER LV_SLP_IDC_UPDATE ECU_ADDRESS 0x7fb971 BIT_MASK 0x1 /end MEASUREMENT
/begin MEASUREMENT lv_stop_rcv_can_msg "" UBYTE _CNV_S_2_RANGE__0___88_CM 1 0. 0. 1. DISPLAY_IDENTIFIER LV_STOP_RCV_CAN_MSG ECU_ADDRESS 0x7fb92c BIT_MASK 0x1 /end MEASUREMENT
/begin MEASUREMENT lv_dlc_tcs1_nvld "" UBYTE _CNV_S_2_RANGE__0___88_CM 1 0. 0. 1. DISPLAY_IDENTIFIER LV_DLC_TCS1_NVLD ECU_ADDRESS 0x7fb331 BIT_MASK 0x1 /end MEASUREMENT
/begin MEASUREMENT lv_dlc_tcs2_nvld "" UBYTE _CNV_S_2_RANGE__0___88_CM 1 0. 0. 1. DISPLAY_IDENTIFIER LV_DLC_TCS2_NVLD ECU_ADDRESS 0x7fb332 BIT_MASK 0x1 /end MEASUREMENT
/begin MEASUREMENT lv_dlc_tcs3_nvld "" UBYTE _CNV_S_2_RANGE__0___88_CM 1 0. 0. 1. DISPLAY_IDENTIFIER LV_DLC_TCS3_NVLD ECU_ADDRESS 0x7fb333 BIT_MASK 0x1 /end MEASUREMENT
/begin MEASUREMENT lv_dlc_tcs8_nvld "" UBYTE _CNV_S_2_RANGE__0___88_CM 1 0. 0. 1. DISPLAY_IDENTIFIER LV_DLC_TCS8_NVLD ECU_ADDRESS 0x7fb334 BIT_MASK 0x1 /end MEASUREMENT
/begin MEASUREMENT lv_dlc_tcu1_nvld "" UBYTE _CNV_S_2_RANGE__0___88_CM 1 0. 0. 1. DISPLAY_IDENTIFIER LV_DLC_TCU1_NVLD ECU_ADDRESS 0x7fb335 BIT_MASK 0x1 /end MEASUREMENT
/begin MEASUREMENT lv_dlc_tcu2_nvld "" UBYTE _CNV_S_2_RANGE__0___88_CM 1 0. 0. 1. DISPLAY_IDENTIFIER LV_DLC_TCU2_NVLD ECU_ADDRESS 0x7fb336 BIT_MASK 0x1 /end MEASUREMENT
/begin MEASUREMENT lv_dlc_airb1_nvld "" UBYTE _CNV_S_2_RANGE__0___88_CM 1 0. 0. 1. DISPLAY_IDENTIFIER LV_DLC_AIRB1_NVLD ECU_ADDRESS 0x7fb337 BIT_MASK 0x1 /end MEASUREMENT
/begin MEASUREMENT lv_dlc_imor_nvld "" UBYTE _CNV_S_2_RANGE__0___88_CM 1 0. 0. 1. DISPLAY_IDENTIFIER LV_DLC_IMOR_NVLD ECU_ADDRESS 0x7fb338 BIT_MASK 0x1 /end MEASUREMENT
/begin MEASUREMENT lv_dlc_icl1_nvld "" UBYTE _CNV_S_2_RANGE__0___88_CM 1 0. 0. 1. DISPLAY_IDENTIFIER LV_DLC_ICL1_NVLD ECU_ADDRESS 0x7fb339 BIT_MASK 0x1 /end MEASUREMENT
/begin MEASUREMENT lv_dlc_ac1_nvld "" UBYTE _CNV_S_2_RANGE__0___88_CM 1 0. 0. 1. DISPLAY_IDENTIFIER LV_DLC_AC1_NVLD ECU_ADDRESS 0x7fb33a BIT_MASK 0x1 /end MEASUREMENT
/begin MEASUREMENT lv_dlc_bem_nvld "" UBYTE _CNV_S_2_RANGE__0___88_CM 1 0. 0. 1. DISPLAY_IDENTIFIER LV_DLC_BEM_NVLD ECU_ADDRESS 0x7fb33b BIT_MASK 0x1 /end MEASUREMENT
/begin MEASUREMENT lv_dlc_cru_nvld "" UBYTE _CNV_S_2_RANGE__0___88_CM 1 0. 0. 1. DISPLAY_IDENTIFIER LV_DLC_CRU_NVLD ECU_ADDRESS 0x7fb33c BIT_MASK 0x1 /end MEASUREMENT
/begin MEASUREMENT lv_dlc_eilu1_nvld "" UBYTE _CNV_S_2_RANGE__0___88_CM 1 0. 0. 1. DISPLAY_IDENTIFIER LV_DLC_EILU1_NVLD ECU_ADDRESS 0x7fb33d BIT_MASK 0x1 /end MEASUREMENT
/begin MEASUREMENT lv_dlc_vecu1_nvld "" UBYTE _CNV_S_2_RANGE__0___88_CM 1 0. 0. 1. DISPLAY_IDENTIFIER LV_DLC_VECU1_NVLD ECU_ADDRESS 0x7fb33e BIT_MASK 0x1 /end MEASUREMENT
/begin MEASUREMENT lv_dlc_if_cft_1_nvld "" UBYTE _CNV_S_2_RANGE__0___88_CM 1 0. 0. 1. DISPLAY_IDENTIFIER LV_DLC_IF_CFT_1_NVLD ECU_ADDRESS 0x7fb33f BIT_MASK 0x1 /end MEASUREMENT
/begin MEASUREMENT lv_dlc_icl2_nvld "" UBYTE _CNV_S_2_RANGE__0___88_CM 1 0. 0. 1. DISPLAY_IDENTIFIER LV_DLC_ICL2_NVLD ECU_ADDRESS 0x7fb340 BIT_MASK 0x1 /end MEASUREMENT
/begin MEASUREMENT lv_dlc_icl3_nvld "" UBYTE _CNV_S_2_RANGE__0___88_CM 1 0. 0. 1. DISPLAY_IDENTIFIER LV_DLC_ICL3_NVLD ECU_ADDRESS 0x7fb341 BIT_MASK 0x1 /end MEASUREMENT
/begin MEASUREMENT lv_dlc_tog1_nvld "" UBYTE _CNV_S_2_RANGE__0___88_CM 1 0. 0. 1. DISPLAY_IDENTIFIER LV_DLC_TOG1_NVLD ECU_ADDRESS 0x7fb342 BIT_MASK 0x1 /end MEASUREMENT
/begin MEASUREMENT lv_dlc_whl_nvld "" UBYTE _CNV_S_2_RANGE__0___88_CM 1 0. 0. 1. DISPLAY_IDENTIFIER LV_DLC_WHL_NVLD ECU_ADDRESS 0x7fb32d BIT_MASK 0x1 /end MEASUREMENT
/begin MEASUREMENT lv_dlc_sys_info_nvld "" UBYTE _CNV_S_2_RANGE__0___88_CM 1 0. 0. 1. DISPLAY_IDENTIFIER LV_DLC_SYS_INFO_NVLD ECU_ADDRESS 0x7fb32e BIT_MASK 0x1 /end MEASUREMENT
/begin MEASUREMENT lv_slp_idc "" UBYTE _CNV_S_2_RANGE__0___88_CM 1 0. 0. 1. DISPLAY_IDENTIFIER LV_SLP_IDC ECU_ADDRESS 0x7fb32b BIT_MASK 0x1 /end MEASUREMENT
/begin MEASUREMENT lv_dlc_nom_sys_nvld "" UBYTE _CNV_S_2_RANGE__0___88_CM 1 0. 0. 1. DISPLAY_IDENTIFIER LV_DLC_NOM_SYS_NVLD ECU_ADDRESS 0x7fb32f BIT_MASK 0x1 /end MEASUREMENT
/begin MEASUREMENT lv_pste_can_vld "Logische Variable fuer erkannte gueltige Botschaft Lenkwinkel 1" UBYTE _CNV_S_2_RANGE__0___88_CM 1 0. 0. 1. DISPLAY_IDENTIFIER LV_PSTE_CAN_VLD ECU_ADDRESS 0x7fb3b4 BIT_MASK 0x1 /end MEASUREMENT
/begin MEASUREMENT ang_pste "Steering angle" UWORD _CNV_A_R_LINEAR_____227_CM 1 0. 0. 1433.55625 DISPLAY_IDENTIFIER ANG_PSTE ECU_ADDRESS 0x7f9748 BYTE_ORDER MSB_LAST FORMAT "%10.5" /end MEASUREMENT
/begin MEASUREMENT ang_grd_pste "Steering angle gradient" UWORD _CNV_A_R_LINEAR_____228_CM 1 0. 0. 1433.55625 DISPLAY_IDENTIFIER ANG_GRD_PSTE ECU_ADDRESS 0x7f974a BYTE_ORDER MSB_LAST FORMAT "%10.5" /end MEASUREMENT
/begin MEASUREMENT lv_n_sp_is_bem_1 "Logische Variable fuer aktive Forderung der Erhoehung der Leerlaufsolldrehzahl Stufe 1" UBYTE _CNV_S_2_RANGE__0___88_CM 1 0. 0. 1. DISPLAY_IDENTIFIER LV_N_SP_IS_BEM_1 ECU_ADDRESS 0x7fb3b1 BIT_MASK 0x1 /end MEASUREMENT
/begin MEASUREMENT lv_n_sp_is_bem_2 "Logische Variable fuer aktive Forderung der Erhoehung der Leerlaufsolldrehzahl Stufe 2" UBYTE _CNV_S_2_RANGE__0___88_CM 1 0. 0. 1. DISPLAY_IDENTIFIER LV_N_SP_IS_BEM_2 ECU_ADDRESS 0x7fb3b2 BIT_MASK 0x1 /end MEASUREMENT
/begin MEASUREMENT lv_bem_can_vld "Logische Variable fuer erkannte gueltige Botschaft BEM" UBYTE _CNV_S_2_RANGE__0___88_CM 1 0. 0. 1. DISPLAY_IDENTIFIER LV_BEM_CAN_VLD ECU_ADDRESS 0x7fb3b3 BIT_MASK 0x1 /end MEASUREMENT
/begin MEASUREMENT gen_load_tq_can "Generatotorlastmoment (FFH = Fehler)" UBYTE _CNV_A_R_LINEAR_____229_CM 1 0. 0. 127.5 DISPLAY_IDENTIFIER GEN_LOAD_TQ_CAN ECU_ADDRESS 0x7fb3af FORMAT "%5.1" /end MEASUREMENT
/begin MEASUREMENT gen_load_pow_can "Leistungsaufnahme Generator (FFH = Fehler)" UBYTE _CNV_A_R_LINEAR_____230_CM 1 0. 0. 12750. DISPLAY_IDENTIFIER GEN_LOAD_POW_CAN ECU_ADDRESS 0x7fb3b0 FORMAT "%5.0" /end MEASUREMENT
/begin MEASUREMENT lv_if_cft_1_can_vld "Logische Variable fuer erkannte gueltige Botschaft interface-comfort" UBYTE _CNV_S_2_RANGE__0___88_CM 1 0. 0. 1. DISPLAY_IDENTIFIER LV_IF_CFT_1_CAN_VLD ECU_ADDRESS 0x7fb3d1 BIT_MASK 0x1 /end MEASUREMENT
/begin MEASUREMENT lv_stb_ack "Bit Sleep Acknowledge" UBYTE _CNV_S_2_RANGE__0___88_CM 1 0. 0. 1. DISPLAY_IDENTIFIER LV_STB_ACK ECU_ADDRESS 0x7fb3d2 BIT_MASK 0x1 /end MEASUREMENT
/begin MEASUREMENT lv_trl_msg_ood_can "Bit Anhaengerbotschaft veraltet" UBYTE _CNV_S_2_RANGE__0___88_CM 1 0. 0. 1. DISPLAY_IDENTIFIER LV_TRL_MSG_OOD_CAN ECU_ADDRESS 0x7fb3d3 BIT_MASK 0x1 /end MEASUREMENT
/begin MEASUREMENT lv_lamp_re_msg_ood_can "Bit Licht-Hinten-Botschaft veraltet" UBYTE _CNV_S_2_RANGE__0___88_CM 1 0. 0. 1. DISPLAY_IDENTIFIER LV_LAMP_RE_MSG_OOD_CAN ECU_ADDRESS 0x7fb3d4 BIT_MASK 0x1 /end MEASUREMENT
/begin MEASUREMENT lv_brake_lamp_le_err_can "Bit Bremslicht links defekt" UBYTE _CNV_S_2_RANGE__0___88_CM 1 0. 0. 1. DISPLAY_IDENTIFIER LV_BRAKE_LAMP_LE_ERR_CAN ECU_ADDRESS 0x7fb3d5 BIT_MASK 0x1 /end MEASUREMENT
/begin MEASUREMENT lv_brake_lamp_ri_err_can "Bit Bremslicht rechts defekt" UBYTE _CNV_S_2_RANGE__0___88_CM 1 0. 0. 1. DISPLAY_IDENTIFIER LV_BRAKE_LAMP_RI_ERR_CAN ECU_ADDRESS 0x7fb3d6 BIT_MASK 0x1 /end MEASUREMENT
/begin MEASUREMENT lv_brake_lamp_mid_err_can "Bit Bremslicht mitte defekt" UBYTE _CNV_S_2_RANGE__0___88_CM 1 0. 0. 1. DISPLAY_IDENTIFIER LV_BRAKE_LAMP_MID_ERR_CAN ECU_ADDRESS 0x7fb3d7 BIT_MASK 0x1 /end MEASUREMENT
/begin MEASUREMENT lv_trl_act_can "Bit Anhaenger erkannt" UBYTE _CNV_S_2_RANGE__0___88_CM 1 0. 0. 1. DISPLAY_IDENTIFIER LV_TRL_ACT_CAN ECU_ADDRESS 0x7fb3d8 BIT_MASK 0x1 /end MEASUREMENT
/begin MEASUREMENT lv_brake_lamp_trl_err_can "Bit Bremslicht Anhaenger defekt" UBYTE _CNV_S_2_RANGE__0___88_CM 1 0. 0. 1. DISPLAY_IDENTIFIER LV_BRAKE_LAMP_TRL_ERR_CAN ECU_ADDRESS 0x7fb3d9 BIT_MASK 0x1 /end MEASUREMENT
/begin MEASUREMENT lv_state_ctl_dece_err_can "Bit ECD ILM unplausibel" UBYTE _CNV_S_2_RANGE__0___88_CM 1 0. 0. 1. DISPLAY_IDENTIFIER LV_STATE_CTL_DECE_ERR_CAN ECU_ADDRESS 0x7fb3da BIT_MASK 0x1 /end MEASUREMENT
/begin MEASUREMENT lv_state_ctl_dece_trlcu_err_can "Bit ECD AAG unplausibel" UBYTE _CNV_S_2_RANGE__0___88_CM 1 0. 0. 1. DISPLAY_IDENTIFIER LV_STATE_CTL_DECE_TRLCU_ERR_CAN ECU_ADDRESS 0x7fb3db BIT_MASK 0x1 /end MEASUREMENT
/begin MEASUREMENT brake_lamp_msg_ctr "Botschaftzaehler Bremslicht" UBYTE _CNV_A_R_LINEAR_____0_CM 1 0. 0. 15. DISPLAY_IDENTIFIER BRAKE_LAMP_MSG_CTR ECU_ADDRESS 0x7fb3dc FORMAT "%2.0" /end MEASUREMENT
/begin MEASUREMENT lv_err_ctr_msg_brake_lamp "Fehlerbit Botschaftzaehler Bremslicht" UBYTE _CNV_S_2_RANGE__0___88_CM 1 0. 0. 1. DISPLAY_IDENTIFIER LV_ERR_CTR_MSG_BRAKE_LAMP ECU_ADDRESS 0x7fb3dd BIT_MASK 0x1 /end MEASUREMENT
/begin MEASUREMENT trlcu_msg_ctr "Botschaftzaehler AAG" UBYTE _CNV_A_R_LINEAR_____0_CM 1 0. 0. 15. DISPLAY_IDENTIFIER TRLCU_MSG_CTR ECU_ADDRESS 0x7fb3de FORMAT "%2.0" /end MEASUREMENT
/begin MEASUREMENT lv_err_ctr_msg_trlcu "Fehlerbit Botschaftzaehler AAG" UBYTE _CNV_S_2_RANGE__0___88_CM 1 0. 0. 1. DISPLAY_IDENTIFIER LV_ERR_CTR_MSG_TRLCU ECU_ADDRESS 0x7fb3df BIT_MASK 0x1 /end MEASUREMENT
/begin MEASUREMENT lv_ich_conf_can "Standheizung verbaut" UBYTE _CNV_S_2_RANGE__0___88_CM 1 0. 0. 1. DISPLAY_IDENTIFIER LV_ICH_CONF_CAN ECU_ADDRESS 0x7fb3e1 BIT_MASK 0x1 /end MEASUREMENT
/begin MEASUREMENT can_vs_abs "Vehicle Speed from TCS" UWORD _CNV_A_R_LINEAR_____74_CM 1 0. 0. 327.67 DISPLAY_IDENTIFIER CAN_VS_ABS ECU_ADDRESS 0x7f973a BYTE_ORDER MSB_LAST FORMAT "%5.2" /end MEASUREMENT
/begin MEASUREMENT lv_err_vs_can "" UBYTE _CNV_A_R_LINEAR_____0_CM 1 0. 0. 1. DISPLAY_IDENTIFIER LV_ERR_VS_CAN ECU_ADDRESS 0x7fb36b FORMAT "%1.0" /end MEASUREMENT
/begin MEASUREMENT tco_sp "coolant temperature setpoint for cooling management functions" UBYTE _CNV_A_R_LINEAR_____235_CM 1 0. -48. 142.5 DISPLAY_IDENTIFIER TCO_SP ECU_ADDRESS 0x7fb716 FORMAT "%5.1" /end MEASUREMENT
/begin MEASUREMENT tco_sp_1 "basic TCO_SP vs. engine speed and load" UBYTE _CNV_A_R_LINEAR_____235_CM 1 0. -48. 142.5 DISPLAY_IDENTIFIER TCO_SP_1 ECU_ADDRESS 0x7fbb35 FORMAT "%5.1" /end MEASUREMENT
/begin MEASUREMENT tco_sp_2 "basic TCO_SP vs. vehicle speed and TIA or TAM" UBYTE _CNV_A_R_LINEAR_____235_CM 1 0. -48. 142.5 DISPLAY_IDENTIFIER TCO_SP_2 ECU_ADDRESS 0x7fbb36 FORMAT "%5.1" /end MEASUREMENT
/begin MEASUREMENT tco_sp_knk "TCO_SP based on knock intensity" UBYTE _CNV_A_R_LINEAR_____235_CM 1 0. -48. 142.5 DISPLAY_IDENTIFIER TCO_SP_KNK ECU_ADDRESS 0x7fbb37 FORMAT "%5.1" /end MEASUREMENT
/begin MEASUREMENT tco_sp_tcu "TCO_SP based on TCU request" UBYTE _CNV_A_R_LINEAR_____235_CM 1 0. -48. 142.5 DISPLAY_IDENTIFIER TCO_SP_TCU ECU_ADDRESS 0x7fbb38 FORMAT "%5.1" /end MEASUREMENT
/begin MEASUREMENT tco_sp_toil "TCO_SP based on TOIL_CAN" UBYTE _CNV_A_R_LINEAR_____235_CM 1 0. -48. 142.5 DISPLAY_IDENTIFIER TCO_SP_TOIL ECU_ADDRESS 0x7fbb39 FORMAT "%5.1" /end MEASUREMENT
/begin MEASUREMENT tco_sp_min_hvr "minimum TCO_SP based on cooling request" UBYTE _CNV_A_R_LINEAR_____235_CM 1 0. -48. 142.5 DISPLAY_IDENTIFIER TCO_SP_MIN_HVR ECU_ADDRESS 0x7fbb3a FORMAT "%5.1" /end MEASUREMENT
/begin MEASUREMENT tco_sp_max_hvr "maximum TCO_SP based on cooling request" UBYTE _CNV_A_R_LINEAR_____235_CM 1 0. -48. 142.5 DISPLAY_IDENTIFIER TCO_SP_MAX_HVR ECU_ADDRESS 0x7fbb3b FORMAT "%5.1" /end MEASUREMENT
/begin MEASUREMENT tco_sp_inter "TCO_SP after minimum selection" UBYTE _CNV_A_R_LINEAR_____235_CM 1 0. -48. 142.5 DISPLAY_IDENTIFIER TCO_SP_INTER ECU_ADDRESS 0x7fbb3c FORMAT "%5.1" /end MEASUREMENT
/begin MEASUREMENT tco_sp_raw "TCO_SP after maximum selection" UBYTE _CNV_A_R_LINEAR_____235_CM 1 0. -48. 142.5 DISPLAY_IDENTIFIER TCO_SP_RAW ECU_ADDRESS 0x7fbb3d FORMAT "%5.1" /end MEASUREMENT
/begin MEASUREMENT tco_sp_clc "TCO_SP before failure evaluation" UBYTE _CNV_A_R_LINEAR_____235_CM 1 0. -48. 142.5 DISPLAY_IDENTIFIER TCO_SP_CLC ECU_ADDRESS 0x7fbb3e FORMAT "%5.1" /end MEASUREMENT
/begin CHARACTERISTIC lc_use_cool_req_tcu_can "switch to activate using of IP_TCO_SP_TCU" VALUE 0x8487e2 _REC_VAL_20_u1 1. _CNV_A_R_LINEAR_____1_CM 0. 1. DISPLAY_IDENTIFIER LC_USE_COOL_REQ_TCU_CAN FORMAT "%1.0" /end CHARACTERISTIC
/begin CHARACTERISTIC lc_use_tia_tco_sp "switch to use TIA or TAM within map IP_TCO_SP_2 (1 means use TIA))" VALUE 0x8487e3 _REC_VAL_20_u1 1. _CNV_A_R_LINEAR_____1_CM 0. 1. DISPLAY_IDENTIFIER LC_USE_TIA_TCO_SP FORMAT "%1.0" /end CHARACTERISTIC
/begin CHARACTERISTIC c_tco_sp_tcu_sub "substitute value for TCO_SP_TCU" VALUE 0x8486da _REC_VAL_20_u1 190.5 _CNV_A_R_LINEAR_____235_CM -48. 142.5 DISPLAY_IDENTIFIER C_TCO_SP_TCU_SUB FORMAT "%5.1" /end CHARACTERISTIC
/begin CHARACTERISTIC c_tco_min_hvr_sub "substitute value for TCO_SP_MIN_HVR" VALUE 0x8486d6 _REC_VAL_20_u1 190.5 _CNV_A_R_LINEAR_____235_CM -48. 142.5 DISPLAY_IDENTIFIER C_TCO_MIN_HVR_SUB FORMAT "%5.1" /end CHARACTERISTIC
/begin CHARACTERISTIC c_tco_max_hvr_sub "substitute value for TCO_SP_MAX_HVR" VALUE 0x8486d0 _REC_VAL_20_u1 190.5 _CNV_A_R_LINEAR_____235_CM -48. 142.5 DISPLAY_IDENTIFIER C_TCO_MAX_HVR_SUB FORMAT "%5.1" /end CHARACTERISTIC
/begin CHARACTERISTIC c_tco_sp_sub "substitute value for TCO_SP in case of failure" VALUE 0x8486d9 _REC_VAL_20_u1 190.5 _CNV_A_R_LINEAR_____235_CM -48. 142.5 DISPLAY_IDENTIFIER C_TCO_SP_SUB FORMAT "%5.1" /end CHARACTERISTIC
/begin CHARACTERISTIC c_crlc_tco_sp_down "TP1 filter constant for TCO_SP for decreasing values" VALUE 0x84835e _REC_VAL_20_u1 0.99609375 _CNV_A_R_LINEAR_____248_CM 0. 0.99609375 DISPLAY_IDENTIFIER C_CRLC_TCO_SP_DOWN FORMAT "%5.3" /end CHARACTERISTIC
/begin CHARACTERISTIC c_crlc_tco_sp_up "TP1 filter constant for TCO_SP for increasing values" VALUE 0x84835f _REC_VAL_20_u1 0.99609375 _CNV_A_R_LINEAR_____248_CM 0. 0.99609375 DISPLAY_IDENTIFIER C_CRLC_TCO_SP_UP FORMAT "%5.3" /end CHARACTERISTIC
/begin AXIS_PTS ldp_n_32__tco_sp "" 0x8445bc n_32 _REC_AXS_20_u1 8160. _CNV_A_R_LINEAR_____84_CM 8 0. 8160. FORMAT "%4.0" /end AXIS_PTS
/begin AXIS_PTS ldp_tqi_req_tra__tco_sp "" 0x844868 tqi_req_tra _REC_AXS_20_u2 1023.96875 _CNV_A_R_LINEAR_____62_CM 8 0. 1023.96875 FORMAT "%7.2" /end AXIS_PTS
/begin CHARACTERISTIC ip_tco_sp_1 "basic TCO_SP vs. engine speed and load" MAP 0x847a78 _REC_MAP_20_u1_u1_u2 190.5 _CNV_A_R_LINEAR_____235_CM -48. 142.5 DISPLAY_IDENTIFIER IP_TCO_SP_1 FORMAT "%5.1"
 /begin AXIS_DESCR COM_AXIS n_32 _CNV_A_R_LINEAR_____84_CM 8 0. 8160. FORMAT "%4.0" AXIS_PTS_REF ldp_n_32__tco_sp /end AXIS_DESCR
 /begin AXIS_DESCR COM_AXIS tqi_req_tra _CNV_A_R_LINEAR_____62_CM 8 0. 1023.96875 FORMAT "%7.2" AXIS_PTS_REF ldp_tqi_req_tra__tco_sp /end AXIS_DESCR
/end CHARACTERISTIC
/begin AXIS_PTS ldp_iga_mv_knk__tco_sp "" 0x84458f NO_INPUT_QUANTITY _REC_AXS_20_u1 48. _CNV_A_R_LINEAR_____259_CM 4 -48. 0. FORMAT "%5.1" /end AXIS_PTS
/begin CHARACTERISTIC ip_tco_sp_knk "TCO_SP vs. knock intensity" CURVE 0x847cf8 _REC_CUR_20_u1_u1 190.5 _CNV_A_R_LINEAR_____235_CM -48. 142.5 DISPLAY_IDENTIFIER IP_TCO_SP_KNK FORMAT "%5.1"
 /begin AXIS_DESCR COM_AXIS NO_INPUT_QUANTITY _CNV_A_R_LINEAR_____259_CM 4 -48. 0. FORMAT "%5.1" AXIS_PTS_REF ldp_iga_mv_knk__tco_sp /end AXIS_DESCR
/end CHARACTERISTIC
/begin AXIS_PTS ldp_vs__tco_sp "" 0x8448ae vs _REC_AXS_20_u1 255. _CNV_A_R_LINEAR_____239_CM 8 0. 255. FORMAT "%3.0" /end AXIS_PTS
/begin AXIS_PTS ldp_tia_tam__tco_sp "" 0x844818 online_dummy _REC_AXS_20_u1 190.5 _CNV_A_R_LINEAR_____235_CM 8 -48. 142.5 FORMAT "%5.1" /end AXIS_PTS
/begin CHARACTERISTIC ip_tco_sp_2 "TCO_SP vs. vehicle speed and TIA or TAM (depending on switch LC_USE_TIA_TCO_SP)" MAP 0x847ab8 _REC_MAP_20_u1_u1_u1 190.5 _CNV_A_R_LINEAR_____235_CM -48. 142.5 DISPLAY_IDENTIFIER IP_TCO_SP_2 FORMAT "%5.1"
 /begin AXIS_DESCR COM_AXIS vs _CNV_A_R_LINEAR_____239_CM 8 0. 255. FORMAT "%3.0" AXIS_PTS_REF ldp_vs__tco_sp /end AXIS_DESCR
 /begin AXIS_DESCR COM_AXIS online_dummy _CNV_A_R_LINEAR_____235_CM 8 -48. 142.5 FORMAT "%5.1" AXIS_PTS_REF ldp_tia_tam__tco_sp /end AXIS_DESCR
/end CHARACTERISTIC
/begin AXIS_PTS ldp_cool_req_tcu_can__tco_sp "" 0x8444f9 cool_req_tcu_can _REC_AXS_20_u1 3. _CNV_A_R_LINEAR_____1_CM 4 0. 3. FORMAT "%3.0" /end AXIS_PTS
/begin CHARACTERISTIC ip_tco_sp_tcu "TCO_SP vs. cooling request of TCU" CURVE 0x847d02 _REC_CUR_20_u1_u1 190.5 _CNV_A_R_LINEAR_____235_CM -48. 142.5 DISPLAY_IDENTIFIER IP_TCO_SP_TCU FORMAT "%5.1"
 /begin AXIS_DESCR COM_AXIS cool_req_tcu_can _CNV_A_R_LINEAR_____1_CM 4 0. 3. FORMAT "%3.0" AXIS_PTS_REF ldp_cool_req_tcu_can__tco_sp /end AXIS_DESCR
/end CHARACTERISTIC
/begin AXIS_PTS ldp_toil__tco_sp "" 0x844826 toil _REC_AXS_20_u1 200. _CNV_A_R_LINEAR_____68_CM 4 -40. 160. FORMAT "%3.0" /end AXIS_PTS
/begin CHARACTERISTIC ip_tco_sp_toil "TCO_SP vs. oil temperature" CURVE 0x847d06 _REC_CUR_20_u1_u1 190.5 _CNV_A_R_LINEAR_____235_CM -48. 142.5 DISPLAY_IDENTIFIER IP_TCO_SP_TOIL FORMAT "%5.1"
 /begin AXIS_DESCR COM_AXIS toil _CNV_A_R_LINEAR_____68_CM 4 -40. 160. FORMAT "%3.0" AXIS_PTS_REF ldp_toil__tco_sp /end AXIS_DESCR
/end CHARACTERISTIC
/begin AXIS_PTS ldpm_v_hvr__tco_hvr "" 0x84499e online_dummy _REC_AXS_20_u2 4.9951171875 _CNV_A_R_LINEAR_____260_CM 3 0. 4.9951171875 FORMAT "%5.3" /end AXIS_PTS
/begin CHARACTERISTIC ip_tco_min_hvr "minimum TCO_SP depending on cooling request" CURVE 0x847a75 _REC_CUR_20_u1_u2 190.5 _CNV_A_R_LINEAR_____235_CM -48. 142.5 DISPLAY_IDENTIFIER IP_TCO_MIN_HVR FORMAT "%5.1"
 /begin AXIS_DESCR COM_AXIS online_dummy _CNV_A_R_LINEAR_____260_CM 3 0. 4.9951171875 FORMAT "%5.3" AXIS_PTS_REF ldpm_v_hvr__tco_hvr /end AXIS_DESCR
/end CHARACTERISTIC
/begin CHARACTERISTIC ip_tco_max_hvr "maximum TCO_SP depending on cooling request" CURVE 0x847a72 _REC_CUR_20_u1_u2 190.5 _CNV_A_R_LINEAR_____235_CM -48. 142.5 DISPLAY_IDENTIFIER IP_TCO_MAX_HVR FORMAT "%5.1"
 /begin AXIS_DESCR COM_AXIS online_dummy _CNV_A_R_LINEAR_____260_CM 3 0. 4.9951171875 FORMAT "%5.3" AXIS_PTS_REF ldpm_v_hvr__tco_hvr /end AXIS_DESCR
/end CHARACTERISTIC
/begin MEASUREMENT tco_dif "difference between TCO_SP and actual TCO" SBYTE _CNV_A_R_LINEAR_____254_CM 1 0. -96. 95.25 DISPLAY_IDENTIFIER TCO_DIF ECU_ADDRESS 0x7fb718 FORMAT "%4.1" /end MEASUREMENT
/begin MEASUREMENT tco_1_2 "difference between actual TCO and TCO_2 (TCO difference before and after cooler)" UBYTE _CNV_A_R_LINEAR_____243_CM 1 0. 0. 190.5 DISPLAY_IDENTIFIER TCO_1_2 ECU_ADDRESS 0x7fb717 FORMAT "%5.1" /end MEASUREMENT
/begin MEASUREMENT lv_ect_act "electrical heated thermostat available and cooling system without failures (for CAN output)" UBYTE _CNV_S_2_RANGE__0___88_CM 1 0. 0. 1. DISPLAY_IDENTIFIER LV_ECT_ACT ECU_ADDRESS 0x7fb719 BIT_MASK 0x1 /end MEASUREMENT
/begin CHARACTERISTIC c_tco_sub_tco_dif "substitute value for TCO for TCO_DIF calculation in case of TCO failure detected" VALUE 0x8486db _REC_VAL_20_u1 190.5 _CNV_A_R_LINEAR_____235_CM -48. 142.5 DISPLAY_IDENTIFIER C_TCO_SUB_TCO_DIF FORMAT "%5.1" /end CHARACTERISTIC
/begin MEASUREMENT tam "Ambient air temperature" UBYTE _CNV_A_R_LINEAR_____235_CM 1 0. -48. 142.5 DISPLAY_IDENTIFIER TAM ECU_ADDRESS 0x7fb77c FORMAT "%5.1" /end MEASUREMENT
/begin CHARACTERISTIC c_tam_sub "Default value for ambient air temperature" VALUE 0x8486be _REC_VAL_20_u1 190.5 _CNV_A_R_LINEAR_____235_CM -48. 142.5 DISPLAY_IDENTIFIER C_TAM_SUB FORMAT "%5.1" /end CHARACTERISTIC
/begin CHARACTERISTIC lc_tam_can_use "Logical value to use the CAN message for TAM evaluation (LC_TAM_CAN_USE = 1)" VALUE 0x8487d8 _REC_VAL_20_u1 1. _CNV_S_2_RANGE__0___88_CM 0. 1. DISPLAY_IDENTIFIER LC_TAM_CAN_USE /end CHARACTERISTIC
/begin CHARACTERISTIC lc_tia_sub_mdl "" VALUE 0x85c370 _REC_VAL_20_u1 1. _CNV_A_R_LINEAR_____0_CM 0. 1. DISPLAY_IDENTIFIER LC_TIA_SUB_MDL FORMAT "%2.0" /end CHARACTERISTIC
/begin MEASUREMENT pv_av "global degree of activation of the accelerator pedal" UWORD _CNV_A_R_LINEAR_____81_CM 1 0. 0. 100. DISPLAY_IDENTIFIER PV_AV ECU_ADDRESS 0x7fc96c BYTE_ORDER MSB_LAST FORMAT "%4.2" /end MEASUREMENT
/begin MEASUREMENT lv_kd "flag for Kick-Down Recognition" UBYTE _CNV_S_2_RANGE______11_CM 1 0. 0. 1. DISPLAY_IDENTIFIER LV_KD ECU_ADDRESS 0x7fca6a /end MEASUREMENT
/begin MEASUREMENT pv_av_1 "degree of activation of the accelerator pedal from PVS-channel 1" UWORD _CNV_A_R_LINEAR_____81_CM 1 0. 0. 100. DISPLAY_IDENTIFIER PV_AV_1 ECU_ADDRESS 0x7fc972 BYTE_ORDER MSB_LAST FORMAT "%4.2" /end MEASUREMENT
/begin MEASUREMENT pv_av_2 "degree of activation of the accelerator pedal from PVS-channel 2" UWORD _CNV_A_R_LINEAR_____81_CM 1 0. 0. 100. DISPLAY_IDENTIFIER PV_AV_2 ECU_ADDRESS 0x7fc974 BYTE_ORDER MSB_LAST FORMAT "%4.2" /end MEASUREMENT
/begin MEASUREMENT lv_pvs_kd "flag for kick-down-recognition (internally recognized from both PVS-Voltages)" UBYTE _CNV_S_2_RANGE______11_CM 1 0. 0. 1. DISPLAY_IDENTIFIER LV_PVS_KD ECU_ADDRESS 0x7fca6b /end MEASUREMENT
/begin MEASUREMENT v_pvs_fil_1 "filtered voltage of pedal value sensor 1" UWORD _CNV_A_R_LINEAR_____33_CM 1 0. 0. 4.9951171875 DISPLAY_IDENTIFIER V_PVS_FIL_1 ECU_ADDRESS 0x7fc982 BYTE_ORDER MSB_LAST FORMAT "%4.3" /end MEASUREMENT
/begin MEASUREMENT v_pvs_fil_2 "filtered voltage of pedal value sensor 2" UWORD _CNV_A_R_LINEAR_____33_CM 1 0. 0. 4.9951171875 DISPLAY_IDENTIFIER V_PVS_FIL_2 ECU_ADDRESS 0x7fc984 BYTE_ORDER MSB_LAST FORMAT "%4.3" /end MEASUREMENT
/begin MEASUREMENT pv_av_grd "gradient of PV_AV" SWORD _CNV_A_R_LINEAR_____261_CM 1 0. -99.90000000000001 99.90000000000001 DISPLAY_IDENTIFIER PV_AV_GRD ECU_ADDRESS 0x7fc970 BYTE_ORDER MSB_LAST FORMAT "%4.2" /end MEASUREMENT
/begin MEASUREMENT pv_av_sel "activation of the accelerator pedal raw value" UWORD _CNV_A_R_LINEAR_____81_CM 1 0. 0. 100. DISPLAY_IDENTIFIER PV_AV_SEL ECU_ADDRESS 0x7fc96e BYTE_ORDER MSB_LAST FORMAT "%4.2" /end MEASUREMENT
/begin CHARACTERISTIC c_v_pvs_hys_fil "band width of dejitter filter" VALUE 0x85c238 _REC_VAL_20_u2 4.9951171875 _CNV_A_R_LINEAR_____33_CM 0. 4.9951171875 DISPLAY_IDENTIFIER C_V_PVS_HYS_FIL FORMAT "%4.3" /end CHARACTERISTIC
/begin CHARACTERISTIC c_v_pvs_thd_is_l_1 "threshold for idle speed recognition (low) of channel 1" VALUE 0x85c26a _REC_VAL_20_u2 4.9951171875 _CNV_A_R_LINEAR_____33_CM 0. 4.9951171875 DISPLAY_IDENTIFIER C_V_PVS_THD_IS_L_1 FORMAT "%4.3" /end CHARACTERISTIC
/begin CHARACTERISTIC c_v_pvs_sp_fl_1 "threshold for full load recognition of channel 1" VALUE 0x85c25a _REC_VAL_20_u2 4.9951171875 _CNV_A_R_LINEAR_____33_CM 0. 4.9951171875 DISPLAY_IDENTIFIER C_V_PVS_SP_FL_1 FORMAT "%4.3" /end CHARACTERISTIC
/begin CHARACTERISTIC c_v_pvs_thd_is_h_1 "threshold for idle speed recognition (high) of channel 1" VALUE 0x85c266 _REC_VAL_20_u2 4.9951171875 _CNV_A_R_LINEAR_____33_CM 0. 4.9951171875 DISPLAY_IDENTIFIER C_V_PVS_THD_IS_H_1 FORMAT "%4.3" /end CHARACTERISTIC
/begin CHARACTERISTIC c_v_pvs_thd_is_l_2 "threshold for idle speed recognition (low) of channel 2" VALUE 0x85c26c _REC_VAL_20_u2 4.9951171875 _CNV_A_R_LINEAR_____33_CM 0. 4.9951171875 DISPLAY_IDENTIFIER C_V_PVS_THD_IS_L_2 FORMAT "%4.3" /end CHARACTERISTIC
/begin CHARACTERISTIC c_v_pvs_thd_is_h_2 "threshold for idle speed recognition (high) of channel 2" VALUE 0x85c268 _REC_VAL_20_u2 4.9951171875 _CNV_A_R_LINEAR_____33_CM 0. 4.9951171875 DISPLAY_IDENTIFIER C_V_PVS_THD_IS_H_2 FORMAT "%4.3" /end CHARACTERISTIC
/begin CHARACTERISTIC c_v_pvs_sp_fl_2 "threshold for full load recognition of channel 2" VALUE 0x85c25c _REC_VAL_20_u2 4.9951171875 _CNV_A_R_LINEAR_____33_CM 0. 4.9951171875 DISPLAY_IDENTIFIER C_V_PVS_SP_FL_2 FORMAT "%4.3" /end CHARACTERISTIC
/begin CHARACTERISTIC c_v_pvs_thd_kd_1 "difference between V_PVS_MAX_1 and Kick-Down-Recognition (channel 1)" VALUE 0x85c26e _REC_VAL_20_u2 4.9951171875 _CNV_A_R_LINEAR_____33_CM 0. 4.9951171875 DISPLAY_IDENTIFIER C_V_PVS_THD_KD_1 FORMAT "%4.3" /end CHARACTERISTIC
/begin CHARACTERISTIC c_v_pvs_thd_kd_2 "difference between V_PVS_MAX_2 and Kick-Down-Recognition (channel 2)" VALUE 0x85c270 _REC_VAL_20_u2 4.9951171875 _CNV_A_R_LINEAR_____33_CM 0. 4.9951171875 DISPLAY_IDENTIFIER C_V_PVS_THD_KD_2 FORMAT "%4.3" /end CHARACTERISTIC
/begin CHARACTERISTIC c_ctr_max_pvs_is_rng_h "PVS_IS_RNG_H counter maximum value" VALUE 0x85bdb9 _REC_VAL_20_u1 255. _CNV_A_R_LINEAR_____0_CM 0. 255. DISPLAY_IDENTIFIER C_CTR_MAX_PVS_IS_RNG_H FORMAT "%3.0" /end CHARACTERISTIC
/begin CHARACTERISTIC c_ctr_max_pvs_is_rng_l "PVS_IS_RNG_L counter maximum value" VALUE 0x85bdba _REC_VAL_20_u1 255. _CNV_A_R_LINEAR_____0_CM 0. 255. DISPLAY_IDENTIFIER C_CTR_MAX_PVS_IS_RNG_L FORMAT "%3.0" /end CHARACTERISTIC
/begin CHARACTERISTIC c_pv_grd_lih_max "maximum positive gradient of PV_AV in case of failure" VALUE 0x85bff6 _REC_VAL_20_u2 100. _CNV_A_R_LINEAR_____263_CM 0. 100. DISPLAY_IDENTIFIER C_PV_GRD_LIH_MAX FORMAT "%4.2" /end CHARACTERISTIC
/begin CHARACTERISTIC c_pv_lih_max "maximum value of PV_AV in case of failure" VALUE 0x85bff8 _REC_VAL_20_u2 100. _CNV_A_R_LINEAR_____81_CM 0. 100. DISPLAY_IDENTIFIER C_PV_LIH_MAX FORMAT "%4.2" /end CHARACTERISTIC
/begin CHARACTERISTIC c_pvs_bls_bts_plaus_lgrd_neg "negative gradient limitation of PV_AV at PVS_BLS_BTS_PLAUS-check" VALUE 0x85bffc _REC_VAL_20_u2 100. _CNV_A_R_LINEAR_____263_CM 0. 100. DISPLAY_IDENTIFIER C_PVS_BLS_BTS_PLAUS_LGRD_NEG FORMAT "%4.2" /end CHARACTERISTIC
/begin CHARACTERISTIC c_pvs_bls_bts_plaus_lgrd_pos "positive gradient limitation of PV_AV at PVS_BLS_BTS_PLAUS-check" VALUE 0x85bffe _REC_VAL_20_u2 100. _CNV_A_R_LINEAR_____263_CM 0. 100. DISPLAY_IDENTIFIER C_PVS_BLS_BTS_PLAUS_LGRD_POS FORMAT "%4.2" /end CHARACTERISTIC
/begin CHARACTERISTIC c_v_pvs_sp_max_1 "maximum voltage of PVS-channel 1" VALUE 0x85c25e _REC_VAL_20_u2 4.9951171875 _CNV_A_R_LINEAR_____33_CM 0. 4.9951171875 DISPLAY_IDENTIFIER C_V_PVS_SP_MAX_1 FORMAT "%4.3" /end CHARACTERISTIC
/begin CHARACTERISTIC c_v_pvs_sp_max_2 "maximum voltage of PVS-channel 2" VALUE 0x85c260 _REC_VAL_20_u2 4.9951171875 _CNV_A_R_LINEAR_____33_CM 0. 4.9951171875 DISPLAY_IDENTIFIER C_V_PVS_SP_MAX_2 FORMAT "%4.3" /end CHARACTERISTIC
/begin CHARACTERISTIC c_v_pvs_thd_grd_1 "threshold for gradient of V_PVS_1" VALUE 0x85c262 _REC_VAL_20_u2 4.9951171875 _CNV_A_R_LINEAR_____33_CM 0. 4.9951171875 DISPLAY_IDENTIFIER C_V_PVS_THD_GRD_1 FORMAT "%4.3" /end CHARACTERISTIC
/begin CHARACTERISTIC c_v_pvs_thd_grd_2 "threshold for gradient of V_PVS_2" VALUE 0x85c264 _REC_VAL_20_u2 4.9951171875 _CNV_A_R_LINEAR_____33_CM 0. 4.9951171875 DISPLAY_IDENTIFIER C_V_PVS_THD_GRD_2 FORMAT "%4.3" /end CHARACTERISTIC
/begin MEASUREMENT cru_swi_pos "CRU SWITCH position which is read either from CAN or Discrete PINS based on CRU - CONF" UBYTE _CNV_A_R_LINEAR_____1_CM 1 0. 0. 255. DISPLAY_IDENTIFIER CRU_SWI_POS ECU_ADDRESS 0x7fb426 FORMAT "%3.0" /end MEASUREMENT
/begin MEASUREMENT cru_swi_pos_deb "debouced hardware state of lever from CAN" UBYTE _CNV_A_R_LINEAR_____1_CM 1 0. 0. 255. DISPLAY_IDENTIFIER CRU_SWI_POS_DEB ECU_ADDRESS 0x7fb427 FORMAT "%3.0" /end MEASUREMENT
/begin MEASUREMENT cru_swi_pos_can "Variable zur Darstellung der Schaltzustaende der GRA (empfangene Botschaft)" UBYTE _CNV_A_R_LINEAR_____1_CM 1 0. 0. 255. DISPLAY_IDENTIFIER CRU_SWI_POS_CAN ECU_ADDRESS 0x7fb3e2 FORMAT "%3.0" /end MEASUREMENT
/begin MEASUREMENT lv_cru_can_vld "Flag fuer \"GRA-Botschaft gueltig / fehlerfrei\"" UBYTE _CNV_S_2_RANGE__0___88_CM 1 0. 0. 1. DISPLAY_IDENTIFIER LV_CRU_CAN_VLD ECU_ADDRESS 0x7fb3e4 BIT_MASK 0x1 /end MEASUREMENT
/begin MEASUREMENT lv_err_cru_dvc_smls "Flag fuer \"GRA-Bedienteilfehler vom sendenden Steuergeraet erkannt\"" UBYTE _CNV_S_2_RANGE__0___88_CM 1 0. 0. 1. DISPLAY_IDENTIFIER LV_ERR_CRU_DVC_SMLS ECU_ADDRESS 0x7fb3e5 BIT_MASK 0x1 /end MEASUREMENT
/begin MEASUREMENT lv_cru_dcc_conf "Kodierinfo vom SMLS; 0=GRA, 1=ACC" UBYTE _CNV_S_2_RANGE__0___88_CM 1 0. 0. 1. DISPLAY_IDENTIFIER LV_CRU_DCC_CONF ECU_ADDRESS 0x7fb3e6 BIT_MASK 0x1 /end MEASUREMENT
/begin MEASUREMENT lv_err_cru_conf "Flag fuer \"Fehler in GRA-Bedienteilkonfiguration erkannt\"" UBYTE _CNV_S_2_RANGE__0___88_CM 1 0. 0. 1. DISPLAY_IDENTIFIER LV_ERR_CRU_CONF ECU_ADDRESS 0x7fb3e7 BIT_MASK 0x1 /end MEASUREMENT
/begin MEASUREMENT lv_err_ctr_msg_cru "Flag fuer \"Botschaftszaehlerfehler erkannt\"" UBYTE _CNV_S_2_RANGE__0___88_CM 1 0. 0. 1. DISPLAY_IDENTIFIER LV_ERR_CTR_MSG_CRU ECU_ADDRESS 0x7fb3e8 BIT_MASK 0x1 /end MEASUREMENT
/begin MEASUREMENT lv_err_cks_cru_can_diag "Flag fuer \"Checksummenfehler erkannt\"" UBYTE _CNV_S_2_RANGE__0___88_CM 1 0. 0. 1. DISPLAY_IDENTIFIER LV_ERR_CKS_CRU_CAN_DIAG ECU_ADDRESS 0x7fb3ea BIT_MASK 0x1 /end MEASUREMENT
/begin MEASUREMENT lv_err_cks_cru_can "Flag fuer \"Checksumme unplausibel\"" UBYTE _CNV_S_2_RANGE__0___88_CM 1 0. 0. 1. DISPLAY_IDENTIFIER LV_ERR_CKS_CRU_CAN ECU_ADDRESS 0x7fb3e9 BIT_MASK 0x1 /end MEASUREMENT
/begin MEASUREMENT cru_conf "GRA-Konfiguration" UBYTE _CNV_S_3_STATE_CRU__333_CM 1 0. 0. 3. DISPLAY_IDENTIFIER CRU_CONF ECU_ADDRESS 0x7fb3e3 /end MEASUREMENT
/begin MEASUREMENT lv_cru_swi_main "Typ Hauptschalter" UBYTE _CNV_S_2_RANGE__0___88_CM 1 0. 0. 1. DISPLAY_IDENTIFIER LV_CRU_SWI_MAIN ECU_ADDRESS 0x7fb3eb BIT_MASK 0x1 /end MEASUREMENT
/begin MEASUREMENT n_max_thd "actual engine speed limit" UWORD _CNV_A_R_LINEAR_____5_CM 1 0. 0. 6375. DISPLAY_IDENTIFIER N_MAX_THD ECU_ADDRESS 0x7fa0b0 BYTE_ORDER MSB_LAST FORMAT "%4.0" /end MEASUREMENT
/begin CHARACTERISTIC c_n_max "general engine speed threshold for engine speed limitation" VALUE 0x8484e2 _REC_VAL_20_u2 6375. _CNV_A_R_LINEAR_____5_CM 0. 6375. DISPLAY_IDENTIFIER C_N_MAX FORMAT "%4.0" /end CHARACTERISTIC
/begin CHARACTERISTIC c_n_max_mt "engine speed limit for engine speed limitation of stopped vehicle" VALUE 0x85bfae _REC_VAL_20_u2 6375. _CNV_A_R_LINEAR_____5_CM 0. 6375. DISPLAY_IDENTIFIER C_N_MAX_MT FORMAT "%4.0" /end CHARACTERISTIC
/begin CHARACTERISTIC c_n_max_mon "engine speed limit in case of detected error by process monitoring" VALUE 0x85bfac _REC_VAL_20_u2 6375. _CNV_A_R_LINEAR_____5_CM 0. 6375. DISPLAY_IDENTIFIER C_N_MAX_MON FORMAT "%4.0" /end CHARACTERISTIC
/begin CHARACTERISTIC c_n_max_tqi "engine speed limit for torque limitation" VALUE 0x85bfb6 _REC_VAL_20_u2 6375. _CNV_A_R_LINEAR_____5_CM 0. 6375. DISPLAY_IDENTIFIER C_N_MAX_TQI FORMAT "%4.0" /end CHARACTERISTIC
/begin CHARACTERISTIC c_n_max_etc "engine speed limit for pedal value" VALUE 0x85bfa0 _REC_VAL_20_u2 6375. _CNV_A_R_LINEAR_____5_CM 0. 6375. DISPLAY_IDENTIFIER C_N_MAX_ETC FORMAT "%4.0" /end CHARACTERISTIC
/begin MEASUREMENT tba "charge air temperature" UBYTE _CNV_A_R_LINEAR_____18_CM 1 0. -50. 205. DISPLAY_IDENTIFIER TBA ECU_ADDRESS 0x7fca88 FORMAT "%3.0" /end MEASUREMENT
/begin CHARACTERISTIC c_tba_sub_diag "charge air temperature substitute value" VALUE 0x85c13a _REC_VAL_20_u1 255. _CNV_A_R_LINEAR_____18_CM -50. 205. DISPLAY_IDENTIFIER C_TBA_SUB_DIAG FORMAT "%3.0" /end CHARACTERISTIC
/begin MEASUREMENT v_tba "charge air temperature (voltage)" UWORD _CNV_A_R_LINEAR_____33_CM 1 0. 0. 4.9951171875 DISPLAY_IDENTIFIER V_TBA ECU_ADDRESS 0x7fc9a0 BYTE_ORDER MSB_LAST FORMAT "%4.3" /end MEASUREMENT
/begin MEASUREMENT tba_mes "measured charge air temperature" UBYTE _CNV_A_R_LINEAR_____18_CM 1 0. -50. 205. DISPLAY_IDENTIFIER TBA_MES ECU_ADDRESS 0x7fca89 FORMAT "%3.0" /end MEASUREMENT
/begin CHARACTERISTIC ip_tba_mes__v_tba "SYS_VAR: TBA sensor map" CURVE 0x85ab08 _REC_CUR_20_u1_u2 255. _CNV_A_R_LINEAR_____18_CM -50. 205. DISPLAY_IDENTIFIER IP_TBA_MES__V_TBA FORMAT "%3.0"
 /begin AXIS_DESCR COM_AXIS v_tba _CNV_A_R_LINEAR_____33_CM 16 0. 4.9951171875 FORMAT "%4.3" AXIS_PTS_REF ldp_v_tba_ip_tba_mes /end AXIS_DESCR
/end CHARACTERISTIC
/begin AXIS_PTS ldp_v_tba_ip_tba_mes "" 0x84331c v_tba _REC_AXS_20_u2 4.9951171875 _CNV_A_R_LINEAR_____33_CM 16 0. 4.9951171875 FORMAT "%4.3" /end AXIS_PTS
/begin MEASUREMENT map_mes "measured intake manifold pressure per segment" UWORD _CNV_A_R_LINEAR_____21_CM 1 0. 0. 5434. DISPLAY_IDENTIFIER MAP_MES ECU_ADDRESS 0x7fc968 BYTE_ORDER MSB_LAST FORMAT "%6.2" /end MEASUREMENT
/begin MEASUREMENT map "intake manifold pressure (incl. substitute value)" UWORD _CNV_A_R_LINEAR_____21_CM 1 0. 0. 5434. DISPLAY_IDENTIFIER MAP ECU_ADDRESS 0x7fc966 BYTE_ORDER MSB_LAST FORMAT "%6.2" /end MEASUREMENT
/begin CHARACTERISTIC ip_map_mes__v_map "AMAP: conversion characteristic for MAP_MES" CURVE 0x84f05c _REC_CUR_20_u2_u2 5434. _CNV_A_R_LINEAR_____21_CM 0. 5434. DISPLAY_IDENTIFIER IP_MAP_MES__V_MAP FORMAT "%6.2"
 /begin AXIS_DESCR COM_AXIS v_map _CNV_A_R_LINEAR_____52_CM 2 0. 4.9999237 FORMAT "%4.3" AXIS_PTS_REF ldp_v_map_ip_map_mes /end AXIS_DESCR
/end CHARACTERISTIC
/begin AXIS_PTS ldp_v_map_ip_map_mes "" 0x8432c8 v_map _REC_AXS_20_u2 4.9999237 _CNV_A_R_LINEAR_____52_CM 2 0. 4.9999237 FORMAT "%4.3" /end AXIS_PTS
/begin CHARACTERISTIC c_map_sub_diag "intake manifold pressure substitute value" VALUE 0x85bf4c _REC_VAL_20_u2 5434. _CNV_A_R_LINEAR_____21_CM 0. 5434. DISPLAY_IDENTIFIER C_MAP_SUB_DIAG FORMAT "%6.2" /end CHARACTERISTIC
/begin MEASUREMENT map_mmv "moving mean value of the manifold pressure" UWORD _CNV_A_R_LINEAR_____21_CM 1 0. 0. 5434. DISPLAY_IDENTIFIER MAP_MMV ECU_ADDRESS 0x7fc96a BYTE_ORDER MSB_LAST FORMAT "%6.2" /end MEASUREMENT
/begin CHARACTERISTIC c_fac_map_fil "filter factor for the moving mean value of the manifold pressure" VALUE 0x85be5c _REC_VAL_20_u2 0.9999874 _CNV_A_R_LINEAR_____90_CM 0. 0.9999874 DISPLAY_IDENTIFIER C_FAC_MAP_FIL FORMAT "%6.5" /end CHARACTERISTIC
/begin MEASUREMENT trt "total running time ECU" ULONG _CNV_A_R_LINEAR_____16_CM 1 0. 0. 4294967295. DISPLAY_IDENTIFIER TRT ECU_ADDRESS 0x7fc8b0 BYTE_ORDER MSB_LAST FORMAT "%10.0" /end MEASUREMENT
/begin MEASUREMENT t_on_ecu "Key ON duration" UWORD _CNV_A_R_LINEAR_____16_CM 1 0. 0. 65535. DISPLAY_IDENTIFIER T_ON_ECU ECU_ADDRESS 0x7fc99e BYTE_ORDER MSB_LAST FORMAT "%5.0" /end MEASUREMENT
/begin MEASUREMENT ctr_max_ti_min_0 "" UBYTE _CNV_A_R_LINEAR_____0_CM 1 0. 0. 255. DISPLAY_IDENTIFIER CTR_MAX_TI_MIN_0 ECU_ADDRESS 0x7fca43 FORMAT "%3.0" /end MEASUREMENT
/begin MEASUREMENT ctr_max_ti_min_1 "" UBYTE _CNV_A_R_LINEAR_____0_CM 1 0. 0. 255. DISPLAY_IDENTIFIER CTR_MAX_TI_MIN_1 ECU_ADDRESS 0x7fca44 FORMAT "%3.0" /end MEASUREMENT
/begin MEASUREMENT ctr_max_ti_min_2 "" UBYTE _CNV_A_R_LINEAR_____0_CM 1 0. 0. 255. DISPLAY_IDENTIFIER CTR_MAX_TI_MIN_2 ECU_ADDRESS 0x7fca45 FORMAT "%3.0" /end MEASUREMENT
/begin MEASUREMENT ctr_max_ti_min_3 "" UBYTE _CNV_A_R_LINEAR_____0_CM 1 0. 0. 255. DISPLAY_IDENTIFIER CTR_MAX_TI_MIN_3 ECU_ADDRESS 0x7fca46 FORMAT "%3.0" /end MEASUREMENT
/begin MEASUREMENT t_sys "system time" ULONG _CNV_A_R_LINEAR_____223_CM 1 0. 0. 42949672.95 DISPLAY_IDENTIFIER T_SYS ECU_ADDRESS 0x7f8660 BYTE_ORDER MSB_LAST FORMAT "%11.5" /end MEASUREMENT
/begin MEASUREMENT t_igk "time \"ignition key on\"" UWORD _CNV_A_R_LINEAR_____223_CM 1 0. 0. 655.35 DISPLAY_IDENTIFIER T_IGK ECU_ADDRESS 0x7f9cca BYTE_ORDER MSB_LAST FORMAT "%6.2" /end MEASUREMENT
/begin CHARACTERISTIC c_toil_grd_max_diag "Schwelle zur Gradientenüberwachung TOIL" VALUE 0x8486f3 _REC_VAL_20_u1 200. _CNV_A_R_LINEAR_____366_CM 0. 200. DISPLAY_IDENTIFIER C_TOIL_GRD_MAX_DIAG FORMAT "%3.0" /end CHARACTERISTIC
/begin MEASUREMENT toil "oil temperature" UBYTE _CNV_A_R_LINEAR_____68_CM 1 0. -40. 160. DISPLAY_IDENTIFIER TOIL ECU_ADDRESS 0x7fb773 FORMAT "%3.0" /end MEASUREMENT
/begin CHARACTERISTIC c_toil_sub_crlc "" VALUE 0x8486fa _REC_VAL_20_u2 0.9999847412109381 _CNV_A_R_LINEAR_____300_CM 0. 0.9999847412109381 DISPLAY_IDENTIFIER C_TOIL_SUB_CRLC FORMAT "%7.5" /end CHARACTERISTIC
/begin CHARACTERISTIC c_tco_swi_cwp_toil "" VALUE 0x8486dc _REC_VAL_20_u1 190.5 _CNV_A_R_LINEAR_____235_CM -48. 142.5 DISPLAY_IDENTIFIER C_TCO_SWI_CWP_TOIL FORMAT "%5.1" /end CHARACTERISTIC
/begin CHARACTERISTIC c_tco_swi_toil_mdl_h "" VALUE 0x8486dd _REC_VAL_20_u1 190.5 _CNV_A_R_LINEAR_____235_CM -48. 142.5 DISPLAY_IDENTIFIER C_TCO_SWI_TOIL_MDL_H FORMAT "%5.1" /end CHARACTERISTIC
/begin CHARACTERISTIC c_toil_sub_h_crlc "" VALUE 0x8486fc _REC_VAL_20_u2 0.9999847412109381 _CNV_A_R_LINEAR_____300_CM 0. 0.9999847412109381 DISPLAY_IDENTIFIER C_TOIL_SUB_H_CRLC FORMAT "%7.5" /end CHARACTERISTIC
/begin CHARACTERISTIC ip_toil_crlc_ofs__t_ast "Korrelationskonstante für TOIL_MDL_OFS" CURVE 0x847ede _REC_CUR_20_u2_u2 0.9999847412109381 _CNV_A_R_LINEAR_____300_CM 0. 0.9999847412109381 DISPLAY_IDENTIFIER IP_TOIL_CRLC_OFS__T_AST FORMAT "%7.5"
 /begin AXIS_DESCR COM_AXIS t_ast _CNV_A_R_LINEAR_____234_CM 6 0.1 6553.5 FORMAT "%6.1" AXIS_PTS_REF ldp_t_ast__toil_crlc_ofs /end AXIS_DESCR
/end CHARACTERISTIC
/begin AXIS_PTS ldp_t_ast__toil_crlc_ofs "" 0x8446be t_ast _REC_AXS_20_u2 6553.400000000001 _CNV_A_R_LINEAR_____234_CM 6 0.1 6553.5 FORMAT "%6.1" /end AXIS_PTS
/begin CHARACTERISTIC ip_toil_ofs__toil_mdl_grd__n_32 "Additiver Offset für TOIL-Berechnung" MAP 0x847f1c _REC_MAP_20_u2_u2_u1 255.996094 _CNV_A_R_LINEAR_____367_CM -128. 127.996094 DISPLAY_IDENTIFIER IP_TOIL_OFS__TOIL_MDL_GRD__N_32 FORMAT "%8.3"
 /begin AXIS_DESCR COM_AXIS NO_INPUT_QUANTITY _CNV_A_R_LINEAR_____367_CM 9 -128. 127.996094 FORMAT "%8.3" AXIS_PTS_REF ldp_toil_mdl_grd_toil_add_ofs /end AXIS_DESCR
 /begin AXIS_DESCR COM_AXIS n_32 _CNV_A_R_LINEAR_____84_CM 4 0. 8160. FORMAT "%4.0" AXIS_PTS_REF ldpm_n_32_toil_sub /end AXIS_DESCR
/end CHARACTERISTIC
/begin AXIS_PTS ldp_toil_mdl_grd_toil_add_ofs "" 0x84482c NO_INPUT_QUANTITY _REC_AXS_20_u2 255.996094 _CNV_A_R_LINEAR_____367_CM 9 -128. 127.996094 FORMAT "%8.3" /end AXIS_PTS
/begin AXIS_PTS ldpm_n_32_toil_sub "" 0x844964 n_32 _REC_AXS_20_u1 8160. _CNV_A_R_LINEAR_____84_CM 4 0. 8160. FORMAT "%4.0" /end AXIS_PTS
/begin CHARACTERISTIC ip_crlc_toil_mdl_3__n_32 "Wichtungsfaktor TOIL-Berechnung (N)" CURVE 0x845618 _REC_CUR_20_u2_u1 0.9999847412109381 _CNV_A_R_LINEAR_____300_CM 0. 0.9999847412109381 DISPLAY_IDENTIFIER IP_CRLC_TOIL_MDL_3__N_32 FORMAT "%7.5"
 /begin AXIS_DESCR COM_AXIS n_32 _CNV_A_R_LINEAR_____84_CM 4 0. 8160. FORMAT "%4.0" AXIS_PTS_REF ldpm_n_32_toil_sub /end AXIS_DESCR
/end CHARACTERISTIC
/begin CHARACTERISTIC ip_crlc_toil_mdl_2__tco "Wichtungsfaktor TOIL-Berechnung (TCO)" CURVE 0x845606 _REC_CUR_20_u2_u1 0.9999847412109381 _CNV_A_R_LINEAR_____300_CM 0. 0.9999847412109381 DISPLAY_IDENTIFIER IP_CRLC_TOIL_MDL_2__TCO FORMAT "%7.5"
 /begin AXIS_DESCR COM_AXIS tco _CNV_A_R_LINEAR_____235_CM 9 -48. 142.5 FORMAT "%5.1" AXIS_PTS_REF ldp_tco_crlc_toil_mdl_2 /end AXIS_DESCR
/end CHARACTERISTIC
/begin AXIS_PTS ldp_tco_crlc_toil_mdl_2 "" 0x8447a5 tco _REC_AXS_20_u1 190.5 _CNV_A_R_LINEAR_____235_CM 9 -48. 142.5 FORMAT "%5.1" /end AXIS_PTS
/begin CHARACTERISTIC ip_crlc_toil_mdl_1__vs__tia "Wichtungsfaktor TOIL-Berechnung (VS, TIA)" MAP 0x8455be _REC_MAP_20_u2_u1_u1 0.9999847412109381 _CNV_A_R_LINEAR_____300_CM 0. 0.9999847412109381 DISPLAY_IDENTIFIER IP_CRLC_TOIL_MDL_1__VS__TIA FORMAT "%7.5"
 /begin AXIS_DESCR COM_AXIS vs _CNV_A_R_LINEAR_____239_CM 6 0. 255. FORMAT "%3.0" AXIS_PTS_REF ldp_vs_crlc_toil_mdl_1 /end AXIS_DESCR
 /begin AXIS_DESCR COM_AXIS tia _CNV_A_R_LINEAR_____235_CM 6 -48. 142.5 FORMAT "%5.1" AXIS_PTS_REF ldp_tia_crlc_toil_mdl_1 /end AXIS_DESCR
/end CHARACTERISTIC
/begin AXIS_PTS ldp_vs_crlc_toil_mdl_1 "" 0x8448c9 vs _REC_AXS_20_u1 255. _CNV_A_R_LINEAR_____239_CM 6 0. 255. FORMAT "%3.0" /end AXIS_PTS
/begin AXIS_PTS ldp_tia_crlc_toil_mdl_1 "" 0x844811 tia _REC_AXS_20_u1 190.5 _CNV_A_R_LINEAR_____235_CM 6 -48. 142.5 FORMAT "%5.1" /end AXIS_PTS
/begin CHARACTERISTIC ip_crlc_toil_mdl_4__t_ast__tco "Wichtungsfaktor TOIL-Berechnung (T_AST, TCO)" MAP 0x845620 _REC_MAP_20_u2_u2_u1 0.9999847412109381 _CNV_A_R_LINEAR_____300_CM 0. 0.9999847412109381 DISPLAY_IDENTIFIER IP_CRLC_TOIL_MDL_4__T_AST__TCO FORMAT "%7.5"
 /begin AXIS_DESCR COM_AXIS t_ast _CNV_A_R_LINEAR_____234_CM 6 0.1 6553.5 FORMAT "%6.1" AXIS_PTS_REF ldp_t_ast_crlc_toil_mdl_4 /end AXIS_DESCR
 /begin AXIS_DESCR COM_AXIS tco _CNV_A_R_LINEAR_____235_CM 4 -48. 142.5 FORMAT "%5.1" AXIS_PTS_REF ldp_tco_crlc_toil_mdl_4 /end AXIS_DESCR
/end CHARACTERISTIC
/begin AXIS_PTS ldp_t_ast_crlc_toil_mdl_4 "" 0x8446cc t_ast _REC_AXS_20_u2 6553.400000000001 _CNV_A_R_LINEAR_____234_CM 6 0.1 6553.5 FORMAT "%6.1" /end AXIS_PTS
/begin AXIS_PTS ldp_tco_crlc_toil_mdl_4 "" 0x8447af tco _REC_AXS_20_u1 190.5 _CNV_A_R_LINEAR_____235_CM 4 -48. 142.5 FORMAT "%5.1" /end AXIS_PTS
/begin CHARACTERISTIC ip_toil_sub__n_32__maf "Öltemperatur" MAP 0x847f64 _REC_MAP_20_u1_u1_u1 200. _CNV_A_R_LINEAR_____68_CM -40. 160. DISPLAY_IDENTIFIER IP_TOIL_SUB__N_32__MAF FORMAT "%3.0"
 /begin AXIS_DESCR COM_AXIS n_32 _CNV_A_R_LINEAR_____84_CM 4 0. 8160. FORMAT "%4.0" AXIS_PTS_REF ldpm_n_32_toil_sub /end AXIS_DESCR
 /begin AXIS_DESCR COM_AXIS maf_hb _CNV_A_R_LINEAR_____368_CM 4 0. 1389. FORMAT "%4.0" AXIS_PTS_REF ldp_maf_toil_sub /end AXIS_DESCR
/end CHARACTERISTIC
/begin AXIS_PTS ldp_maf_toil_sub "" 0x844594 maf_hb _REC_AXS_20_u1 1389. _CNV_A_R_LINEAR_____368_CM 4 0. 1389. FORMAT "%4.0" /end AXIS_PTS
/begin MEASUREMENT toil_max "maximum oil temperature during driving cycle" UBYTE _CNV_A_R_LINEAR_____68_CM 1 0. -40. 160. DISPLAY_IDENTIFIER TOIL_MAX ECU_ADDRESS 0x7fb774 FORMAT "%3.0" /end MEASUREMENT
/begin MEASUREMENT toil_sens "oil temperature from sensor" UBYTE _CNV_A_R_LINEAR_____68_CM 1 0. -40. 160. DISPLAY_IDENTIFIER TOIL_SENS ECU_ADDRESS 0x7fb775 FORMAT "%3.0" /end MEASUREMENT
/begin CHARACTERISTIC lc_var_toil_sens "flag for TOIL-sensor (1 = available)" VALUE 0x8487ef _REC_VAL_20_u1 1. _CNV_A_R_LINEAR_____1_CM 0. 1. DISPLAY_IDENTIFIER LC_VAR_TOIL_SENS FORMAT "%1.0" /end CHARACTERISTIC
/begin AXIS_PTS ldp_v_toil_10__toil "" 0x84487a v_toil _REC_AXS_20_u2 4.9951171875 _CNV_A_R_LINEAR_____260_CM 16 0. 4.9951171875 FORMAT "%5.3" /end AXIS_PTS
/begin CHARACTERISTIC ip_toil__v_toil "characteristic line of oil temperature sensor" CURVE 0x847ece _REC_CUR_20_u1_u2 200. _CNV_A_R_LINEAR_____68_CM -40. 160. DISPLAY_IDENTIFIER IP_TOIL__V_TOIL FORMAT "%3.0"
 /begin AXIS_DESCR COM_AXIS v_toil _CNV_A_R_LINEAR_____260_CM 16 0. 4.9951171875 FORMAT "%5.3" AXIS_PTS_REF ldp_v_toil_10__toil /end AXIS_DESCR
/end CHARACTERISTIC
/begin CHARACTERISTIC c_toil_grd_max "" VALUE 0x8486f2 _REC_VAL_20_u1 200. _CNV_A_R_LINEAR_____366_CM 0. 200. DISPLAY_IDENTIFIER C_TOIL_GRD_MAX FORMAT "%3.0" /end CHARACTERISTIC
/begin CHARACTERISTIC c_crk_dif_max_er "limitation of adaptation range ( mechanical tolerance)" VALUE 0x85bd3e _REC_VAL_20_u2 7.8125 _CNV_A_R_LINEAR_____378_CM 0. 7.8125 DISPLAY_IDENTIFIER C_CRK_DIF_MAX_ER FORMAT "%3.2" /end CHARACTERISTIC
/begin CHARACTERISTIC c_n_seg_t_ad_max_er "Maximum engine speed threshold for crankshaft position wheel learning" VALUE 0x85bfc6 _REC_VAL_20_u1 8160. _CNV_A_R_LINEAR_____58_CM 0. 8160. DISPLAY_IDENTIFIER C_N_SEG_T_AD_MAX_ER FORMAT "%4.0" /end CHARACTERISTIC
/begin CHARACTERISTIC c_n_seg_t_ad_min_er "Minimum engine speed threshold for crankshaft position wheel learning" VALUE 0x85bfc7 _REC_VAL_20_u1 8160. _CNV_A_R_LINEAR_____58_CM 0. 8160. DISPLAY_IDENTIFIER C_N_SEG_T_AD_MIN_ER FORMAT "%4.0" /end CHARACTERISTIC
/begin CHARACTERISTIC c_seg_t_ad_cor_drv1_max_er "Maximum value of dynamic part of engine roughness" VALUE 0x85c016 _REC_VAL_20_u2 32767. _CNV_A_R_LINEAR_____359_CM 0. 32767. DISPLAY_IDENTIFIER C_SEG_T_AD_COR_DRV1_MAX_ER FORMAT "%5.0" /end CHARACTERISTIC
/begin CHARACTERISTIC c_seg_t_ad_crlc_er "Correlation factor for segment adaptation" VALUE 0x85c018 _REC_VAL_20_u2 0.9999847412109381 _CNV_A_R_LINEAR_____14_CM 0. 0.9999847412109381 DISPLAY_IDENTIFIER C_SEG_T_AD_CRLC_ER FORMAT "%6.5" /end CHARACTERISTIC
/begin CHARACTERISTIC c_seg_t_fast_ad_crlc_er "correlation factor for segment adaptation fast (only necessary if NC_USE_EXT_ADJ = 1)" VALUE 0x85c01a _REC_VAL_20_u2 0.9999847412109381 _CNV_A_R_LINEAR_____14_CM 0. 0.9999847412109381 DISPLAY_IDENTIFIER C_SEG_T_FAST_AD_CRLC_ER FORMAT "%6.5" /end CHARACTERISTIC
/begin CHARACTERISTIC c_t_seg_ad_dly "" VALUE 0x85c130 _REC_VAL_20_u1 25.5 _CNV_A_R_LINEAR_____19_CM 0. 25.5 DISPLAY_IDENTIFIER C_T_SEG_AD_DLY FORMAT "%3.1" /end CHARACTERISTIC
/begin MEASUREMENT drv0_er "static component for engine roughness calvulation update each SEG" SLONG _CNV_A_R_LINEAR_____359_CM 1 0. -2147483648. 2147483647. DISPLAY_IDENTIFIER DRV0_ER ECU_ADDRESS 0x7f865c BYTE_ORDER MSB_LAST FORMAT "%11.0" /end MEASUREMENT
/begin MEASUREMENT drv2_mmv_er "averaged curvature for engine roughness calculation update each SEG" SWORD _CNV_A_R_LINEAR_____359_CM 1 0. -32768. 32767. DISPLAY_IDENTIFIER DRV2_MMV_ER ECU_ADDRESS 0x7f9926 BYTE_ORDER MSB_LAST FORMAT "%6.0" /end MEASUREMENT
/begin MEASUREMENT er[0] "" SWORD _CNV_A_R_LINEAR_____359_CM 1 0. -32768. 32767. DISPLAY_IDENTIFIER ER_0_ ECU_ADDRESS 0x7f992e BYTE_ORDER MSB_LAST FORMAT "%6.0" /end MEASUREMENT
/begin MEASUREMENT er[1] "" SWORD _CNV_A_R_LINEAR_____359_CM 1 0. -32768. 32767. DISPLAY_IDENTIFIER ER_1_ ECU_ADDRESS 0x7f9930 BYTE_ORDER MSB_LAST FORMAT "%6.0" /end MEASUREMENT
/begin MEASUREMENT er[2] "" SWORD _CNV_A_R_LINEAR_____359_CM 1 0. -32768. 32767. DISPLAY_IDENTIFIER ER_2_ ECU_ADDRESS 0x7f9932 BYTE_ORDER MSB_LAST FORMAT "%6.0" /end MEASUREMENT
/begin MEASUREMENT er_av "currently used engine roughness value updated each SEG" SWORD _CNV_A_R_LINEAR_____359_CM 1 0. -32768. 32767. DISPLAY_IDENTIFIER ER_AV ECU_ADDRESS 0x7f9922 BYTE_ORDER MSB_LAST FORMAT "%6.0" /end MEASUREMENT
/begin MEASUREMENT er_rr "currently used engine roughness value without DRV2_MMV_ER, updated each SEG" SWORD _CNV_A_R_LINEAR_____359_CM 1 0. -32768. 32767. DISPLAY_IDENTIFIER ER_RR ECU_ADDRESS 0x7f992c BYTE_ORDER MSB_LAST FORMAT "%6.0" /end MEASUREMENT
/begin MEASUREMENT lv_seg_ad_act_state "boolean for state of segment adaptation process (Passive : Active)" UBYTE _CNV_S_2_RANGE______11_CM 1 0. 0. 1. DISPLAY_IDENTIFIER LV_SEG_AD_ACT_STATE ECU_ADDRESS 0x7fb4d0 /end MEASUREMENT
/begin MEASUREMENT lv_seg_ad_lim "boolean for segment adaptation values at limit" UBYTE _CNV_S_2_RANGE______11_CM 1 0. 0. 1. DISPLAY_IDENTIFIER LV_SEG_AD_LIM ECU_ADDRESS 0x7fb4ce /end MEASUREMENT
/begin MEASUREMENT seg_ad_mmv[0] "adaptation values for each segment(x = 0...NC_CYL_NR-1)" SWORD _CNV_A_R_LINEAR_____379_CM 1 0. -7.812507 7.812269 DISPLAY_IDENTIFIER SEG_AD_MMV_0_ ECU_ADDRESS 0x7f991a BYTE_ORDER MSB_LAST FORMAT "%7.5" /end MEASUREMENT
/begin MEASUREMENT seg_ad_mmv[1] "adaptation values for each segment(x = 0...NC_CYL_NR-1)" SWORD _CNV_A_R_LINEAR_____379_CM 1 0. -7.812507 7.812269 DISPLAY_IDENTIFIER SEG_AD_MMV_1_ ECU_ADDRESS 0x7f991c BYTE_ORDER MSB_LAST FORMAT "%7.5" /end MEASUREMENT
/begin MEASUREMENT seg_ad_mmv[2] "adaptation values for each segment(x = 0...NC_CYL_NR-1)" SWORD _CNV_A_R_LINEAR_____379_CM 1 0. -7.812507 7.812269 DISPLAY_IDENTIFIER SEG_AD_MMV_2_ ECU_ADDRESS 0x7f991e BYTE_ORDER MSB_LAST FORMAT "%7.5" /end MEASUREMENT
/begin MEASUREMENT seg_nr_er "segment counter for segment identification (0...NC_CYL_NR - 1)" UBYTE _CNV_A_R_LINEAR_____0_CM 1 0. 0. 30. DISPLAY_IDENTIFIER SEG_NR_ER ECU_ADDRESS 0x7fb4cf FORMAT "%2.0" /end MEASUREMENT
/begin MEASUREMENT seg_t_cor "corrected, measured segment time, calculated every segment" UWORD _CNV_A_R_LINEAR_____359_CM 1 0. 0. 65535. DISPLAY_IDENTIFIER SEG_T_COR ECU_ADDRESS 0x7f992a BYTE_ORDER MSB_LAST FORMAT "%5.0" /end MEASUREMENT
/begin MEASUREMENT seg_t_cor_buf[0] "" UWORD _CNV_A_R_LINEAR_____359_CM 1 0. 0. 65535. DISPLAY_IDENTIFIER SEG_T_COR_BUF_0_ ECU_ADDRESS 0x7f9936 BYTE_ORDER MSB_LAST FORMAT "%5.0" /end MEASUREMENT
/begin MEASUREMENT seg_t_cor_buf[1] "" UWORD _CNV_A_R_LINEAR_____359_CM 1 0. 0. 65535. DISPLAY_IDENTIFIER SEG_T_COR_BUF_1_ ECU_ADDRESS 0x7f9938 BYTE_ORDER MSB_LAST FORMAT "%5.0" /end MEASUREMENT
/begin MEASUREMENT seg_t_cor_buf[2] "" UWORD _CNV_A_R_LINEAR_____359_CM 1 0. 0. 65535. DISPLAY_IDENTIFIER SEG_T_COR_BUF_2_ ECU_ADDRESS 0x7f993a BYTE_ORDER MSB_LAST FORMAT "%5.0" /end MEASUREMENT
/begin MEASUREMENT seg_t_cor_buf[3] "" UWORD _CNV_A_R_LINEAR_____359_CM 1 0. 0. 65535. DISPLAY_IDENTIFIER SEG_T_COR_BUF_3_ ECU_ADDRESS 0x7f993c BYTE_ORDER MSB_LAST FORMAT "%5.0" /end MEASUREMENT
/begin MEASUREMENT seg_t_cor_buf[4] "" UWORD _CNV_A_R_LINEAR_____359_CM 1 0. 0. 65535. DISPLAY_IDENTIFIER SEG_T_COR_BUF_4_ ECU_ADDRESS 0x7f993e BYTE_ORDER MSB_LAST FORMAT "%5.0" /end MEASUREMENT
/begin MEASUREMENT seg_t_cor_buf[5] "" UWORD _CNV_A_R_LINEAR_____359_CM 1 0. 0. 65535. DISPLAY_IDENTIFIER SEG_T_COR_BUF_5_ ECU_ADDRESS 0x7f9940 BYTE_ORDER MSB_LAST FORMAT "%5.0" /end MEASUREMENT
/begin AXIS_PTS ldpm_n_32__drv2_er "ER: weighting factor for engine roughness curvature component calculation (correction amount), MT vehicle" 0x8438c2 n_32 _REC_AXS_20_u1 8160. _CNV_A_R_LINEAR_____58_CM 4 0. 8160. FORMAT "%4.0" /end AXIS_PTS
/begin CHARACTERISTIC ip_crlc_drv2_er_mt "ER: correlation coefficient for drv2 MT" CURVE 0x84a3f2 _REC_CUR_20_u1_u1 0.99609375 _CNV_A_R_LINEAR_____34_CM 0. 0.99609375 DISPLAY_IDENTIFIER IP_CRLC_DRV2_ER_MT FORMAT "%4.3"
 /begin AXIS_DESCR COM_AXIS n_32 _CNV_A_R_LINEAR_____58_CM 4 0. 8160. FORMAT "%4.0" AXIS_PTS_REF ldpm_n_32__drv2_er /end AXIS_DESCR
/end CHARACTERISTIC
/begin CHARACTERISTIC ip_fac_drv2_er_at "ER: weighting factor for engine roughness curvature component calculation (correction amount), AT vehicle" CURVE 0x84b956 _REC_CUR_20_u1_u1 3.984375 _CNV_A_R_LINEAR_____98_CM 0. 3.984375 DISPLAY_IDENTIFIER IP_FAC_DRV2_ER_AT FORMAT "%4.3"
 /begin AXIS_DESCR COM_AXIS n_32 _CNV_A_R_LINEAR_____58_CM 4 0. 8160. FORMAT "%4.0" AXIS_PTS_REF ldpm_n_32__drv2_er /end AXIS_DESCR
/end CHARACTERISTIC
/begin CHARACTERISTIC ip_fac_drv2_er_mt "ER: factor for drv2 MT" CURVE 0x84b95a _REC_CUR_20_u1_u1 3.984375 _CNV_A_R_LINEAR_____98_CM 0. 3.984375 DISPLAY_IDENTIFIER IP_FAC_DRV2_ER_MT FORMAT "%4.3"
 /begin AXIS_DESCR COM_AXIS n_32 _CNV_A_R_LINEAR_____58_CM 4 0. 8160. FORMAT "%4.0" AXIS_PTS_REF ldpm_n_32__drv2_er /end AXIS_DESCR
/end CHARACTERISTIC
/begin CHARACTERISTIC ip_crlc_drv2_er_at "ER: correlation factor for engine roughness curvature component calculation (correction duration), AT vehicle" CURVE 0x84a3ee _REC_CUR_20_u1_u1 0.99609375 _CNV_A_R_LINEAR_____34_CM 0. 0.99609375 DISPLAY_IDENTIFIER IP_CRLC_DRV2_ER_AT FORMAT "%4.3"
 /begin AXIS_DESCR COM_AXIS n_32 _CNV_A_R_LINEAR_____58_CM 4 0. 8160. FORMAT "%4.0" AXIS_PTS_REF ldpm_n_32__drv2_er /end AXIS_DESCR
/end CHARACTERISTIC
/begin MEASUREMENT drv1_er "dynamic component for engine roughness calculation update each SEG" SWORD _CNV_A_R_LINEAR_____359_CM 1 0. -32768. 32767. DISPLAY_IDENTIFIER DRV1_ER ECU_ADDRESS 0x7f9924 BYTE_ORDER MSB_LAST FORMAT "%6.0" /end MEASUREMENT
/begin MEASUREMENT iv_off_er "byte buffer that shows the injector status" UBYTE _CNV_A_R_LINEAR_____0_CM 1 0. 0. 255. DISPLAY_IDENTIFIER IV_OFF_ER ECU_ADDRESS 0x7fb4d1 FORMAT "%3.0" /end MEASUREMENT
/begin MEASUREMENT lv_inh_seg_ad "boolean for segment time adaptation activation set by project specific conditions" UBYTE _CNV_A_R_LINEAR_____0_CM 1 0. 0. 1. DISPLAY_IDENTIFIER LV_INH_SEG_AD ECU_ADDRESS 0x7fb4d2 FORMAT "%1.0" /end MEASUREMENT
/begin MEASUREMENT lv_seg_ad_fdout "boolean for segment time adaptation activation set by DS-specific conditions" UBYTE _CNV_S_2_RANGE______11_CM 1 0. 0. 1. DISPLAY_IDENTIFIER LV_SEG_AD_FDOUT ECU_ADDRESS 0x7fb4d3 /end MEASUREMENT
/begin MEASUREMENT maf "total air mass" UWORD _CNV_A_R_LINEAR_____23_CM 1 0. 0. 1389. DISPLAY_IDENTIFIER MAF ECU_ADDRESS 0x7fc94a BYTE_ORDER MSB_LAST FORMAT "%6.2" /end MEASUREMENT
/begin MEASUREMENT maf_kgh "total mass air flow" UWORD _CNV_A_R_LINEAR_____112_CM 1 0. 0. 1023.984375 DISPLAY_IDENTIFIER MAF_KGH ECU_ADDRESS 0x7fc94e BYTE_ORDER MSB_LAST FORMAT "%6.2" /end MEASUREMENT
/begin MEASUREMENT maf_kgh_mes "measured total mass air flow" UWORD _CNV_A_R_LINEAR_____112_CM 1 0. 0. 1023.984375 DISPLAY_IDENTIFIER MAF_KGH_MES ECU_ADDRESS 0x7fc952 BYTE_ORDER MSB_LAST FORMAT "%5.0" /end MEASUREMENT
/begin MEASUREMENT maf_mmv "moving mean value of the global air mass flow MAF" UWORD _CNV_A_R_LINEAR_____23_CM 1 0. 0. 1389. DISPLAY_IDENTIFIER MAF_MMV ECU_ADDRESS 0x7fc95a BYTE_ORDER MSB_LAST FORMAT "%6.2" /end MEASUREMENT
/begin MEASUREMENT v_maf "mass air flow raw acquisition (1ms recurrence)" UWORD _CNV_A_R_LINEAR_____33_CM 1 0. 0. 4.9951171875 DISPLAY_IDENTIFIER V_MAF ECU_ADDRESS 0x7fc960 BYTE_ORDER MSB_LAST FORMAT "%3.2" /end MEASUREMENT
/begin MEASUREMENT v_maf_x "" UBYTE _CNV_A_R_LINEAR_____0_CM 1 0. 0. 15. DISPLAY_IDENTIFIER V_MAF_X ECU_ADDRESS 0x7fca52 FORMAT "%2.0" /end MEASUREMENT
/begin MEASUREMENT v_maf_y "" UBYTE _CNV_A_R_LINEAR_____0_CM 1 0. 0. 15. DISPLAY_IDENTIFIER V_MAF_Y ECU_ADDRESS 0x7fca53 FORMAT "%2.0" /end MEASUREMENT
/begin MEASUREMENT lv_maf_0_puls "flag for detection of air mass flow pulsation; j = 0 ... (NC_MAF_NR - 1)" UBYTE _CNV_S_2_RANGE______11_CM 1 0. 0. 1. DISPLAY_IDENTIFIER LV_MAF_0_PULS ECU_ADDRESS 0x7fca58 /end MEASUREMENT
/begin MEASUREMENT maf_0 "air mass; j = 0 ... (NC_MAF_NR - 1)" UWORD _CNV_A_R_LINEAR_____23_CM 1 0. 0. 1389. DISPLAY_IDENTIFIER MAF_0 ECU_ADDRESS 0x7fc94c BYTE_ORDER MSB_LAST FORMAT "%6.2" /end MEASUREMENT
/begin MEASUREMENT maf_0_kgh "mass air flow; j = 0 ... (NC_MAF_NR - 1)" UWORD _CNV_A_R_LINEAR_____112_CM 1 0. 0. 1023.984375 DISPLAY_IDENTIFIER MAF_0_KGH ECU_ADDRESS 0x7fc950 BYTE_ORDER MSB_LAST FORMAT "%6.2" /end MEASUREMENT
/begin MEASUREMENT maf_0_kgh_grd "gradient of air mass flow; j = 0 ... (NC_MAF_NR - 1)" SWORD _CNV_A_R_LINEAR_____112_CM 1 0. -512. 511.984375 DISPLAY_IDENTIFIER MAF_0_KGH_GRD ECU_ADDRESS 0x7fc958 BYTE_ORDER MSB_LAST FORMAT "%6.2" /end MEASUREMENT
/begin MEASUREMENT maf_0_kgh_mes "measured mass air flow; j = 0 ... (NC_MAF_NR - 1)" UWORD _CNV_A_R_LINEAR_____112_CM 1 0. 0. 1023.984375 DISPLAY_IDENTIFIER MAF_0_KGH_MES ECU_ADDRESS 0x7fc954 BYTE_ORDER MSB_LAST FORMAT "%5.0" /end MEASUREMENT
/begin MEASUREMENT maf_0_kgh_puls "air mass flow pulsation; j = 0 ... (NC_MAF_NR - 1)" UWORD _CNV_A_R_LINEAR_____112_CM 1 0. 0. 1023.984375 DISPLAY_IDENTIFIER MAF_0_KGH_PULS ECU_ADDRESS 0x7fc95e BYTE_ORDER MSB_LAST FORMAT "%6.2" /end MEASUREMENT
/begin MEASUREMENT maf_0_kgh_sub "substitutional value for MAF_j_KGH; j = 0 ... (NC_MAF_NR - 1)" UWORD _CNV_A_R_LINEAR_____112_CM 1 0. 0. 1023.984375 DISPLAY_IDENTIFIER MAF_0_KGH_SUB ECU_ADDRESS 0x7fc956 BYTE_ORDER MSB_LAST FORMAT "%5.0" /end MEASUREMENT
/begin MEASUREMENT maf_0_mmv "moving mean value of the air mass flow MAF_j; j = 0 ... (NC_MAF_NR - 1)" UWORD _CNV_A_R_LINEAR_____23_CM 1 0. 0. 1389. DISPLAY_IDENTIFIER MAF_0_MMV ECU_ADDRESS 0x7fc95c BYTE_ORDER MSB_LAST FORMAT "%6.2" /end MEASUREMENT
/begin CHARACTERISTIC c_ctr_maf_kgh_puls "counter for pulsation detection and reset" VALUE 0x85bdad _REC_VAL_20_u1 15. _CNV_A_R_LINEAR_____0_CM 0. 15. DISPLAY_IDENTIFIER C_CTR_MAF_KGH_PULS FORMAT "%2.0" /end CHARACTERISTIC
/begin CHARACTERISTIC c_n_32_max_puls "maximum engine speed for pulsation detection" VALUE 0x85bf86 _REC_VAL_20_u1 8160. _CNV_A_R_LINEAR_____58_CM 0. 8160. DISPLAY_IDENTIFIER C_N_32_MAX_PULS FORMAT "%5.1" /end CHARACTERISTIC
/begin CHARACTERISTIC c_maf_kgh_grd_max_puls "MAF_KGH_GRD threshold for pulsation detection" VALUE 0x85bf02 _REC_VAL_20_s2 1023.984375 _CNV_A_R_LINEAR_____112_CM -512. 511.984375 DISPLAY_IDENTIFIER C_MAF_KGH_GRD_MAX_PULS FORMAT "%7.2" /end CHARACTERISTIC
/begin CHARACTERISTIC c_maf_kgh_puls_hys "MAF_KGH_PULS hysteresis for IP_MAF_KGH_PULS_MAX threshold" VALUE 0x85bf0c _REC_VAL_20_u2 1023.984375 _CNV_A_R_LINEAR_____112_CM 0. 1023.984375 DISPLAY_IDENTIFIER C_MAF_KGH_PULS_HYS FORMAT "%7.2" /end CHARACTERISTIC
/begin CHARACTERISTIC c_thrpwm_max_puls "minimum throttle PWM for pulsation detection" VALUE 0x85c1ae _REC_VAL_20_u2 99.99847412109381 _CNV_A_R_LINEAR_____8_CM 0. 99.99847412109381 DISPLAY_IDENTIFIER C_THRPWM_MAX_PULS FORMAT "%5.3" /end CHARACTERISTIC
/begin CHARACTERISTIC c_t_thrpwm_max_puls "filter time for THRPWM for pulsation detection" VALUE 0x85c132 _REC_VAL_20_u2 4.19424 _CNV_A_R_LINEAR_____67_CM 0. 4.19424 DISPLAY_IDENTIFIER C_T_THRPWM_MAX_PULS FORMAT "%5.4" /end CHARACTERISTIC
/begin CHARACTERISTIC ip_maf_kgh_puls_max__n_32 "MAF: MAF_KGH_PULS threshold for pulsation detection" CURVE 0x84cf96 _REC_CUR_20_u2_u1 1023.984375 _CNV_A_R_LINEAR_____112_CM 0. 1023.984375 DISPLAY_IDENTIFIER IP_MAF_KGH_PULS_MAX__N_32 FORMAT "%7.3"
 /begin AXIS_DESCR COM_AXIS n_32 _CNV_A_R_LINEAR_____58_CM 6 0. 8160. FORMAT "%4.0" AXIS_PTS_REF ldp_n_32_ip_maf_kgh_puls_max /end AXIS_DESCR
/end CHARACTERISTIC
/begin AXIS_PTS ldp_n_32_ip_maf_kgh_puls_max "MAF: MAF_KGH_PULS threshold for pulsation detection" 0x8418fa n_32 _REC_AXS_20_u1 8160. _CNV_A_R_LINEAR_____58_CM 6 0. 8160. FORMAT "%4.0" /end AXIS_PTS
/begin CHARACTERISTIC c_fac_maf_fil "filter factor for MAF_MMV" VALUE 0x85be4c _REC_VAL_20_u2 0.9999847412109381 _CNV_A_R_LINEAR_____14_CM 0. 0.9999847412109381 DISPLAY_IDENTIFIER C_FAC_MAF_FIL FORMAT "%5.4" /end CHARACTERISTIC
/begin CHARACTERISTIC ip_fac_maf__n_32 "MAF: recovery factor" CURVE 0x84baec _REC_CUR_20_u1_u1 1.9921875 _CNV_A_R_LINEAR_____24_CM 0. 1.9921875 DISPLAY_IDENTIFIER IP_FAC_MAF__N_32 FORMAT "%4.3"
 /begin AXIS_DESCR COM_AXIS n_32 _CNV_A_R_LINEAR_____58_CM 6 0. 8160. FORMAT "%4.0" AXIS_PTS_REF ldp_n_32_ip_fac_maf /end AXIS_DESCR
/end CHARACTERISTIC
/begin AXIS_PTS ldp_n_32_ip_fac_maf "MAF: factor for MAF_CYL_KGH" 0x8418ea n_32 _REC_AXS_20_u1 8160. _CNV_A_R_LINEAR_____58_CM 6 0. 8160. FORMAT "%4.0" /end AXIS_PTS
/begin CHARACTERISTIC lc_maf_frq "activation of signal processing for frequency MAF sensor" VALUE 0x85c338 _REC_VAL_20_u1 1. _CNV_A_R_LINEAR_____0_CM 0. 1. DISPLAY_IDENTIFIER LC_MAF_FRQ FORMAT "%1.0" /end CHARACTERISTIC
/begin CHARACTERISTIC c_tac_sub_diag "Exhaust temperature after catalyst substitute value" VALUE 0x85c136 _REC_VAL_20_u2 1024. _CNV_A_R_LINEAR_____56_CM 0. 1024. DISPLAY_IDENTIFIER C_TAC_SUB_DIAG FORMAT "%6.2" /end CHARACTERISTIC
/begin MEASUREMENT tac_mes "Measured exhaust gas temperature after catalyst" UWORD _CNV_A_R_LINEAR_____56_CM 1 0. 0. 1024. DISPLAY_IDENTIFIER TAC_MES ECU_ADDRESS 0x7fc992 BYTE_ORDER MSB_LAST FORMAT "%6.2" /end MEASUREMENT
/begin MEASUREMENT v_tac "Exhaust gas temperature after catalyst" UWORD _CNV_A_R_LINEAR_____33_CM 1 0. 0. 4.9951171875 DISPLAY_IDENTIFIER V_TAC ECU_ADDRESS 0x7fc994 BYTE_ORDER MSB_LAST FORMAT "%3.2" /end MEASUREMENT
/begin AXIS_PTS ldp_tac_bas_ip_tac_mes "TAC sensor map" 0x842656 v_tac _REC_AXS_20_u2 4.9951171875 _CNV_A_R_LINEAR_____33_CM 16 0. 4.9951171875 FORMAT "%3.2" /end AXIS_PTS
/begin CHARACTERISTIC ip_tac_mes__tac_bas "TAC Exhaust gas temperature" CURVE 0x85aae8 _REC_CUR_20_u2_u2 1024. _CNV_A_R_LINEAR_____56_CM 0. 1024. DISPLAY_IDENTIFIER IP_TAC_MES__TAC_BAS FORMAT "%6.2"
 /begin AXIS_DESCR COM_AXIS v_tac _CNV_A_R_LINEAR_____33_CM 16 0. 4.9951171875 FORMAT "%3.2" AXIS_PTS_REF ldp_tac_bas_ip_tac_mes /end AXIS_DESCR
/end CHARACTERISTIC
/begin MEASUREMENT tac "Exhaust gas temperature after catalyst" UWORD _CNV_A_R_LINEAR_____56_CM 1 0. 0. 1024. DISPLAY_IDENTIFIER TAC ECU_ADDRESS 0x7fc990 BYTE_ORDER MSB_LAST FORMAT "%6.2" /end MEASUREMENT
/begin MEASUREMENT t_atic20 "" UBYTE _CNV_A_R_LINEAR_____18_CM 1 0. -50. 205. DISPLAY_IDENTIFIER T_ATIC20 ECU_ADDRESS 0x7fca7e FORMAT "%3.0" /end MEASUREMENT
/begin MEASUREMENT v_t_atic20 "" UBYTE _CNV_A_R_LINEAR_____365_CM 1 0. 0. 4.98046875 DISPLAY_IDENTIFIER V_T_ATIC20 ECU_ADDRESS 0x7fca80 FORMAT "%3.2" /end MEASUREMENT
/begin MEASUREMENT v_t_lc "" UBYTE _CNV_A_R_LINEAR_____365_CM 1 0. 0. 4.98046875 DISPLAY_IDENTIFIER V_T_LC ECU_ADDRESS 0x7fca81 FORMAT "%3.2" /end MEASUREMENT
/begin MEASUREMENT t_lc "" UBYTE _CNV_A_R_LINEAR_____18_CM 1 0. -50. 205. DISPLAY_IDENTIFIER T_LC ECU_ADDRESS 0x7fca7f FORMAT "%3.0" /end MEASUREMENT
/begin MEASUREMENT tia "Intake air temperature" UBYTE _CNV_A_R_LINEAR_____18_CM 1 0. -50. 205. DISPLAY_IDENTIFIER TIA ECU_ADDRESS 0x7fb772 FORMAT "%3.0" /end MEASUREMENT
/begin MEASUREMENT v_toil "oil temperature (voltage)" UBYTE _CNV_A_R_LINEAR_____365_CM 1 0. 0. 4.98046875 DISPLAY_IDENTIFIER V_TOIL ECU_ADDRESS 0x7fb78a FORMAT "%3.1" /end MEASUREMENT
/begin MEASUREMENT can_tq_driv_sub "" UBYTE _CNV_A_R_LINEAR_____393_CM 1 0. -100. 410. DISPLAY_IDENTIFIER CAN_TQ_DRIV_SUB ECU_ADDRESS 0x7fb741 FORMAT "%3.0" /end MEASUREMENT
/begin MEASUREMENT can_tq_req_sta "" UBYTE _CNV_S_5_RANGE______394_CM 1 0. 0. 255. DISPLAY_IDENTIFIER CAN_TQ_REQ_STA ECU_ADDRESS 0x7fb742 /end MEASUREMENT
/begin MEASUREMENT lv_can_brake_abs "" UBYTE _CNV_S_2_RANGE______3_CM 1 0. 0. 1. DISPLAY_IDENTIFIER LV_CAN_BRAKE_ABS ECU_ADDRESS 0x7fb73e /end MEASUREMENT
/begin MEASUREMENT lv_lock_imob "" UBYTE _CNV_S_2_RANGE______11_CM 1 0. 0. 1. DISPLAY_IDENTIFIER LV_LOCK_IMOB ECU_ADDRESS 0x7fb733 /end MEASUREMENT
/begin MEASUREMENT lv_r_heat_1 "" UBYTE _CNV_S_2_RANGE______11_CM 1 0. 0. 1. DISPLAY_IDENTIFIER LV_R_HEAT_1 ECU_ADDRESS 0x7fb73f /end MEASUREMENT
/begin MEASUREMENT lv_r_heat_2 "" UBYTE _CNV_S_2_RANGE______11_CM 1 0. 0. 1. DISPLAY_IDENTIFIER LV_R_HEAT_2 ECU_ADDRESS 0x7fb740 /end MEASUREMENT
/begin MEASUREMENT lv_tcu1_can_vld "logische Variable fuer erkannte gueltige Botschaft TCU1" UBYTE _CNV_S_2_RANGE__0___88_CM 1 0. 0. 1. DISPLAY_IDENTIFIER LV_TCU1_CAN_VLD ECU_ADDRESS 0x7fb392 BIT_MASK 0x1 /end MEASUREMENT
/begin MEASUREMENT lv_gs_act "logische Variable fuer Schaltung aktiv" UBYTE _CNV_S_2_RANGE__0___88_CM 1 0. 0. 1. DISPLAY_IDENTIFIER LV_GS_ACT ECU_ADDRESS 0x7fb393 BIT_MASK 0x1 /end MEASUREMENT
/begin MEASUREMENT lv_tqi_gs_fast_dec_inh "Logische Variable fuer Unterdrueckung der Zuendwinkelruecknahme waehrend aktiver Schaltung" UBYTE _CNV_S_2_RANGE__0___88_CM 1 0. 0. 1. DISPLAY_IDENTIFIER LV_TQI_GS_FAST_DEC_INH ECU_ADDRESS 0x7fb394 BIT_MASK 0x1 /end MEASUREMENT
/begin MEASUREMENT lv_acc_off_can_tcu1 "logische Variable fuer Anforderung der Abschaltung Klimakompressor" UBYTE _CNV_S_2_RANGE__0___88_CM 1 0. 0. 1. DISPLAY_IDENTIFIER LV_ACC_OFF_CAN_TCU1 ECU_ADDRESS 0x7fb395 BIT_MASK 0x1 /end MEASUREMENT
/begin MEASUREMENT state_cc "Zustand Wandlerkupplung" UBYTE _CNV_S_4_STATE_CC_R_427_CM 1 0. 0. 3. DISPLAY_IDENTIFIER STATE_CC ECU_ADDRESS 0x7fb389 /end MEASUREMENT
/begin MEASUREMENT lv_n_sp_is_tcu_ena "Logische Variable fuer Anforderung der Anhebung der Leerlaufsolldrehzahl durch Getriebe" UBYTE _CNV_S_2_RANGE__0___88_CM 1 0. 0. 1. DISPLAY_IDENTIFIER LV_N_SP_IS_TCU_ENA ECU_ADDRESS 0x7fb396 BIT_MASK 0x1 /end MEASUREMENT
/begin MEASUREMENT lv_gs_req "logische Variable fuer Schaltanforderung (Byte 3 wird gueltig)" UBYTE _CNV_S_2_RANGE__0___88_CM 1 0. 0. 1. DISPLAY_IDENTIFIER LV_GS_REQ ECU_ADDRESS 0x7fb397 BIT_MASK 0x1 /end MEASUREMENT
/begin MEASUREMENT gear_can "Zielgang oder eingelegter Gang" UBYTE _CNV_S_12_GEAR_CAN_R_428_CM 1 0. 0. 15. DISPLAY_IDENTIFIER GEAR_CAN ECU_ADDRESS 0x7fb38a /end MEASUREMENT
/begin MEASUREMENT sel_psn "Waehlhebelposition" UBYTE _CNV_S_16_SEL_PSN_RA_429_CM 1 0. 0. 15. DISPLAY_IDENTIFIER SEL_PSN ECU_ADDRESS 0x7fb38b /end MEASUREMENT
/begin MEASUREMENT gear_ratio_tcu1 "Uebertragungsfunktion NRad / NKurbelwelle" UBYTE _CNV_A_R_LINEAR_____258_CM 1 0. 0. 25.5 DISPLAY_IDENTIFIER GEAR_RATIO_TCU1 ECU_ADDRESS 0x7fb38c FORMAT "%4.1" /end MEASUREMENT
/begin MEASUREMENT tqi_gs_req_can "inneres Sollmotormoment (normiert auf C_TQI_STDN)" UBYTE _CNV_A_R_LINEAR_____430_CM 1 0. 0. 99.45 DISPLAY_IDENTIFIER TQI_GS_REQ_CAN ECU_ADDRESS 0x7fb38f FORMAT "%4.1" /end MEASUREMENT
/begin MEASUREMENT tqi_gs_req "inneres Sollmotormoment" SWORD _CNV_A_R_LINEAR_____62_CM 1 0. 0. 1023.96875 DISPLAY_IDENTIFIER TQI_GS_REQ ECU_ADDRESS 0x7f9742 BYTE_ORDER MSB_LAST FORMAT "%7.2" /end MEASUREMENT
/begin MEASUREMENT cool_req_tcu_can "Kuehlleistungsanforderung Getriebesteuergeraet" UBYTE _CNV_A_R_LINEAR_____1_CM 1 0. 0. 255. DISPLAY_IDENTIFIER COOL_REQ_TCU_CAN ECU_ADDRESS 0x7fb38d FORMAT "%3.0" /end MEASUREMENT
/begin MEASUREMENT lv_mil_on_can "OBD-Status (geforderte Aktivierung OBD-Fehlerlampe)" UBYTE _CNV_S_2_RANGE__0___88_CM 1 0. 0. 1. DISPLAY_IDENTIFIER LV_MIL_ON_CAN ECU_ADDRESS 0x7fb398 BIT_MASK 0x1 /end MEASUREMENT
/begin MEASUREMENT lv_mil_on_tcu1 "OBD- Bit Getriebesteuergeraetes (geforderte Aktivierung OBD-Fehlerlampe)" UBYTE _CNV_S_2_RANGE__0___88_CM 1 0. 0. 1. DISPLAY_IDENTIFIER LV_MIL_ON_TCU1 ECU_ADDRESS 0x7fb399 BIT_MASK 0x1 /end MEASUREMENT
/begin MEASUREMENT tq_loss_tcu1_can "Belastungsmoment durch Gertriebe (normiert auf C_TQI_STND)" UBYTE _CNV_A_R_LINEAR_____430_CM 1 0. 0. 99.45 DISPLAY_IDENTIFIER TQ_LOSS_TCU1_CAN ECU_ADDRESS 0x7fb999 FORMAT "%4.1" /end MEASUREMENT
/begin MEASUREMENT tq_loss_tcu1 "Belastungsmoment durch Getriebe" SWORD _CNV_A_R_LINEAR_____62_CM 1 0. 0. 1023.96875 DISPLAY_IDENTIFIER TQ_LOSS_TCU1 ECU_ADDRESS 0x7f9744 BYTE_ORDER MSB_LAST FORMAT "%7.2" /end MEASUREMENT
/begin MEASUREMENT tcu1_msg_ctr "Botschaftszaehler zur Lebenderkennung der TCU1-Botschaft" UBYTE _CNV_A_R_LINEAR_____1_CM 1 0. 0. 255. DISPLAY_IDENTIFIER TCU1_MSG_CTR ECU_ADDRESS 0x7fb391 FORMAT "%3.0" /end MEASUREMENT
/begin MEASUREMENT state_mil_on_tcu1 "OBD- Status des Getriebesteuergeraetes (geforderte Aktivierung OBD- Fehlerlampe)" UBYTE _CNV_S_4_STATE_MIL__431_CM 1 0. 0. 3. DISPLAY_IDENTIFIER STATE_MIL_ON_TCU1 ECU_ADDRESS 0x7fb38e /end MEASUREMENT
/begin MEASUREMENT drg_tcu "Fahrwiderstandsindex, normiert auf % Steigung am Berg" UBYTE _CNV_A_R_LINEAR_____328_CM 1 0. -31.623 31.872 DISPLAY_IDENTIFIER DRG_TCU ECU_ADDRESS 0x7fb390 FORMAT "%5.1" /end MEASUREMENT
/begin MEASUREMENT drg_tcu_can "CAN-Botschaft Fahrwiderstandsindex, inclusive Fehlerfall" UBYTE _CNV_A_R_LINEAR_____328_CM 1 0. -31.623 31.872 DISPLAY_IDENTIFIER DRG_TCU_CAN ECU_ADDRESS 0x7fb99a FORMAT "%5.1" /end MEASUREMENT
/begin MEASUREMENT lv_err_ctr_msg_tcu1 "logische Variable fuer Fehler Botschaftszaehler" UBYTE _CNV_S_2_RANGE__0___88_CM 1 0. 0. 1. DISPLAY_IDENTIFIER LV_ERR_CTR_MSG_TCU1 ECU_ADDRESS 0x7fb39a BIT_MASK 0x1 /end MEASUREMENT
/begin MEASUREMENT lv_tcu2_can_vld "logische Variable fuer erkannte gueltige Botschaft TCU2" UBYTE _CNV_S_2_RANGE__0___88_CM 1 0. 0. 1. DISPLAY_IDENTIFIER LV_TCU2_CAN_VLD ECU_ADDRESS 0x7fb39b BIT_MASK 0x1 /end MEASUREMENT
/begin MEASUREMENT lv_is_ad_inh_tcu2 "Logische Variable zur Sperrung der Leerlauffuellungsadaption" UBYTE _CNV_S_2_RANGE__0___88_CM 1 0. 0. 1. DISPLAY_IDENTIFIER LV_IS_AD_INH_TCU2 ECU_ADDRESS 0x7fb39c BIT_MASK 0x1 /end MEASUREMENT
/begin MEASUREMENT lv_req_puc_deac_tcu2 "Logische Variable zum Verlassen des Motorbetriebszustandes PUC" UBYTE _CNV_S_2_RANGE__0___88_CM 1 0. 0. 1. DISPLAY_IDENTIFIER LV_REQ_PUC_DEAC_TCU2 ECU_ADDRESS 0x7fb39d BIT_MASK 0x1 /end MEASUREMENT
/begin MEASUREMENT tcu2_msg_ctr "Botschaftszaehler zur Lebenderkennung der TCU2-Botschaft" UBYTE _CNV_A_R_LINEAR_____1_CM 1 0. 0. 255. DISPLAY_IDENTIFIER TCU2_MSG_CTR ECU_ADDRESS 0x7fb39f FORMAT "%3.0" /end MEASUREMENT
/begin MEASUREMENT n_sp_is_tcu2 "Leerlaufwunschsolldrehzahl vom Getriebe" UWORD _CNV_A_R_LINEAR_____257_CM 1 0. 0. 8160. DISPLAY_IDENTIFIER N_SP_IS_TCU2 ECU_ADDRESS 0x7f9746 BYTE_ORDER MSB_LAST FORMAT "%4.0" /end MEASUREMENT
/begin MEASUREMENT tq_dif_tra_max "Maximaler Gradient des Motordrehmomentes fuer Teillastanfahrten" UBYTE _CNV_A_R_LINEAR_____432_CM 1 0. 0. 2550. DISPLAY_IDENTIFIER TQ_DIF_TRA_MAX ECU_ADDRESS 0x7fb3a0 FORMAT "%4.0" /end MEASUREMENT
/begin MEASUREMENT lv_n_tcu_req "Zwischengasflag" UBYTE _CNV_S_2_RANGE__0___88_CM 1 0. 0. 1. DISPLAY_IDENTIFIER LV_N_TCU_REQ ECU_ADDRESS 0x7fb3a6 BIT_MASK 0x1 /end MEASUREMENT
/begin MEASUREMENT n_tcu_req "Synchronisations-Wunschdrehzahl" UBYTE _CNV_A_R_LINEAR_____433_CM 1 0. 0. 6375. DISPLAY_IDENTIFIER N_TCU_REQ ECU_ADDRESS 0x7fb3a3 FORMAT "%4.0" /end MEASUREMENT
/begin MEASUREMENT n_tcu_req_ivs "Synchronisations-Wunschdrehzahl (aus bitinvertierter Uebertragung)" UBYTE _CNV_A_R_LINEAR_____433_CM 1 0. 0. 6375. DISPLAY_IDENTIFIER N_TCU_REQ_IVS ECU_ADDRESS 0x7fb3a4 FORMAT "%4.0" /end MEASUREMENT
/begin MEASUREMENT t_n_tcu_req "Synchronisationszeit" UBYTE _CNV_A_R_LINEAR_____434_CM 1 0. 0. 5100. DISPLAY_IDENTIFIER T_N_TCU_REQ ECU_ADDRESS 0x7fb3a5 FORMAT "%4.0" /end MEASUREMENT
/begin MEASUREMENT lv_err_ctr_msg_tcu2 "logische Variable fuer Fehler Botschaftszaehler" UBYTE _CNV_S_2_RANGE__0___88_CM 1 0. 0. 1. DISPLAY_IDENTIFIER LV_ERR_CTR_MSG_TCU2 ECU_ADDRESS 0x7fb39e BIT_MASK 0x1 /end MEASUREMENT
/begin MEASUREMENT lv_tcu_cod_vld "Getriebekodierung ist im Motorsteuergeraet in Ordnung" UBYTE _CNV_S_2_RANGE__0___88_CM 1 0. 0. 1. DISPLAY_IDENTIFIER LV_TCU_COD_VLD ECU_ADDRESS 0x7fb3a2 BIT_MASK 0x1 /end MEASUREMENT
/begin MEASUREMENT tcu_lih_can "Getriebenotlauf" UBYTE _CNV_A_R_LINEAR_____0_CM 1 0. 0. 15. DISPLAY_IDENTIFIER TCU_LIH_CAN ECU_ADDRESS 0x7fb3a1 FORMAT "%2.0" /end MEASUREMENT
/begin MEASUREMENT lv_ac1_can_vld "logische Variable fuer erkannte gueltige Botschaft AC1" UBYTE _CNV_S_2_RANGE__0___88_CM 1 0. 0. 1. DISPLAY_IDENTIFIER LV_AC1_CAN_VLD ECU_ADDRESS 0x7fb349 BIT_MASK 0x1 /end MEASUREMENT
/begin MEASUREMENT lv_acin_can "logische Variable fuer Klimabereitschaft" UBYTE _CNV_S_2_RANGE__0___88_CM 1 0. 0. 1. DISPLAY_IDENTIFIER LV_ACIN_CAN ECU_ADDRESS 0x7fb34a BIT_MASK 0x1 /end MEASUREMENT
/begin MEASUREMENT lv_accin_on_can "logische Variable fuer Kompressorzustand (beim Klimahalbautomat AC-Schalter)" UBYTE _CNV_S_2_RANGE__0___88_CM 1 0. 0. 1. DISPLAY_IDENTIFIER LV_ACCIN_ON_CAN ECU_ADDRESS 0x7fb34b BIT_MASK 0x1 /end MEASUREMENT
/begin MEASUREMENT acp_can "Klimadrucksignal" UBYTE _CNV_A_R_LINEAR_____435_CM 1 0. 0. 51. DISPLAY_IDENTIFIER ACP_CAN ECU_ADDRESS 0x7fb345 FORMAT "%4.1" /end MEASUREMENT
/begin MEASUREMENT tq_acc_can "Kompressorlast" UBYTE _CNV_A_R_LINEAR_____93_CM 1 0. 0. 63.75 DISPLAY_IDENTIFIER TQ_ACC_CAN ECU_ADDRESS 0x7fb346 FORMAT "%4.1" /end MEASUREMENT
/begin MEASUREMENT lv_ac_sw_can "Logische Variable fuer AC-Schalter Klimahalbautomat" UBYTE _CNV_S_2_RANGE__0___88_CM 1 0. 0. 1. DISPLAY_IDENTIFIER LV_AC_SW_CAN ECU_ADDRESS 0x7fb34c BIT_MASK 0x1 /end MEASUREMENT
/begin MEASUREMENT ecf_req_ac_can "Forderung Kuehlerluefteransteuerung" UBYTE _CNV_A_R_LINEAR_____82_CM 1 0. 0. 99.609375 DISPLAY_IDENTIFIER ECF_REQ_AC_CAN ECU_ADDRESS 0x7fb347 FORMAT "%4.1" /end MEASUREMENT
/begin MEASUREMENT lv_ecf_req_ac_can_err "Fehlerflag Kuehlerluefteransteuerung" UBYTE _CNV_S_2_RANGE__0___88_CM 1 0. 0. 1. DISPLAY_IDENTIFIER LV_ECF_REQ_AC_CAN_ERR ECU_ADDRESS 0x7fb34d BIT_MASK 0x1 /end MEASUREMENT
/begin MEASUREMENT state_ich "Zustand Standheizung" UBYTE _CNV_S_3_STATE_ICH__436_CM 1 0. 0. 2. DISPLAY_IDENTIFIER STATE_ICH ECU_ADDRESS 0x7fb348 /end MEASUREMENT
/begin MEASUREMENT lv_req_heat_can "Fahrerwunsch Zuheizer" UBYTE _CNV_S_2_RANGE__0___88_CM 1 0. 0. 1. DISPLAY_IDENTIFIER LV_REQ_HEAT_CAN ECU_ADDRESS 0x7fb34e BIT_MASK 0x1 /end MEASUREMENT
/begin MEASUREMENT lv_st_req_can "logische variable for Startanforderung (Klemme 50)" UBYTE _CNV_S_2_RANGE__0___88_CM 1 0. 0. 1. DISPLAY_IDENTIFIER LV_ST_REQ_CAN ECU_ADDRESS 0x7fb3fb BIT_MASK 0x1 /end MEASUREMENT
/begin MEASUREMENT lv_eilu_can_vld "logische variable for erkannte gueltige botschaft vom ZAS1/ EILU " UBYTE _CNV_S_2_RANGE__0___88_CM 1 0. 0. 1. DISPLAY_IDENTIFIER LV_EILU_CAN_VLD ECU_ADDRESS 0x7fb3fa BIT_MASK 0x1 /end MEASUREMENT
/begin MEASUREMENT lv_igk_can "Zuendung ein (Klemme 15)" UBYTE _CNV_S_2_RANGE__0___88_CM 1 0. 0. 1. DISPLAY_IDENTIFIER LV_IGK_CAN ECU_ADDRESS 0x7fb3fc BIT_MASK 0x1 /end MEASUREMENT
/begin CHARACTERISTIC c_can_vers "CAN-Version" VALUE 0x848349 _REC_VAL_20_u1 36. _CNV_S_17_CAN_VERS_R_437_CM 9. 45. DISPLAY_IDENTIFIER C_CAN_VERS /end CHARACTERISTIC
/begin CHARACTERISTIC c_eng_typ_2 "Motorkodierung" VALUE 0x848421 _REC_VAL_20_u1 63. _CNV_A_R_LINEAR_____1_CM 0. 63. DISPLAY_IDENTIFIER C_ENG_TYP_2 FORMAT "%3.0" /end CHARACTERISTIC
/begin CHARACTERISTIC c_tqi_stnd "Standardisierungsmoment fuer CAN-Botschaften" VALUE 0x84871a _REC_VAL_20_u2 1023.96875 _CNV_A_R_LINEAR_____62_CM 0. 1023.96875 DISPLAY_IDENTIFIER C_TQI_STND FORMAT "%7.2" /end CHARACTERISTIC
/begin CHARACTERISTIC c_n_tqi_tol "Drehzahl bei max. Motormoment" VALUE 0x848520 _REC_VAL_20_u1 6300. _CNV_A_R_LINEAR_____438_CM 0. 6300. DISPLAY_IDENTIFIER C_N_TQI_TOL FORMAT "%4.0" /end CHARACTERISTIC
/begin CHARACTERISTIC c_tqi_tol "maximales Motormoment bei C_N_TQI_TOL" VALUE 0x84871c _REC_VAL_20_u1 630. _CNV_A_R_LINEAR_____439_CM 0. 630. DISPLAY_IDENTIFIER C_TQI_TOL FORMAT "%3.0" /end CHARACTERISTIC
/begin CHARACTERISTIC c_eng_typ "Motortyp" VALUE 0x848420 _REC_VAL_20_u1 3. _CNV_A_R_LINEAR_____1_CM 0. 3. DISPLAY_IDENTIFIER C_ENG_TYP FORMAT "%3.0" /end CHARACTERISTIC
/begin CHARACTERISTIC c_eg_typ_ems5 "Abgastyp" VALUE 0x84840e _REC_VAL_20_u1 31. _CNV_A_R_LINEAR_____1_CM 0. 31. DISPLAY_IDENTIFIER C_EG_TYP_EMS5 FORMAT "%3.0" /end CHARACTERISTIC
/begin MEASUREMENT lv_toil_max_can "Logische Variable fuer Motortemperatur ueber Sollwert" UBYTE _CNV_S_2_RANGE__0___88_CM 1 0. 0. 1. DISPLAY_IDENTIFIER LV_TOIL_MAX_CAN ECU_ADDRESS 0x7fb994 BIT_MASK 0x1 /end MEASUREMENT
/begin CHARACTERISTIC c_eng_pow "Motorleistung" VALUE 0x84841e _REC_VAL_20_u2 511. _CNV_A_R_LINEAR_____440_CM 0. 511. DISPLAY_IDENTIFIER C_ENG_POW FORMAT "%3.0" /end CHARACTERISTIC
/begin CHARACTERISTIC c_num_valve "Anzahl Ventile / Zylinder" VALUE 0x848582 _REC_VAL_20_u1 7. _CNV_A_R_LINEAR_____1_CM 0. 7. DISPLAY_IDENTIFIER C_NUM_VALVE FORMAT "%3.0" /end CHARACTERISTIC
/begin CHARACTERISTIC c_eng_vol "Hubraum" VALUE 0x848422 _REC_VAL_20_u1 12.7 _CNV_A_R_LINEAR_____441_CM 0. 12.7 DISPLAY_IDENTIFIER C_ENG_VOL FORMAT "%4.1" /end CHARACTERISTIC
/begin CHARACTERISTIC c_oil_ofs_warn "Oelwarnschwelle Offset" VALUE 0x84858c _REC_VAL_20_u1 630. _CNV_A_R_LINEAR_____442_CM 0. 630. DISPLAY_IDENTIFIER C_OIL_OFS_WARN FORMAT "%3.0" /end CHARACTERISTIC
/begin CHARACTERISTIC c_oil_tol_warn "Oelwarnschwelle Tolerenz" VALUE 0x84858e _REC_VAL_20_u1 630. _CNV_A_R_LINEAR_____442_CM 0. 630. DISPLAY_IDENTIFIER C_OIL_TOL_WARN FORMAT "%3.0" /end CHARACTERISTIC
/begin CHARACTERISTIC c_km_min_asa "Minimale Kilometerzahl bis zum Service" VALUE 0x848485 _REC_VAL_20_u1 127000. _CNV_A_R_LINEAR_____443_CM 0. 127000. DISPLAY_IDENTIFIER C_KM_MIN_ASA FORMAT "%5.4" /end CHARACTERISTIC
/begin CHARACTERISTIC c_km_max_asa "Maximale Kilometerzahl bis zum Service" VALUE 0x848484 _REC_VAL_20_u1 127000. _CNV_A_R_LINEAR_____443_CM 0. 127000. DISPLAY_IDENTIFIER C_KM_MAX_ASA FORMAT "%5.4" /end CHARACTERISTIC
/begin CHARACTERISTIC c_ctr_min_oil "minimale geforderte Anzahl Mittlungen fuer Oelstandsdifferenzauswertung" VALUE 0x848361 _REC_VAL_20_u1 7500. _CNV_A_R_LINEAR_____444_CM 0. 7500. DISPLAY_IDENTIFIER C_CTR_MIN_OIL FORMAT "%4.0" /end CHARACTERISTIC
/begin CHARACTERISTIC c_t_min_asa "Minimales Zeitintervall bis zum Service" VALUE 0x84868c _REC_VAL_20_u1 63. _CNV_A_R_LINEAR_____445_CM 0. 63. DISPLAY_IDENTIFIER C_T_MIN_ASA FORMAT "%2.0" /end CHARACTERISTIC
/begin CHARACTERISTIC c_t_max_asa "Maximales Zeitintervall bis zum Service" VALUE 0x848679 _REC_VAL_20_u1 63. _CNV_A_R_LINEAR_____445_CM 0. 63. DISPLAY_IDENTIFIER C_T_MAX_ASA FORMAT "%2.0" /end CHARACTERISTIC
/begin CHARACTERISTIC c_km_min_oil "Minimal geforderte Strecke fuer Oelstandsauswertung" VALUE 0x848486 _REC_VAL_20_u1 375. _CNV_A_R_LINEAR_____446_CM 0. 375. DISPLAY_IDENTIFIER C_KM_MIN_OIL FORMAT "%4.0" /end CHARACTERISTIC
/begin CHARACTERISTIC c_oil_max_thd "Schwellwert fuer Maximum Oelstand" VALUE 0x84858b _REC_VAL_20_u1 3100. _CNV_A_R_LINEAR_____447_CM 0. 3100. DISPLAY_IDENTIFIER C_OIL_MAX_THD FORMAT "%5.0" /end CHARACTERISTIC
/begin CHARACTERISTIC c_oil_max_ofs "Maximum Offset" VALUE 0x848589 _REC_VAL_20_u1 750. _CNV_A_R_LINEAR_____448_CM 0. 750. DISPLAY_IDENTIFIER C_OIL_MAX_OFS FORMAT "%5.0" /end CHARACTERISTIC
/begin CHARACTERISTIC c_oil_max_over_hys "Ueberfuellungsschwellen Hysterese" VALUE 0x84858a _REC_VAL_20_u1 750. _CNV_A_R_LINEAR_____448_CM 0. 750. DISPLAY_IDENTIFIER C_OIL_MAX_OVER_HYS FORMAT "%5.0" /end CHARACTERISTIC
/begin CHARACTERISTIC c_oil_ctr_fast "Anz. Mittlung schneller Oelfuellstandmittelwert" VALUE 0x848586 _REC_VAL_20_u1 1500. _CNV_A_R_LINEAR_____449_CM 0. 1500. DISPLAY_IDENTIFIER C_OIL_CTR_FAST FORMAT "%5.0" /end CHARACTERISTIC
/begin CHARACTERISTIC lc_oil_max_det "Ueberfuellungserkennung aktiv" VALUE 0x8487d0 _REC_VAL_20_u1 1. _CNV_A_R_LINEAR_____1_CM 0. 1. DISPLAY_IDENTIFIER LC_OIL_MAX_DET FORMAT "%1.0" /end CHARACTERISTIC
/begin CHARACTERISTIC lc_n_ems_can_sel "Schalter fuer Drehzahlausgabe N_EMS1" VALUE 0x8487cd _REC_VAL_20_u1 1. _CNV_A_R_LINEAR_____1_CM 0. 1. DISPLAY_IDENTIFIER LC_N_EMS_CAN_SEL FORMAT "%1.0" /end CHARACTERISTIC
/begin CHARACTERISTIC c_diam_whl "Durchmesser Reifen" VALUE 0x848364 _REC_VAL_20_u2 2.0475 _CNV_A_R_LINEAR_____450_CM 0. 2.0475 DISPLAY_IDENTIFIER C_DIAM_WHL FORMAT "%7.5" /end CHARACTERISTIC
/begin MEASUREMENT tqi_int_fb_tcu_intv "Rueckmeldung Momentenintegral Getriebeeingriff" UBYTE _CNV_A_R_LINEAR_____82_CM 1 0. 0. 99.609375 DISPLAY_IDENTIFIER TQI_INT_FB_TCU_INTV ECU_ADDRESS 0x7fb993 FORMAT "%4.1" /end MEASUREMENT
/begin MEASUREMENT lv_frs_err_can "logische Variable fuer Fehlerstatus Tank" UBYTE _CNV_S_2_RANGE__0___88_CM 1 0. 0. 1. DISPLAY_IDENTIFIER LV_FRS_ERR_CAN ECU_ADDRESS 0x7fb37b BIT_MASK 0x1 /end MEASUREMENT
/begin MEASUREMENT lv_frs_can "Tankwarnung" UBYTE _CNV_S_2_RANGE__0___88_CM 1 0. 0. 1. DISPLAY_IDENTIFIER LV_FRS_CAN ECU_ADDRESS 0x7fb37c BIT_MASK 0x1 /end MEASUREMENT
/begin MEASUREMENT vs_icl1 "ermittelte Geschwindigkeit des Kombisteuergeraetes" UWORD _CNV_A_R_LINEAR_____74_CM 1 0. 0. 327.67 DISPLAY_IDENTIFIER VS_ICL1 ECU_ADDRESS 0x7f973e BYTE_ORDER MSB_LAST FORMAT "%6.2" /end MEASUREMENT
/begin MEASUREMENT lv_vs_icl1_vld "logische Variable fuer erkannte gueltige Geschwindigkeit" UBYTE _CNV_S_2_RANGE__0___88_CM 1 0. 0. 1. DISPLAY_IDENTIFIER LV_VS_ICL1_VLD ECU_ADDRESS 0x7fb37d BIT_MASK 0x1 /end MEASUREMENT
/begin MEASUREMENT lv_icl2_can_vld "logische Variable fuer erkannte gueltige Botschaft ICL2" UBYTE _CNV_S_2_RANGE__0___88_CM 1 0. 0. 1. DISPLAY_IDENTIFIER LV_ICL2_CAN_VLD ECU_ADDRESS 0x7fb384 BIT_MASK 0x1 /end MEASUREMENT
/begin MEASUREMENT lv_tam_err_can "logische Variable fuer Fehlerstatus Aussentemperatur" UBYTE _CNV_S_2_RANGE__0___88_CM 1 0. 0. 1. DISPLAY_IDENTIFIER LV_TAM_ERR_CAN ECU_ADDRESS 0x7fb380 BIT_MASK 0x1 /end MEASUREMENT
/begin MEASUREMENT tam_fil_can "Gefilterte Aussentemperatur" UBYTE _CNV_A_R_LINEAR_____251_CM 1 0. -48. 142.5 DISPLAY_IDENTIFIER TAM_FIL_CAN ECU_ADDRESS 0x7fb37e FORMAT "%6.2" /end MEASUREMENT
/begin MEASUREMENT tam_can "ungefilterte Aussentemperatur" UBYTE _CNV_A_R_LINEAR_____251_CM 1 0. -48. 142.5 DISPLAY_IDENTIFIER TAM_CAN ECU_ADDRESS 0x7fb37f FORMAT "%6.2" /end MEASUREMENT
/begin MEASUREMENT lv_icl3_can_vld "logische Variable fuer erkannte gueltige Botschaft ICL3" UBYTE _CNV_S_2_RANGE__0___88_CM 1 0. 0. 1. DISPLAY_IDENTIFIER LV_ICL3_CAN_VLD ECU_ADDRESS 0x7fb385 BIT_MASK 0x1 /end MEASUREMENT
/begin MEASUREMENT t_last_dc_can "Standzeit" UWORD _CNV_A_R_LINEAR_____451_CM 1 0. 0. 131068. DISPLAY_IDENTIFIER T_LAST_DC_CAN ECU_ADDRESS 0x7f9740 BYTE_ORDER MSB_LAST FORMAT "%6.0" /end MEASUREMENT
/begin MEASUREMENT ctr_km_can "km-Zaehler" ULONG _CNV_A_R_LINEAR_____452_CM 1 0. 0. 1000000. DISPLAY_IDENTIFIER CTR_KM_CAN ECU_ADDRESS 0x7f8658 BYTE_ORDER MSB_LAST FORMAT "%7.0" /end MEASUREMENT
/begin MEASUREMENT lv_icl1_can_vld "logische Variable fuer erkannte gueltige Botschaft ICL1" UBYTE _CNV_S_2_RANGE__0___88_CM 1 0. 0. 1. DISPLAY_IDENTIFIER LV_ICL1_CAN_VLD ECU_ADDRESS 0x7fb383 BIT_MASK 0x1 /end MEASUREMENT
/begin MEASUREMENT lv_frs_wal_can "Tankwarnlampe" UBYTE _CNV_S_2_RANGE__0___88_CM 1 0. 0. 1. DISPLAY_IDENTIFIER LV_FRS_WAL_CAN ECU_ADDRESS 0x7fb387 BIT_MASK 0x1 /end MEASUREMENT
/begin MEASUREMENT lv_gll_fb_can "Rueckmeldeinformation der Vorgluehlampe" UBYTE _CNV_S_2_RANGE__0___88_CM 1 0. 0. 1. DISPLAY_IDENTIFIER LV_GLL_FB_CAN ECU_ADDRESS 0x7fb388 BIT_MASK 0x1 /end MEASUREMENT
/begin MEASUREMENT ftl_can "Tankinhalt" UBYTE _CNV_A_R_LINEAR_____0_CM 1 0. 0. 127. DISPLAY_IDENTIFIER FTL_CAN ECU_ADDRESS 0x7fb386 FORMAT "%3.0" /end MEASUREMENT
/begin MEASUREMENT lv_tog_act "logische Variable fuer TOG nicht verbaut (Roh-Information)" UBYTE _CNV_S_2_RANGE__0___88_CM 1 0. 0. 1. DISPLAY_IDENTIFIER LV_TOG_ACT ECU_ADDRESS 0x7fb381 BIT_MASK 0x1 /end MEASUREMENT
/begin MEASUREMENT lv_tog_pres "logische Variable fuer TOG verbaut" UBYTE _CNV_S_2_RANGE__0___88_CM 1 0. 0. 1. DISPLAY_IDENTIFIER LV_TOG_PRES ECU_ADDRESS 0x7fb382 BIT_MASK 0x1 /end MEASUREMENT
/begin MEASUREMENT lv_tcs1_can_vld "logische Variable fuer erkannte gueltige Botschaft TCS1" UBYTE _CNV_S_2_RANGE__0___88_CM 1 0. 0. 1. DISPLAY_IDENTIFIER LV_TCS1_CAN_VLD ECU_ADDRESS 0x7fb356 BIT_MASK 0x1 /end MEASUREMENT
/begin MEASUREMENT lv_asr_req "logische Variable fuer ASR-Anforderung" UBYTE _CNV_S_2_RANGE__0___88_CM 1 0. 0. 1. DISPLAY_IDENTIFIER LV_ASR_REQ ECU_ADDRESS 0x7fb357 BIT_MASK 0x1 /end MEASUREMENT
/begin MEASUREMENT lv_msr_req "logische Variable fuer MSR-Anforderung" UBYTE _CNV_S_2_RANGE__0___88_CM 1 0. 0. 1. DISPLAY_IDENTIFIER LV_MSR_REQ ECU_ADDRESS 0x7fb358 BIT_MASK 0x1 /end MEASUREMENT
/begin MEASUREMENT lv_abs_req "logische Variable fuer ABS-Bremsung" UBYTE _CNV_S_2_RANGE__0___88_CM 1 0. 0. 1. DISPLAY_IDENTIFIER LV_ABS_REQ ECU_ADDRESS 0x7fb359 BIT_MASK 0x1 /end MEASUREMENT
/begin MEASUREMENT lv_esp_req "logische Variable fuer EPS-Eingriff" UBYTE _CNV_S_2_RANGE__0___88_CM 1 0. 0. 1. DISPLAY_IDENTIFIER LV_ESP_REQ ECU_ADDRESS 0x7fb35a BIT_MASK 0x1 /end MEASUREMENT
/begin MEASUREMENT lv_bls_tcs "\"Fahrer bremst\" - Information" UBYTE _CNV_S_2_RANGE__0___88_CM 1 0. 0. 1. DISPLAY_IDENTIFIER LV_BLS_TCS ECU_ADDRESS 0x7fb35b BIT_MASK 0x1 /end MEASUREMENT
/begin MEASUREMENT lv_bkv_state_can "Status des aktiven Bremskraftverstaerkers" UBYTE _CNV_S_2_RANGE__0___88_CM 1 0. 0. 1. DISPLAY_IDENTIFIER LV_BKV_STATE_CAN ECU_ADDRESS 0x7fb35c BIT_MASK 0x1 /end MEASUREMENT
/begin MEASUREMENT lv_rr_can "Information fuer Schlechtwegausblendung" UBYTE _CNV_S_2_RANGE__0___88_CM 1 0. 0. 1. DISPLAY_IDENTIFIER LV_RR_CAN ECU_ADDRESS 0x7fb35d BIT_MASK 0x1 /end MEASUREMENT
/begin MEASUREMENT lv_rr_err_can "Fehlerstatus Schlechtwegausblendung" UBYTE _CNV_S_2_RANGE__0___88_CM 1 0. 0. 1. DISPLAY_IDENTIFIER LV_RR_ERR_CAN ECU_ADDRESS 0x7fb35e BIT_MASK 0x1 /end MEASUREMENT
/begin MEASUREMENT lv_esp_err_can "Fehlerstatus ESP" UBYTE _CNV_S_2_RANGE__0___88_CM 1 0. 0. 1. DISPLAY_IDENTIFIER LV_ESP_ERR_CAN ECU_ADDRESS 0x7fb365 BIT_MASK 0x1 /end MEASUREMENT
/begin MEASUREMENT lv_bkv_can "aktiver Bremskraftverstaerker" UBYTE _CNV_S_2_RANGE__0___88_CM 1 0. 0. 1. DISPLAY_IDENTIFIER LV_BKV_CAN ECU_ADDRESS 0x7fb35f BIT_MASK 0x1 /end MEASUREMENT
/begin MEASUREMENT vs_tcs1 "ermittelte Geschwindigkeit des ABS-Steuergeraetes" UWORD _CNV_A_R_LINEAR_____74_CM 1 0. 0. 327.67 DISPLAY_IDENTIFIER VS_TCS1 ECU_ADDRESS 0x7f972a BYTE_ORDER MSB_LAST FORMAT "%6.2" /end MEASUREMENT
/begin MEASUREMENT state_vs_tcs1 "Statusregister TCS-Geschwindigkeit" UBYTE _CNV_S_5_STATE_VS_T_453_CM 1 0. 0. 8. DISPLAY_IDENTIFIER STATE_VS_TCS1 ECU_ADDRESS 0x7fb366 /end MEASUREMENT
/begin MEASUREMENT tqi_asr_req_slow_can "ASR-Eingriffsmoment (langsamer Pfad, normiert auf C_TQI_STND)" UBYTE _CNV_A_R_LINEAR_____430_CM 1 0. 0. 99.45 DISPLAY_IDENTIFIER TQI_ASR_REQ_SLOW_CAN ECU_ADDRESS 0x7fb360 FORMAT "%4.1" /end MEASUREMENT
/begin MEASUREMENT tqi_asr_req_slow "ASR-Eingriffsmoment (langsamer Pfad)" UWORD _CNV_A_R_LINEAR_____62_CM 1 0. 0. 1023.96875 DISPLAY_IDENTIFIER TQI_ASR_REQ_SLOW ECU_ADDRESS 0x7f972c BYTE_ORDER MSB_LAST FORMAT "%7.2" /end MEASUREMENT
/begin MEASUREMENT tqi_asr_req_fast_can "ASR-Eingriffsmoment (schneller Pfad, normiert auf C_TQI_STND)" UBYTE _CNV_A_R_LINEAR_____430_CM 1 0. 0. 99.45 DISPLAY_IDENTIFIER TQI_ASR_REQ_FAST_CAN ECU_ADDRESS 0x7fb361 FORMAT "%4.1" /end MEASUREMENT
/begin MEASUREMENT tqi_asr_req_fast "ASR-Eingriffsmoment (schneller Pfad)" UWORD _CNV_A_R_LINEAR_____62_CM 1 0. 0. 1023.96875 DISPLAY_IDENTIFIER TQI_ASR_REQ_FAST ECU_ADDRESS 0x7f972e BYTE_ORDER MSB_LAST FORMAT "%7.2" /end MEASUREMENT
/begin MEASUREMENT tqi_msr_req_can "MSR-Eingriffsmoment (normiert auf C_TQI_STND)" UBYTE _CNV_A_R_LINEAR_____430_CM 1 0. 0. 99.45 DISPLAY_IDENTIFIER TQI_MSR_REQ_CAN ECU_ADDRESS 0x7fb362 FORMAT "%4.1" /end MEASUREMENT
/begin MEASUREMENT tqi_msr_req "MSR-Eingriffsmoment" UWORD _CNV_A_R_LINEAR_____62_CM 1 0. 0. 1023.96875 DISPLAY_IDENTIFIER TQI_MSR_REQ ECU_ADDRESS 0x7f9730 BYTE_ORDER MSB_LAST FORMAT "%7.2" /end MEASUREMENT
/begin MEASUREMENT tcs1_msg_ctr "Botschaftszaehler" UBYTE _CNV_A_R_LINEAR_____1_CM 1 0. 0. 255. DISPLAY_IDENTIFIER TCS1_MSG_CTR ECU_ADDRESS 0x7fb363 FORMAT "%3.0" /end MEASUREMENT
/begin MEASUREMENT lv_sub_vs_tcs1 "logische Variable fuer Geschwindigkeit aus Ersatzwert" UBYTE _CNV_S_2_RANGE__0___88_CM 1 0. 0. 1. DISPLAY_IDENTIFIER LV_SUB_VS_TCS1 ECU_ADDRESS 0x7fb364 BIT_MASK 0x1 /end MEASUREMENT
/begin MEASUREMENT lv_err_ctr_msg_tcs1 "Fehlerbit Botschaftszaehler" UBYTE _CNV_S_2_RANGE__0___88_CM 1 0. 0. 1. DISPLAY_IDENTIFIER LV_ERR_CTR_MSG_TCS1 ECU_ADDRESS 0x7fb355 BIT_MASK 0x1 /end MEASUREMENT
/begin MEASUREMENT lv_tcs2_can_vld "Logische Variable fuer erkannte gueltige Botschaft TCS2" UBYTE _CNV_S_2_RANGE__0___88_CM 1 0. 0. 1. DISPLAY_IDENTIFIER LV_TCS2_CAN_VLD ECU_ADDRESS 0x7fb369 BIT_MASK 0x1 /end MEASUREMENT
/begin MEASUREMENT ac_trv_tcs2 "Querbeschleunigung" UBYTE _CNV_A_R_LINEAR_____454_CM 1 0. -12.7 12.8 DISPLAY_IDENTIFIER AC_TRV_TCS2 ECU_ADDRESS 0x7fb367 FORMAT "%5.1" /end MEASUREMENT
/begin MEASUREMENT lv_ac_trv_tcs2_act "Logische Variable fuer Uebertragung der Querbeschleunigung in Byte 0" UBYTE _CNV_S_2_RANGE__0___88_CM 1 0. 0. 1. DISPLAY_IDENTIFIER LV_AC_TRV_TCS2_ACT ECU_ADDRESS 0x7fb368 BIT_MASK 0x1 /end MEASUREMENT
/begin MEASUREMENT lv_tcs3_can_vld "Logische Variable fuer erkannte gueltige Botschaft TCS3" UBYTE _CNV_S_2_RANGE__0___88_CM 1 0. 0. 1. DISPLAY_IDENTIFIER LV_TCS3_CAN_VLD ECU_ADDRESS 0x7fb36a BIT_MASK 0x1 /end MEASUREMENT
/begin MEASUREMENT can_wheel_fn_ri "Radgeschwindigkeit vorne-rechts" UWORD _CNV_A_R_LINEAR_____74_CM 1 0. 0. 327.67 DISPLAY_IDENTIFIER CAN_WHEEL_FN_RI ECU_ADDRESS 0x7f9732 BYTE_ORDER MSB_LAST FORMAT "%6.2" /end MEASUREMENT
/begin MEASUREMENT can_wheel_fn_le "Radgeschwindigkeit vorne-links" UWORD _CNV_A_R_LINEAR_____74_CM 1 0. 0. 327.67 DISPLAY_IDENTIFIER CAN_WHEEL_FN_LE ECU_ADDRESS 0x7f9734 BYTE_ORDER MSB_LAST FORMAT "%6.2" /end MEASUREMENT
/begin MEASUREMENT can_wheel_re_ri "Radgeschwindigkeit hinten-rechts" UWORD _CNV_A_R_LINEAR_____74_CM 1 0. 0. 327.67 DISPLAY_IDENTIFIER CAN_WHEEL_RE_RI ECU_ADDRESS 0x7f9736 BYTE_ORDER MSB_LAST FORMAT "%6.2" /end MEASUREMENT
/begin MEASUREMENT can_wheel_re_le "Radgeschwindigkeit hinten-links" UWORD _CNV_A_R_LINEAR_____74_CM 1 0. 0. 327.67 DISPLAY_IDENTIFIER CAN_WHEEL_RE_LE ECU_ADDRESS 0x7f9738 BYTE_ORDER MSB_LAST FORMAT "%6.2" /end MEASUREMENT
/begin MEASUREMENT lv_err_cks_tcs4_can_diag "Fehlerbit Checksummenfehler fuer CAN-Diagnose Irreversible" UBYTE _CNV_S_2_RANGE__0___88_CM 1 0. 0. 1. DISPLAY_IDENTIFIER LV_ERR_CKS_TCS4_CAN_DIAG ECU_ADDRESS 0x7fb36c BIT_MASK 0x1 /end MEASUREMENT
/begin MEASUREMENT state_thd_dep "Unterdruckschwellwert" UBYTE _CNV_S_4_STATE_THD__455_CM 1 0. 0. 3. DISPLAY_IDENTIFIER STATE_THD_DEP ECU_ADDRESS 0x7fb371 /end MEASUREMENT
/begin MEASUREMENT dep_abs "Bremskraftverstaerker Unterdruck" UBYTE _CNV_A_R_LINEAR_____456_CM 1 0. 0. 1020. DISPLAY_IDENTIFIER DEP_ABS ECU_ADDRESS 0x7fb372 FORMAT "%4.0" /end MEASUREMENT
/begin MEASUREMENT lv_tcs4_can_vld "Logische Variable fuer erkannte gueltige Botschaft TCS3" UBYTE _CNV_S_2_RANGE__0___88_CM 1 0. 0. 1. DISPLAY_IDENTIFIER LV_TCS4_CAN_VLD ECU_ADDRESS 0x7fb370 BIT_MASK 0x1 /end MEASUREMENT
/begin MEASUREMENT lv_err_ctr_msg_tcs4 "Fehlerbit Botschaftszaehler" UBYTE _CNV_S_2_RANGE__0___88_CM 1 0. 0. 1. DISPLAY_IDENTIFIER LV_ERR_CTR_MSG_TCS4 ECU_ADDRESS 0x7fb36e BIT_MASK 0x1 /end MEASUREMENT
/begin MEASUREMENT lv_var_bsup_ext_save "Fehlerbit Botschaftszaehler" UBYTE _CNV_S_2_RANGE__0___88_CM 1 0. 0. 1. DISPLAY_IDENTIFIER LV_VAR_BSUP_EXT_SAVE ECU_ADDRESS 0x7fb36f BIT_MASK 0x1 /end MEASUREMENT
/begin MEASUREMENT lv_err_cks_tcs4_can "Fehlerbit Checksummenfehler fuer CAN-Diagnose" UBYTE _CNV_S_2_RANGE__0___88_CM 1 0. 0. 1. DISPLAY_IDENTIFIER LV_ERR_CKS_TCS4_CAN ECU_ADDRESS 0x7fb36d BIT_MASK 0x1 /end MEASUREMENT
/begin MEASUREMENT lv_tcs8_can_vld "logische Variable fuer erkannte gueltige Botschaft TCS8" UBYTE _CNV_S_2_RANGE__0___88_CM 1 0. 0. 1. DISPLAY_IDENTIFIER LV_TCS8_CAN_VLD ECU_ADDRESS 0x7fb373 BIT_MASK 0x1 /end MEASUREMENT
/begin MEASUREMENT lv_err_ctr_msg_tcs8 "Fehlerbit Botschaftszaehler" UBYTE _CNV_S_2_RANGE__0___88_CM 1 0. 0. 1. DISPLAY_IDENTIFIER LV_ERR_CTR_MSG_TCS8 ECU_ADDRESS 0x7fb374 BIT_MASK 0x1 /end MEASUREMENT
/begin MEASUREMENT lv_err_cks_tcs8_can "Fehlerbit Checksummenfehler" UBYTE _CNV_S_2_RANGE__0___88_CM 1 0. 0. 1. DISPLAY_IDENTIFIER LV_ERR_CKS_TCS8_CAN ECU_ADDRESS 0x7fb375 BIT_MASK 0x1 /end MEASUREMENT
/begin MEASUREMENT lv_dcc_tcs_req_can "Bit ACC-Anforderung" UBYTE _CNV_S_2_RANGE__0___88_CM 1 0. 0. 1. DISPLAY_IDENTIFIER LV_DCC_TCS_REQ_CAN ECU_ADDRESS 0x7fb376 BIT_MASK 0x1 /end MEASUREMENT
/begin MEASUREMENT lv_brake_temp_max_can "Bit Bremsentemperatur zu hoch" UBYTE _CNV_S_2_RANGE__0___88_CM 1 0. 0. 1. DISPLAY_IDENTIFIER LV_BRAKE_TEMP_MAX_CAN ECU_ADDRESS 0x7fb377 BIT_MASK 0x1 /end MEASUREMENT
/begin MEASUREMENT lv_dcc_msg_not_ok "Bit ACC-Botschaft nicht konsistent" UBYTE _CNV_S_2_RANGE__0___88_CM 1 0. 0. 1. DISPLAY_IDENTIFIER LV_DCC_MSG_NOT_OK ECU_ADDRESS 0x7fb378 BIT_MASK 0x1 /end MEASUREMENT
/begin MEASUREMENT lv_dece_ctl_ems_err_can "Statusbit Verzoegerungsregler" UBYTE _CNV_S_2_RANGE__0___88_CM 1 0. 0. 1. DISPLAY_IDENTIFIER LV_DECE_CTL_EMS_ERR_CAN ECU_ADDRESS 0x7fb379 BIT_MASK 0x1 /end MEASUREMENT
/begin MEASUREMENT lv_err_cks_tcs8_can_diag "Fehlerbit Checksummenfehler Irreversible" UBYTE _CNV_S_2_RANGE__0___88_CM 1 0. 0. 1. DISPLAY_IDENTIFIER LV_ERR_CKS_TCS8_CAN_DIAG ECU_ADDRESS 0x7fb37a BIT_MASK 0x1 /end MEASUREMENT
/begin MEASUREMENT ac_lgt_tcs8_can "Laengsbeschleunigung" UWORD _CNV_A_R_LINEAR_____457_CM 1 0. -16. 15.96875 DISPLAY_IDENTIFIER AC_LGT_TCS8_CAN ECU_ADDRESS 0x7f973c BYTE_ORDER MSB_LAST FORMAT "%6.2" /end MEASUREMENT
/begin CHARACTERISTIC c_t_pas_can_tcs4 "Zeit nach Initialisierung, nach der die Auswertung der TCS4-Botschaft beginnt" VALUE 0x848698 _REC_VAL_20_u1 2.55 _CNV_A_R_LINEAR_____113_CM 0. 2.55 DISPLAY_IDENTIFIER C_T_PAS_CAN_TCS4 FORMAT "%4.2" /end CHARACTERISTIC
/begin MEASUREMENT lv_tog1_can_vld "TOG-Botschaft gueltig" UBYTE _CNV_S_2_RANGE__0___88_CM 1 0. 0. 1. DISPLAY_IDENTIFIER LV_TOG1_CAN_VLD ECU_ADDRESS 0x7fb3c9 BIT_MASK 0x1 /end MEASUREMENT
/begin MEASUREMENT tog1_msg_ctr "Botschaftszaehler der TOG1- Botschaft fuer Lebenderkennung" UBYTE _CNV_A_R_LINEAR_____1_CM 1 0. 0. 255. DISPLAY_IDENTIFIER TOG1_MSG_CTR ECU_ADDRESS 0x7fb3c8 FORMAT "%3.0" /end MEASUREMENT
/begin MEASUREMENT t_oil_level1_can "Fuellstandszeit 1" UWORD _CNV_A_R_LINEAR_____290_CM 1 0. 100. 1123.5 DISPLAY_IDENTIFIER T_OIL_LEVEL1_CAN ECU_ADDRESS 0x7f974c BYTE_ORDER MSB_LAST FORMAT "%6.4" /end MEASUREMENT
/begin MEASUREMENT t_oil_level2_can "Fuellstandszeit 2" UWORD _CNV_A_R_LINEAR_____290_CM 1 0. 100. 1123.5 DISPLAY_IDENTIFIER T_OIL_LEVEL2_CAN ECU_ADDRESS 0x7f974e BYTE_ORDER MSB_LAST FORMAT "%6.4" /end MEASUREMENT
/begin MEASUREMENT t_oil_level3_can "Fuellstandszeit 3" UWORD _CNV_A_R_LINEAR_____290_CM 1 0. 100. 1123.5 DISPLAY_IDENTIFIER T_OIL_LEVEL3_CAN ECU_ADDRESS 0x7f9750 BYTE_ORDER MSB_LAST FORMAT "%6.4" /end MEASUREMENT
/begin MEASUREMENT t_oil_level4_can "Fuellstandszeit 4" UWORD _CNV_A_R_LINEAR_____290_CM 1 0. 100. 1123.5 DISPLAY_IDENTIFIER T_OIL_LEVEL4_CAN ECU_ADDRESS 0x7f9752 BYTE_ORDER MSB_LAST FORMAT "%6.4" /end MEASUREMENT
/begin MEASUREMENT t_toil_can "Oeltemperaturzeit" UWORD _CNV_A_R_LINEAR_____301_CM 1 0. 0. 127.875 DISPLAY_IDENTIFIER T_TOIL_CAN ECU_ADDRESS 0x7f9754 BYTE_ORDER MSB_LAST FORMAT "%7.3" /end MEASUREMENT
/begin MEASUREMENT lv_tog_err_can "Logische Variable fuer Sensorfehler TOG" UBYTE _CNV_S_2_RANGE__0___88_CM 1 0. 0. 1. DISPLAY_IDENTIFIER LV_TOG_ERR_CAN ECU_ADDRESS 0x7fb3ca BIT_MASK 0x1 /end MEASUREMENT
/begin MEASUREMENT lv_oil_level_ofs_warn "Logische Variable fuer \"Oelwarnschwelle plus Offset ueberschritten\"" UBYTE _CNV_S_2_RANGE__0___88_CM 1 0. 0. 1. DISPLAY_IDENTIFIER LV_OIL_LEVEL_OFS_WARN ECU_ADDRESS 0x7fb3cb BIT_MASK 0x1 /end MEASUREMENT
/begin MEASUREMENT lv_oil_level_tol_warn "Logische Variable fuer \"Oelwarnschwelle minus Toleranz unterschritten\"" UBYTE _CNV_S_2_RANGE__0___88_CM 1 0. 0. 1. DISPLAY_IDENTIFIER LV_OIL_LEVEL_TOL_WARN ECU_ADDRESS 0x7fb3cc BIT_MASK 0x1 /end MEASUREMENT
/begin MEASUREMENT lv_oil_level_max_warn "Maximum Oelfuellstand ueberschritten" UBYTE _CNV_S_2_RANGE__0___88_CM 1 0. 0. 1. DISPLAY_IDENTIFIER LV_OIL_LEVEL_MAX_WARN ECU_ADDRESS 0x7fb3ce BIT_MASK 0x1 /end MEASUREMENT
/begin MEASUREMENT lv_oil_level_max_tol_warn "Maximum Oelfuellstand plus Offset ueberschritten" UBYTE _CNV_S_2_RANGE__0___88_CM 1 0. 0. 1. DISPLAY_IDENTIFIER LV_OIL_LEVEL_MAX_TOL_WARN ECU_ADDRESS 0x7fb3cf BIT_MASK 0x1 /end MEASUREMENT
/begin MEASUREMENT lv_oil_level_up_warn "Oelwarnschwelle ueberschritten" UBYTE _CNV_S_2_RANGE__0___88_CM 1 0. 0. 1. DISPLAY_IDENTIFIER LV_OIL_LEVEL_UP_WARN ECU_ADDRESS 0x7fb3cd BIT_MASK 0x1 /end MEASUREMENT
/begin MEASUREMENT lv_err_ctr_msg_tog1 "Fehler Botschaftszaehler" UBYTE _CNV_S_2_RANGE__0___88_CM 1 0. 0. 1. DISPLAY_IDENTIFIER LV_ERR_CTR_MSG_TOG1 ECU_ADDRESS 0x7fb3d0 BIT_MASK 0x1 /end MEASUREMENT
/begin MEASUREMENT lv_vecu1_can_vld "logische Variable fuer erkannte gueltige Botschaft VECU1" UBYTE _CNV_S_2_RANGE__0___88_CM 1 0. 0. 1. DISPLAY_IDENTIFIER LV_VECU1_CAN_VLD ECU_ADDRESS 0x7fb3ab BIT_MASK 0x1 /end MEASUREMENT
/begin MEASUREMENT lv_acc_off_can_vecu1 "logische Variable fuer Anforderung der Abschaltung Klimakompressor" UBYTE _CNV_S_2_RANGE__0___88_CM 1 0. 0. 1. DISPLAY_IDENTIFIER LV_ACC_OFF_CAN_VECU1 ECU_ADDRESS 0x7fb3a9 BIT_MASK 0x1 /end MEASUREMENT
/begin MEASUREMENT lv_n_sp_is_add_can_2 "logische Variable fuer aktive Forderung der Erhoehung der Leerlaufsolldrehzahl Stufe 2" UBYTE _CNV_S_2_RANGE__0___88_CM 1 0. 0. 1. DISPLAY_IDENTIFIER LV_N_SP_IS_ADD_CAN_2 ECU_ADDRESS 0x7fb3a8 BIT_MASK 0x1 /end MEASUREMENT
/begin MEASUREMENT lv_ecfpwm_max_vecu "logische Variable fuer aktive Forderung zur maximalen Ansteuerung der Kuehlerluefter" UBYTE _CNV_S_2_RANGE__0___88_CM 1 0. 0. 1. DISPLAY_IDENTIFIER LV_ECFPWM_MAX_VECU ECU_ADDRESS 0x7fb3aa BIT_MASK 0x1 /end MEASUREMENT
/begin MEASUREMENT lv_igk_vecu_can "ZAS Klemme 15" UBYTE _CNV_S_2_RANGE__0___88_CM 1 0. 0. 1. DISPLAY_IDENTIFIER LV_IGK_VECU_CAN ECU_ADDRESS 0x7fb3ac BIT_MASK 0x1 /end MEASUREMENT
/begin MEASUREMENT lv_igk_mot_vecu_can "Klemme 15 Motorraum" UBYTE _CNV_S_2_RANGE__0___88_CM 1 0. 0. 1. DISPLAY_IDENTIFIER LV_IGK_MOT_VECU_CAN ECU_ADDRESS 0x7fb3ad BIT_MASK 0x1 /end MEASUREMENT
/begin MEASUREMENT lv_n_sp_is_add_can_1 "logische Variable fuer aktive Forderung der Erhoehung der Leerlaufsolldrehzahl Stufe 1" UBYTE _CNV_S_2_RANGE__0___88_CM 1 0. 0. 1. DISPLAY_IDENTIFIER LV_N_SP_IS_ADD_CAN_1 ECU_ADDRESS 0x7fb3a7 BIT_MASK 0x1 /end MEASUREMENT
/begin MEASUREMENT lv_bat_off_can "Batterie ab erkannt" UBYTE _CNV_S_2_RANGE__0___88_CM 1 0. 0. 1. DISPLAY_IDENTIFIER LV_BAT_OFF_CAN ECU_ADDRESS 0x7fb3ae BIT_MASK 0x1 /end MEASUREMENT
/begin MEASUREMENT lv_airb1_can_vld "logische Variable fuer erkannte gueltige Botschaft AIRB1" UBYTE _CNV_S_2_RANGE__0___88_CM 1 0. 0. 1. DISPLAY_IDENTIFIER LV_AIRB1_CAN_VLD ECU_ADDRESS 0x7fb350 BIT_MASK 0x1 /end MEASUREMENT
/begin MEASUREMENT lv_crash_can "Zustandsvariable Crash" UBYTE _CNV_S_2_RANGE__0___88_CM 1 0. 0. 1. DISPLAY_IDENTIFIER LV_CRASH_CAN ECU_ADDRESS 0x7fb34f BIT_MASK 0x1 /end MEASUREMENT
/begin MEASUREMENT lv_err_ctr_msg_airb1 "logische Variable fuer Fehler Botschaftszaehler" UBYTE _CNV_S_2_RANGE__0___88_CM 1 0. 0. 1. DISPLAY_IDENTIFIER LV_ERR_CTR_MSG_AIRB1 ECU_ADDRESS 0x7fb352 BIT_MASK 0x1 /end MEASUREMENT
/begin MEASUREMENT crash_state_airb1 "Variable zur Darstellung der Crash-Intensitaet" UBYTE _CNV_A_R_LINEAR_____1_CM 1 0. 0. 255. DISPLAY_IDENTIFIER CRASH_STATE_AIRB1 ECU_ADDRESS 0x7fb354 FORMAT "%3.0" /end MEASUREMENT
/begin MEASUREMENT lv_err_cks_airb1_diag "logische Variable fuer Fehler Botschaftszaehler" UBYTE _CNV_S_2_RANGE__0___88_CM 1 0. 0. 1. DISPLAY_IDENTIFIER LV_ERR_CKS_AIRB1_DIAG ECU_ADDRESS 0x7fb353 BIT_MASK 0x1 /end MEASUREMENT
/begin MEASUREMENT lv_err_cks_airb1 "logische Variable fuer Fehler Botschaftszaehler" UBYTE _CNV_S_2_RANGE__0___88_CM 1 0. 0. 1. DISPLAY_IDENTIFIER LV_ERR_CKS_AIRB1 ECU_ADDRESS 0x7fb351 BIT_MASK 0x1 /end MEASUREMENT
/begin COMPU_METHOD _CNV_A_R_LINEAR_____0_CM "" RAT_FUNC "%6.3" "[-]" COEFFS 0 1. 0. 0 0 1 /end COMPU_METHOD
/begin COMPU_METHOD _CNV_A_R_LINEAR_____1_CM "" RAT_FUNC "%6.3" "-" COEFFS 0 1. 0. 0 0 1 /end COMPU_METHOD
/begin COMPU_METHOD _CNV_S_2_RANGE______3_CM "" TAB_VERB "%6.3" "[-]" COMPU_TAB_REF _CNV_S_2_RANGE______3 /end COMPU_METHOD
/begin COMPU_VTAB _CNV_S_2_RANGE______3 "" TAB_VERB 2 0 "" 1 "1" /end COMPU_VTAB
/begin COMPU_METHOD _CNV_A_R_LINEAR_____5_CM "" RAT_FUNC "%6.3" "[rpm]" COEFFS 0 1. 0. 0 0 1 /end COMPU_METHOD
/begin COMPU_METHOD _CNV_A_R_LINEAR_____8_CM "" RAT_FUNC "%6.3" "[%]" COEFFS 0 655.3599999999997 0. 0 0 1 /end COMPU_METHOD
/begin COMPU_METHOD _CNV_S_2_RANGE______11_CM "" TAB_VERB "%6.3" "[-]" COMPU_TAB_REF _CNV_S_2_RANGE______11 /end COMPU_METHOD
/begin COMPU_VTAB _CNV_S_2_RANGE______11 "" TAB_VERB 2 0 "0" 1 "1" /end COMPU_VTAB
/begin COMPU_METHOD _CNV_A_R_LINEAR_____14_CM "" RAT_FUNC "%6.3" "[-]" COEFFS 0 65535.99999999996 0. 0 0 1 /end COMPU_METHOD
/begin COMPU_METHOD _CNV_A_R_LINEAR_____16_CM "" RAT_FUNC "%6.3" "[s]" COEFFS 0 1. 0. 0 0 1 /end COMPU_METHOD
/begin COMPU_METHOD _CNV_A_R_LINEAR_____17_CM "" RAT_FUNC "%6.3" "[°C/s]" COEFFS 0 1. 0. 0 0 1 /end COMPU_METHOD
/begin COMPU_METHOD _CNV_A_R_LINEAR_____18_CM "" RAT_FUNC "%6.3" "[°C]" COEFFS 0 1. 50. 0 0 1 /end COMPU_METHOD
/begin COMPU_METHOD _CNV_A_R_LINEAR_____19_CM "" RAT_FUNC "%6.3" "[s]" COEFFS 0 10. 0. 0 0 1 /end COMPU_METHOD
/begin COMPU_METHOD _CNV_A_R_LINEAR_____21_CM "" RAT_FUNC "%6.3" "[hPa]" COEFFS 0 12.06017666543982 0. 0 0 1 /end COMPU_METHOD
/begin COMPU_METHOD _CNV_A_R_LINEAR_____23_CM "" RAT_FUNC "%6.3" "[mg/stk]" COEFFS 0 47.18142548596112 0. 0 0 1 /end COMPU_METHOD
/begin COMPU_METHOD _CNV_A_R_LINEAR_____24_CM "" RAT_FUNC "%6.3" "[-]" COEFFS 0 128. 0. 0 0 1 /end COMPU_METHOD
/begin COMPU_METHOD _CNV_A_R_LINEAR_____33_CM "" RAT_FUNC "%6.3" "[V]" COEFFS 0 204.8 0. 0 0 1 /end COMPU_METHOD
/begin COMPU_METHOD _CNV_A_R_LINEAR_____34_CM "" RAT_FUNC "%6.3" "[-]" COEFFS 0 256. 0. 0 0 1 /end COMPU_METHOD
/begin COMPU_METHOD _CNV_A_R_LINEAR_____39_CM "" RAT_FUNC "%6.3" "[km/h]" COEFFS 0 1. 0. 0 0 1 /end COMPU_METHOD
/begin COMPU_METHOD _CNV_A_R_LINEAR_____44_CM "" RAT_FUNC "%6.3" "[%]" COEFFS 0 2.55 0. 0 0 1 /end COMPU_METHOD
/begin COMPU_METHOD _CNV_A_R_LINEAR_____52_CM "" RAT_FUNC "%6.3" "[V]" COEFFS 0 13107.20001587224 0. 0 0 1 /end COMPU_METHOD
/begin COMPU_METHOD _CNV_A_R_LINEAR_____56_CM "" RAT_FUNC "%6.3" "[°C]" COEFFS 0 63.9990234375 0. 0 0 1 /end COMPU_METHOD
/begin COMPU_METHOD _CNV_A_R_LINEAR_____58_CM "" RAT_FUNC "%6.3" "[rpm]" COEFFS 0 3.125e-002 0. 0 0 1 /end COMPU_METHOD
/begin COMPU_METHOD _CNV_A_R_LINEAR_____59_CM "" RAT_FUNC "%6.3" "[s]" COEFFS 0 100. 0. 0 0 1 /end COMPU_METHOD
/begin COMPU_METHOD _CNV_A_R_LINEAR_____62_CM "" RAT_FUNC "%6.3" "[Nm]" COEFFS 0 32. 0. 0 0 1 /end COMPU_METHOD
/begin COMPU_METHOD _CNV_A_R_LINEAR_____67_CM "" RAT_FUNC "%6.3" "[s]" COEFFS 0 15625. 0. 0 0 1 /end COMPU_METHOD
/begin COMPU_METHOD _CNV_A_R_LINEAR_____68_CM "" RAT_FUNC "%6.3" "°C" COEFFS 0 1. 40. 0 0 1 /end COMPU_METHOD
/begin COMPU_METHOD _CNV_A_R_LINEAR_____74_CM "" RAT_FUNC "%6.3" "[km/h]" COEFFS 0 100. 0. 0 0 1 /end COMPU_METHOD
/begin COMPU_METHOD _CNV_A_R_LINEAR_____81_CM "" RAT_FUNC "%6.3" "[%]" COEFFS 0 10.23 0. 0 0 1 /end COMPU_METHOD
/begin COMPU_METHOD _CNV_A_R_LINEAR_____82_CM "" RAT_FUNC "%6.3" "[%]" COEFFS 0 2.56 0. 0 0 1 /end COMPU_METHOD
/begin COMPU_METHOD _CNV_A_R_LINEAR_____84_CM "" RAT_FUNC "%6.3" "rpm" COEFFS 0 3.125e-002 0. 0 0 1 /end COMPU_METHOD
/begin COMPU_METHOD _CNV_S_2_RANGE__0___88_CM "" TAB_VERB "%6.3" "-" COMPU_TAB_REF _CNV_S_2_RANGE__0___88 /end COMPU_METHOD
/begin COMPU_VTAB _CNV_S_2_RANGE__0___88 "" TAB_VERB 2 0 "0" 1 "1" /end COMPU_VTAB
/begin COMPU_METHOD _CNV_A_R_LINEAR_____90_CM "" RAT_FUNC "%6.3" "[-]" COEFFS 0 65535.82575140447 0. 0 0 1 /end COMPU_METHOD
/begin COMPU_METHOD _CNV_A_R_LINEAR_____93_CM "" RAT_FUNC "%6.3" "[Nm]" COEFFS 0 4. 0. 0 0 1 /end COMPU_METHOD
/begin COMPU_METHOD _CNV_A_R_LINEAR_____98_CM "" RAT_FUNC "%6.3" "[-]" COEFFS 0 64. 0. 0 0 1 /end COMPU_METHOD
/begin COMPU_METHOD _CNV_A_R_LINEAR_____112_CM "" RAT_FUNC "%6.3" "[kg/h]" COEFFS 0 64. 0. 0 0 1 /end COMPU_METHOD
/begin COMPU_METHOD _CNV_A_R_LINEAR_____113_CM "" RAT_FUNC "%6.3" "[-]" COEFFS 0 100. 0. 0 0 1 /end COMPU_METHOD
/begin COMPU_METHOD _CNV_A_R_LINEAR_____137_CM "" RAT_FUNC "%6.3" "[°C/s]" COEFFS 0 256. 0. 0 0 1 /end COMPU_METHOD
/begin COMPU_METHOD _CNV_A_R_LINEAR_____206_CM "" RAT_FUNC "%6.3" "[kPa]" COEFFS 0 8.225806451612903e-002 0. 0 0 1 /end COMPU_METHOD
/begin COMPU_METHOD _CNV_A_R_LINEAR_____207_CM "" RAT_FUNC "%6.3" "[Hz]" COEFFS 0 2.55 0. 0 0 1 /end COMPU_METHOD
/begin COMPU_METHOD _CNV_A_R_LINEAR_____223_CM "" RAT_FUNC "%6.3" "s" COEFFS 0 100. 0. 0 0 1 /end COMPU_METHOD
/begin COMPU_METHOD _CNV_A_R_LINEAR_____227_CM "" RAT_FUNC "%6.3" "grad" COEFFS 0 22.85714285714285 0. 0 0 1 /end COMPU_METHOD
/begin COMPU_METHOD _CNV_A_R_LINEAR_____228_CM "" RAT_FUNC "%6.3" "grad/s" COEFFS 0 22.85714285714285 0. 0 0 1 /end COMPU_METHOD
/begin COMPU_METHOD _CNV_A_R_LINEAR_____229_CM "" RAT_FUNC "%6.3" "[Nm]" COEFFS 0 2. 0. 0 0 1 /end COMPU_METHOD
/begin COMPU_METHOD _CNV_A_R_LINEAR_____230_CM "" RAT_FUNC "%6.3" "[W]" COEFFS 0 2.e-002 0. 0 0 1 /end COMPU_METHOD
/begin COMPU_METHOD _CNV_A_R_LINEAR_____234_CM "" RAT_FUNC "%6.3" "s" COEFFS 0 10. 0. 0 0 1 /end COMPU_METHOD
/begin COMPU_METHOD _CNV_A_R_LINEAR_____235_CM "" RAT_FUNC "%6.3" "[\260C]" COEFFS 0 1.333333333333333 64. 0 0 1 /end COMPU_METHOD
/begin COMPU_METHOD _CNV_A_R_LINEAR_____239_CM "" RAT_FUNC "%6.3" "km/h" COEFFS 0 1. 0. 0 0 1 /end COMPU_METHOD
/begin COMPU_METHOD _CNV_A_R_LINEAR_____243_CM "" RAT_FUNC "%6.3" "[°C]" COEFFS 0 1.333333333333333 0. 0 0 1 /end COMPU_METHOD
/begin COMPU_METHOD _CNV_A_R_LINEAR_____248_CM "" RAT_FUNC "%6.3" "-" COEFFS 0 256. 0. 0 0 1 /end COMPU_METHOD
/begin COMPU_METHOD _CNV_A_R_LINEAR_____251_CM "" RAT_FUNC "%6.3" "°C" COEFFS 0 1.333333333333333 64. 0 0 1 /end COMPU_METHOD
/begin COMPU_METHOD _CNV_A_R_LINEAR_____254_CM "" RAT_FUNC "%6.3" "[C]" COEFFS 0 1.333333333333333 0. 0 0 1 /end COMPU_METHOD
/begin COMPU_METHOD _CNV_A_R_LINEAR_____257_CM "" RAT_FUNC "%6.3" "rpm" COEFFS 0 1. 0. 0 0 1 /end COMPU_METHOD
/begin COMPU_METHOD _CNV_A_R_LINEAR_____258_CM "" RAT_FUNC "%6.3" "[-]" COEFFS 0 10. 0. 0 0 1 /end COMPU_METHOD
/begin COMPU_METHOD _CNV_A_R_LINEAR_____259_CM "" RAT_FUNC "%6.3" "[°CRK]" COEFFS 0 2.666666666666667 128. 0 0 1 /end COMPU_METHOD
/begin COMPU_METHOD _CNV_A_R_LINEAR_____260_CM "" RAT_FUNC "%6.3" "V" COEFFS 0 204.8 0. 0 0 1 /end COMPU_METHOD
/begin COMPU_METHOD _CNV_A_R_LINEAR_____261_CM "" RAT_FUNC "%6.3" "[%]" COEFFS 0 10.24024024024024 0. 0 0 1 /end COMPU_METHOD
/begin COMPU_METHOD _CNV_A_R_LINEAR_____263_CM "" RAT_FUNC "%6.3" "[%/10ms]" COEFFS 0 10.23 0. 0 0 1 /end COMPU_METHOD
/begin COMPU_METHOD _CNV_A_R_LINEAR_____290_CM "" RAT_FUNC "%6.3" "[ms]" COEFFS 0 2. -200. 0 0 1 /end COMPU_METHOD
/begin COMPU_METHOD _CNV_A_R_LINEAR_____300_CM "" RAT_FUNC "%6.3" "-" COEFFS 0 65535.99999999996 0. 0 0 1 /end COMPU_METHOD
/begin COMPU_METHOD _CNV_A_R_LINEAR_____301_CM "" RAT_FUNC "%6.3" "[ms]" COEFFS 0 8. 0. 0 0 1 /end COMPU_METHOD
/begin COMPU_METHOD _CNV_A_R_LINEAR_____328_CM "" RAT_FUNC "%6.3" "%" COEFFS 0 4.016064257028112 127. 0 0 1 /end COMPU_METHOD
/begin COMPU_METHOD _CNV_S_3_STATE_CRU__333_CM "" TAB_VERB "%6.3" "[-]" COMPU_TAB_REF _CNV_S_3_STATE_CRU__333 /end COMPU_METHOD
/begin COMPU_VTAB _CNV_S_3_STATE_CRU__333 "" TAB_VERB 3 0 "VECU" 1 "LSM(6Pos)" 3 "LSM(4Pos)" /end COMPU_VTAB
/begin COMPU_METHOD _CNV_A_R_LINEAR_____359_CM "" RAT_FUNC "%6.3" "[us]" COEFFS 0 1. 0. 0 0 1 /end COMPU_METHOD
/begin COMPU_METHOD _CNV_A_R_LINEAR_____365_CM "" RAT_FUNC "%6.3" "[V]" COEFFS 0 51.2 0. 0 0 1 /end COMPU_METHOD
/begin COMPU_METHOD _CNV_A_R_LINEAR_____366_CM "" RAT_FUNC "%6.3" "°C/s" COEFFS 0 1. 0. 0 0 1 /end COMPU_METHOD
/begin COMPU_METHOD _CNV_A_R_LINEAR_____367_CM "" RAT_FUNC "%6.3" "°C" COEFFS 0 255.9999997499962 32767.99996799951 0 0 1 /end COMPU_METHOD
/begin COMPU_METHOD _CNV_A_R_LINEAR_____368_CM "" RAT_FUNC "%6.3" "mg/stk" COEFFS 0 0.183585313174946 0. 0 0 1 /end COMPU_METHOD
/begin COMPU_METHOD _CNV_A_R_LINEAR_____378_CM "" RAT_FUNC "%6.3" "[°/oo]" COEFFS 0 65.408 0. 0 0 1 /end COMPU_METHOD
/begin COMPU_METHOD _CNV_A_R_LINEAR_____379_CM "" RAT_FUNC "%6.3" "[°/oo]" COEFFS 0 4194.300129486656 -8.782845907262527e-004 0 0 1 /end COMPU_METHOD
/begin COMPU_METHOD _CNV_A_R_LINEAR_____393_CM "" RAT_FUNC "%6.3" "[Nm]" COEFFS 0 0.5 50. 0 0 1 /end COMPU_METHOD
/begin COMPU_METHOD _CNV_S_5_RANGE______394_CM "" TAB_VERB "%6.3" "[-]" COMPU_TAB_REF _CNV_S_5_RANGE______394 /end COMPU_METHOD
/begin COMPU_VTAB _CNV_S_5_RANGE______394 "" TAB_VERB 256 0 "NO_TQ_REQ" 1 "ERR_REQ" 2 "ERR_REQ" 3 "ERR_REQ" 4 "ERR_REQ" 5 "ASR_REQ" 6 "MSR_REQ" 7 "ERR_REQ" 8 "ERR_REQ" 9 "ERR_REQ" 10 "ERR_REQ" 11 "ERR_REQ" 12 "ERR_REQ" 13 "ERR_REQ" 14 "ERR_REQ" 15 "ERR_REQ" 16 "ERR_REQ" 17 "ERR_REQ" 18 "ERR_REQ" 19 "ERR_REQ" 20 "ERR_REQ" 21 "ERR_REQ" 22 "ERR_REQ" 23 "ERR_REQ" 24 "ERR_REQ" 25 "ERR_REQ" 26 "ERR_REQ" 27 "ERR_REQ" 28 "ERR_REQ" 29 "ERR_REQ" 30 "ERR_REQ" 31 "ERR_REQ" 32 "ERR_REQ" 33 "ERR_REQ" 34 "ERR_REQ" 35 "ERR_REQ" 36 "ERR_REQ" 37 "ERR_REQ" 38 "ERR_REQ" 39 "ERR_REQ" 40 "ERR_REQ" 41 "ERR_REQ" 42 "ERR_REQ" 43 "ERR_REQ" 44 "ERR_REQ" 45 "ERR_REQ" 46 "ERR_REQ" 47 "ERR_REQ" 48 "ERR_REQ" 49 "ERR_REQ" 50 "ERR_REQ" 51 "ERR_REQ" 52 "ERR_REQ" 53 "ERR_REQ" 54 "ERR_REQ" 55 "ERR_REQ" 56 "ERR_REQ" 57 "ERR_REQ" 58 "ERR_REQ" 59 "ERR_REQ" 60 "ERR_REQ" 61 "ERR_REQ" 62 "ERR_REQ" 63 "ERR_REQ" 64 "ERR_REQ" 65 "ERR_REQ" 66 "ERR_REQ" 67 "ERR_REQ" 68 "ERR_REQ" 69 "ERR_REQ" 70 "ERR_REQ" 71 "ERR_REQ" 72 "ERR_REQ" 73 "ERR_REQ" 74 "ERR_REQ" 75 "ERR_REQ" 76 "ERR_REQ" 77 "ERR_REQ" 78 "ERR_REQ" 79 "ERR_REQ" 80 "ERR_REQ" 81 "ERR_REQ" 82 "ERR_REQ" 83 "ERR_REQ" 84 "ERR_REQ" 85 "ERR_REQ" 86 "ERR_REQ" 87 "ERR_REQ" 88 "ERR_REQ" 89 "ERR_REQ" 90 "ERR_REQ" 91 "ERR_REQ" 92 "ERR_REQ" 93 "ERR_REQ" 94 "ERR_REQ" 95 "ERR_REQ" 96 "ERR_REQ" 97 "ERR_REQ" 98 "ERR_REQ" 99 "ERR_REQ" 100 "ERR_REQ" 101 "ERR_REQ" 102 "ERR_REQ" 103 "ERR_REQ" 104 "ERR_REQ" 105 "ERR_REQ" 106 "ERR_REQ" 107 "ERR_REQ" 108 "ERR_REQ" 109 "ERR_REQ" 110 "ERR_REQ" 111 "ERR_REQ" 112 "ERR_REQ" 113 "ERR_REQ" 114 "ERR_REQ" 115 "ERR_REQ" 116 "ERR_REQ" 117 "ERR_REQ" 118 "ERR_REQ" 119 "ERR_REQ" 120 "ERR_REQ" 121 "ERR_REQ" 122 "ERR_REQ" 123 "ERR_REQ" 124 "ERR_REQ" 125 "ERR_REQ" 126 "ERR_REQ" 127 "ERR_REQ" 128 "ERR_REQ" 129 "ERR_REQ" 130 "ERR_REQ" 131 "ERR_REQ" 132 "ERR_REQ" 133 "ERR_REQ" 134 "ERR_REQ" 135 "ERR_REQ" 136 "ERR_REQ" 137 "ERR_REQ" 138 "ERR_REQ" 139 "ERR_REQ" 140 "ERR_REQ" 141 "ERR_REQ" 142 "ERR_REQ" 143 "ERR_REQ" 144 "ERR_REQ" 145 "ERR_REQ" 146 "ERR_REQ" 147 "ERR_REQ" 148 "ERR_REQ" 149 "ERR_REQ" 150 "ERR_REQ" 151 "ERR_REQ" 152 "ERR_REQ" 153 "ERR_REQ" 154 "ERR_REQ" 155 "ERR_REQ" 156 "ERR_REQ" 157 "ERR_REQ" 158 "ERR_REQ" 159 "ERR_REQ" 160 "ERR_REQ" 161 "ERR_REQ" 162 "ERR_REQ" 163 "ERR_REQ" 164 "ERR_REQ" 165 "ERR_REQ" 166 "ERR_REQ" 167 "ERR_REQ" 168 "ERR_REQ" 169 "ERR_REQ" 170 "ERR_REQ" 171 "ERR_REQ" 172 "ERR_REQ" 173 "ERR_REQ" 174 "ERR_REQ" 175 "ERR_REQ" 176 "ERR_REQ" 177 "ERR_REQ" 178 "ERR_REQ" 179 "ERR_REQ" 180 "ERR_REQ" 181 "ERR_REQ" 182 "ERR_REQ" 183 "ERR_REQ" 184 "ERR_REQ" 185 "ERR_REQ" 186 "ERR_REQ" 187 "ERR_REQ" 188 "ERR_REQ" 189 "ERR_REQ" 190 "ERR_REQ" 191 "ERR_REQ" 192 "ERR_REQ" 193 "ERR_REQ" 194 "ERR_REQ" 195 "ERR_REQ" 196 "ERR_REQ" 197 "ERR_REQ" 198 "ERR_REQ" 199 "ERR_REQ" 200 "ERR_REQ" 201 "ERR_REQ" 202 "ERR_REQ" 203 "ERR_REQ" 204 "ERR_REQ" 205 "ERR_REQ" 206 "ERR_REQ" 207 "ERR_REQ" 208 "ERR_REQ" 209 "ERR_REQ" 210 "ERR_REQ" 211 "ERR_REQ" 212 "ERR_REQ" 213 "ERR_REQ" 214 "ERR_REQ" 215 "ERR_REQ" 216 "ERR_REQ" 217 "ERR_REQ" 218 "ERR_REQ" 219 "ERR_REQ" 220 "ERR_REQ" 221 "ERR_REQ" 222 "ERR_REQ" 223 "ERR_REQ" 224 "ERR_REQ" 225 "ERR_REQ" 226 "ERR_REQ" 227 "ERR_REQ" 228 "ERR_REQ" 229 "ERR_REQ" 230 "ERR_REQ" 231 "ERR_REQ" 232 "ERR_REQ" 233 "ERR_REQ" 234 "ERR_REQ" 235 "ERR_REQ" 236 "ERR_REQ" 237 "ERR_REQ" 238 "ERR_REQ" 239 "ERR_REQ" 240 "ERR_REQ" 241 "ERR_REQ" 242 "ERR_REQ" 243 "ERR_REQ" 244 "ERR_REQ" 245 "ERR_REQ" 246 "ERR_REQ" 247 "ERR_REQ" 248 "ERR_REQ" 249 "ERR_REQ" 250 "ERR_REQ" 251 "ERR_REQ" 252 "ERR_REQ" 253 "ERR_REQ" 254 "ERR_REQ" 255 "ERR_REQ" /end COMPU_VTAB
/begin COMPU_METHOD _CNV_S_4_STATE_CC_R_427_CM "" TAB_VERB "%6.3" "-" COMPU_TAB_REF _CNV_S_4_STATE_CC_R_427 /end COMPU_METHOD
/begin COMPU_VTAB _CNV_S_4_STATE_CC_R_427 "" TAB_VERB 4 0 "OPEN" 1 "CONTROL" 2 "CLOSED" 3 "ERROR" /end COMPU_VTAB
/begin COMPU_METHOD _CNV_S_12_GEAR_CAN_R_428_CM "" TAB_VERB "%6.3" "[-]" COMPU_TAB_REF _CNV_S_12_GEAR_CAN_R_428 /end COMPU_METHOD
/begin COMPU_VTAB _CNV_S_12_GEAR_CAN_R_428 "" TAB_VERB 12 0 "OPEN" 1 "GEAR 1" 2 "GEAR 2" 3 "GEAR 3" 4 "GEAR 4" 5 "GEAR 5" 6 "1m" 7 "R" 8 "GEAR 6" 9 "GEAR 7" 14 "NOT DEF" 15 "ERROR" /end COMPU_VTAB
/begin COMPU_METHOD _CNV_S_16_SEL_PSN_RA_429_CM "" TAB_VERB "%6.3" "[-]" COMPU_TAB_REF _CNV_S_16_SEL_PSN_RA_429 /end COMPU_METHOD
/begin COMPU_VTAB _CNV_S_16_SEL_PSN_RA_429 "" TAB_VERB 16 0 "INTER" 1 "Pos 1" 2 "Pos 2" 3 "Pos 3" 4 "Pos 4" 5 "D" 6 "N" 7 "R" 8 "P" 9 "RSP" 10 "Z1" 11 "Z2" 12 "S" 13 "L" 14 "TIP" 15 "ERROR" /end COMPU_VTAB
/begin COMPU_METHOD _CNV_A_R_LINEAR_____430_CM "" RAT_FUNC "%6.3" "%" COEFFS 0 2.564102564102564 0. 0 0 1 /end COMPU_METHOD
/begin COMPU_METHOD _CNV_S_4_STATE_MIL__431_CM "" TAB_VERB "%6.3" "-" COMPU_TAB_REF _CNV_S_4_STATE_MIL__431 /end COMPU_METHOD
/begin COMPU_VTAB _CNV_S_4_STATE_MIL__431 "" TAB_VERB 4 0 "OFF" 1 "ON" 2 "ON" 3 "ON" /end COMPU_VTAB
/begin COMPU_METHOD _CNV_A_R_LINEAR_____432_CM "" RAT_FUNC "%6.3" "[Nm/s]" COEFFS 0 0.1 0. 0 0 1 /end COMPU_METHOD
/begin COMPU_METHOD _CNV_A_R_LINEAR_____433_CM "" RAT_FUNC "%6.3" "[-]" COEFFS 0 4.e-002 0. 0 0 1 /end COMPU_METHOD
/begin COMPU_METHOD _CNV_A_R_LINEAR_____434_CM "" RAT_FUNC "%6.3" "ms" COEFFS 0 5.e-002 0. 0 0 1 /end COMPU_METHOD
/begin COMPU_METHOD _CNV_A_R_LINEAR_____435_CM "" RAT_FUNC "%6.3" "[bar]" COEFFS 0 5. 0. 0 0 1 /end COMPU_METHOD
/begin COMPU_METHOD _CNV_S_3_STATE_ICH__436_CM "" TAB_VERB "%6.3" "-" COMPU_TAB_REF _CNV_S_3_STATE_ICH__436 /end COMPU_METHOD
/begin COMPU_VTAB _CNV_S_3_STATE_ICH__436 "" TAB_VERB 3 0 "NO HEATING" 1 "INTERIEUR" 2 "ENGINE" /end COMPU_VTAB
/begin COMPU_METHOD _CNV_S_17_CAN_VERS_R_437_CM "" TAB_VERB "%6.3" "[-]" COMPU_TAB_REF _CNV_S_17_CAN_VERS_R_437 /end COMPU_METHOD
/begin COMPU_VTAB _CNV_S_17_CAN_VERS_R_437 "" TAB_VERB 17 9 "CAN 4.0.1" 10 "CAN 4.0.2" 11 "CAN 4.0.3" 12 "CAN 4.1.1" 13 "CAN 4.1.2" 14 "CAN 4.1.3" 18 "CAN 4.2.3" 19 "CAN 4.2.4" 20 "CAN 4.2.5" 25 "CAN 4.3.5" 26 "CAN 4.3.6" 31 "CAN 4.4.5" 37 "CAN 4.5.6" 38 "CAN 4.6.5" 39 "CAN 4.6.6" 44 "CAN 4.7.6" 45 "CAN 4.7.7" /end COMPU_VTAB
/begin COMPU_METHOD _CNV_A_R_LINEAR_____438_CM "" RAT_FUNC "%6.3" "[rpm]" COEFFS 0 1.e-002 0. 0 0 1 /end COMPU_METHOD
/begin COMPU_METHOD _CNV_A_R_LINEAR_____439_CM "" RAT_FUNC "%6.3" "[Nm]" COEFFS 0 0.1 0. 0 0 1 /end COMPU_METHOD
/begin COMPU_METHOD _CNV_A_R_LINEAR_____440_CM "" RAT_FUNC "%6.3" "[kW]" COEFFS 0 1. 0. 0 0 1 /end COMPU_METHOD
/begin COMPU_METHOD _CNV_A_R_LINEAR_____441_CM "" RAT_FUNC "%6.3" "[l]" COEFFS 0 10. 0. 0 0 1 /end COMPU_METHOD
/begin COMPU_METHOD _CNV_A_R_LINEAR_____442_CM "" RAT_FUNC "%6.3" "[ml]" COEFFS 0 0.1 0. 0 0 1 /end COMPU_METHOD
/begin COMPU_METHOD _CNV_A_R_LINEAR_____443_CM "" RAT_FUNC "%6.3" "[km]" COEFFS 0 1.e-003 0. 0 0 1 /end COMPU_METHOD
/begin COMPU_METHOD _CNV_A_R_LINEAR_____444_CM "" RAT_FUNC "%6.3" "[-]" COEFFS 0 2.e-003 0. 0 0 1 /end COMPU_METHOD
/begin COMPU_METHOD _CNV_A_R_LINEAR_____445_CM "" RAT_FUNC "%6.3" "Monat" COEFFS 0 1. 0. 0 0 1 /end COMPU_METHOD
/begin COMPU_METHOD _CNV_A_R_LINEAR_____446_CM "" RAT_FUNC "%6.3" "km" COEFFS 0 4.e-002 0. 0 0 1 /end COMPU_METHOD
/begin COMPU_METHOD _CNV_A_R_LINEAR_____447_CM "" RAT_FUNC "%6.3" "ml" COEFFS 0 1.e-002 0. 0 0 1 /end COMPU_METHOD
/begin COMPU_METHOD _CNV_A_R_LINEAR_____448_CM "" RAT_FUNC "%6.3" "ml" COEFFS 0 2.e-002 0. 0 0 1 /end COMPU_METHOD
/begin COMPU_METHOD _CNV_A_R_LINEAR_____449_CM "" RAT_FUNC "%6.3" "-" COEFFS 0 1.e-002 0. 0 0 1 /end COMPU_METHOD
/begin COMPU_METHOD _CNV_A_R_LINEAR_____450_CM "" RAT_FUNC "%6.3" "m" COEFFS 0 2000. 0. 0 0 1 /end COMPU_METHOD
/begin COMPU_METHOD _CNV_A_R_LINEAR_____451_CM "" RAT_FUNC "%6.3" "[s]" COEFFS 0 0.25 0. 0 0 1 /end COMPU_METHOD
/begin COMPU_METHOD _CNV_A_R_LINEAR_____452_CM "" RAT_FUNC "%6.3" "[km]" COEFFS 0 1. 0. 0 0 1 /end COMPU_METHOD
/begin COMPU_METHOD _CNV_S_5_STATE_VS_T_453_CM "" TAB_VERB "%6.3" "-" COMPU_TAB_REF _CNV_S_5_STATE_VS_T_453 /end COMPU_METHOD
/begin COMPU_VTAB _CNV_S_5_STATE_VS_T_453 "" TAB_VERB 5 0 "NOT VALID" 1 "VALID" 2 "INIT" 4 "USPG" 8 "ERROR" /end COMPU_VTAB
/begin COMPU_METHOD _CNV_A_R_LINEAR_____454_CM "" RAT_FUNC "%6.3" "m/s²" COEFFS 0 10. 127. 0 0 1 /end COMPU_METHOD
/begin COMPU_METHOD _CNV_S_4_STATE_THD__455_CM "" TAB_VERB "%6.3" "-" COMPU_TAB_REF _CNV_S_4_STATE_THD__455 /end COMPU_METHOD
/begin COMPU_VTAB _CNV_S_4_STATE_THD__455 "" TAB_VERB 4 0 "NO SIGNAL" 1 "Dep.>450 mbar" 2 "Dep.<=450 mbar" 3 "ERROR" /end COMPU_VTAB
/begin COMPU_METHOD _CNV_A_R_LINEAR_____456_CM "" RAT_FUNC "%6.3" "[hPa]" COEFFS 0 0.25 0. 0 0 1 /end COMPU_METHOD
/begin COMPU_METHOD _CNV_A_R_LINEAR_____457_CM "" RAT_FUNC "%6.3" "m/s²" COEFFS 0 32. 512. 0 0 1 /end COMPU_METHOD
/begin RECORD_LAYOUT _REC_VAL_20_u1 FNC_VALUES 1 UBYTE COLUMN_DIR DIRECT /end RECORD_LAYOUT
/begin RECORD_LAYOUT _REC_AXS_20_u2 NO_AXIS_PTS_X 1 UWORD AXIS_PTS_X 2 UWORD INDEX_INCR DIRECT /end RECORD_LAYOUT
/begin RECORD_LAYOUT _REC_CUR_20_u1_u2 FNC_VALUES 1 UBYTE COLUMN_DIR DIRECT /end RECORD_LAYOUT
/begin RECORD_LAYOUT _REC_VAL_20_u2 FNC_VALUES 1 UWORD COLUMN_DIR DIRECT /end RECORD_LAYOUT
/begin RECORD_LAYOUT _REC_VAL_20_s2 FNC_VALUES 1 SWORD COLUMN_DIR DIRECT /end RECORD_LAYOUT
/begin RECORD_LAYOUT _REC_AXS_20_u1 NO_AXIS_PTS_X 1 UBYTE AXIS_PTS_X 2 UBYTE INDEX_INCR DIRECT /end RECORD_LAYOUT
/begin RECORD_LAYOUT _REC_MAP_20_u1_u1_u2 FNC_VALUES 1 UBYTE COLUMN_DIR DIRECT /end RECORD_LAYOUT
/begin RECORD_LAYOUT _REC_CUR_20_u2_u2 FNC_VALUES 1 UWORD COLUMN_DIR DIRECT /end RECORD_LAYOUT
/begin RECORD_LAYOUT _REC_CUR_20_u2_u1 FNC_VALUES 1 UWORD COLUMN_DIR DIRECT /end RECORD_LAYOUT
/begin RECORD_LAYOUT _REC_MAP_20_u2_u1_u1 FNC_VALUES 1 UWORD COLUMN_DIR DIRECT /end RECORD_LAYOUT
/begin RECORD_LAYOUT _REC_MAP_20_u2_u2_u1 FNC_VALUES 1 UWORD COLUMN_DIR DIRECT /end RECORD_LAYOUT
/begin RECORD_LAYOUT _REC_CUR_20_u1_u1 FNC_VALUES 1 UBYTE COLUMN_DIR DIRECT /end RECORD_LAYOUT
/begin RECORD_LAYOUT _REC_MAP_20_u1_u1_u1 FNC_VALUES 1 UBYTE COLUMN_DIR DIRECT /end RECORD_LAYOUT
/begin FUNCTION PCR_Generic ""
 /begin OUT_MEASUREMENT lv_efp_rly lv_efp_reset lv_efp_reset_st lv_efp_reset_es ctr_max_ti_min_0 ctr_max_ti_min_1 ctr_max_ti_min_2 ctr_max_ti_min_3 t_atic20 v_t_atic20 v_t_lc t_lc can_tq_driv_sub can_tq_req_sta lv_can_brake_abs lv_lock_imob lv_r_heat_1 lv_r_heat_2 /end OUT_MEASUREMENT
/end FUNCTION
/begin FUNCTION PSA_PN0 "" /end FUNCTION
/begin FUNCTION C_0_BGO "" /end FUNCTION
/begin FUNCTION C_1_GEN "C_1_GEN"
 /begin SUB_FUNCTION GEN_Variant_Coding GEN_Init_Variables_Non_Impl_Fct GEN_System_Overview GEN_Appl_System /end SUB_FUNCTION
/end FUNCTION
/begin FUNCTION GEN_Variant_Coding "Variant_Coding"
 /begin DEF_CHARACTERISTIC c_dsk_byte_1 c_dsk_byte_2 c_dsk_byte_3 c_dsk_byte_4 c_dsk_byte_0 c_var_code_2 c_var_code_3 c_var_code_5 c_var_code_6 c_var_code_7 c_var_code_8 c_var_code_9 c_var_code_10 c_var_code_11 c_var_code_12 c_var_code_13 c_var_code_14 c_var_code_15 c_var_code_1 c_var_code_16 c_var_code_4 /end DEF_CHARACTERISTIC
 /begin OUT_MEASUREMENT lv_var_sap lv_var_sav lv_var_egr lv_var_knks_2 lv_var_mil lv_var_pwl lv_var_cps lv_var_cs lv_var_can lv_var_can_vecu lv_var_rr_sw lv_var_ac lv_var_syn lv_var_climatronic lv_var_can_tcs lv_var_can_acu lv_var_can_ccu lv_var_can_tcu lv_at lv_var_asr lv_var_ect lv_var_can_bem lv_var_vim lv_var_vim_1 lv_var_vim_2 lv_var_ecfpwm lv_var_ecfpwm_1 lv_var_ecfpwm_2 lv_dct lv_cvt lv_var_msr lv_var_vim_fb lv_var_can_tog lv_var_can_stans lv_var_vcv lv_var_port lv_var_cwp lv_var_aeb lv_var_tldp lv_var_can_if_cft lv_var_can_dt_ccp lv_var_can_ccp lv_var_can_icl lv_var_can_eilu /end OUT_MEASUREMENT
/end FUNCTION
/begin FUNCTION GEN_Init_Variables_Non_Impl_Fct "Init_Variables_Non_Impl_Fct" /end FUNCTION
/begin FUNCTION GEN_System_Overview "System_Overview" /end FUNCTION
/begin FUNCTION GEN_Appl_System "Appl_System" /end FUNCTION
/begin FUNCTION C_2_BIO "" /begin SUB_FUNCTION SYS_ETC_MONITORING_ECM2 BIO_Key_Position_Determination /end SUB_FUNCTION /end FUNCTION
/begin FUNCTION SYS_ETC_MONITORING_ECM2 "" /end FUNCTION
/begin FUNCTION BIO_Key_Position_Determination "" /begin OUT_MEASUREMENT t_sys t_igk /end OUT_MEASUREMENT /end FUNCTION
/begin FUNCTION C_4_SYS ""
 /begin SUB_FUNCTION SYS_CAN SYS_CAN_Messages_EMS SYS_Coolant_Temp_Setpoint SYS_Ambient_Air_Temperature SYS_AN_LIM_C SYS_AMAP SYS_ATBA SYS_ATIMER SYS_Oil_Temp SYS_CAN_Messages_EMS__AI SYS_AER SYS_AERINCI SYS_AMAF SYS_ATAC SYS_ATIA SYS_ATOILINCI /end SUB_FUNCTION
/end FUNCTION
/begin FUNCTION SYS_CAN "" /begin OUT_MEASUREMENT can_vs_abs lv_err_vs_can /end OUT_MEASUREMENT /end FUNCTION
/begin FUNCTION SYS_CAN_Messages_EMS ""
 /begin DEF_CHARACTERISTIC c_can_vers c_eng_typ_2 c_tqi_stnd c_n_tqi_tol c_tqi_tol c_eng_typ c_eg_typ_ems5 c_eng_pow c_num_valve c_eng_vol c_oil_ofs_warn c_oil_tol_warn c_km_min_asa c_km_max_asa c_ctr_min_oil c_t_min_asa c_t_max_asa c_km_min_oil c_oil_max_thd c_oil_max_ofs c_oil_max_over_hys c_oil_ctr_fast lc_oil_max_det lc_n_ems_can_sel c_diam_whl c_t_pas_can_tcs4 /end DEF_CHARACTERISTIC
 /begin OUT_MEASUREMENT lv_can_ena lv_slp_idc_update lv_stop_rcv_can_msg lv_dlc_tcs1_nvld lv_dlc_tcs2_nvld lv_dlc_tcs3_nvld lv_dlc_tcs8_nvld lv_dlc_tcu1_nvld lv_dlc_tcu2_nvld lv_dlc_airb1_nvld lv_dlc_imor_nvld lv_dlc_icl1_nvld lv_dlc_ac1_nvld lv_dlc_bem_nvld lv_dlc_cru_nvld lv_dlc_eilu1_nvld lv_dlc_vecu1_nvld lv_dlc_if_cft_1_nvld lv_dlc_icl2_nvld lv_dlc_icl3_nvld lv_dlc_tog1_nvld lv_dlc_whl_nvld lv_dlc_sys_info_nvld lv_slp_idc lv_dlc_nom_sys_nvld lv_pste_can_vld ang_pste ang_grd_pste lv_n_sp_is_bem_1 lv_n_sp_is_bem_2 lv_bem_can_vld gen_load_tq_can gen_load_pow_can cru_swi_pos cru_swi_pos_deb cru_swi_pos_can lv_cru_can_vld lv_err_cru_dvc_smls lv_cru_dcc_conf lv_err_cru_conf lv_err_ctr_msg_cru lv_err_cks_cru_can_diag lv_err_cks_cru_can cru_conf lv_cru_swi_main lv_tcu1_can_vld lv_gs_act lv_tqi_gs_fast_dec_inh lv_acc_off_can_tcu1 state_cc lv_n_sp_is_tcu_ena lv_gs_req gear_can sel_psn gear_ratio_tcu1 tqi_gs_req_can tqi_gs_req cool_req_tcu_can lv_mil_on_can lv_mil_on_tcu1 tq_loss_tcu1_can tq_loss_tcu1 tcu1_msg_ctr state_mil_on_tcu1 drg_tcu drg_tcu_can lv_err_ctr_msg_tcu1 lv_tcu2_can_vld lv_is_ad_inh_tcu2 lv_req_puc_deac_tcu2 tcu2_msg_ctr n_sp_is_tcu2 tq_dif_tra_max lv_n_tcu_req n_tcu_req n_tcu_req_ivs t_n_tcu_req lv_err_ctr_msg_tcu2 lv_tcu_cod_vld tcu_lih_can lv_ac1_can_vld lv_acin_can lv_accin_on_can acp_can tq_acc_can lv_ac_sw_can ecf_req_ac_can lv_ecf_req_ac_can_err state_ich lv_req_heat_can lv_st_req_can lv_eilu_can_vld lv_igk_can lv_toil_max_can tqi_int_fb_tcu_intv lv_frs_err_can lv_frs_can vs_icl1 lv_vs_icl1_vld lv_icl2_can_vld lv_tam_err_can tam_fil_can tam_can lv_icl3_can_vld t_last_dc_can ctr_km_can lv_icl1_can_vld lv_frs_wal_can lv_gll_fb_can ftl_can lv_tog_act lv_tog_pres lv_tcs1_can_vld lv_asr_req lv_msr_req lv_abs_req lv_esp_req lv_bls_tcs lv_bkv_state_can lv_rr_can lv_rr_err_can lv_esp_err_can lv_bkv_can vs_tcs1 state_vs_tcs1 tqi_asr_req_slow_can tqi_asr_req_slow tqi_asr_req_fast_can tqi_asr_req_fast tqi_msr_req_can tqi_msr_req tcs1_msg_ctr lv_sub_vs_tcs1 lv_err_ctr_msg_tcs1 lv_tcs2_can_vld ac_trv_tcs2 lv_ac_trv_tcs2_act lv_tcs3_can_vld can_wheel_fn_ri can_wheel_fn_le can_wheel_re_ri can_wheel_re_le lv_err_cks_tcs4_can_diag state_thd_dep dep_abs lv_tcs4_can_vld lv_err_ctr_msg_tcs4 lv_var_bsup_ext_save lv_err_cks_tcs4_can lv_tcs8_can_vld lv_err_ctr_msg_tcs8 lv_err_cks_tcs8_can lv_dcc_tcs_req_can lv_brake_temp_max_can lv_dcc_msg_not_ok lv_dece_ctl_ems_err_can lv_err_cks_tcs8_can_diag ac_lgt_tcs8_can lv_tog1_can_vld tog1_msg_ctr t_oil_level1_can t_oil_level2_can t_oil_level3_can t_oil_level4_can t_toil_can lv_tog_err_can lv_oil_level_ofs_warn lv_oil_level_tol_warn lv_oil_level_max_warn lv_oil_level_max_tol_warn lv_oil_level_up_warn lv_err_ctr_msg_tog1 lv_vecu1_can_vld lv_acc_off_can_vecu1 lv_n_sp_is_add_can_2 lv_ecfpwm_max_vecu lv_igk_vecu_can lv_igk_mot_vecu_can lv_n_sp_is_add_can_1 lv_bat_off_can lv_airb1_can_vld lv_crash_can lv_err_ctr_msg_airb1 crash_state_airb1 lv_err_cks_airb1_diag lv_err_cks_airb1 /end OUT_MEASUREMENT
/end FUNCTION
/begin FUNCTION SYS_Coolant_Temp_Setpoint ""
 /begin DEF_CHARACTERISTIC lc_use_cool_req_tcu_can lc_use_tia_tco_sp c_tco_sp_tcu_sub c_tco_min_hvr_sub c_tco_max_hvr_sub c_tco_sp_sub c_crlc_tco_sp_down c_crlc_tco_sp_up ldp_n_32__tco_sp ldp_tqi_req_tra__tco_sp ip_tco_sp_1 ldp_iga_mv_knk__tco_sp ip_tco_sp_knk ldp_vs__tco_sp ldp_tia_tam__tco_sp ip_tco_sp_2 ldp_cool_req_tcu_can__tco_sp ip_tco_sp_tcu ldp_toil__tco_sp ip_tco_sp_toil ldpm_v_hvr__tco_hvr ip_tco_min_hvr ip_tco_max_hvr c_tco_sub_tco_dif /end DEF_CHARACTERISTIC
 /begin OUT_MEASUREMENT tco_sp tco_sp_1 tco_sp_2 tco_sp_knk tco_sp_tcu tco_sp_toil tco_sp_min_hvr tco_sp_max_hvr tco_sp_inter tco_sp_raw tco_sp_clc tco_dif tco_1_2 lv_ect_act /end OUT_MEASUREMENT
/end FUNCTION
/begin FUNCTION SYS_Ambient_Air_Temperature "" /begin DEF_CHARACTERISTIC c_tam_sub lc_tam_can_use /end DEF_CHARACTERISTIC /begin OUT_MEASUREMENT tam /end OUT_MEASUREMENT /end FUNCTION
/begin FUNCTION SYS_AN_LIM_C "Engine Speed Limit Coordination" /begin DEF_CHARACTERISTIC c_n_max c_n_max_mt c_n_max_mon c_n_max_tqi c_n_max_etc /end DEF_CHARACTERISTIC /begin OUT_MEASUREMENT n_max_thd /end OUT_MEASUREMENT /end FUNCTION
/begin FUNCTION SYS_AMAP "Manifold Air Pressure Variables"
 /begin DEF_CHARACTERISTIC ip_map_mes__v_map ldp_v_map_ip_map_mes c_map_sub_diag c_fac_map_fil /end DEF_CHARACTERISTIC
 /begin OUT_MEASUREMENT map_mes map map_mmv /end OUT_MEASUREMENT
/end FUNCTION
/begin FUNCTION SYS_ATBA "Charge Air Temperature Acquisition" /begin DEF_CHARACTERISTIC c_tba_sub_diag ip_tba_mes__v_tba ldp_v_tba_ip_tba_mes /end DEF_CHARACTERISTIC /begin OUT_MEASUREMENT tba v_tba tba_mes /end OUT_MEASUREMENT /end FUNCTION
/begin FUNCTION SYS_ATIMER "Engine Runtime and time after key on calculation" /begin OUT_MEASUREMENT trt t_on_ecu /end OUT_MEASUREMENT /end FUNCTION
/begin FUNCTION SYS_Oil_Temp "Oil Sensor Variables"
 /begin DEF_CHARACTERISTIC c_toil_grd_max_diag c_toil_sub_crlc c_tco_swi_cwp_toil c_tco_swi_toil_mdl_h c_toil_sub_h_crlc ip_toil_crlc_ofs__t_ast ldp_t_ast__toil_crlc_ofs ip_toil_ofs__toil_mdl_grd__n_32 ldp_toil_mdl_grd_toil_add_ofs ldpm_n_32_toil_sub ip_crlc_toil_mdl_3__n_32 ip_crlc_toil_mdl_2__tco ldp_tco_crlc_toil_mdl_2 ip_crlc_toil_mdl_1__vs__tia ldp_vs_crlc_toil_mdl_1 ldp_tia_crlc_toil_mdl_1 ip_crlc_toil_mdl_4__t_ast__tco ldp_t_ast_crlc_toil_mdl_4 ldp_tco_crlc_toil_mdl_4 ip_toil_sub__n_32__maf ldp_maf_toil_sub lc_var_toil_sens ldp_v_toil_10__toil ip_toil__v_toil c_toil_grd_max /end DEF_CHARACTERISTIC
 /begin OUT_MEASUREMENT toil toil_max toil_sens /end OUT_MEASUREMENT
/end FUNCTION
/begin FUNCTION SYS_CAN_Messages_EMS__AI ""
 /begin OUT_MEASUREMENT lv_if_cft_1_can_vld lv_stb_ack lv_trl_msg_ood_can lv_lamp_re_msg_ood_can lv_brake_lamp_le_err_can lv_brake_lamp_ri_err_can lv_brake_lamp_mid_err_can lv_trl_act_can lv_brake_lamp_trl_err_can lv_state_ctl_dece_err_can lv_state_ctl_dece_trlcu_err_can brake_lamp_msg_ctr lv_err_ctr_msg_brake_lamp trlcu_msg_ctr lv_err_ctr_msg_trlcu lv_ich_conf_can /end OUT_MEASUREMENT
/end FUNCTION
/begin FUNCTION SYS_AER "Engine Roughness Calculation"
 /begin DEF_CHARACTERISTIC c_crk_dif_max_er c_n_seg_t_ad_max_er c_n_seg_t_ad_min_er c_seg_t_ad_cor_drv1_max_er c_seg_t_ad_crlc_er c_seg_t_fast_ad_crlc_er c_t_seg_ad_dly ip_crlc_drv2_er_mt ip_fac_drv2_er_at ip_fac_drv2_er_mt ip_crlc_drv2_er_at /end DEF_CHARACTERISTIC
 /begin OUT_MEASUREMENT drv0_er drv2_mmv_er er[0] er[1] er[2] er_av er_rr lv_seg_ad_act_state lv_seg_ad_lim seg_ad_mmv[0] seg_ad_mmv[1] seg_ad_mmv[2] seg_nr_er seg_t_cor seg_t_cor_buf[0] seg_t_cor_buf[1] seg_t_cor_buf[2] seg_t_cor_buf[3] seg_t_cor_buf[4] seg_t_cor_buf[5] drv1_er /end OUT_MEASUREMENT
/end FUNCTION
/begin FUNCTION SYS_AERINCI "Application Incidences for Engine Roughness" /begin OUT_MEASUREMENT iv_off_er lv_inh_seg_ad lv_seg_ad_fdout /end OUT_MEASUREMENT /end FUNCTION
/begin FUNCTION SYS_AMAF "Mass Airflow Variables"
 /begin DEF_CHARACTERISTIC c_ctr_maf_kgh_puls c_n_32_max_puls c_maf_kgh_grd_max_puls c_maf_kgh_puls_hys c_thrpwm_max_puls c_t_thrpwm_max_puls ip_maf_kgh_puls_max__n_32 ldp_n_32_ip_maf_kgh_puls_max c_fac_maf_fil ip_fac_maf__n_32 ldp_n_32_ip_fac_maf lc_maf_frq /end DEF_CHARACTERISTIC
 /begin OUT_MEASUREMENT maf maf_kgh maf_kgh_mes maf_mmv v_maf v_maf_x v_maf_y lv_maf_0_puls maf_0 maf_0_kgh maf_0_kgh_grd maf_0_kgh_mes maf_0_kgh_puls maf_0_kgh_sub maf_0_mmv /end OUT_MEASUREMENT
/end FUNCTION
/begin FUNCTION SYS_ATAC "Exhaust Gas Temperature Coordination TAC" /begin DEF_CHARACTERISTIC c_tac_sub_diag ldp_tac_bas_ip_tac_mes ip_tac_mes__tac_bas /end DEF_CHARACTERISTIC /begin OUT_MEASUREMENT tac_mes v_tac tac /end OUT_MEASUREMENT /end FUNCTION
/begin FUNCTION SYS_ATIA "Intake Air Temperature" /begin OUT_MEASUREMENT tia /end OUT_MEASUREMENT /end FUNCTION
/begin FUNCTION SYS_ATOILINCI "Oil Temperature Acquisition" /begin OUT_MEASUREMENT v_toil /end OUT_MEASUREMENT /end FUNCTION
/begin FUNCTION C_4_SYS_VAR ""
 /begin SUB_FUNCTION SYS_VAR_ACS SYS_VAR_ABRAKE SYS_VAR_ATCO_SUB SYS_VAR_TCO SYS_VAR_IS SYS_VAR_IS_COR SYS_VAR_NIS SYS_VAR_AACP SYS_VAR_TIA SYS_VAR_APVS VAR_APPSCLC SYS_VAR_AALT SYS_VAR_BPAAQ SYS_VAR_EGRVAQ SYS_VAR_THRAQ SYS_VAR_AN SYS_VAR_AN_IS_SP SYS_VAR_AN_IS_SP_I SYS_VAR_ATEGPC VAR_ADIP_PF /end SUB_FUNCTION
/end FUNCTION
/begin FUNCTION SYS_VAR_ACS "" /begin DEF_CHARACTERISTIC c_vs_cs c_t_max_cs_fil lc_conf_cs c_cs_sub_diag /end DEF_CHARACTERISTIC /begin OUT_MEASUREMENT lv_cs lv_get_cs lv_cs_raw lv_cs_fil t_cs_fil sf_clu /end OUT_MEASUREMENT /end FUNCTION
/begin FUNCTION SYS_VAR_ABRAKE "" /begin DEF_CHARACTERISTIC lc_bts_det_on lc_bls_can /end DEF_CHARACTERISTIC /begin OUT_MEASUREMENT lv_bls lv_get_bls lv_get_bts lv_bts /end OUT_MEASUREMENT /end FUNCTION
/begin FUNCTION SYS_VAR_ATCO_SUB "" /begin DEF_CHARACTERISTIC c_tco_sub_ini c_tco_sub_grd c_tco_sub_tol c_tco_2_dif_sub /end DEF_CHARACTERISTIC /begin OUT_MEASUREMENT tco_sub tco_1_sub tco_2_sub /end OUT_MEASUREMENT /end FUNCTION
/begin FUNCTION SYS_VAR_TCO ""
 /begin DEF_CHARACTERISTIC c_tco_grd_max ip_tco_1_mes__v_tco_1 ip_tco_2_mes__v_tco_2 ldpm_v_tco__ip_tco_1_mes ldpm_v_tco__ip_tco_2_mes /end DEF_CHARACTERISTIC
 /begin OUT_MEASUREMENT tco tco_mes tco_st tco_1 tco_2 tco_1_mes tco_2_mes v_tco_1 v_tco_2 /end OUT_MEASUREMENT
/end FUNCTION
/begin FUNCTION SYS_VAR_IS "" /end FUNCTION
/begin FUNCTION SYS_VAR_IS_COR "" /begin DEF_CHARACTERISTIC c_n_sp_is_add_acin c_n_sp_is_min_heat c_n_sp_is_min /end DEF_CHARACTERISTIC /begin OUT_MEASUREMENT n_sp_is_add_comp lv_req_n_sp_is_min n_sp_is_min /end OUT_MEASUREMENT /end FUNCTION
/begin FUNCTION SYS_VAR_NIS "" /end FUNCTION
/begin FUNCTION SYS_VAR_AACP ""
 /begin DEF_CHARACTERISTIC lc_tq_acc_can_use ip_acp_mes__ducy_acp_pwm ldp_ducy_acp_pwm_ip_acp_mes c_acp_sub_diag /end DEF_CHARACTERISTIC
 /begin OUT_MEASUREMENT ducy_acp_pwm acp acp_mes tq_loss_acc_inp lv_acp_orng lv_tq_loss_acc_inp_orng /end OUT_MEASUREMENT
/end FUNCTION
/begin FUNCTION SYS_VAR_TIA "" /begin DEF_CHARACTERISTIC lc_tia_sub_mdl /end DEF_CHARACTERISTIC /end FUNCTION
/begin FUNCTION SYS_VAR_APVS "Determination of accelerator pedal value (PVS)"
 /begin DEF_CHARACTERISTIC c_v_pvs_hys_fil c_v_pvs_thd_is_l_1 c_v_pvs_sp_fl_1 c_v_pvs_thd_is_h_1 c_v_pvs_thd_is_l_2 c_v_pvs_thd_is_h_2 c_v_pvs_sp_fl_2 c_v_pvs_thd_kd_1 c_v_pvs_thd_kd_2 c_ctr_max_pvs_is_rng_h c_ctr_max_pvs_is_rng_l c_pv_grd_lih_max c_pv_lih_max c_pvs_bls_bts_plaus_lgrd_neg c_pvs_bls_bts_plaus_lgrd_pos c_v_pvs_sp_max_1 c_v_pvs_sp_max_2 c_v_pvs_thd_grd_1 c_v_pvs_thd_grd_2 /end DEF_CHARACTERISTIC
 /begin OUT_MEASUREMENT pv_av lv_kd pv_av_1 pv_av_2 lv_pvs_kd v_pvs_fil_1 v_pvs_fil_2 pv_av_grd pv_av_sel /end OUT_MEASUREMENT
/end FUNCTION
/end MODULE
/end PROJECT
