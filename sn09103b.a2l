/* -------------------------------------------------------------------------
E T A S
Data Declaration System (DDS)
- ASAP2 export -
DDS-Version 2.3.0
Component-Version Build<000026.02> 2001/11/02 11:17:13
CreationDate 04 Aug 2003, 18:43:14
Project SN0
Number PRJ_NUM
Structure 910
Serial Nr. 0
Option Project (DataBase) D:\p\sn0\910_pis\mc1_u\tmp\db
Option Verbose false
Option ASAP2File D:\p\sn0\910_pis\mc1_u\out\cal\sn09103b.a2l
Option IgnoreAddressCheck false
Option ASAP2Version 1.41
Option ExportSoftwareGrouping false
Option ExportComponentGrouping false
Option SuppressFunctionGrouping false
Option SuppressAxisFunctionGrouping false
Option ExportDisplayIdentifier <2>
Option ExportLongIdentifier <0>
Option ExportAnnotation false
Option PartialExportViaFunction
Option MemoryRegionAutoAssignment <0>
Option ExportReference2MemorySegment false
Option AddressOffset <0>
Option IfDataSetList 'ETK_P2'
Option IfDataOutputFormat <0>
Option CalibrationMethodList
Option SuppressEcuAddress false
Option SuppressFloat false
Option SuppressVariantCoding false
Option DontSplitVarCodedStructs false
Option OnlineOnly false
Option ExportHiddenData false
Option Map2PointLinearConv2RatFunc true
Option NonLinearConvMode <0>
Option MapVTabRange2VTab true
Option MaxCompuTabValuePairs <256>
Option DefaultFormat4VerbalConvers...
Option WriteEscapeCharacters false
Option AllowASAP1_3IdentsAlso4NonI... false
Option IgnorePartialIdentLengthCheck true
Option A2MLIncludeMode <0>
------------------------------------------------------------------------- */
ASAP2_VERSION 1 41
/begin PROJECT SN0 "SIMOS PPD"
/begin HEADER "_default_HeaderComment" PROJECT_NO PRJ_NUM /end HEADER
/begin MODULE _default_ModuleName "_default_ModuleLongIdentifier"
/begin MOD_PAR "_default_ModParComment" ADDR_EPK 0x840008 EPK "SN09100"
 /begin MEMORY_SEGMENT _RAM "" VARIABLES RAM EXTERN 0x187d000 0x3000 -1 -1 -1 -1 -1 /begin IF_DATA ETK DP_BLOB 0x187d000 0x3000 /end IF_DATA /end MEMORY_SEGMENT
 /begin MEMORY_SEGMENT _ROM "" DATA FLASH EXTERN 0x840000 0x3d000 -1 -1 -1 -1 -1 /begin IF_DATA ETK DP_BLOB 0x840000 0x3d000 /end IF_DATA /end MEMORY_SEGMENT
 /begin MEMORY_SEGMENT _INT_RAM "" VARIABLES RAM INTERN 0x7f8000 0x8000 -1 -1 -1 -1 -1 /begin IF_DATA ETK DP_BLOB 0x7f8000 0x8000 /end IF_DATA /end MEMORY_SEGMENT
 /begin MEMORY_SEGMENT _INT_RAM_BIT "" VARIABLES RAM INTERN 0x7f8000 0x8000 -1 -1 -1 -1 -1 /begin IF_DATA ETK DP_BLOB 0x7f8000 0x8000 /end IF_DATA /end MEMORY_SEGMENT
 /begin MEMORY_SEGMENT _ECU_CODE1 "" CODE FLASH EXTERN 0x280000 0x180000 -1 -1 -1 -1 -1 /begin IF_DATA ETK DP_BLOB 0x280000 0x180000 /end IF_DATA /end MEMORY_SEGMENT
 /begin MEMORY_SEGMENT _ROM_CAL_AS "" CODE FLASH EXTERN 0x87d000 0x3000 -1 -1 -1 -1 -1 /begin IF_DATA ETK DP_BLOB 0x87d000 0x3000 /end IF_DATA /end MEMORY_SEGMENT
/end MOD_PAR
/begin MOD_COMMON "_default_ModCommonComment" DEPOSIT ABSOLUTE BYTE_ORDER MSB_FIRST ALIGNMENT_BYTE 1 ALIGNMENT_WORD 2 ALIGNMENT_LONG 4 ALIGNMENT_FLOAT32_IEEE 4 ALIGNMENT_FLOAT64_IEEE 8 /end MOD_COMMON
/begin IF_DATA ETK
 /begin SOURCE "Segment Synchronous" 103 1 QP_BLOB 1 0x3c 0x840200 0x187e180 0x187e140 0 0x0 0x0 /end SOURCE
 /begin SOURCE "Time Synchronous Cylinder 10ms" 4 1 QP_BLOB 2 0x5c 0x8402f8 0x187e1bc 0x187e142 10 0x0 0x0 /end SOURCE
 /begin SOURCE "Time Synchronous Cylinder 100ms" 5 1 QP_BLOB 3 0x5c 0x840470 0x187e218 0x187e144 100 0x0 0x0 /end SOURCE
 /begin SOURCE "Bypass Segment Synchronous" 103 1 QP_BLOB 4 0x30 0x8405e8 0x187e274 0x187e146 0 0x10 0x840778 /end SOURCE
 /begin SOURCE "Bypass Time Synchronous" 4 1 QP_BLOB 5 0x30 0x8406b0 0x187e2a4 0x187e148 10 0x20 0x8407a0 /end SOURCE
 /begin TP_BLOB 0x01000001 0x0 0x00000800
  /begin DISTAB_CFG 0xD 0x0111 0x1 0x0187E100 0x1010100 TRG_MOD 0x0 0xB7 0x0 0x0 0x0 /end DISTAB_CFG
  CODE_CHK 0x0 0x0 0x0 0x0 ETK_CFG 0x02 0xE2 0x4E 0xDF 0xEF 0x4E 0xDF 0xEF 0x4E 0xCF 0xFB 0xFE 0xFF 0xFF 0xFB 0xFF 0xFF 0xFF 0xFF 0xFF 0x03 0xFF 0x01 0xFF RESERVED 0x840200 0x0600 EXTERN -1 -1 -1 -1 -1 /end TP_BLOB
/end IF_DATA
/begin MEASUREMENT cyl_id_sam_trig "" UBYTE _CNV_A_R_ZYL_ID_2_CM 1 0. 1. 6. DISPLAY_IDENTIFIER CYL_ID_SAM_TRIG ECU_ADDRESS 0x7fc2e4 FORMAT "%0.0" /end MEASUREMENT
/begin MEASUREMENT lv_mil "" UBYTE _CNV_S_2_RANGE______3_CM 1 0. 0. 1. DISPLAY_IDENTIFIER LV_MIL ECU_ADDRESS 0x7fc03a /end MEASUREMENT
/begin MEASUREMENT ar_egrv_pctl_the_bas "" UWORD _CNV_A_R_LINEAR_____7_CM 1 0. 0. 78.08 DISPLAY_IDENTIFIER AR_EGRV_PCTL_THE_BAS ECU_ADDRESS 0x7fc918 BYTE_ORDER MSB_LAST FORMAT "%5.3" /end MEASUREMENT
/begin MEASUREMENT maf_rel "" UWORD _CNV_A_R_LINEAR_____8_CM 1 0. 0. 99.99847412109381 DISPLAY_IDENTIFIER MAF_REL ECU_ADDRESS 0x7fa7b6 BYTE_ORDER MSB_LAST FORMAT "%6.4" /end MEASUREMENT
/begin MEASUREMENT maf_rel_sp "" UWORD _CNV_A_R_LINEAR_____8_CM 1 0. 0. 99.99847412109381 DISPLAY_IDENTIFIER MAF_REL_SP ECU_ADDRESS 0x7fa7b8 BYTE_ORDER MSB_LAST FORMAT "%6.4" /end MEASUREMENT
/begin MEASUREMENT bpapwm_dyn "" SWORD _CNV_A_R_LINEAR_____9_CM 1 0. -100. 99.99695 DISPLAY_IDENTIFIER BPAPWM_DYN ECU_ADDRESS 0x7fa68a BYTE_ORDER MSB_LAST FORMAT "%7.2" /end MEASUREMENT
/begin MEASUREMENT map_sp_lim_grd "" SWORD _CNV_A_R_LINEAR_____10_CM 1 0. -2717.041459 2716.958541 DISPLAY_IDENTIFIER MAP_SP_LIM_GRD ECU_ADDRESS 0x7fa6ac BYTE_ORDER MSB_LAST FORMAT "%7.3" /end MEASUREMENT
/begin MEASUREMENT lv_dir_v_hbr[0] "" UBYTE _CNV_S_2_RANGE______11_CM 1 0. 0. 1. DISPLAY_IDENTIFIER LV_DIR_V_HBR_0_ ECU_ADDRESS 0x7fba5a /end MEASUREMENT
/begin MEASUREMENT lv_dir_v_hbr[1] "" UBYTE _CNV_S_2_RANGE______11_CM 1 0. 0. 1. DISPLAY_IDENTIFIER LV_DIR_V_HBR_1_ ECU_ADDRESS 0x7fba5b /end MEASUREMENT
/begin MEASUREMENT abs_hbr_pwm[0] "" UWORD _CNV_A_R_LINEAR_____8_CM 1 0. 0. 99.99847412109381 DISPLAY_IDENTIFIER ABS_HBR_PWM_0_ ECU_ADDRESS 0x7f98b4 BYTE_ORDER MSB_LAST FORMAT "%5.3" /end MEASUREMENT
/begin MEASUREMENT abs_hbr_pwm[1] "" UWORD _CNV_A_R_LINEAR_____8_CM 1 0. 0. 99.99847412109381 DISPLAY_IDENTIFIER ABS_HBR_PWM_1_ ECU_ADDRESS 0x7f98b6 BYTE_ORDER MSB_LAST FORMAT "%5.3" /end MEASUREMENT
/begin MEASUREMENT dir_hbr[0] "" UBYTE _CNV_S_2_RANGE______11_CM 1 0. 0. 1. DISPLAY_IDENTIFIER DIR_HBR_0_ ECU_ADDRESS 0x7fb497 /end MEASUREMENT
/begin MEASUREMENT dir_hbr[1] "" UBYTE _CNV_S_2_RANGE______11_CM 1 0. 0. 1. DISPLAY_IDENTIFIER DIR_HBR_1_ ECU_ADDRESS 0x7fb498 /end MEASUREMENT
/begin MEASUREMENT inp_hbr[0] "" SWORD _CNV_A_R_LINEAR_____12_CM 1 0. -100. 99.996948242 DISPLAY_IDENTIFIER INP_HBR_0_ ECU_ADDRESS 0x7f98b8 BYTE_ORDER MSB_LAST FORMAT "%7.3" /end MEASUREMENT
/begin MEASUREMENT inp_hbr[1] "" SWORD _CNV_A_R_LINEAR_____12_CM 1 0. -100. 99.996948242 DISPLAY_IDENTIFIER INP_HBR_1_ ECU_ADDRESS 0x7f98ba BYTE_ORDER MSB_LAST FORMAT "%7.3" /end MEASUREMENT
/begin MEASUREMENT fac_cor_hbr[0] "" UWORD _CNV_A_R_LINEAR_____13_CM 1 0. 0. 15.999755 DISPLAY_IDENTIFIER FAC_COR_HBR_0_ ECU_ADDRESS 0x7f98bc BYTE_ORDER MSB_LAST FORMAT "%6.5" /end MEASUREMENT
/begin MEASUREMENT fac_cor_hbr[1] "" UWORD _CNV_A_R_LINEAR_____13_CM 1 0. 0. 15.999755 DISPLAY_IDENTIFIER FAC_COR_HBR_1_ ECU_ADDRESS 0x7f98be BYTE_ORDER MSB_LAST FORMAT "%6.5" /end MEASUREMENT
/begin MEASUREMENT ar_egrv_pctl_the "" UWORD _CNV_A_R_LINEAR_____7_CM 1 0. 0. 78.08 DISPLAY_IDENTIFIER AR_EGRV_PCTL_THE ECU_ADDRESS 0x7fc916 BYTE_ORDER MSB_LAST FORMAT "%5.3" /end MEASUREMENT
/begin MEASUREMENT pq_egrv_sp "" UWORD _CNV_A_R_LINEAR_____15_CM 1 0. 0. 3.99993896484375 DISPLAY_IDENTIFIER PQ_EGRV_SP ECU_ADDRESS 0x7fc91a BYTE_ORDER MSB_LAST FORMAT "%5.4" /end MEASUREMENT
/begin MEASUREMENT abs_hbr_pwm_tmp[0] "" SWORD _CNV_A_R_LINEAR_____12_CM 1 0. -100. 99.996948242 DISPLAY_IDENTIFIER ABS_HBR_PWM_TMP_0_ ECU_ADDRESS 0x7f98b0 BYTE_ORDER MSB_LAST FORMAT "%7.3" /end MEASUREMENT
/begin MEASUREMENT abs_hbr_pwm_tmp[1] "" SWORD _CNV_A_R_LINEAR_____12_CM 1 0. -100. 99.996948242 DISPLAY_IDENTIFIER ABS_HBR_PWM_TMP_1_ ECU_ADDRESS 0x7f98b2 BYTE_ORDER MSB_LAST FORMAT "%7.3" /end MEASUREMENT
/begin MEASUREMENT ctr_err_dyn_nr "" UBYTE _CNV_A_R_LINEAR_____0_CM 1 0. 0. 255. DISPLAY_IDENTIFIER FMY_CTR_ERR_DYN_NR ECU_ADDRESS 0x7fbe64 FORMAT "%3.0" /end MEASUREMENT
/begin MEASUREMENT ctr_err_his_nr "" UBYTE _CNV_A_R_LINEAR_____0_CM 1 0. 0. 255. DISPLAY_IDENTIFIER FMY_CTR_ERR_HIS_NR ECU_ADDRESS 0x7fc038 FORMAT "%3.0" /end MEASUREMENT
/begin MEASUREMENT fmy_ram_dyn[0].dtc_cod "" UWORD _CNV_A_R_LINEAR_____0_CM 1 0. 0. 65535. DISPLAY_IDENTIFIER FMY_0_DTC_COD ECU_ADDRESS 0x7fbdd8 BYTE_ORDER MSB_LAST FORMAT "%6.0" /end MEASUREMENT
/begin MEASUREMENT fmy_ram_dyn[0].ctr_frc "Frequency counter of failure N" UBYTE _CNV_A_R_LINEAR_____0_CM 1 0. 0. 255. DISPLAY_IDENTIFIER FMY_0_CTR_FRC ECU_ADDRESS 0x7fbdde FORMAT "%3.0" /end MEASUREMENT
/begin MEASUREMENT fmy_ram_dyn[0].ctr_wup_cyc "Counter for warm-up cycle" UBYTE _CNV_A_R_LINEAR_____0_CM 1 0. 0. 255. DISPLAY_IDENTIFIER FMY_0_CTR_WUP_CYC ECU_ADDRESS 0x7fbddf FORMAT "%3.0" /end MEASUREMENT
/begin MEASUREMENT fmy_ram_dyn[0].ctr_dc "Counter for driving cycle" UBYTE _CNV_A_R_LINEAR_____0_CM 1 0. 0. 255. DISPLAY_IDENTIFIER FMY_0_CTR_DC ECU_ADDRESS 0x7fbde0 FORMAT "%3.0" /end MEASUREMENT
/begin MEASUREMENT fmy_ram_dyn[0].diag_inst "" UWORD _CNV_S_173_CONV_DIAG__26_CM 1 0. 0. 172. DISPLAY_IDENTIFIER FMY_0_DIAG_INST ECU_ADDRESS 0x7fbdda BYTE_ORDER MSB_LAST /end MEASUREMENT
/begin MEASUREMENT fmy_ram_dyn[0].idx_frf "" UBYTE _CNV_A_R_ZYL_ID_2_CM 1 0. 1. 256. DISPLAY_IDENTIFIER FMY_0_IDX_FRF ECU_ADDRESS 0x7fbde1 FORMAT "%3.0" /end MEASUREMENT
/begin MEASUREMENT fmy_ram_dyn[0].err_info_dyn.lv_err_mkd "" UWORD _CNV_S_2_RANGE______11_CM 1 0. 0. 1. DISPLAY_IDENTIFIER FMY_0_LV_ERR_MKD ECU_ADDRESS 0x7fbddc BYTE_ORDER MSB_LAST BIT_MASK 0x200 /end MEASUREMENT
/begin MEASUREMENT fmy_ram_dyn[0].err_info_dyn.lv_dc_max "" UWORD _CNV_S_2_RANGE______11_CM 1 0. 0. 1. DISPLAY_IDENTIFIER FMY_0_LV_DC_MAX ECU_ADDRESS 0x7fbddc BYTE_ORDER MSB_LAST BIT_MASK 0x100 /end MEASUREMENT
/begin MEASUREMENT fmy_ram_dyn[0].err_info_dyn.lv_err_disa "" UWORD _CNV_S_2_RANGE______11_CM 1 0. 0. 1. DISPLAY_IDENTIFIER FMY_0_LV_ERR_DISA ECU_ADDRESS 0x7fbddc BYTE_ORDER MSB_LAST BIT_MASK 0x80 /end MEASUREMENT
/begin MEASUREMENT fmy_ram_dyn[0].err_info_dyn.lv_err_cfm "" UWORD _CNV_S_2_RANGE______11_CM 1 0. 0. 1. DISPLAY_IDENTIFIER FMY_0_LV_ERR_CFM ECU_ADDRESS 0x7fbddc BYTE_ORDER MSB_LAST BIT_MASK 0x40 /end MEASUREMENT
/begin MEASUREMENT fmy_ram_dyn[0].err_info_dyn.lv_err_tmp "" UWORD _CNV_S_2_RANGE______11_CM 1 0. 0. 1. DISPLAY_IDENTIFIER FMY_0_LV_ERR_TMP ECU_ADDRESS 0x7fbddc BYTE_ORDER MSB_LAST BIT_MASK 0x20 /end MEASUREMENT
/begin MEASUREMENT fmy_ram_dyn[0].err_info_dyn.lv_err_dc "" UWORD _CNV_S_2_RANGE______11_CM 1 0. 0. 1. DISPLAY_IDENTIFIER FMY_0_LV_ERR_DC ECU_ADDRESS 0x7fbddc BYTE_ORDER MSB_LAST BIT_MASK 0x10 /end MEASUREMENT
/begin MEASUREMENT fmy_ram_dyn[0].err_info_dyn.err_sym_mem "" UWORD _CNV_S_6_CONV_ERRM__27_CM 1 0. 0. 15. DISPLAY_IDENTIFIER FMY_0_ERR_SYM_MEM ECU_ADDRESS 0x7fbddc BYTE_ORDER MSB_LAST BIT_MASK 0xF /end MEASUREMENT
/begin MEASUREMENT fmy_ram_dyn[0].err_info_dyn.err_sym_lst "" UWORD _CNV_S_6_CONV_ERRM__27_CM 1 0. 0. 15. DISPLAY_IDENTIFIER FMY_0_ERR_SYM_LST ECU_ADDRESS 0x7fbddc BYTE_ORDER MSB_LAST BIT_MASK 0x7800 /end MEASUREMENT
/begin MEASUREMENT fmy_ram_dyn[0].err_info_dyn.lv_err_pnd "" UWORD _CNV_S_2_RANGE______11_CM 1 0. 0. 1. DISPLAY_IDENTIFIER FMY_0_LV_ERR_PND ECU_ADDRESS 0x7fbddc BYTE_ORDER MSB_LAST BIT_MASK 0x400 /end MEASUREMENT
/begin MEASUREMENT fmy_ram_dyn[0].err_info_dyn.lv_cdn_diag_dc "This flag permits to detect that diag conditions have been met during drinving cycle." UWORD _CNV_S_2_RANGE______11_CM 1 0. 0. 1. DISPLAY_IDENTIFIER FMY_0_LV_CDN_DIAG_DC ECU_ADDRESS 0x7fbddc BYTE_ORDER MSB_LAST BIT_MASK 0x8000 /end MEASUREMENT
/begin MEASUREMENT fmy_ram_dyn[0].ctr_dc_err_det "Number of driving cycles since DTC detection" UBYTE _CNV_A_R_LINEAR_____1_CM 1 0. 0. 255. DISPLAY_IDENTIFIER FMY_0_CTR_DC_ERR_DET ECU_ADDRESS 0x7fbde2 FORMAT "%3.0" /end MEASUREMENT
/begin MEASUREMENT fmy_ram_dyn[0].ctr_dc_err_det_diag_cdn "Number of driving cycles since DTC detection with diag started within these driving cycle." UBYTE _CNV_A_R_LINEAR_____1_CM 1 0. 0. 255. DISPLAY_IDENTIFIER FMY_0_CTR_DC_ERR_DET_DIAG_CDN ECU_ADDRESS 0x7fbde3 FORMAT "%3.0" /end MEASUREMENT
/begin MEASUREMENT fmy_ram_dyn[0].ctr_dc_err_det_diag_cmpl "Number of driving cycles since DTC detection with diag completed during these driving cycles." UBYTE _CNV_A_R_LINEAR_____1_CM 1 0. 0. 255. DISPLAY_IDENTIFIER FMY_0_CTR_DC_ERR_DET_DIAG_CMPL ECU_ADDRESS 0x7fbde4 FORMAT "%3.0" /end MEASUREMENT
/begin MEASUREMENT fmy_ram_dyn[0].ctr_wup_act_mil "Number of warm-up cycles +1 since MIL activation for this failure" UBYTE _CNV_A_R_LINEAR_____1_CM 1 0. 0. 255. DISPLAY_IDENTIFIER FMY_0_CTR_WUP_ACT_MIL ECU_ADDRESS 0x7fbde5 FORMAT "%3.0" /end MEASUREMENT
/begin MEASUREMENT fmy_ram_dyn[1].dtc_cod "" UWORD _CNV_A_R_LINEAR_____0_CM 1 0. 0. 65535. DISPLAY_IDENTIFIER FMY_1_DTC_COD ECU_ADDRESS 0x7fbde6 BYTE_ORDER MSB_LAST FORMAT "%6.0" /end MEASUREMENT
/begin MEASUREMENT fmy_ram_dyn[1].ctr_frc "Frequency counter of failure N" UBYTE _CNV_A_R_LINEAR_____0_CM 1 0. 0. 255. DISPLAY_IDENTIFIER FMY_1_CTR_FRC ECU_ADDRESS 0x7fbdec FORMAT "%3.0" /end MEASUREMENT
/begin MEASUREMENT fmy_ram_dyn[1].ctr_wup_cyc "Counter for warm-up cycle" UBYTE _CNV_A_R_LINEAR_____0_CM 1 0. 0. 255. DISPLAY_IDENTIFIER FMY_1_CTR_WUP_CYC ECU_ADDRESS 0x7fbded FORMAT "%3.0" /end MEASUREMENT
/begin MEASUREMENT fmy_ram_dyn[1].ctr_dc "Counter for driving cycle" UBYTE _CNV_A_R_LINEAR_____0_CM 1 0. 0. 255. DISPLAY_IDENTIFIER FMY_1_CTR_DC ECU_ADDRESS 0x7fbdee FORMAT "%3.0" /end MEASUREMENT
/begin MEASUREMENT fmy_ram_dyn[1].diag_inst "" UWORD _CNV_S_173_CONV_DIAG__26_CM 1 0. 0. 172. DISPLAY_IDENTIFIER FMY_1_DIAG_INST ECU_ADDRESS 0x7fbde8 BYTE_ORDER MSB_LAST /end MEASUREMENT
/begin MEASUREMENT fmy_ram_dyn[1].idx_frf "" UBYTE _CNV_A_R_ZYL_ID_2_CM 1 0. 1. 256. DISPLAY_IDENTIFIER FMY_1_IDX_FRF ECU_ADDRESS 0x7fbdef FORMAT "%3.0" /end MEASUREMENT
/begin MEASUREMENT fmy_ram_dyn[1].err_info_dyn.lv_err_mkd "" UWORD _CNV_S_2_RANGE______11_CM 1 0. 0. 1. DISPLAY_IDENTIFIER FMY_1_LV_ERR_MKD ECU_ADDRESS 0x7fbdea BYTE_ORDER MSB_LAST BIT_MASK 0x200 /end MEASUREMENT
/begin MEASUREMENT fmy_ram_dyn[1].err_info_dyn.lv_dc_max "" UWORD _CNV_S_2_RANGE______11_CM 1 0. 0. 1. DISPLAY_IDENTIFIER FMY_1_LV_DC_MAX ECU_ADDRESS 0x7fbdea BYTE_ORDER MSB_LAST BIT_MASK 0x100 /end MEASUREMENT
/begin MEASUREMENT fmy_ram_dyn[1].err_info_dyn.lv_err_disa "" UWORD _CNV_S_2_RANGE______11_CM 1 0. 0. 1. DISPLAY_IDENTIFIER FMY_1_LV_ERR_DISA ECU_ADDRESS 0x7fbdea BYTE_ORDER MSB_LAST BIT_MASK 0x80 /end MEASUREMENT
/begin MEASUREMENT fmy_ram_dyn[1].err_info_dyn.lv_err_cfm "" UWORD _CNV_S_2_RANGE______11_CM 1 0. 0. 1. DISPLAY_IDENTIFIER FMY_1_LV_ERR_CFM ECU_ADDRESS 0x7fbdea BYTE_ORDER MSB_LAST BIT_MASK 0x40 /end MEASUREMENT
/begin MEASUREMENT fmy_ram_dyn[1].err_info_dyn.lv_err_tmp "" UWORD _CNV_S_2_RANGE______11_CM 1 0. 0. 1. DISPLAY_IDENTIFIER FMY_1_LV_ERR_TMP ECU_ADDRESS 0x7fbdea BYTE_ORDER MSB_LAST BIT_MASK 0x20 /end MEASUREMENT
/begin MEASUREMENT fmy_ram_dyn[1].err_info_dyn.lv_err_dc "" UWORD _CNV_S_2_RANGE______11_CM 1 0. 0. 1. DISPLAY_IDENTIFIER FMY_1_LV_ERR_DC ECU_ADDRESS 0x7fbdea BYTE_ORDER MSB_LAST BIT_MASK 0x10 /end MEASUREMENT
/begin MEASUREMENT fmy_ram_dyn[1].err_info_dyn.err_sym_mem "" UWORD _CNV_S_6_CONV_ERRM__27_CM 1 0. 0. 15. DISPLAY_IDENTIFIER FMY_1_ERR_SYM_MEM ECU_ADDRESS 0x7fbdea BYTE_ORDER MSB_LAST BIT_MASK 0xF /end MEASUREMENT
/begin MEASUREMENT fmy_ram_dyn[1].err_info_dyn.err_sym_lst "" UWORD _CNV_S_6_CONV_ERRM__27_CM 1 0. 0. 15. DISPLAY_IDENTIFIER FMY_1_ERR_SYM_LST ECU_ADDRESS 0x7fbdea BYTE_ORDER MSB_LAST BIT_MASK 0x7800 /end MEASUREMENT
/begin MEASUREMENT fmy_ram_dyn[1].err_info_dyn.lv_err_pnd "" UWORD _CNV_S_2_RANGE______11_CM 1 0. 0. 1. DISPLAY_IDENTIFIER FMY_1_LV_ERR_PND ECU_ADDRESS 0x7fbdea BYTE_ORDER MSB_LAST BIT_MASK 0x400 /end MEASUREMENT
/begin MEASUREMENT fmy_ram_dyn[1].err_info_dyn.lv_cdn_diag_dc "This flag permits to detect that diag conditions have been met during drinving cycle." UWORD _CNV_S_2_RANGE______11_CM 1 0. 0. 1. DISPLAY_IDENTIFIER FMY_1_LV_CDN_DIAG_DC ECU_ADDRESS 0x7fbdea BYTE_ORDER MSB_LAST BIT_MASK 0x8000 /end MEASUREMENT
/begin MEASUREMENT fmy_ram_dyn[1].ctr_dc_err_det "Number of driving cycles since DTC detection" UBYTE _CNV_A_R_LINEAR_____1_CM 1 0. 0. 255. DISPLAY_IDENTIFIER FMY_1_CTR_DC_ERR_DET ECU_ADDRESS 0x7fbdf0 FORMAT "%3.0" /end MEASUREMENT
/begin MEASUREMENT fmy_ram_dyn[1].ctr_dc_err_det_diag_cdn "Number of driving cycles since DTC detection with diag started within these driving cycle." UBYTE _CNV_A_R_LINEAR_____1_CM 1 0. 0. 255. DISPLAY_IDENTIFIER FMY_1_CTR_DC_ERR_DET_DIAG_CDN ECU_ADDRESS 0x7fbdf1 FORMAT "%3.0" /end MEASUREMENT
/begin MEASUREMENT fmy_ram_dyn[1].ctr_dc_err_det_diag_cmpl "Number of driving cycles since DTC detection with diag completed during these driving cycles." UBYTE _CNV_A_R_LINEAR_____1_CM 1 0. 0. 255. DISPLAY_IDENTIFIER FMY_1_CTR_DC_ERR_DET_DIAG_CMPL ECU_ADDRESS 0x7fbdf2 FORMAT "%3.0" /end MEASUREMENT
/begin MEASUREMENT fmy_ram_dyn[1].ctr_wup_act_mil "Number of warm-up cycles +1 since MIL activation for this failure" UBYTE _CNV_A_R_LINEAR_____1_CM 1 0. 0. 255. DISPLAY_IDENTIFIER FMY_1_CTR_WUP_ACT_MIL ECU_ADDRESS 0x7fbdf3 FORMAT "%3.0" /end MEASUREMENT
/begin MEASUREMENT fmy_ram_dyn[2].dtc_cod "" UWORD _CNV_A_R_LINEAR_____0_CM 1 0. 0. 65535. DISPLAY_IDENTIFIER FMY_2_DTC_COD ECU_ADDRESS 0x7fbdf4 BYTE_ORDER MSB_LAST FORMAT "%6.0" /end MEASUREMENT
/begin MEASUREMENT fmy_ram_dyn[2].ctr_frc "Frequency counter of failure N" UBYTE _CNV_A_R_LINEAR_____0_CM 1 0. 0. 255. DISPLAY_IDENTIFIER FMY_2_CTR_FRC ECU_ADDRESS 0x7fbdfa FORMAT "%3.0" /end MEASUREMENT
/begin MEASUREMENT fmy_ram_dyn[2].ctr_wup_cyc "Counter for warm-up cycle" UBYTE _CNV_A_R_LINEAR_____0_CM 1 0. 0. 255. DISPLAY_IDENTIFIER FMY_2_CTR_WUP_CYC ECU_ADDRESS 0x7fbdfb FORMAT "%3.0" /end MEASUREMENT
/begin MEASUREMENT fmy_ram_dyn[2].ctr_dc "Counter for driving cycle" UBYTE _CNV_A_R_LINEAR_____0_CM 1 0. 0. 255. DISPLAY_IDENTIFIER FMY_2_CTR_DC ECU_ADDRESS 0x7fbdfc FORMAT "%3.0" /end MEASUREMENT
/begin MEASUREMENT fmy_ram_dyn[2].diag_inst "" UWORD _CNV_S_173_CONV_DIAG__26_CM 1 0. 0. 172. DISPLAY_IDENTIFIER FMY_2_DIAG_INST ECU_ADDRESS 0x7fbdf6 BYTE_ORDER MSB_LAST /end MEASUREMENT
/begin MEASUREMENT fmy_ram_dyn[2].idx_frf "" UBYTE _CNV_A_R_ZYL_ID_2_CM 1 0. 1. 256. DISPLAY_IDENTIFIER FMY_2_IDX_FRF ECU_ADDRESS 0x7fbdfd FORMAT "%3.0" /end MEASUREMENT
/begin MEASUREMENT fmy_ram_dyn[2].err_info_dyn.lv_err_mkd "" UWORD _CNV_S_2_RANGE______11_CM 1 0. 0. 1. DISPLAY_IDENTIFIER FMY_2_LV_ERR_MKD ECU_ADDRESS 0x7fbdf8 BYTE_ORDER MSB_LAST BIT_MASK 0x200 /end MEASUREMENT
/begin MEASUREMENT fmy_ram_dyn[2].err_info_dyn.lv_dc_max "" UWORD _CNV_S_2_RANGE______11_CM 1 0. 0. 1. DISPLAY_IDENTIFIER FMY_2_LV_DC_MAX ECU_ADDRESS 0x7fbdf8 BYTE_ORDER MSB_LAST BIT_MASK 0x100 /end MEASUREMENT
/begin MEASUREMENT fmy_ram_dyn[2].err_info_dyn.lv_err_disa "" UWORD _CNV_S_2_RANGE______11_CM 1 0. 0. 1. DISPLAY_IDENTIFIER FMY_2_LV_ERR_DISA ECU_ADDRESS 0x7fbdf8 BYTE_ORDER MSB_LAST BIT_MASK 0x80 /end MEASUREMENT
/begin MEASUREMENT fmy_ram_dyn[2].err_info_dyn.lv_err_cfm "" UWORD _CNV_S_2_RANGE______11_CM 1 0. 0. 1. DISPLAY_IDENTIFIER FMY_2_LV_ERR_CFM ECU_ADDRESS 0x7fbdf8 BYTE_ORDER MSB_LAST BIT_MASK 0x40 /end MEASUREMENT
/begin MEASUREMENT fmy_ram_dyn[2].err_info_dyn.lv_err_tmp "" UWORD _CNV_S_2_RANGE______11_CM 1 0. 0. 1. DISPLAY_IDENTIFIER FMY_2_LV_ERR_TMP ECU_ADDRESS 0x7fbdf8 BYTE_ORDER MSB_LAST BIT_MASK 0x20 /end MEASUREMENT
/begin MEASUREMENT fmy_ram_dyn[2].err_info_dyn.lv_err_dc "" UWORD _CNV_S_2_RANGE______11_CM 1 0. 0. 1. DISPLAY_IDENTIFIER FMY_2_LV_ERR_DC ECU_ADDRESS 0x7fbdf8 BYTE_ORDER MSB_LAST BIT_MASK 0x10 /end MEASUREMENT
/begin MEASUREMENT fmy_ram_dyn[2].err_info_dyn.err_sym_mem "" UWORD _CNV_S_6_CONV_ERRM__27_CM 1 0. 0. 15. DISPLAY_IDENTIFIER FMY_2_ERR_SYM_MEM ECU_ADDRESS 0x7fbdf8 BYTE_ORDER MSB_LAST BIT_MASK 0xF /end MEASUREMENT
/begin MEASUREMENT fmy_ram_dyn[2].err_info_dyn.err_sym_lst "" UWORD _CNV_S_6_CONV_ERRM__27_CM 1 0. 0. 15. DISPLAY_IDENTIFIER FMY_2_ERR_SYM_LST ECU_ADDRESS 0x7fbdf8 BYTE_ORDER MSB_LAST BIT_MASK 0x7800 /end MEASUREMENT
/begin MEASUREMENT fmy_ram_dyn[2].err_info_dyn.lv_err_pnd "" UWORD _CNV_S_2_RANGE______11_CM 1 0. 0. 1. DISPLAY_IDENTIFIER FMY_2_LV_ERR_PND ECU_ADDRESS 0x7fbdf8 BYTE_ORDER MSB_LAST BIT_MASK 0x400 /end MEASUREMENT
/begin MEASUREMENT fmy_ram_dyn[2].err_info_dyn.lv_cdn_diag_dc "This flag permits to detect that diag conditions have been met during drinving cycle." UWORD _CNV_S_2_RANGE______11_CM 1 0. 0. 1. DISPLAY_IDENTIFIER FMY_2_LV_CDN_DIAG_DC ECU_ADDRESS 0x7fbdf8 BYTE_ORDER MSB_LAST BIT_MASK 0x8000 /end MEASUREMENT
/begin MEASUREMENT fmy_ram_dyn[2].ctr_dc_err_det "Number of driving cycles since DTC detection" UBYTE _CNV_A_R_LINEAR_____1_CM 1 0. 0. 255. DISPLAY_IDENTIFIER FMY_2_CTR_DC_ERR_DET ECU_ADDRESS 0x7fbdfe FORMAT "%3.0" /end MEASUREMENT
/begin MEASUREMENT fmy_ram_dyn[2].ctr_dc_err_det_diag_cdn "Number of driving cycles since DTC detection with diag started within these driving cycle." UBYTE _CNV_A_R_LINEAR_____1_CM 1 0. 0. 255. DISPLAY_IDENTIFIER FMY_2_CTR_DC_ERR_DET_DIAG_CDN ECU_ADDRESS 0x7fbdff FORMAT "%3.0" /end MEASUREMENT
/begin MEASUREMENT fmy_ram_dyn[2].ctr_dc_err_det_diag_cmpl "Number of driving cycles since DTC detection with diag completed during these driving cycles." UBYTE _CNV_A_R_LINEAR_____1_CM 1 0. 0. 255. DISPLAY_IDENTIFIER FMY_2_CTR_DC_ERR_DET_DIAG_CMPL ECU_ADDRESS 0x7fbe00 FORMAT "%3.0" /end MEASUREMENT
/begin MEASUREMENT fmy_ram_dyn[2].ctr_wup_act_mil "Number of warm-up cycles +1 since MIL activation for this failure" UBYTE _CNV_A_R_LINEAR_____1_CM 1 0. 0. 255. DISPLAY_IDENTIFIER FMY_2_CTR_WUP_ACT_MIL ECU_ADDRESS 0x7fbe01 FORMAT "%3.0" /end MEASUREMENT
/begin MEASUREMENT fmy_ram_dyn[3].dtc_cod "" UWORD _CNV_A_R_LINEAR_____0_CM 1 0. 0. 65535. DISPLAY_IDENTIFIER FMY_3_DTC_COD ECU_ADDRESS 0x7fbe02 BYTE_ORDER MSB_LAST FORMAT "%6.0" /end MEASUREMENT
/begin MEASUREMENT fmy_ram_dyn[3].ctr_frc "Frequency counter of failure N" UBYTE _CNV_A_R_LINEAR_____0_CM 1 0. 0. 255. DISPLAY_IDENTIFIER FMY_3_CTR_FRC ECU_ADDRESS 0x7fbe08 FORMAT "%3.0" /end MEASUREMENT
/begin MEASUREMENT fmy_ram_dyn[3].ctr_wup_cyc "Counter for warm-up cycle" UBYTE _CNV_A_R_LINEAR_____0_CM 1 0. 0. 255. DISPLAY_IDENTIFIER FMY_3_CTR_WUP_CYC ECU_ADDRESS 0x7fbe09 FORMAT "%3.0" /end MEASUREMENT
/begin MEASUREMENT fmy_ram_dyn[3].ctr_dc "Counter for driving cycle" UBYTE _CNV_A_R_LINEAR_____0_CM 1 0. 0. 255. DISPLAY_IDENTIFIER FMY_3_CTR_DC ECU_ADDRESS 0x7fbe0a FORMAT "%3.0" /end MEASUREMENT
/begin MEASUREMENT fmy_ram_dyn[3].diag_inst "" UWORD _CNV_S_173_CONV_DIAG__26_CM 1 0. 0. 172. DISPLAY_IDENTIFIER FMY_3_DIAG_INST ECU_ADDRESS 0x7fbe04 BYTE_ORDER MSB_LAST /end MEASUREMENT
/begin MEASUREMENT fmy_ram_dyn[3].idx_frf "" UBYTE _CNV_A_R_ZYL_ID_2_CM 1 0. 1. 256. DISPLAY_IDENTIFIER FMY_3_IDX_FRF ECU_ADDRESS 0x7fbe0b FORMAT "%3.0" /end MEASUREMENT
/begin MEASUREMENT fmy_ram_dyn[3].err_info_dyn.lv_err_mkd "" UWORD _CNV_S_2_RANGE______11_CM 1 0. 0. 1. DISPLAY_IDENTIFIER FMY_3_LV_ERR_MKD ECU_ADDRESS 0x7fbe06 BYTE_ORDER MSB_LAST BIT_MASK 0x200 /end MEASUREMENT
/begin MEASUREMENT fmy_ram_dyn[3].err_info_dyn.lv_dc_max "" UWORD _CNV_S_2_RANGE______11_CM 1 0. 0. 1. DISPLAY_IDENTIFIER FMY_3_LV_DC_MAX ECU_ADDRESS 0x7fbe06 BYTE_ORDER MSB_LAST BIT_MASK 0x100 /end MEASUREMENT
/begin MEASUREMENT fmy_ram_dyn[3].err_info_dyn.lv_err_disa "" UWORD _CNV_S_2_RANGE______11_CM 1 0. 0. 1. DISPLAY_IDENTIFIER FMY_3_LV_ERR_DISA ECU_ADDRESS 0x7fbe06 BYTE_ORDER MSB_LAST BIT_MASK 0x80 /end MEASUREMENT
/begin MEASUREMENT fmy_ram_dyn[3].err_info_dyn.lv_err_cfm "" UWORD _CNV_S_2_RANGE______11_CM 1 0. 0. 1. DISPLAY_IDENTIFIER FMY_3_LV_ERR_CFM ECU_ADDRESS 0x7fbe06 BYTE_ORDER MSB_LAST BIT_MASK 0x40 /end MEASUREMENT
/begin MEASUREMENT fmy_ram_dyn[3].err_info_dyn.lv_err_tmp "" UWORD _CNV_S_2_RANGE______11_CM 1 0. 0. 1. DISPLAY_IDENTIFIER FMY_3_LV_ERR_TMP ECU_ADDRESS 0x7fbe06 BYTE_ORDER MSB_LAST BIT_MASK 0x20 /end MEASUREMENT
/begin MEASUREMENT fmy_ram_dyn[3].err_info_dyn.lv_err_dc "" UWORD _CNV_S_2_RANGE______11_CM 1 0. 0. 1. DISPLAY_IDENTIFIER FMY_3_LV_ERR_DC ECU_ADDRESS 0x7fbe06 BYTE_ORDER MSB_LAST BIT_MASK 0x10 /end MEASUREMENT
/begin MEASUREMENT fmy_ram_dyn[3].err_info_dyn.err_sym_mem "" UWORD _CNV_S_6_CONV_ERRM__27_CM 1 0. 0. 15. DISPLAY_IDENTIFIER FMY_3_ERR_SYM_MEM ECU_ADDRESS 0x7fbe06 BYTE_ORDER MSB_LAST BIT_MASK 0xF /end MEASUREMENT
/begin MEASUREMENT fmy_ram_dyn[3].err_info_dyn.err_sym_lst "" UWORD _CNV_S_6_CONV_ERRM__27_CM 1 0. 0. 15. DISPLAY_IDENTIFIER FMY_3_ERR_SYM_LST ECU_ADDRESS 0x7fbe06 BYTE_ORDER MSB_LAST BIT_MASK 0x7800 /end MEASUREMENT
/begin MEASUREMENT fmy_ram_dyn[3].err_info_dyn.lv_err_pnd "" UWORD _CNV_S_2_RANGE______11_CM 1 0. 0. 1. DISPLAY_IDENTIFIER FMY_3_LV_ERR_PND ECU_ADDRESS 0x7fbe06 BYTE_ORDER MSB_LAST BIT_MASK 0x400 /end MEASUREMENT
/begin MEASUREMENT fmy_ram_dyn[3].err_info_dyn.lv_cdn_diag_dc "This flag permits to detect that diag conditions have been met during drinving cycle." UWORD _CNV_S_2_RANGE______11_CM 1 0. 0. 1. DISPLAY_IDENTIFIER FMY_3_LV_CDN_DIAG_DC ECU_ADDRESS 0x7fbe06 BYTE_ORDER MSB_LAST BIT_MASK 0x8000 /end MEASUREMENT
/begin MEASUREMENT fmy_ram_dyn[3].ctr_dc_err_det "Number of driving cycles since DTC detection" UBYTE _CNV_A_R_LINEAR_____1_CM 1 0. 0. 255. DISPLAY_IDENTIFIER FMY_3_CTR_DC_ERR_DET ECU_ADDRESS 0x7fbe0c FORMAT "%3.0" /end MEASUREMENT
/begin MEASUREMENT fmy_ram_dyn[3].ctr_dc_err_det_diag_cdn "Number of driving cycles since DTC detection with diag started within these driving cycle." UBYTE _CNV_A_R_LINEAR_____1_CM 1 0. 0. 255. DISPLAY_IDENTIFIER FMY_3_CTR_DC_ERR_DET_DIAG_CDN ECU_ADDRESS 0x7fbe0d FORMAT "%3.0" /end MEASUREMENT
/begin MEASUREMENT fmy_ram_dyn[3].ctr_dc_err_det_diag_cmpl "Number of driving cycles since DTC detection with diag completed during these driving cycles." UBYTE _CNV_A_R_LINEAR_____1_CM 1 0. 0. 255. DISPLAY_IDENTIFIER FMY_3_CTR_DC_ERR_DET_DIAG_CMPL ECU_ADDRESS 0x7fbe0e FORMAT "%3.0" /end MEASUREMENT
/begin MEASUREMENT fmy_ram_dyn[3].ctr_wup_act_mil "Number of warm-up cycles +1 since MIL activation for this failure" UBYTE _CNV_A_R_LINEAR_____1_CM 1 0. 0. 255. DISPLAY_IDENTIFIER FMY_3_CTR_WUP_ACT_MIL ECU_ADDRESS 0x7fbe0f FORMAT "%3.0" /end MEASUREMENT
/begin MEASUREMENT fmy_ram_dyn[4].dtc_cod "" UWORD _CNV_A_R_LINEAR_____0_CM 1 0. 0. 65535. DISPLAY_IDENTIFIER FMY_4_DTC_COD ECU_ADDRESS 0x7fbe10 BYTE_ORDER MSB_LAST FORMAT "%6.0" /end MEASUREMENT
/begin MEASUREMENT fmy_ram_dyn[4].ctr_frc "Frequency counter of failure N" UBYTE _CNV_A_R_LINEAR_____0_CM 1 0. 0. 255. DISPLAY_IDENTIFIER FMY_4_CTR_FRC ECU_ADDRESS 0x7fbe16 FORMAT "%3.0" /end MEASUREMENT
/begin MEASUREMENT fmy_ram_dyn[4].ctr_wup_cyc "Counter for warm-up cycle" UBYTE _CNV_A_R_LINEAR_____0_CM 1 0. 0. 255. DISPLAY_IDENTIFIER FMY_4_CTR_WUP_CYC ECU_ADDRESS 0x7fbe17 FORMAT "%3.0" /end MEASUREMENT
/begin MEASUREMENT fmy_ram_dyn[4].ctr_dc "Counter for driving cycle" UBYTE _CNV_A_R_LINEAR_____0_CM 1 0. 0. 255. DISPLAY_IDENTIFIER FMY_4_CTR_DC ECU_ADDRESS 0x7fbe18 FORMAT "%3.0" /end MEASUREMENT
/begin MEASUREMENT fmy_ram_dyn[4].diag_inst "" UWORD _CNV_S_173_CONV_DIAG__26_CM 1 0. 0. 172. DISPLAY_IDENTIFIER FMY_4_DIAG_INST ECU_ADDRESS 0x7fbe12 BYTE_ORDER MSB_LAST /end MEASUREMENT
/begin MEASUREMENT fmy_ram_dyn[4].idx_frf "" UBYTE _CNV_A_R_ZYL_ID_2_CM 1 0. 1. 256. DISPLAY_IDENTIFIER FMY_4_IDX_FRF ECU_ADDRESS 0x7fbe19 FORMAT "%3.0" /end MEASUREMENT
/begin MEASUREMENT fmy_ram_dyn[4].err_info_dyn.lv_err_mkd "" UWORD _CNV_S_2_RANGE______11_CM 1 0. 0. 1. DISPLAY_IDENTIFIER FMY_4_LV_ERR_MKD ECU_ADDRESS 0x7fbe14 BYTE_ORDER MSB_LAST BIT_MASK 0x200 /end MEASUREMENT
/begin MEASUREMENT fmy_ram_dyn[4].err_info_dyn.lv_dc_max "" UWORD _CNV_S_2_RANGE______11_CM 1 0. 0. 1. DISPLAY_IDENTIFIER FMY_4_LV_DC_MAX ECU_ADDRESS 0x7fbe14 BYTE_ORDER MSB_LAST BIT_MASK 0x100 /end MEASUREMENT
/begin MEASUREMENT fmy_ram_dyn[4].err_info_dyn.lv_err_disa "" UWORD _CNV_S_2_RANGE______11_CM 1 0. 0. 1. DISPLAY_IDENTIFIER FMY_4_LV_ERR_DISA ECU_ADDRESS 0x7fbe14 BYTE_ORDER MSB_LAST BIT_MASK 0x80 /end MEASUREMENT
/begin MEASUREMENT fmy_ram_dyn[4].err_info_dyn.lv_err_cfm "" UWORD _CNV_S_2_RANGE______11_CM 1 0. 0. 1. DISPLAY_IDENTIFIER FMY_4_LV_ERR_CFM ECU_ADDRESS 0x7fbe14 BYTE_ORDER MSB_LAST BIT_MASK 0x40 /end MEASUREMENT
/begin MEASUREMENT fmy_ram_dyn[4].err_info_dyn.lv_err_tmp "" UWORD _CNV_S_2_RANGE______11_CM 1 0. 0. 1. DISPLAY_IDENTIFIER FMY_4_LV_ERR_TMP ECU_ADDRESS 0x7fbe14 BYTE_ORDER MSB_LAST BIT_MASK 0x20 /end MEASUREMENT
/begin MEASUREMENT fmy_ram_dyn[4].err_info_dyn.lv_err_dc "" UWORD _CNV_S_2_RANGE______11_CM 1 0. 0. 1. DISPLAY_IDENTIFIER FMY_4_LV_ERR_DC ECU_ADDRESS 0x7fbe14 BYTE_ORDER MSB_LAST BIT_MASK 0x10 /end MEASUREMENT
/begin MEASUREMENT fmy_ram_dyn[4].err_info_dyn.err_sym_mem "" UWORD _CNV_S_6_CONV_ERRM__27_CM 1 0. 0. 15. DISPLAY_IDENTIFIER FMY_4_ERR_SYM_MEM ECU_ADDRESS 0x7fbe14 BYTE_ORDER MSB_LAST BIT_MASK 0xF /end MEASUREMENT
/begin MEASUREMENT fmy_ram_dyn[4].err_info_dyn.err_sym_lst "" UWORD _CNV_S_6_CONV_ERRM__27_CM 1 0. 0. 15. DISPLAY_IDENTIFIER FMY_4_ERR_SYM_LST ECU_ADDRESS 0x7fbe14 BYTE_ORDER MSB_LAST BIT_MASK 0x7800 /end MEASUREMENT
/begin MEASUREMENT fmy_ram_dyn[4].err_info_dyn.lv_err_pnd "" UWORD _CNV_S_2_RANGE______11_CM 1 0. 0. 1. DISPLAY_IDENTIFIER FMY_4_LV_ERR_PND ECU_ADDRESS 0x7fbe14 BYTE_ORDER MSB_LAST BIT_MASK 0x400 /end MEASUREMENT
/begin MEASUREMENT fmy_ram_dyn[4].err_info_dyn.lv_cdn_diag_dc "This flag permits to detect that diag conditions have been met during drinving cycle." UWORD _CNV_S_2_RANGE______11_CM 1 0. 0. 1. DISPLAY_IDENTIFIER FMY_4_LV_CDN_DIAG_DC ECU_ADDRESS 0x7fbe14 BYTE_ORDER MSB_LAST BIT_MASK 0x8000 /end MEASUREMENT
/begin MEASUREMENT fmy_ram_dyn[4].ctr_dc_err_det "Number of driving cycles since DTC detection" UBYTE _CNV_A_R_LINEAR_____1_CM 1 0. 0. 255. DISPLAY_IDENTIFIER FMY_4_CTR_DC_ERR_DET ECU_ADDRESS 0x7fbe1a FORMAT "%3.0" /end MEASUREMENT
/begin MEASUREMENT fmy_ram_dyn[4].ctr_dc_err_det_diag_cdn "Number of driving cycles since DTC detection with diag started within these driving cycle." UBYTE _CNV_A_R_LINEAR_____1_CM 1 0. 0. 255. DISPLAY_IDENTIFIER FMY_4_CTR_DC_ERR_DET_DIAG_CDN ECU_ADDRESS 0x7fbe1b FORMAT "%3.0" /end MEASUREMENT
/begin MEASUREMENT fmy_ram_dyn[4].ctr_dc_err_det_diag_cmpl "Number of driving cycles since DTC detection with diag completed during these driving cycles." UBYTE _CNV_A_R_LINEAR_____1_CM 1 0. 0. 255. DISPLAY_IDENTIFIER FMY_4_CTR_DC_ERR_DET_DIAG_CMPL ECU_ADDRESS 0x7fbe1c FORMAT "%3.0" /end MEASUREMENT
/begin MEASUREMENT fmy_ram_dyn[4].ctr_wup_act_mil "Number of warm-up cycles +1 since MIL activation for this failure" UBYTE _CNV_A_R_LINEAR_____1_CM 1 0. 0. 255. DISPLAY_IDENTIFIER FMY_4_CTR_WUP_ACT_MIL ECU_ADDRESS 0x7fbe1d FORMAT "%3.0" /end MEASUREMENT
/begin MEASUREMENT fmy_ram_dyn[5].dtc_cod "" UWORD _CNV_A_R_LINEAR_____0_CM 1 0. 0. 65535. DISPLAY_IDENTIFIER FMY_5_DTC_COD ECU_ADDRESS 0x7fbe1e BYTE_ORDER MSB_LAST FORMAT "%6.0" /end MEASUREMENT
/begin MEASUREMENT fmy_ram_dyn[5].ctr_frc "Frequency counter of failure N" UBYTE _CNV_A_R_LINEAR_____0_CM 1 0. 0. 255. DISPLAY_IDENTIFIER FMY_5_CTR_FRC ECU_ADDRESS 0x7fbe24 FORMAT "%3.0" /end MEASUREMENT
/begin MEASUREMENT fmy_ram_dyn[5].ctr_wup_cyc "Counter for warm-up cycle" UBYTE _CNV_A_R_LINEAR_____0_CM 1 0. 0. 255. DISPLAY_IDENTIFIER FMY_5_CTR_WUP_CYC ECU_ADDRESS 0x7fbe25 FORMAT "%3.0" /end MEASUREMENT
/begin MEASUREMENT fmy_ram_dyn[5].ctr_dc "Counter for driving cycle" UBYTE _CNV_A_R_LINEAR_____0_CM 1 0. 0. 255. DISPLAY_IDENTIFIER FMY_5_CTR_DC ECU_ADDRESS 0x7fbe26 FORMAT "%3.0" /end MEASUREMENT
/begin MEASUREMENT fmy_ram_dyn[5].diag_inst "" UWORD _CNV_S_173_CONV_DIAG__26_CM 1 0. 0. 172. DISPLAY_IDENTIFIER FMY_5_DIAG_INST ECU_ADDRESS 0x7fbe20 BYTE_ORDER MSB_LAST /end MEASUREMENT
/begin MEASUREMENT fmy_ram_dyn[5].idx_frf "" UBYTE _CNV_A_R_ZYL_ID_2_CM 1 0. 1. 256. DISPLAY_IDENTIFIER FMY_5_IDX_FRF ECU_ADDRESS 0x7fbe27 FORMAT "%3.0" /end MEASUREMENT
/begin MEASUREMENT fmy_ram_dyn[5].err_info_dyn.lv_err_mkd "" UWORD _CNV_S_2_RANGE______11_CM 1 0. 0. 1. DISPLAY_IDENTIFIER FMY_5_LV_ERR_MKD ECU_ADDRESS 0x7fbe22 BYTE_ORDER MSB_LAST BIT_MASK 0x200 /end MEASUREMENT
/begin MEASUREMENT fmy_ram_dyn[5].err_info_dyn.lv_dc_max "" UWORD _CNV_S_2_RANGE______11_CM 1 0. 0. 1. DISPLAY_IDENTIFIER FMY_5_LV_DC_MAX ECU_ADDRESS 0x7fbe22 BYTE_ORDER MSB_LAST BIT_MASK 0x100 /end MEASUREMENT
/begin MEASUREMENT fmy_ram_dyn[5].err_info_dyn.lv_err_disa "" UWORD _CNV_S_2_RANGE______11_CM 1 0. 0. 1. DISPLAY_IDENTIFIER FMY_5_LV_ERR_DISA ECU_ADDRESS 0x7fbe22 BYTE_ORDER MSB_LAST BIT_MASK 0x80 /end MEASUREMENT
/begin MEASUREMENT fmy_ram_dyn[5].err_info_dyn.lv_err_cfm "" UWORD _CNV_S_2_RANGE______11_CM 1 0. 0. 1. DISPLAY_IDENTIFIER FMY_5_LV_ERR_CFM ECU_ADDRESS 0x7fbe22 BYTE_ORDER MSB_LAST BIT_MASK 0x40 /end MEASUREMENT
/begin MEASUREMENT fmy_ram_dyn[5].err_info_dyn.lv_err_tmp "" UWORD _CNV_S_2_RANGE______11_CM 1 0. 0. 1. DISPLAY_IDENTIFIER FMY_5_LV_ERR_TMP ECU_ADDRESS 0x7fbe22 BYTE_ORDER MSB_LAST BIT_MASK 0x20 /end MEASUREMENT
/begin MEASUREMENT fmy_ram_dyn[5].err_info_dyn.lv_err_dc "" UWORD _CNV_S_2_RANGE______11_CM 1 0. 0. 1. DISPLAY_IDENTIFIER FMY_5_LV_ERR_DC ECU_ADDRESS 0x7fbe22 BYTE_ORDER MSB_LAST BIT_MASK 0x10 /end MEASUREMENT
/begin MEASUREMENT fmy_ram_dyn[5].err_info_dyn.err_sym_mem "" UWORD _CNV_S_6_CONV_ERRM__27_CM 1 0. 0. 15. DISPLAY_IDENTIFIER FMY_5_ERR_SYM_MEM ECU_ADDRESS 0x7fbe22 BYTE_ORDER MSB_LAST BIT_MASK 0xF /end MEASUREMENT
/begin MEASUREMENT fmy_ram_dyn[5].err_info_dyn.err_sym_lst "" UWORD _CNV_S_6_CONV_ERRM__27_CM 1 0. 0. 15. DISPLAY_IDENTIFIER FMY_5_ERR_SYM_LST ECU_ADDRESS 0x7fbe22 BYTE_ORDER MSB_LAST BIT_MASK 0x7800 /end MEASUREMENT
/begin MEASUREMENT fmy_ram_dyn[5].err_info_dyn.lv_err_pnd "" UWORD _CNV_S_2_RANGE______11_CM 1 0. 0. 1. DISPLAY_IDENTIFIER FMY_5_LV_ERR_PND ECU_ADDRESS 0x7fbe22 BYTE_ORDER MSB_LAST BIT_MASK 0x400 /end MEASUREMENT
/begin MEASUREMENT fmy_ram_dyn[5].err_info_dyn.lv_cdn_diag_dc "This flag permits to detect that diag conditions have been met during drinving cycle." UWORD _CNV_S_2_RANGE______11_CM 1 0. 0. 1. DISPLAY_IDENTIFIER FMY_5_LV_CDN_DIAG_DC ECU_ADDRESS 0x7fbe22 BYTE_ORDER MSB_LAST BIT_MASK 0x8000 /end MEASUREMENT
/begin MEASUREMENT fmy_ram_dyn[5].ctr_dc_err_det "Number of driving cycles since DTC detection" UBYTE _CNV_A_R_LINEAR_____1_CM 1 0. 0. 255. DISPLAY_IDENTIFIER FMY_5_CTR_DC_ERR_DET ECU_ADDRESS 0x7fbe28 FORMAT "%3.0" /end MEASUREMENT
/begin MEASUREMENT fmy_ram_dyn[5].ctr_dc_err_det_diag_cdn "Number of driving cycles since DTC detection with diag started within these driving cycle." UBYTE _CNV_A_R_LINEAR_____1_CM 1 0. 0. 255. DISPLAY_IDENTIFIER FMY_5_CTR_DC_ERR_DET_DIAG_CDN ECU_ADDRESS 0x7fbe29 FORMAT "%3.0" /end MEASUREMENT
/begin MEASUREMENT fmy_ram_dyn[5].ctr_dc_err_det_diag_cmpl "Number of driving cycles since DTC detection with diag completed during these driving cycles." UBYTE _CNV_A_R_LINEAR_____1_CM 1 0. 0. 255. DISPLAY_IDENTIFIER FMY_5_CTR_DC_ERR_DET_DIAG_CMPL ECU_ADDRESS 0x7fbe2a FORMAT "%3.0" /end MEASUREMENT
/begin MEASUREMENT fmy_ram_dyn[5].ctr_wup_act_mil "Number of warm-up cycles +1 since MIL activation for this failure" UBYTE _CNV_A_R_LINEAR_____1_CM 1 0. 0. 255. DISPLAY_IDENTIFIER FMY_5_CTR_WUP_ACT_MIL ECU_ADDRESS 0x7fbe2b FORMAT "%3.0" /end MEASUREMENT
/begin MEASUREMENT fmy_ram_dyn[6].dtc_cod "" UWORD _CNV_A_R_LINEAR_____0_CM 1 0. 0. 65535. DISPLAY_IDENTIFIER FMY_6_DTC_COD ECU_ADDRESS 0x7fbe2c BYTE_ORDER MSB_LAST FORMAT "%6.0" /end MEASUREMENT
/begin MEASUREMENT fmy_ram_dyn[6].ctr_frc "Frequency counter of failure N" UBYTE _CNV_A_R_LINEAR_____0_CM 1 0. 0. 255. DISPLAY_IDENTIFIER FMY_6_CTR_FRC ECU_ADDRESS 0x7fbe32 FORMAT "%3.0" /end MEASUREMENT
/begin MEASUREMENT fmy_ram_dyn[6].ctr_wup_cyc "Counter for warm-up cycle" UBYTE _CNV_A_R_LINEAR_____0_CM 1 0. 0. 255. DISPLAY_IDENTIFIER FMY_6_CTR_WUP_CYC ECU_ADDRESS 0x7fbe33 FORMAT "%3.0" /end MEASUREMENT
/begin MEASUREMENT fmy_ram_dyn[6].ctr_dc "Counter for driving cycle" UBYTE _CNV_A_R_LINEAR_____0_CM 1 0. 0. 255. DISPLAY_IDENTIFIER FMY_6_CTR_DC ECU_ADDRESS 0x7fbe34 FORMAT "%3.0" /end MEASUREMENT
/begin MEASUREMENT fmy_ram_dyn[6].diag_inst "" UWORD _CNV_S_173_CONV_DIAG__26_CM 1 0. 0. 172. DISPLAY_IDENTIFIER FMY_6_DIAG_INST ECU_ADDRESS 0x7fbe2e BYTE_ORDER MSB_LAST /end MEASUREMENT
/begin MEASUREMENT fmy_ram_dyn[6].idx_frf "" UBYTE _CNV_A_R_ZYL_ID_2_CM 1 0. 1. 256. DISPLAY_IDENTIFIER FMY_6_IDX_FRF ECU_ADDRESS 0x7fbe35 FORMAT "%3.0" /end MEASUREMENT
/begin MEASUREMENT fmy_ram_dyn[6].err_info_dyn.lv_err_mkd "" UWORD _CNV_S_2_RANGE______11_CM 1 0. 0. 1. DISPLAY_IDENTIFIER FMY_6_LV_ERR_MKD ECU_ADDRESS 0x7fbe30 BYTE_ORDER MSB_LAST BIT_MASK 0x200 /end MEASUREMENT
/begin MEASUREMENT fmy_ram_dyn[6].err_info_dyn.lv_dc_max "" UWORD _CNV_S_2_RANGE______11_CM 1 0. 0. 1. DISPLAY_IDENTIFIER FMY_6_LV_DC_MAX ECU_ADDRESS 0x7fbe30 BYTE_ORDER MSB_LAST BIT_MASK 0x100 /end MEASUREMENT
/begin MEASUREMENT fmy_ram_dyn[6].err_info_dyn.lv_err_disa "" UWORD _CNV_S_2_RANGE______11_CM 1 0. 0. 1. DISPLAY_IDENTIFIER FMY_6_LV_ERR_DISA ECU_ADDRESS 0x7fbe30 BYTE_ORDER MSB_LAST BIT_MASK 0x80 /end MEASUREMENT
/begin MEASUREMENT fmy_ram_dyn[6].err_info_dyn.lv_err_cfm "" UWORD _CNV_S_2_RANGE______11_CM 1 0. 0. 1. DISPLAY_IDENTIFIER FMY_6_LV_ERR_CFM ECU_ADDRESS 0x7fbe30 BYTE_ORDER MSB_LAST BIT_MASK 0x40 /end MEASUREMENT
/begin MEASUREMENT fmy_ram_dyn[6].err_info_dyn.lv_err_tmp "" UWORD _CNV_S_2_RANGE______11_CM 1 0. 0. 1. DISPLAY_IDENTIFIER FMY_6_LV_ERR_TMP ECU_ADDRESS 0x7fbe30 BYTE_ORDER MSB_LAST BIT_MASK 0x20 /end MEASUREMENT
/begin MEASUREMENT fmy_ram_dyn[6].err_info_dyn.lv_err_dc "" UWORD _CNV_S_2_RANGE______11_CM 1 0. 0. 1. DISPLAY_IDENTIFIER FMY_6_LV_ERR_DC ECU_ADDRESS 0x7fbe30 BYTE_ORDER MSB_LAST BIT_MASK 0x10 /end MEASUREMENT
/begin MEASUREMENT fmy_ram_dyn[6].err_info_dyn.err_sym_mem "" UWORD _CNV_S_6_CONV_ERRM__27_CM 1 0. 0. 15. DISPLAY_IDENTIFIER FMY_6_ERR_SYM_MEM ECU_ADDRESS 0x7fbe30 BYTE_ORDER MSB_LAST BIT_MASK 0xF /end MEASUREMENT
/begin MEASUREMENT fmy_ram_dyn[6].err_info_dyn.err_sym_lst "" UWORD _CNV_S_6_CONV_ERRM__27_CM 1 0. 0. 15. DISPLAY_IDENTIFIER FMY_6_ERR_SYM_LST ECU_ADDRESS 0x7fbe30 BYTE_ORDER MSB_LAST BIT_MASK 0x7800 /end MEASUREMENT
/begin MEASUREMENT fmy_ram_dyn[6].err_info_dyn.lv_err_pnd "" UWORD _CNV_S_2_RANGE______11_CM 1 0. 0. 1. DISPLAY_IDENTIFIER FMY_6_LV_ERR_PND ECU_ADDRESS 0x7fbe30 BYTE_ORDER MSB_LAST BIT_MASK 0x400 /end MEASUREMENT
/begin MEASUREMENT fmy_ram_dyn[6].err_info_dyn.lv_cdn_diag_dc "This flag permits to detect that diag conditions have been met during drinving cycle." UWORD _CNV_S_2_RANGE______11_CM 1 0. 0. 1. DISPLAY_IDENTIFIER FMY_6_LV_CDN_DIAG_DC ECU_ADDRESS 0x7fbe30 BYTE_ORDER MSB_LAST BIT_MASK 0x8000 /end MEASUREMENT
/begin MEASUREMENT fmy_ram_dyn[6].ctr_dc_err_det "Number of driving cycles since DTC detection" UBYTE _CNV_A_R_LINEAR_____1_CM 1 0. 0. 255. DISPLAY_IDENTIFIER FMY_6_CTR_DC_ERR_DET ECU_ADDRESS 0x7fbe36 FORMAT "%3.0" /end MEASUREMENT
/begin MEASUREMENT fmy_ram_dyn[6].ctr_dc_err_det_diag_cdn "Number of driving cycles since DTC detection with diag started within these driving cycle." UBYTE _CNV_A_R_LINEAR_____1_CM 1 0. 0. 255. DISPLAY_IDENTIFIER FMY_6_CTR_DC_ERR_DET_DIAG_CDN ECU_ADDRESS 0x7fbe37 FORMAT "%3.0" /end MEASUREMENT
/begin MEASUREMENT fmy_ram_dyn[6].ctr_dc_err_det_diag_cmpl "Number of driving cycles since DTC detection with diag completed during these driving cycles." UBYTE _CNV_A_R_LINEAR_____1_CM 1 0. 0. 255. DISPLAY_IDENTIFIER FMY_6_CTR_DC_ERR_DET_DIAG_CMPL ECU_ADDRESS 0x7fbe38 FORMAT "%3.0" /end MEASUREMENT
/begin MEASUREMENT fmy_ram_dyn[6].ctr_wup_act_mil "Number of warm-up cycles +1 since MIL activation for this failure" UBYTE _CNV_A_R_LINEAR_____1_CM 1 0. 0. 255. DISPLAY_IDENTIFIER FMY_6_CTR_WUP_ACT_MIL ECU_ADDRESS 0x7fbe39 FORMAT "%3.0" /end MEASUREMENT
/begin MEASUREMENT fmy_ram_dyn[7].dtc_cod "" UWORD _CNV_A_R_LINEAR_____0_CM 1 0. 0. 65535. DISPLAY_IDENTIFIER FMY_7_DTC_COD ECU_ADDRESS 0x7fbe3a BYTE_ORDER MSB_LAST FORMAT "%6.0" /end MEASUREMENT
/begin MEASUREMENT fmy_ram_dyn[7].ctr_frc "Frequency counter of failure N" UBYTE _CNV_A_R_LINEAR_____0_CM 1 0. 0. 255. DISPLAY_IDENTIFIER FMY_7_CTR_FRC ECU_ADDRESS 0x7fbe40 FORMAT "%3.0" /end MEASUREMENT
/begin MEASUREMENT fmy_ram_dyn[7].ctr_wup_cyc "Counter for warm-up cycle" UBYTE _CNV_A_R_LINEAR_____0_CM 1 0. 0. 255. DISPLAY_IDENTIFIER FMY_7_CTR_WUP_CYC ECU_ADDRESS 0x7fbe41 FORMAT "%3.0" /end MEASUREMENT
/begin MEASUREMENT fmy_ram_dyn[7].ctr_dc "Counter for driving cycle" UBYTE _CNV_A_R_LINEAR_____0_CM 1 0. 0. 255. DISPLAY_IDENTIFIER FMY_7_CTR_DC ECU_ADDRESS 0x7fbe42 FORMAT "%3.0" /end MEASUREMENT
/begin MEASUREMENT fmy_ram_dyn[7].diag_inst "" UWORD _CNV_S_173_CONV_DIAG__26_CM 1 0. 0. 172. DISPLAY_IDENTIFIER FMY_7_DIAG_INST ECU_ADDRESS 0x7fbe3c BYTE_ORDER MSB_LAST /end MEASUREMENT
/begin MEASUREMENT fmy_ram_dyn[7].idx_frf "" UBYTE _CNV_A_R_ZYL_ID_2_CM 1 0. 1. 256. DISPLAY_IDENTIFIER FMY_7_IDX_FRF ECU_ADDRESS 0x7fbe43 FORMAT "%3.0" /end MEASUREMENT
/begin MEASUREMENT fmy_ram_dyn[7].err_info_dyn.lv_err_mkd "" UWORD _CNV_S_2_RANGE______11_CM 1 0. 0. 1. DISPLAY_IDENTIFIER FMY_7_LV_ERR_MKD ECU_ADDRESS 0x7fbe3e BYTE_ORDER MSB_LAST BIT_MASK 0x200 /end MEASUREMENT
/begin MEASUREMENT fmy_ram_dyn[7].err_info_dyn.lv_dc_max "" UWORD _CNV_S_2_RANGE______11_CM 1 0. 0. 1. DISPLAY_IDENTIFIER FMY_7_LV_DC_MAX ECU_ADDRESS 0x7fbe3e BYTE_ORDER MSB_LAST BIT_MASK 0x100 /end MEASUREMENT
/begin MEASUREMENT fmy_ram_dyn[7].err_info_dyn.lv_err_disa "" UWORD _CNV_S_2_RANGE______11_CM 1 0. 0. 1. DISPLAY_IDENTIFIER FMY_7_LV_ERR_DISA ECU_ADDRESS 0x7fbe3e BYTE_ORDER MSB_LAST BIT_MASK 0x80 /end MEASUREMENT
/begin MEASUREMENT fmy_ram_dyn[7].err_info_dyn.lv_err_cfm "" UWORD _CNV_S_2_RANGE______11_CM 1 0. 0. 1. DISPLAY_IDENTIFIER FMY_7_LV_ERR_CFM ECU_ADDRESS 0x7fbe3e BYTE_ORDER MSB_LAST BIT_MASK 0x40 /end MEASUREMENT
/begin MEASUREMENT fmy_ram_dyn[7].err_info_dyn.lv_err_tmp "" UWORD _CNV_S_2_RANGE______11_CM 1 0. 0. 1. DISPLAY_IDENTIFIER FMY_7_LV_ERR_TMP ECU_ADDRESS 0x7fbe3e BYTE_ORDER MSB_LAST BIT_MASK 0x20 /end MEASUREMENT
/begin MEASUREMENT fmy_ram_dyn[7].err_info_dyn.lv_err_dc "" UWORD _CNV_S_2_RANGE______11_CM 1 0. 0. 1. DISPLAY_IDENTIFIER FMY_7_LV_ERR_DC ECU_ADDRESS 0x7fbe3e BYTE_ORDER MSB_LAST BIT_MASK 0x10 /end MEASUREMENT
/begin MEASUREMENT fmy_ram_dyn[7].err_info_dyn.err_sym_mem "" UWORD _CNV_S_6_CONV_ERRM__27_CM 1 0. 0. 15. DISPLAY_IDENTIFIER FMY_7_ERR_SYM_MEM ECU_ADDRESS 0x7fbe3e BYTE_ORDER MSB_LAST BIT_MASK 0xF /end MEASUREMENT
/begin MEASUREMENT fmy_ram_dyn[7].err_info_dyn.err_sym_lst "" UWORD _CNV_S_6_CONV_ERRM__27_CM 1 0. 0. 15. DISPLAY_IDENTIFIER FMY_7_ERR_SYM_LST ECU_ADDRESS 0x7fbe3e BYTE_ORDER MSB_LAST BIT_MASK 0x7800 /end MEASUREMENT
/begin MEASUREMENT fmy_ram_dyn[7].err_info_dyn.lv_err_pnd "" UWORD _CNV_S_2_RANGE______11_CM 1 0. 0. 1. DISPLAY_IDENTIFIER FMY_7_LV_ERR_PND ECU_ADDRESS 0x7fbe3e BYTE_ORDER MSB_LAST BIT_MASK 0x400 /end MEASUREMENT
/begin MEASUREMENT fmy_ram_dyn[7].err_info_dyn.lv_cdn_diag_dc "This flag permits to detect that diag conditions have been met during drinving cycle." UWORD _CNV_S_2_RANGE______11_CM 1 0. 0. 1. DISPLAY_IDENTIFIER FMY_7_LV_CDN_DIAG_DC ECU_ADDRESS 0x7fbe3e BYTE_ORDER MSB_LAST BIT_MASK 0x8000 /end MEASUREMENT
/begin MEASUREMENT fmy_ram_dyn[7].ctr_dc_err_det "Number of driving cycles since DTC detection" UBYTE _CNV_A_R_LINEAR_____1_CM 1 0. 0. 255. DISPLAY_IDENTIFIER FMY_7_CTR_DC_ERR_DET ECU_ADDRESS 0x7fbe44 FORMAT "%3.0" /end MEASUREMENT
/begin MEASUREMENT fmy_ram_dyn[7].ctr_dc_err_det_diag_cdn "Number of driving cycles since DTC detection with diag started within these driving cycle." UBYTE _CNV_A_R_LINEAR_____1_CM 1 0. 0. 255. DISPLAY_IDENTIFIER FMY_7_CTR_DC_ERR_DET_DIAG_CDN ECU_ADDRESS 0x7fbe45 FORMAT "%3.0" /end MEASUREMENT
/begin MEASUREMENT fmy_ram_dyn[7].ctr_dc_err_det_diag_cmpl "Number of driving cycles since DTC detection with diag completed during these driving cycles." UBYTE _CNV_A_R_LINEAR_____1_CM 1 0. 0. 255. DISPLAY_IDENTIFIER FMY_7_CTR_DC_ERR_DET_DIAG_CMPL ECU_ADDRESS 0x7fbe46 FORMAT "%3.0" /end MEASUREMENT
/begin MEASUREMENT fmy_ram_dyn[7].ctr_wup_act_mil "Number of warm-up cycles +1 since MIL activation for this failure" UBYTE _CNV_A_R_LINEAR_____1_CM 1 0. 0. 255. DISPLAY_IDENTIFIER FMY_7_CTR_WUP_ACT_MIL ECU_ADDRESS 0x7fbe47 FORMAT "%3.0" /end MEASUREMENT
/begin MEASUREMENT fmy_ram_dyn[8].dtc_cod "" UWORD _CNV_A_R_LINEAR_____0_CM 1 0. 0. 65535. DISPLAY_IDENTIFIER FMY_8_DTC_COD ECU_ADDRESS 0x7fbe48 BYTE_ORDER MSB_LAST FORMAT "%6.0" /end MEASUREMENT
/begin MEASUREMENT fmy_ram_dyn[8].ctr_frc "Frequency counter of failure N" UBYTE _CNV_A_R_LINEAR_____0_CM 1 0. 0. 255. DISPLAY_IDENTIFIER FMY_8_CTR_FRC ECU_ADDRESS 0x7fbe4e FORMAT "%3.0" /end MEASUREMENT
/begin MEASUREMENT fmy_ram_dyn[8].ctr_wup_cyc "Counter for warm-up cycle" UBYTE _CNV_A_R_LINEAR_____0_CM 1 0. 0. 255. DISPLAY_IDENTIFIER FMY_8_CTR_WUP_CYC ECU_ADDRESS 0x7fbe4f FORMAT "%3.0" /end MEASUREMENT
/begin MEASUREMENT fmy_ram_dyn[8].ctr_dc "Counter for driving cycle" UBYTE _CNV_A_R_LINEAR_____0_CM 1 0. 0. 255. DISPLAY_IDENTIFIER FMY_8_CTR_DC ECU_ADDRESS 0x7fbe50 FORMAT "%3.0" /end MEASUREMENT
/begin MEASUREMENT fmy_ram_dyn[8].diag_inst "" UWORD _CNV_S_173_CONV_DIAG__26_CM 1 0. 0. 172. DISPLAY_IDENTIFIER FMY_8_DIAG_INST ECU_ADDRESS 0x7fbe4a BYTE_ORDER MSB_LAST /end MEASUREMENT
/begin MEASUREMENT fmy_ram_dyn[8].idx_frf "" UBYTE _CNV_A_R_ZYL_ID_2_CM 1 0. 1. 256. DISPLAY_IDENTIFIER FMY_8_IDX_FRF ECU_ADDRESS 0x7fbe51 FORMAT "%3.0" /end MEASUREMENT
/begin MEASUREMENT fmy_ram_dyn[8].err_info_dyn.lv_err_mkd "" UWORD _CNV_S_2_RANGE______11_CM 1 0. 0. 1. DISPLAY_IDENTIFIER FMY_8_LV_ERR_MKD ECU_ADDRESS 0x7fbe4c BYTE_ORDER MSB_LAST BIT_MASK 0x200 /end MEASUREMENT
/begin MEASUREMENT fmy_ram_dyn[8].err_info_dyn.lv_dc_max "" UWORD _CNV_S_2_RANGE______11_CM 1 0. 0. 1. DISPLAY_IDENTIFIER FMY_8_LV_DC_MAX ECU_ADDRESS 0x7fbe4c BYTE_ORDER MSB_LAST BIT_MASK 0x100 /end MEASUREMENT
/begin MEASUREMENT fmy_ram_dyn[8].err_info_dyn.lv_err_disa "" UWORD _CNV_S_2_RANGE______11_CM 1 0. 0. 1. DISPLAY_IDENTIFIER FMY_8_LV_ERR_DISA ECU_ADDRESS 0x7fbe4c BYTE_ORDER MSB_LAST BIT_MASK 0x80 /end MEASUREMENT
/begin MEASUREMENT fmy_ram_dyn[8].err_info_dyn.lv_err_cfm "" UWORD _CNV_S_2_RANGE______11_CM 1 0. 0. 1. DISPLAY_IDENTIFIER FMY_8_LV_ERR_CFM ECU_ADDRESS 0x7fbe4c BYTE_ORDER MSB_LAST BIT_MASK 0x40 /end MEASUREMENT
/begin MEASUREMENT fmy_ram_dyn[8].err_info_dyn.lv_err_tmp "" UWORD _CNV_S_2_RANGE______11_CM 1 0. 0. 1. DISPLAY_IDENTIFIER FMY_8_LV_ERR_TMP ECU_ADDRESS 0x7fbe4c BYTE_ORDER MSB_LAST BIT_MASK 0x20 /end MEASUREMENT
/begin MEASUREMENT fmy_ram_dyn[8].err_info_dyn.lv_err_dc "" UWORD _CNV_S_2_RANGE______11_CM 1 0. 0. 1. DISPLAY_IDENTIFIER FMY_8_LV_ERR_DC ECU_ADDRESS 0x7fbe4c BYTE_ORDER MSB_LAST BIT_MASK 0x10 /end MEASUREMENT
/begin MEASUREMENT fmy_ram_dyn[8].err_info_dyn.err_sym_mem "" UWORD _CNV_S_6_CONV_ERRM__27_CM 1 0. 0. 15. DISPLAY_IDENTIFIER FMY_8_ERR_SYM_MEM ECU_ADDRESS 0x7fbe4c BYTE_ORDER MSB_LAST BIT_MASK 0xF /end MEASUREMENT
/begin MEASUREMENT fmy_ram_dyn[8].err_info_dyn.err_sym_lst "" UWORD _CNV_S_6_CONV_ERRM__27_CM 1 0. 0. 15. DISPLAY_IDENTIFIER FMY_8_ERR_SYM_LST ECU_ADDRESS 0x7fbe4c BYTE_ORDER MSB_LAST BIT_MASK 0x7800 /end MEASUREMENT
/begin MEASUREMENT fmy_ram_dyn[8].err_info_dyn.lv_err_pnd "" UWORD _CNV_S_2_RANGE______11_CM 1 0. 0. 1. DISPLAY_IDENTIFIER FMY_8_LV_ERR_PND ECU_ADDRESS 0x7fbe4c BYTE_ORDER MSB_LAST BIT_MASK 0x400 /end MEASUREMENT
/begin MEASUREMENT fmy_ram_dyn[8].err_info_dyn.lv_cdn_diag_dc "This flag permits to detect that diag conditions have been met during drinving cycle." UWORD _CNV_S_2_RANGE______11_CM 1 0. 0. 1. DISPLAY_IDENTIFIER FMY_8_LV_CDN_DIAG_DC ECU_ADDRESS 0x7fbe4c BYTE_ORDER MSB_LAST BIT_MASK 0x8000 /end MEASUREMENT
/begin MEASUREMENT fmy_ram_dyn[8].ctr_dc_err_det "Number of driving cycles since DTC detection" UBYTE _CNV_A_R_LINEAR_____1_CM 1 0. 0. 255. DISPLAY_IDENTIFIER FMY_8_CTR_DC_ERR_DET ECU_ADDRESS 0x7fbe52 FORMAT "%3.0" /end MEASUREMENT
/begin MEASUREMENT fmy_ram_dyn[8].ctr_dc_err_det_diag_cdn "Number of driving cycles since DTC detection with diag started within these driving cycle." UBYTE _CNV_A_R_LINEAR_____1_CM 1 0. 0. 255. DISPLAY_IDENTIFIER FMY_8_CTR_DC_ERR_DET_DIAG_CDN ECU_ADDRESS 0x7fbe53 FORMAT "%3.0" /end MEASUREMENT
/begin MEASUREMENT fmy_ram_dyn[8].ctr_dc_err_det_diag_cmpl "Number of driving cycles since DTC detection with diag completed during these driving cycles." UBYTE _CNV_A_R_LINEAR_____1_CM 1 0. 0. 255. DISPLAY_IDENTIFIER FMY_8_CTR_DC_ERR_DET_DIAG_CMPL ECU_ADDRESS 0x7fbe54 FORMAT "%3.0" /end MEASUREMENT
/begin MEASUREMENT fmy_ram_dyn[8].ctr_wup_act_mil "Number of warm-up cycles +1 since MIL activation for this failure" UBYTE _CNV_A_R_LINEAR_____1_CM 1 0. 0. 255. DISPLAY_IDENTIFIER FMY_8_CTR_WUP_ACT_MIL ECU_ADDRESS 0x7fbe55 FORMAT "%3.0" /end MEASUREMENT
/begin MEASUREMENT fmy_ram_dyn[9].dtc_cod "" UWORD _CNV_A_R_LINEAR_____0_CM 1 0. 0. 65535. DISPLAY_IDENTIFIER FMY_9_DTC_COD ECU_ADDRESS 0x7fbe56 BYTE_ORDER MSB_LAST FORMAT "%6.0" /end MEASUREMENT
/begin MEASUREMENT fmy_ram_dyn[9].ctr_frc "Frequency counter of failure N" UBYTE _CNV_A_R_LINEAR_____0_CM 1 0. 0. 255. DISPLAY_IDENTIFIER FMY_9_CTR_FRC ECU_ADDRESS 0x7fbe5c FORMAT "%3.0" /end MEASUREMENT
/begin MEASUREMENT fmy_ram_dyn[9].ctr_wup_cyc "Counter for warm-up cycle" UBYTE _CNV_A_R_LINEAR_____0_CM 1 0. 0. 255. DISPLAY_IDENTIFIER FMY_9_CTR_WUP_CYC ECU_ADDRESS 0x7fbe5d FORMAT "%3.0" /end MEASUREMENT
/begin MEASUREMENT fmy_ram_dyn[9].ctr_dc "Counter for driving cycle" UBYTE _CNV_A_R_LINEAR_____0_CM 1 0. 0. 255. DISPLAY_IDENTIFIER FMY_9_CTR_DC ECU_ADDRESS 0x7fbe5e FORMAT "%3.0" /end MEASUREMENT
/begin MEASUREMENT fmy_ram_dyn[9].diag_inst "" UWORD _CNV_S_173_CONV_DIAG__26_CM 1 0. 0. 172. DISPLAY_IDENTIFIER FMY_9_DIAG_INST ECU_ADDRESS 0x7fbe58 BYTE_ORDER MSB_LAST /end MEASUREMENT
/begin MEASUREMENT fmy_ram_dyn[9].idx_frf "" UBYTE _CNV_A_R_ZYL_ID_2_CM 1 0. 1. 256. DISPLAY_IDENTIFIER FMY_9_IDX_FRF ECU_ADDRESS 0x7fbe5f FORMAT "%3.0" /end MEASUREMENT
/begin MEASUREMENT fmy_ram_dyn[9].err_info_dyn.lv_err_mkd "" UWORD _CNV_S_2_RANGE______11_CM 1 0. 0. 1. DISPLAY_IDENTIFIER FMY_9_LV_ERR_MKD ECU_ADDRESS 0x7fbe5a BYTE_ORDER MSB_LAST BIT_MASK 0x200 /end MEASUREMENT
/begin MEASUREMENT fmy_ram_dyn[9].err_info_dyn.lv_dc_max "" UWORD _CNV_S_2_RANGE______11_CM 1 0. 0. 1. DISPLAY_IDENTIFIER FMY_9_LV_DC_MAX ECU_ADDRESS 0x7fbe5a BYTE_ORDER MSB_LAST BIT_MASK 0x100 /end MEASUREMENT
/begin MEASUREMENT fmy_ram_dyn[9].err_info_dyn.lv_err_disa "" UWORD _CNV_S_2_RANGE______11_CM 1 0. 0. 1. DISPLAY_IDENTIFIER FMY_9_LV_ERR_DISA ECU_ADDRESS 0x7fbe5a BYTE_ORDER MSB_LAST BIT_MASK 0x80 /end MEASUREMENT
/begin MEASUREMENT fmy_ram_dyn[9].err_info_dyn.lv_err_cfm "" UWORD _CNV_S_2_RANGE______11_CM 1 0. 0. 1. DISPLAY_IDENTIFIER FMY_9_LV_ERR_CFM ECU_ADDRESS 0x7fbe5a BYTE_ORDER MSB_LAST BIT_MASK 0x40 /end MEASUREMENT
/begin MEASUREMENT fmy_ram_dyn[9].err_info_dyn.lv_err_tmp "" UWORD _CNV_S_2_RANGE______11_CM 1 0. 0. 1. DISPLAY_IDENTIFIER FMY_9_LV_ERR_TMP ECU_ADDRESS 0x7fbe5a BYTE_ORDER MSB_LAST BIT_MASK 0x20 /end MEASUREMENT
/begin MEASUREMENT fmy_ram_dyn[9].err_info_dyn.lv_err_dc "" UWORD _CNV_S_2_RANGE______11_CM 1 0. 0. 1. DISPLAY_IDENTIFIER FMY_9_LV_ERR_DC ECU_ADDRESS 0x7fbe5a BYTE_ORDER MSB_LAST BIT_MASK 0x10 /end MEASUREMENT
/begin MEASUREMENT fmy_ram_dyn[9].err_info_dyn.err_sym_mem "" UWORD _CNV_S_6_CONV_ERRM__27_CM 1 0. 0. 15. DISPLAY_IDENTIFIER FMY_9_ERR_SYM_MEM ECU_ADDRESS 0x7fbe5a BYTE_ORDER MSB_LAST BIT_MASK 0xF /end MEASUREMENT
/begin MEASUREMENT fmy_ram_dyn[9].err_info_dyn.err_sym_lst "" UWORD _CNV_S_6_CONV_ERRM__27_CM 1 0. 0. 15. DISPLAY_IDENTIFIER FMY_9_ERR_SYM_LST ECU_ADDRESS 0x7fbe5a BYTE_ORDER MSB_LAST BIT_MASK 0x7800 /end MEASUREMENT
/begin MEASUREMENT fmy_ram_dyn[9].err_info_dyn.lv_err_pnd "" UWORD _CNV_S_2_RANGE______11_CM 1 0. 0. 1. DISPLAY_IDENTIFIER FMY_9_LV_ERR_PND ECU_ADDRESS 0x7fbe5a BYTE_ORDER MSB_LAST BIT_MASK 0x400 /end MEASUREMENT
/begin MEASUREMENT fmy_ram_dyn[9].err_info_dyn.lv_cdn_diag_dc "This flag permits to detect that diag conditions have been met during drinving cycle." UWORD _CNV_S_2_RANGE______11_CM 1 0. 0. 1. DISPLAY_IDENTIFIER FMY_9_LV_CDN_DIAG_DC ECU_ADDRESS 0x7fbe5a BYTE_ORDER MSB_LAST BIT_MASK 0x8000 /end MEASUREMENT
/begin MEASUREMENT fmy_ram_dyn[9].ctr_dc_err_det "Number of driving cycles since DTC detection" UBYTE _CNV_A_R_LINEAR_____1_CM 1 0. 0. 255. DISPLAY_IDENTIFIER FMY_9_CTR_DC_ERR_DET ECU_ADDRESS 0x7fbe60 FORMAT "%3.0" /end MEASUREMENT
/begin MEASUREMENT fmy_ram_dyn[9].ctr_dc_err_det_diag_cdn "Number of driving cycles since DTC detection with diag started within these driving cycle." UBYTE _CNV_A_R_LINEAR_____1_CM 1 0. 0. 255. DISPLAY_IDENTIFIER FMY_9_CTR_DC_ERR_DET_DIAG_CDN ECU_ADDRESS 0x7fbe61 FORMAT "%3.0" /end MEASUREMENT
/begin MEASUREMENT fmy_ram_dyn[9].ctr_dc_err_det_diag_cmpl "Number of driving cycles since DTC detection with diag completed during these driving cycles." UBYTE _CNV_A_R_LINEAR_____1_CM 1 0. 0. 255. DISPLAY_IDENTIFIER FMY_9_CTR_DC_ERR_DET_DIAG_CMPL ECU_ADDRESS 0x7fbe62 FORMAT "%3.0" /end MEASUREMENT
/begin MEASUREMENT fmy_ram_dyn[9].ctr_wup_act_mil "Number of warm-up cycles +1 since MIL activation for this failure" UBYTE _CNV_A_R_LINEAR_____1_CM 1 0. 0. 255. DISPLAY_IDENTIFIER FMY_9_CTR_WUP_ACT_MIL ECU_ADDRESS 0x7fbe63 FORMAT "%3.0" /end MEASUREMENT
/begin MEASUREMENT tbl_frf[0].envd.header "" UBYTE _CNV_A_R_LINEAR_____0_CM 1 0. 0. 255. DISPLAY_IDENTIFIER FMY_FRF_1_ENVD_HD ECU_ADDRESS 0x7fbe69 FORMAT "%3.0" /end MEASUREMENT
/begin MEASUREMENT tbl_frf[0].envd.cus_set[0][0] "" UBYTE _CNV_A_R_LINEAR_____0_CM 1 0. 0. 255. DISPLAY_IDENTIFIER FMY_FRF_1_ENVD_CUS_SET_1_CMN_1_ ECU_ADDRESS 0x7fbe6a FORMAT "%3.0" /end MEASUREMENT
/begin MEASUREMENT tbl_frf[0].envd.cus_set[0][1] "" UBYTE _CNV_A_R_LINEAR_____0_CM 1 0. 0. 255. DISPLAY_IDENTIFIER FMY_FRF_1_ENVD_CUS_SET_1_CMN_2_ ECU_ADDRESS 0x7fbe6b FORMAT "%3.0" /end MEASUREMENT
/begin MEASUREMENT tbl_frf[0].envd.cus_set[0][2] "" UBYTE _CNV_A_R_LINEAR_____0_CM 1 0. 0. 255. DISPLAY_IDENTIFIER FMY_FRF_1_ENVD_CUS_SET_1_CMN_3_ ECU_ADDRESS 0x7fbe6c FORMAT "%3.0" /end MEASUREMENT
/begin MEASUREMENT tbl_frf[0].envd.cus_set[0][3] "" UBYTE _CNV_A_R_LINEAR_____0_CM 1 0. 0. 255. DISPLAY_IDENTIFIER FMY_FRF_1_ENVD_CUS_SET_1_CMN_4_ ECU_ADDRESS 0x7fbe6d FORMAT "%3.0" /end MEASUREMENT
/begin MEASUREMENT tbl_frf[0].envd.cus_set[0][4] "" UBYTE _CNV_A_R_LINEAR_____0_CM 1 0. 0. 255. DISPLAY_IDENTIFIER FMY_FRF_1_ENVD_CUS_SET_1_CMN_5_ ECU_ADDRESS 0x7fbe6e FORMAT "%3.0" /end MEASUREMENT
/begin MEASUREMENT tbl_frf[0].envd.cus_set[0][5] "" UBYTE _CNV_A_R_LINEAR_____0_CM 1 0. 0. 255. DISPLAY_IDENTIFIER FMY_FRF_1_ENVD_CUS_SET_1_CMN_6_ ECU_ADDRESS 0x7fbe6f FORMAT "%3.0" /end MEASUREMENT
/begin MEASUREMENT tbl_frf[0].envd.cus_set[0][6] "" UBYTE _CNV_A_R_LINEAR_____0_CM 1 0. 0. 255. DISPLAY_IDENTIFIER FMY_FRF_1_ENVD_CUS_SET_1_SPC_1_ ECU_ADDRESS 0x7fbe70 FORMAT "%3.0" /end MEASUREMENT
/begin MEASUREMENT tbl_frf[0].envd.cus_set[0][7] "" UBYTE _CNV_A_R_LINEAR_____0_CM 1 0. 0. 255. DISPLAY_IDENTIFIER FMY_FRF_1_ENVD_CUS_SET_1_SPC_2_ ECU_ADDRESS 0x7fbe71 FORMAT "%3.0" /end MEASUREMENT
/begin MEASUREMENT tbl_frf[0].envd.cus_set[0][8] "" UBYTE _CNV_A_R_LINEAR_____0_CM 1 0. 0. 255. DISPLAY_IDENTIFIER FMY_FRF_1_ENVD_CUS_SET_1_SPC_3_ ECU_ADDRESS 0x7fbe72 FORMAT "%3.0" /end MEASUREMENT
/begin MEASUREMENT tbl_frf[0].envd.cus_set[0][9] "" UBYTE _CNV_A_R_LINEAR_____0_CM 1 0. 0. 255. DISPLAY_IDENTIFIER FMY_FRF_1_ENVD_CUS_SET_1_SPC_4_ ECU_ADDRESS 0x7fbe73 FORMAT "%3.0" /end MEASUREMENT
/begin MEASUREMENT tbl_frf[0].envd.cus_set[0][10] "" UBYTE _CNV_A_R_LINEAR_____0_CM 1 0. 0. 255. DISPLAY_IDENTIFIER FMY_FRF_1_ENVD_CUS_SET_1_SPC_5_ ECU_ADDRESS 0x7fbe74 FORMAT "%3.0" /end MEASUREMENT
/begin MEASUREMENT tbl_frf[0].envd.cus_set[0][11] "" UBYTE _CNV_A_R_LINEAR_____0_CM 1 0. 0. 255. DISPLAY_IDENTIFIER FMY_FRF_1_ENVD_CUS_SET_1_SPC_6_ ECU_ADDRESS 0x7fbe75 FORMAT "%3.0" /end MEASUREMENT
/begin MEASUREMENT tbl_frf[0].envd.cus_set[0][12] "" UBYTE _CNV_A_R_LINEAR_____0_CM 1 0. 0. 255. DISPLAY_IDENTIFIER FMY_FRF_1_ENVD_CUS_SET_1_SPC_7_ ECU_ADDRESS 0x7fbe76 FORMAT "%3.0" /end MEASUREMENT
/begin MEASUREMENT tbl_frf[0].envd.cus_set[0][13] "" UBYTE _CNV_A_R_LINEAR_____0_CM 1 0. 0. 255. DISPLAY_IDENTIFIER FMY_FRF_1_ENVD_CUS_SET_1_SPC_8_ ECU_ADDRESS 0x7fbe77 FORMAT "%3.0" /end MEASUREMENT
/begin MEASUREMENT tbl_frf[0].envd.cus_set[1][0] "" UBYTE _CNV_A_R_LINEAR_____0_CM 1 0. 0. 255. DISPLAY_IDENTIFIER FMY_FRF_1_ENVD_CUS_SET_2_CMN_1_ ECU_ADDRESS 0x7fbe78 FORMAT "%3.0" /end MEASUREMENT
/begin MEASUREMENT tbl_frf[0].envd.cus_set[1][1] "" UBYTE _CNV_A_R_LINEAR_____0_CM 1 0. 0. 255. DISPLAY_IDENTIFIER FMY_FRF_1_ENVD_CUS_SET_2_CMN_2_ ECU_ADDRESS 0x7fbe79 FORMAT "%3.0" /end MEASUREMENT
/begin MEASUREMENT tbl_frf[0].envd.cus_set[1][2] "" UBYTE _CNV_A_R_LINEAR_____0_CM 1 0. 0. 255. DISPLAY_IDENTIFIER FMY_FRF_1_ENVD_CUS_SET_2_CMN_3_ ECU_ADDRESS 0x7fbe7a FORMAT "%3.0" /end MEASUREMENT
/begin MEASUREMENT tbl_frf[0].envd.cus_set[1][3] "" UBYTE _CNV_A_R_LINEAR_____0_CM 1 0. 0. 255. DISPLAY_IDENTIFIER FMY_FRF_1_ENVD_CUS_SET_2_CMN_4_ ECU_ADDRESS 0x7fbe7b FORMAT "%3.0" /end MEASUREMENT
/begin MEASUREMENT tbl_frf[0].envd.cus_set[1][4] "" UBYTE _CNV_A_R_LINEAR_____0_CM 1 0. 0. 255. DISPLAY_IDENTIFIER FMY_FRF_1_ENVD_CUS_SET_2_CMN_5_ ECU_ADDRESS 0x7fbe7c FORMAT "%3.0" /end MEASUREMENT
/begin MEASUREMENT tbl_frf[0].envd.cus_set[1][5] "" UBYTE _CNV_A_R_LINEAR_____0_CM 1 0. 0. 255. DISPLAY_IDENTIFIER FMY_FRF_1_ENVD_CUS_SET_2_CMN_6_ ECU_ADDRESS 0x7fbe7d FORMAT "%3.0" /end MEASUREMENT
/begin MEASUREMENT tbl_frf[0].envd.cus_set[1][6] "" UBYTE _CNV_A_R_LINEAR_____0_CM 1 0. 0. 255. DISPLAY_IDENTIFIER FMY_FRF_1_ENVD_CUS_SET_2_SPC_1_ ECU_ADDRESS 0x7fbe7e FORMAT "%3.0" /end MEASUREMENT
/begin MEASUREMENT tbl_frf[0].envd.cus_set[1][7] "" UBYTE _CNV_A_R_LINEAR_____0_CM 1 0. 0. 255. DISPLAY_IDENTIFIER FMY_FRF_1_ENVD_CUS_SET_2_SPC_2_ ECU_ADDRESS 0x7fbe7f FORMAT "%3.0" /end MEASUREMENT
/begin MEASUREMENT tbl_frf[0].envd.cus_set[1][8] "" UBYTE _CNV_A_R_LINEAR_____0_CM 1 0. 0. 255. DISPLAY_IDENTIFIER FMY_FRF_1_ENVD_CUS_SET_2_SPC_3_ ECU_ADDRESS 0x7fbe80 FORMAT "%3.0" /end MEASUREMENT
/begin MEASUREMENT tbl_frf[0].envd.cus_set[1][9] "" UBYTE _CNV_A_R_LINEAR_____0_CM 1 0. 0. 255. DISPLAY_IDENTIFIER FMY_FRF_1_ENVD_CUS_SET_2_SPC_4_ ECU_ADDRESS 0x7fbe81 FORMAT "%3.0" /end MEASUREMENT
/begin MEASUREMENT tbl_frf[0].envd.cus_set[1][10] "" UBYTE _CNV_A_R_LINEAR_____0_CM 1 0. 0. 255. DISPLAY_IDENTIFIER FMY_FRF_1_ENVD_CUS_SET_2_SPC_5_ ECU_ADDRESS 0x7fbe82 FORMAT "%3.0" /end MEASUREMENT
/begin MEASUREMENT tbl_frf[0].envd.cus_set[1][11] "" UBYTE _CNV_A_R_LINEAR_____0_CM 1 0. 0. 255. DISPLAY_IDENTIFIER FMY_FRF_1_ENVD_CUS_SET_2_SPC_6_ ECU_ADDRESS 0x7fbe83 FORMAT "%3.0" /end MEASUREMENT
/begin MEASUREMENT tbl_frf[0].envd.cus_set[1][12] "" UBYTE _CNV_A_R_LINEAR_____0_CM 1 0. 0. 255. DISPLAY_IDENTIFIER FMY_FRF_1_ENVD_CUS_SET_2_SPC_7_ ECU_ADDRESS 0x7fbe84 FORMAT "%3.0" /end MEASUREMENT
/begin MEASUREMENT tbl_frf[0].envd.cus_set[1][13] "" UBYTE _CNV_A_R_LINEAR_____0_CM 1 0. 0. 255. DISPLAY_IDENTIFIER FMY_FRF_1_ENVD_CUS_SET_2_SPC_8_ ECU_ADDRESS 0x7fbe85 FORMAT "%3.0" /end MEASUREMENT
/begin MEASUREMENT tbl_frf[0].envd.cmn_cus[0] "" UBYTE _CNV_A_R_LINEAR_____0_CM 1 0. 0. 255. DISPLAY_IDENTIFIER FMY_FRF_1_ENVD_CUS_CMN_1_ ECU_ADDRESS 0x7fbe86 FORMAT "%3.0" /end MEASUREMENT
/begin MEASUREMENT tbl_frf[0].envd.obd[0] "" UBYTE _CNV_A_R_LINEAR_____0_CM 1 0. 0. 255. DISPLAY_IDENTIFIER FMY_FRF_1_ENVD_OBD_1_ ECU_ADDRESS 0x7fbe87 FORMAT "%3.0" /end MEASUREMENT
/begin MEASUREMENT tbl_frf[0].envd.obd[1] "" UBYTE _CNV_A_R_LINEAR_____0_CM 1 0. 0. 255. DISPLAY_IDENTIFIER FMY_FRF_1_ENVD_OBD_2_ ECU_ADDRESS 0x7fbe88 FORMAT "%3.0" /end MEASUREMENT
/begin MEASUREMENT tbl_frf[0].envd.obd[2] "" UBYTE _CNV_A_R_LINEAR_____0_CM 1 0. 0. 255. DISPLAY_IDENTIFIER FMY_FRF_1_ENVD_OBD_3_ ECU_ADDRESS 0x7fbe89 FORMAT "%3.0" /end MEASUREMENT
/begin MEASUREMENT tbl_frf[0].envd.obd[3] "" UBYTE _CNV_A_R_LINEAR_____0_CM 1 0. 0. 255. DISPLAY_IDENTIFIER FMY_FRF_1_ENVD_OBD_4_ ECU_ADDRESS 0x7fbe8a FORMAT "%3.0" /end MEASUREMENT
/begin MEASUREMENT tbl_frf[0].envd.obd[4] "" UBYTE _CNV_A_R_LINEAR_____0_CM 1 0. 0. 255. DISPLAY_IDENTIFIER FMY_FRF_1_ENVD_OBD_5_ ECU_ADDRESS 0x7fbe8b FORMAT "%3.0" /end MEASUREMENT
/begin MEASUREMENT tbl_frf[0].envd.obd[5] "" UBYTE _CNV_A_R_LINEAR_____0_CM 1 0. 0. 255. DISPLAY_IDENTIFIER FMY_FRF_1_ENVD_OBD_6_ ECU_ADDRESS 0x7fbe8c FORMAT "%3.0" /end MEASUREMENT
/begin MEASUREMENT tbl_frf[0].envd.obd[6] "" UBYTE _CNV_A_R_LINEAR_____0_CM 1 0. 0. 255. DISPLAY_IDENTIFIER FMY_FRF_1_ENVD_OBD_7_ ECU_ADDRESS 0x7fbe8d FORMAT "%3.0" /end MEASUREMENT
/begin MEASUREMENT tbl_frf[0].envd.obd[7] "" UBYTE _CNV_A_R_LINEAR_____0_CM 1 0. 0. 255. DISPLAY_IDENTIFIER FMY_FRF_1_ENVD_OBD_8_ ECU_ADDRESS 0x7fbe8e FORMAT "%3.0" /end MEASUREMENT
/begin MEASUREMENT tbl_frf[1].envd.header "" UBYTE _CNV_A_R_LINEAR_____0_CM 1 0. 0. 255. DISPLAY_IDENTIFIER FMY_FRF_2_ENVD_HD ECU_ADDRESS 0x7fbe8f FORMAT "%3.0" /end MEASUREMENT
/begin MEASUREMENT tbl_frf[1].envd.cus_set[0][0] "" UBYTE _CNV_A_R_LINEAR_____0_CM 1 0. 0. 255. DISPLAY_IDENTIFIER FMY_FRF_2_ENVD_CUS_SET_1_CMN_1_ ECU_ADDRESS 0x7fbe90 FORMAT "%3.0" /end MEASUREMENT
/begin MEASUREMENT tbl_frf[1].envd.cus_set[0][1] "" UBYTE _CNV_A_R_LINEAR_____0_CM 1 0. 0. 255. DISPLAY_IDENTIFIER FMY_FRF_2_ENVD_CUS_SET_1_CMN_2_ ECU_ADDRESS 0x7fbe91 FORMAT "%3.0" /end MEASUREMENT
/begin MEASUREMENT tbl_frf[1].envd.cus_set[0][2] "" UBYTE _CNV_A_R_LINEAR_____0_CM 1 0. 0. 255. DISPLAY_IDENTIFIER FMY_FRF_2_ENVD_CUS_SET_1_CMN_3_ ECU_ADDRESS 0x7fbe92 FORMAT "%3.0" /end MEASUREMENT
/begin MEASUREMENT tbl_frf[1].envd.cus_set[0][3] "" UBYTE _CNV_A_R_LINEAR_____0_CM 1 0. 0. 255. DISPLAY_IDENTIFIER FMY_FRF_2_ENVD_CUS_SET_1_CMN_4_ ECU_ADDRESS 0x7fbe93 FORMAT "%3.0" /end MEASUREMENT
/begin MEASUREMENT tbl_frf[1].envd.cus_set[0][4] "" UBYTE _CNV_A_R_LINEAR_____0_CM 1 0. 0. 255. DISPLAY_IDENTIFIER FMY_FRF_2_ENVD_CUS_SET_1_CMN_5_ ECU_ADDRESS 0x7fbe94 FORMAT "%3.0" /end MEASUREMENT
/begin MEASUREMENT tbl_frf[1].envd.cus_set[0][5] "" UBYTE _CNV_A_R_LINEAR_____0_CM 1 0. 0. 255. DISPLAY_IDENTIFIER FMY_FRF_2_ENVD_CUS_SET_1_CMN_6_ ECU_ADDRESS 0x7fbe95 FORMAT "%3.0" /end MEASUREMENT
/begin MEASUREMENT tbl_frf[1].envd.cus_set[0][6] "" UBYTE _CNV_A_R_LINEAR_____0_CM 1 0. 0. 255. DISPLAY_IDENTIFIER FMY_FRF_2_ENVD_CUS_SET_1_SPC_1_ ECU_ADDRESS 0x7fbe96 FORMAT "%3.0" /end MEASUREMENT
/begin MEASUREMENT tbl_frf[1].envd.cus_set[0][7] "" UBYTE _CNV_A_R_LINEAR_____0_CM 1 0. 0. 255. DISPLAY_IDENTIFIER FMY_FRF_2_ENVD_CUS_SET_1_SPC_2_ ECU_ADDRESS 0x7fbe97 FORMAT "%3.0" /end MEASUREMENT
/begin MEASUREMENT tbl_frf[1].envd.cus_set[0][8] "" UBYTE _CNV_A_R_LINEAR_____0_CM 1 0. 0. 255. DISPLAY_IDENTIFIER FMY_FRF_2_ENVD_CUS_SET_1_SPC_3_ ECU_ADDRESS 0x7fbe98 FORMAT "%3.0" /end MEASUREMENT
/begin MEASUREMENT tbl_frf[1].envd.cus_set[0][9] "" UBYTE _CNV_A_R_LINEAR_____0_CM 1 0. 0. 255. DISPLAY_IDENTIFIER FMY_FRF_2_ENVD_CUS_SET_1_SPC_4_ ECU_ADDRESS 0x7fbe99 FORMAT "%3.0" /end MEASUREMENT
/begin MEASUREMENT tbl_frf[1].envd.cus_set[0][10] "" UBYTE _CNV_A_R_LINEAR_____0_CM 1 0. 0. 255. DISPLAY_IDENTIFIER FMY_FRF_2_ENVD_CUS_SET_1_SPC_5_ ECU_ADDRESS 0x7fbe9a FORMAT "%3.0" /end MEASUREMENT
/begin MEASUREMENT tbl_frf[1].envd.cus_set[0][11] "" UBYTE _CNV_A_R_LINEAR_____0_CM 1 0. 0. 255. DISPLAY_IDENTIFIER FMY_FRF_2_ENVD_CUS_SET_1_SPC_6_ ECU_ADDRESS 0x7fbe9b FORMAT "%3.0" /end MEASUREMENT
/begin MEASUREMENT tbl_frf[1].envd.cus_set[0][12] "" UBYTE _CNV_A_R_LINEAR_____0_CM 1 0. 0. 255. DISPLAY_IDENTIFIER FMY_FRF_2_ENVD_CUS_SET_1_SPC_7_ ECU_ADDRESS 0x7fbe9c FORMAT "%3.0" /end MEASUREMENT
/begin MEASUREMENT tbl_frf[1].envd.cus_set[0][13] "" UBYTE _CNV_A_R_LINEAR_____0_CM 1 0. 0. 255. DISPLAY_IDENTIFIER FMY_FRF_2_ENVD_CUS_SET_1_SPC_8_ ECU_ADDRESS 0x7fbe9d FORMAT "%3.0" /end MEASUREMENT
/begin MEASUREMENT tbl_frf[1].envd.cus_set[1][0] "" UBYTE _CNV_A_R_LINEAR_____0_CM 1 0. 0. 255. DISPLAY_IDENTIFIER FMY_FRF_2_ENVD_CUS_SET_2_CMN_1_ ECU_ADDRESS 0x7fbe9e FORMAT "%3.0" /end MEASUREMENT
/begin MEASUREMENT tbl_frf[1].envd.cus_set[1][1] "" UBYTE _CNV_A_R_LINEAR_____0_CM 1 0. 0. 255. DISPLAY_IDENTIFIER FMY_FRF_2_ENVD_CUS_SET_2_CMN_2_ ECU_ADDRESS 0x7fbe9f FORMAT "%3.0" /end MEASUREMENT
/begin MEASUREMENT tbl_frf[1].envd.cus_set[1][2] "" UBYTE _CNV_A_R_LINEAR_____0_CM 1 0. 0. 255. DISPLAY_IDENTIFIER FMY_FRF_2_ENVD_CUS_SET_2_CMN_3_ ECU_ADDRESS 0x7fbea0 FORMAT "%3.0" /end MEASUREMENT
/begin MEASUREMENT tbl_frf[1].envd.cus_set[1][3] "" UBYTE _CNV_A_R_LINEAR_____0_CM 1 0. 0. 255. DISPLAY_IDENTIFIER FMY_FRF_2_ENVD_CUS_SET_2_CMN_4_ ECU_ADDRESS 0x7fbea1 FORMAT "%3.0" /end MEASUREMENT
/begin MEASUREMENT tbl_frf[1].envd.cus_set[1][4] "" UBYTE _CNV_A_R_LINEAR_____0_CM 1 0. 0. 255. DISPLAY_IDENTIFIER FMY_FRF_2_ENVD_CUS_SET_2_CMN_5_ ECU_ADDRESS 0x7fbea2 FORMAT "%3.0" /end MEASUREMENT
/begin MEASUREMENT tbl_frf[1].envd.cus_set[1][5] "" UBYTE _CNV_A_R_LINEAR_____0_CM 1 0. 0. 255. DISPLAY_IDENTIFIER FMY_FRF_2_ENVD_CUS_SET_2_CMN_6_ ECU_ADDRESS 0x7fbea3 FORMAT "%3.0" /end MEASUREMENT
/begin MEASUREMENT tbl_frf[1].envd.cus_set[1][6] "" UBYTE _CNV_A_R_LINEAR_____0_CM 1 0. 0. 255. DISPLAY_IDENTIFIER FMY_FRF_2_ENVD_CUS_SET_2_SPC_1_ ECU_ADDRESS 0x7fbea4 FORMAT "%3.0" /end MEASUREMENT
/begin MEASUREMENT tbl_frf[1].envd.cus_set[1][7] "" UBYTE _CNV_A_R_LINEAR_____0_CM 1 0. 0. 255. DISPLAY_IDENTIFIER FMY_FRF_2_ENVD_CUS_SET_2_SPC_2_ ECU_ADDRESS 0x7fbea5 FORMAT "%3.0" /end MEASUREMENT
/begin MEASUREMENT tbl_frf[1].envd.cus_set[1][8] "" UBYTE _CNV_A_R_LINEAR_____0_CM 1 0. 0. 255. DISPLAY_IDENTIFIER FMY_FRF_2_ENVD_CUS_SET_2_SPC_3_ ECU_ADDRESS 0x7fbea6 FORMAT "%3.0" /end MEASUREMENT
/begin MEASUREMENT tbl_frf[1].envd.cus_set[1][9] "" UBYTE _CNV_A_R_LINEAR_____0_CM 1 0. 0. 255. DISPLAY_IDENTIFIER FMY_FRF_2_ENVD_CUS_SET_2_SPC_4_ ECU_ADDRESS 0x7fbea7 FORMAT "%3.0" /end MEASUREMENT
/begin MEASUREMENT tbl_frf[1].envd.cus_set[1][10] "" UBYTE _CNV_A_R_LINEAR_____0_CM 1 0. 0. 255. DISPLAY_IDENTIFIER FMY_FRF_2_ENVD_CUS_SET_2_SPC_5_ ECU_ADDRESS 0x7fbea8 FORMAT "%3.0" /end MEASUREMENT
/begin MEASUREMENT tbl_frf[1].envd.cus_set[1][11] "" UBYTE _CNV_A_R_LINEAR_____0_CM 1 0. 0. 255. DISPLAY_IDENTIFIER FMY_FRF_2_ENVD_CUS_SET_2_SPC_6_ ECU_ADDRESS 0x7fbea9 FORMAT "%3.0" /end MEASUREMENT
/begin MEASUREMENT tbl_frf[1].envd.cus_set[1][12] "" UBYTE _CNV_A_R_LINEAR_____0_CM 1 0. 0. 255. DISPLAY_IDENTIFIER FMY_FRF_2_ENVD_CUS_SET_2_SPC_7_ ECU_ADDRESS 0x7fbeaa FORMAT "%3.0" /end MEASUREMENT
/begin MEASUREMENT tbl_frf[1].envd.cus_set[1][13] "" UBYTE _CNV_A_R_LINEAR_____0_CM 1 0. 0. 255. DISPLAY_IDENTIFIER FMY_FRF_2_ENVD_CUS_SET_2_SPC_8_ ECU_ADDRESS 0x7fbeab FORMAT "%3.0" /end MEASUREMENT
/begin MEASUREMENT tbl_frf[1].envd.cmn_cus[0] "" UBYTE _CNV_A_R_LINEAR_____0_CM 1 0. 0. 255. DISPLAY_IDENTIFIER FMY_FRF_2_ENVD_CUS_CMN_1_ ECU_ADDRESS 0x7fbeac FORMAT "%3.0" /end MEASUREMENT
/begin MEASUREMENT tbl_frf[1].envd.obd[0] "" UBYTE _CNV_A_R_LINEAR_____0_CM 1 0. 0. 255. DISPLAY_IDENTIFIER FMY_FRF_2_ENVD_OBD_1_ ECU_ADDRESS 0x7fbead FORMAT "%3.0" /end MEASUREMENT
/begin MEASUREMENT tbl_frf[1].envd.obd[1] "" UBYTE _CNV_A_R_LINEAR_____0_CM 1 0. 0. 255. DISPLAY_IDENTIFIER FMY_FRF_2_ENVD_OBD_2_ ECU_ADDRESS 0x7fbeae FORMAT "%3.0" /end MEASUREMENT
/begin MEASUREMENT tbl_frf[1].envd.obd[2] "" UBYTE _CNV_A_R_LINEAR_____0_CM 1 0. 0. 255. DISPLAY_IDENTIFIER FMY_FRF_2_ENVD_OBD_3_ ECU_ADDRESS 0x7fbeaf FORMAT "%3.0" /end MEASUREMENT
/begin MEASUREMENT tbl_frf[1].envd.obd[3] "" UBYTE _CNV_A_R_LINEAR_____0_CM 1 0. 0. 255. DISPLAY_IDENTIFIER FMY_FRF_2_ENVD_OBD_4_ ECU_ADDRESS 0x7fbeb0 FORMAT "%3.0" /end MEASUREMENT
/begin MEASUREMENT tbl_frf[1].envd.obd[4] "" UBYTE _CNV_A_R_LINEAR_____0_CM 1 0. 0. 255. DISPLAY_IDENTIFIER FMY_FRF_2_ENVD_OBD_5_ ECU_ADDRESS 0x7fbeb1 FORMAT "%3.0" /end MEASUREMENT
/begin MEASUREMENT tbl_frf[1].envd.obd[5] "" UBYTE _CNV_A_R_LINEAR_____0_CM 1 0. 0. 255. DISPLAY_IDENTIFIER FMY_FRF_2_ENVD_OBD_6_ ECU_ADDRESS 0x7fbeb2 FORMAT "%3.0" /end MEASUREMENT
/begin MEASUREMENT tbl_frf[1].envd.obd[6] "" UBYTE _CNV_A_R_LINEAR_____0_CM 1 0. 0. 255. DISPLAY_IDENTIFIER FMY_FRF_2_ENVD_OBD_7_ ECU_ADDRESS 0x7fbeb3 FORMAT "%3.0" /end MEASUREMENT
/begin MEASUREMENT tbl_frf[1].envd.obd[7] "" UBYTE _CNV_A_R_LINEAR_____0_CM 1 0. 0. 255. DISPLAY_IDENTIFIER FMY_FRF_2_ENVD_OBD_8_ ECU_ADDRESS 0x7fbeb4 FORMAT "%3.0" /end MEASUREMENT
/begin MEASUREMENT tbl_frf[2].envd.header "" UBYTE _CNV_A_R_LINEAR_____0_CM 1 0. 0. 255. DISPLAY_IDENTIFIER FMY_FRF_3_ENVD_HD ECU_ADDRESS 0x7fbeb5 FORMAT "%3.0" /end MEASUREMENT
/begin MEASUREMENT tbl_frf[2].envd.cus_set[0][0] "" UBYTE _CNV_A_R_LINEAR_____0_CM 1 0. 0. 255. DISPLAY_IDENTIFIER FMY_FRF_3_ENVD_CUS_SET_1_CMN_1_ ECU_ADDRESS 0x7fbeb6 FORMAT "%3.0" /end MEASUREMENT
/begin MEASUREMENT tbl_frf[2].envd.cus_set[0][1] "" UBYTE _CNV_A_R_LINEAR_____0_CM 1 0. 0. 255. DISPLAY_IDENTIFIER FMY_FRF_3_ENVD_CUS_SET_1_CMN_2_ ECU_ADDRESS 0x7fbeb7 FORMAT "%3.0" /end MEASUREMENT
/begin MEASUREMENT tbl_frf[2].envd.cus_set[0][2] "" UBYTE _CNV_A_R_LINEAR_____0_CM 1 0. 0. 255. DISPLAY_IDENTIFIER FMY_FRF_3_ENVD_CUS_SET_1_CMN_3_ ECU_ADDRESS 0x7fbeb8 FORMAT "%3.0" /end MEASUREMENT
/begin MEASUREMENT tbl_frf[2].envd.cus_set[0][3] "" UBYTE _CNV_A_R_LINEAR_____0_CM 1 0. 0. 255. DISPLAY_IDENTIFIER FMY_FRF_3_ENVD_CUS_SET_1_CMN_4_ ECU_ADDRESS 0x7fbeb9 FORMAT "%3.0" /end MEASUREMENT
/begin MEASUREMENT tbl_frf[2].envd.cus_set[0][4] "" UBYTE _CNV_A_R_LINEAR_____0_CM 1 0. 0. 255. DISPLAY_IDENTIFIER FMY_FRF_3_ENVD_CUS_SET_1_CMN_5_ ECU_ADDRESS 0x7fbeba FORMAT "%3.0" /end MEASUREMENT
/begin MEASUREMENT tbl_frf[2].envd.cus_set[0][5] "" UBYTE _CNV_A_R_LINEAR_____0_CM 1 0. 0. 255. DISPLAY_IDENTIFIER FMY_FRF_3_ENVD_CUS_SET_1_CMN_6_ ECU_ADDRESS 0x7fbebb FORMAT "%3.0" /end MEASUREMENT
/begin MEASUREMENT tbl_frf[2].envd.cus_set[0][6] "" UBYTE _CNV_A_R_LINEAR_____0_CM 1 0. 0. 255. DISPLAY_IDENTIFIER FMY_FRF_3_ENVD_CUS_SET_1_SPC_1_ ECU_ADDRESS 0x7fbebc FORMAT "%3.0" /end MEASUREMENT
/begin MEASUREMENT tbl_frf[2].envd.cus_set[0][7] "" UBYTE _CNV_A_R_LINEAR_____0_CM 1 0. 0. 255. DISPLAY_IDENTIFIER FMY_FRF_3_ENVD_CUS_SET_1_SPC_2_ ECU_ADDRESS 0x7fbebd FORMAT "%3.0" /end MEASUREMENT
/begin MEASUREMENT tbl_frf[2].envd.cus_set[0][8] "" UBYTE _CNV_A_R_LINEAR_____0_CM 1 0. 0. 255. DISPLAY_IDENTIFIER FMY_FRF_3_ENVD_CUS_SET_1_SPC_3_ ECU_ADDRESS 0x7fbebe FORMAT "%3.0" /end MEASUREMENT
/begin MEASUREMENT tbl_frf[2].envd.cus_set[0][9] "" UBYTE _CNV_A_R_LINEAR_____0_CM 1 0. 0. 255. DISPLAY_IDENTIFIER FMY_FRF_3_ENVD_CUS_SET_1_SPC_4_ ECU_ADDRESS 0x7fbebf FORMAT "%3.0" /end MEASUREMENT
/begin MEASUREMENT tbl_frf[2].envd.cus_set[0][10] "" UBYTE _CNV_A_R_LINEAR_____0_CM 1 0. 0. 255. DISPLAY_IDENTIFIER FMY_FRF_3_ENVD_CUS_SET_1_SPC_5_ ECU_ADDRESS 0x7fbec0 FORMAT "%3.0" /end MEASUREMENT
/begin MEASUREMENT tbl_frf[2].envd.cus_set[0][11] "" UBYTE _CNV_A_R_LINEAR_____0_CM 1 0. 0. 255. DISPLAY_IDENTIFIER FMY_FRF_3_ENVD_CUS_SET_1_SPC_6_ ECU_ADDRESS 0x7fbec1 FORMAT "%3.0" /end MEASUREMENT
/begin MEASUREMENT tbl_frf[2].envd.cus_set[0][12] "" UBYTE _CNV_A_R_LINEAR_____0_CM 1 0. 0. 255. DISPLAY_IDENTIFIER FMY_FRF_3_ENVD_CUS_SET_1_SPC_7_ ECU_ADDRESS 0x7fbec2 FORMAT "%3.0" /end MEASUREMENT
/begin MEASUREMENT tbl_frf[2].envd.cus_set[0][13] "" UBYTE _CNV_A_R_LINEAR_____0_CM 1 0. 0. 255. DISPLAY_IDENTIFIER FMY_FRF_3_ENVD_CUS_SET_1_SPC_8_ ECU_ADDRESS 0x7fbec3 FORMAT "%3.0" /end MEASUREMENT
/begin MEASUREMENT tbl_frf[2].envd.cus_set[1][0] "" UBYTE _CNV_A_R_LINEAR_____0_CM 1 0. 0. 255. DISPLAY_IDENTIFIER FMY_FRF_3_ENVD_CUS_SET_2_CMN_1_ ECU_ADDRESS 0x7fbec4 FORMAT "%3.0" /end MEASUREMENT
/begin MEASUREMENT tbl_frf[2].envd.cus_set[1][1] "" UBYTE _CNV_A_R_LINEAR_____0_CM 1 0. 0. 255. DISPLAY_IDENTIFIER FMY_FRF_3_ENVD_CUS_SET_2_CMN_2_ ECU_ADDRESS 0x7fbec5 FORMAT "%3.0" /end MEASUREMENT
/begin MEASUREMENT tbl_frf[2].envd.cus_set[1][2] "" UBYTE _CNV_A_R_LINEAR_____0_CM 1 0. 0. 255. DISPLAY_IDENTIFIER FMY_FRF_3_ENVD_CUS_SET_2_CMN_3_ ECU_ADDRESS 0x7fbec6 FORMAT "%3.0" /end MEASUREMENT
/begin MEASUREMENT tbl_frf[2].envd.cus_set[1][3] "" UBYTE _CNV_A_R_LINEAR_____0_CM 1 0. 0. 255. DISPLAY_IDENTIFIER FMY_FRF_3_ENVD_CUS_SET_2_CMN_4_ ECU_ADDRESS 0x7fbec7 FORMAT "%3.0" /end MEASUREMENT
/begin MEASUREMENT tbl_frf[2].envd.cus_set[1][4] "" UBYTE _CNV_A_R_LINEAR_____0_CM 1 0. 0. 255. DISPLAY_IDENTIFIER FMY_FRF_3_ENVD_CUS_SET_2_CMN_5_ ECU_ADDRESS 0x7fbec8 FORMAT "%3.0" /end MEASUREMENT
/begin MEASUREMENT tbl_frf[2].envd.cus_set[1][5] "" UBYTE _CNV_A_R_LINEAR_____0_CM 1 0. 0. 255. DISPLAY_IDENTIFIER FMY_FRF_3_ENVD_CUS_SET_2_CMN_6_ ECU_ADDRESS 0x7fbec9 FORMAT "%3.0" /end MEASUREMENT
/begin MEASUREMENT tbl_frf[2].envd.cus_set[1][6] "" UBYTE _CNV_A_R_LINEAR_____0_CM 1 0. 0. 255. DISPLAY_IDENTIFIER FMY_FRF_3_ENVD_CUS_SET_2_SPC_1_ ECU_ADDRESS 0x7fbeca FORMAT "%3.0" /end MEASUREMENT
/begin MEASUREMENT tbl_frf[2].envd.cus_set[1][7] "" UBYTE _CNV_A_R_LINEAR_____0_CM 1 0. 0. 255. DISPLAY_IDENTIFIER FMY_FRF_3_ENVD_CUS_SET_2_SPC_2_ ECU_ADDRESS 0x7fbecb FORMAT "%3.0" /end MEASUREMENT
/begin MEASUREMENT tbl_frf[2].envd.cus_set[1][8] "" UBYTE _CNV_A_R_LINEAR_____0_CM 1 0. 0. 255. DISPLAY_IDENTIFIER FMY_FRF_3_ENVD_CUS_SET_2_SPC_3_ ECU_ADDRESS 0x7fbecc FORMAT "%3.0" /end MEASUREMENT
/begin MEASUREMENT tbl_frf[2].envd.cus_set[1][9] "" UBYTE _CNV_A_R_LINEAR_____0_CM 1 0. 0. 255. DISPLAY_IDENTIFIER FMY_FRF_3_ENVD_CUS_SET_2_SPC_4_ ECU_ADDRESS 0x7fbecd FORMAT "%3.0" /end MEASUREMENT
/begin MEASUREMENT tbl_frf[2].envd.cus_set[1][10] "" UBYTE _CNV_A_R_LINEAR_____0_CM 1 0. 0. 255. DISPLAY_IDENTIFIER FMY_FRF_3_ENVD_CUS_SET_2_SPC_5_ ECU_ADDRESS 0x7fbece FORMAT "%3.0" /end MEASUREMENT
/begin MEASUREMENT tbl_frf[2].envd.cus_set[1][11] "" UBYTE _CNV_A_R_LINEAR_____0_CM 1 0. 0. 255. DISPLAY_IDENTIFIER FMY_FRF_3_ENVD_CUS_SET_2_SPC_6_ ECU_ADDRESS 0x7fbecf FORMAT "%3.0" /end MEASUREMENT
/begin MEASUREMENT tbl_frf[2].envd.cus_set[1][12] "" UBYTE _CNV_A_R_LINEAR_____0_CM 1 0. 0. 255. DISPLAY_IDENTIFIER FMY_FRF_3_ENVD_CUS_SET_2_SPC_7_ ECU_ADDRESS 0x7fbed0 FORMAT "%3.0" /end MEASUREMENT
/begin MEASUREMENT tbl_frf[2].envd.cus_set[1][13] "" UBYTE _CNV_A_R_LINEAR_____0_CM 1 0. 0. 255. DISPLAY_IDENTIFIER FMY_FRF_3_ENVD_CUS_SET_2_SPC_8_ ECU_ADDRESS 0x7fbed1 FORMAT "%3.0" /end MEASUREMENT
/begin MEASUREMENT tbl_frf[2].envd.cmn_cus[0] "" UBYTE _CNV_A_R_LINEAR_____0_CM 1 0. 0. 255. DISPLAY_IDENTIFIER FMY_FRF_3_ENVD_CUS_CMN_1_ ECU_ADDRESS 0x7fbed2 FORMAT "%3.0" /end MEASUREMENT
/begin MEASUREMENT tbl_frf[2].envd.obd[0] "" UBYTE _CNV_A_R_LINEAR_____0_CM 1 0. 0. 255. DISPLAY_IDENTIFIER FMY_FRF_3_ENVD_OBD_1_ ECU_ADDRESS 0x7fbed3 FORMAT "%3.0" /end MEASUREMENT
/begin MEASUREMENT tbl_frf[2].envd.obd[1] "" UBYTE _CNV_A_R_LINEAR_____0_CM 1 0. 0. 255. DISPLAY_IDENTIFIER FMY_FRF_3_ENVD_OBD_2_ ECU_ADDRESS 0x7fbed4 FORMAT "%3.0" /end MEASUREMENT
/begin MEASUREMENT tbl_frf[2].envd.obd[2] "" UBYTE _CNV_A_R_LINEAR_____0_CM 1 0. 0. 255. DISPLAY_IDENTIFIER FMY_FRF_3_ENVD_OBD_3_ ECU_ADDRESS 0x7fbed5 FORMAT "%3.0" /end MEASUREMENT
/begin MEASUREMENT tbl_frf[2].envd.obd[3] "" UBYTE _CNV_A_R_LINEAR_____0_CM 1 0. 0. 255. DISPLAY_IDENTIFIER FMY_FRF_3_ENVD_OBD_4_ ECU_ADDRESS 0x7fbed6 FORMAT "%3.0" /end MEASUREMENT
/begin MEASUREMENT tbl_frf[2].envd.obd[4] "" UBYTE _CNV_A_R_LINEAR_____0_CM 1 0. 0. 255. DISPLAY_IDENTIFIER FMY_FRF_3_ENVD_OBD_5_ ECU_ADDRESS 0x7fbed7 FORMAT "%3.0" /end MEASUREMENT
/begin MEASUREMENT tbl_frf[2].envd.obd[5] "" UBYTE _CNV_A_R_LINEAR_____0_CM 1 0. 0. 255. DISPLAY_IDENTIFIER FMY_FRF_3_ENVD_OBD_6_ ECU_ADDRESS 0x7fbed8 FORMAT "%3.0" /end MEASUREMENT
/begin MEASUREMENT tbl_frf[2].envd.obd[6] "" UBYTE _CNV_A_R_LINEAR_____0_CM 1 0. 0. 255. DISPLAY_IDENTIFIER FMY_FRF_3_ENVD_OBD_7_ ECU_ADDRESS 0x7fbed9 FORMAT "%3.0" /end MEASUREMENT
/begin MEASUREMENT tbl_frf[2].envd.obd[7] "" UBYTE _CNV_A_R_LINEAR_____0_CM 1 0. 0. 255. DISPLAY_IDENTIFIER FMY_FRF_3_ENVD_OBD_8_ ECU_ADDRESS 0x7fbeda FORMAT "%3.0" /end MEASUREMENT
/begin MEASUREMENT tbl_frf[3].envd.header "" UBYTE _CNV_A_R_LINEAR_____0_CM 1 0. 0. 255. DISPLAY_IDENTIFIER FMY_FRF_4_ENVD_HD ECU_ADDRESS 0x7fbedb FORMAT "%3.0" /end MEASUREMENT
/begin MEASUREMENT tbl_frf[3].envd.cus_set[0][0] "" UBYTE _CNV_A_R_LINEAR_____0_CM 1 0. 0. 255. DISPLAY_IDENTIFIER FMY_FRF_4_ENVD_CUS_SET_1_CMN_1_ ECU_ADDRESS 0x7fbedc FORMAT "%3.0" /end MEASUREMENT
/begin MEASUREMENT tbl_frf[3].envd.cus_set[0][1] "" UBYTE _CNV_A_R_LINEAR_____0_CM 1 0. 0. 255. DISPLAY_IDENTIFIER FMY_FRF_4_ENVD_CUS_SET_1_CMN_2_ ECU_ADDRESS 0x7fbedd FORMAT "%3.0" /end MEASUREMENT
/begin MEASUREMENT tbl_frf[3].envd.cus_set[0][2] "" UBYTE _CNV_A_R_LINEAR_____0_CM 1 0. 0. 255. DISPLAY_IDENTIFIER FMY_FRF_4_ENVD_CUS_SET_1_CMN_3_ ECU_ADDRESS 0x7fbede FORMAT "%3.0" /end MEASUREMENT
/begin MEASUREMENT tbl_frf[3].envd.cus_set[0][3] "" UBYTE _CNV_A_R_LINEAR_____0_CM 1 0. 0. 255. DISPLAY_IDENTIFIER FMY_FRF_4_ENVD_CUS_SET_1_CMN_4_ ECU_ADDRESS 0x7fbedf FORMAT "%3.0" /end MEASUREMENT
/begin MEASUREMENT tbl_frf[3].envd.cus_set[0][4] "" UBYTE _CNV_A_R_LINEAR_____0_CM 1 0. 0. 255. DISPLAY_IDENTIFIER FMY_FRF_4_ENVD_CUS_SET_1_CMN_5_ ECU_ADDRESS 0x7fbee0 FORMAT "%3.0" /end MEASUREMENT
/begin MEASUREMENT tbl_frf[3].envd.cus_set[0][5] "" UBYTE _CNV_A_R_LINEAR_____0_CM 1 0. 0. 255. DISPLAY_IDENTIFIER FMY_FRF_4_ENVD_CUS_SET_1_CMN_6_ ECU_ADDRESS 0x7fbee1 FORMAT "%3.0" /end MEASUREMENT
/begin MEASUREMENT tbl_frf[3].envd.cus_set[0][6] "" UBYTE _CNV_A_R_LINEAR_____0_CM 1 0. 0. 255. DISPLAY_IDENTIFIER FMY_FRF_4_ENVD_CUS_SET_1_SPC_1_ ECU_ADDRESS 0x7fbee2 FORMAT "%3.0" /end MEASUREMENT
/begin MEASUREMENT tbl_frf[3].envd.cus_set[0][7] "" UBYTE _CNV_A_R_LINEAR_____0_CM 1 0. 0. 255. DISPLAY_IDENTIFIER FMY_FRF_4_ENVD_CUS_SET_1_SPC_2_ ECU_ADDRESS 0x7fbee3 FORMAT "%3.0" /end MEASUREMENT
/begin MEASUREMENT tbl_frf[3].envd.cus_set[0][8] "" UBYTE _CNV_A_R_LINEAR_____0_CM 1 0. 0. 255. DISPLAY_IDENTIFIER FMY_FRF_4_ENVD_CUS_SET_1_SPC_3_ ECU_ADDRESS 0x7fbee4 FORMAT "%3.0" /end MEASUREMENT
/begin MEASUREMENT tbl_frf[3].envd.cus_set[0][9] "" UBYTE _CNV_A_R_LINEAR_____0_CM 1 0. 0. 255. DISPLAY_IDENTIFIER FMY_FRF_4_ENVD_CUS_SET_1_SPC_4_ ECU_ADDRESS 0x7fbee5 FORMAT "%3.0" /end MEASUREMENT
/begin MEASUREMENT tbl_frf[3].envd.cus_set[0][10] "" UBYTE _CNV_A_R_LINEAR_____0_CM 1 0. 0. 255. DISPLAY_IDENTIFIER FMY_FRF_4_ENVD_CUS_SET_1_SPC_5_ ECU_ADDRESS 0x7fbee6 FORMAT "%3.0" /end MEASUREMENT
/begin MEASUREMENT tbl_frf[3].envd.cus_set[0][11] "" UBYTE _CNV_A_R_LINEAR_____0_CM 1 0. 0. 255. DISPLAY_IDENTIFIER FMY_FRF_4_ENVD_CUS_SET_1_SPC_6_ ECU_ADDRESS 0x7fbee7 FORMAT "%3.0" /end MEASUREMENT
/begin MEASUREMENT tbl_frf[3].envd.cus_set[0][12] "" UBYTE _CNV_A_R_LINEAR_____0_CM 1 0. 0. 255. DISPLAY_IDENTIFIER FMY_FRF_4_ENVD_CUS_SET_1_SPC_7_ ECU_ADDRESS 0x7fbee8 FORMAT "%3.0" /end MEASUREMENT
/begin MEASUREMENT tbl_frf[3].envd.cus_set[0][13] "" UBYTE _CNV_A_R_LINEAR_____0_CM 1 0. 0. 255. DISPLAY_IDENTIFIER FMY_FRF_4_ENVD_CUS_SET_1_SPC_8_ ECU_ADDRESS 0x7fbee9 FORMAT "%3.0" /end MEASUREMENT
/begin MEASUREMENT tbl_frf[3].envd.cus_set[1][0] "" UBYTE _CNV_A_R_LINEAR_____0_CM 1 0. 0. 255. DISPLAY_IDENTIFIER FMY_FRF_4_ENVD_CUS_SET_2_CMN_1_ ECU_ADDRESS 0x7fbeea FORMAT "%3.0" /end MEASUREMENT
/begin MEASUREMENT tbl_frf[3].envd.cus_set[1][1] "" UBYTE _CNV_A_R_LINEAR_____0_CM 1 0. 0. 255. DISPLAY_IDENTIFIER FMY_FRF_4_ENVD_CUS_SET_2_CMN_2_ ECU_ADDRESS 0x7fbeeb FORMAT "%3.0" /end MEASUREMENT
/begin MEASUREMENT tbl_frf[3].envd.cus_set[1][2] "" UBYTE _CNV_A_R_LINEAR_____0_CM 1 0. 0. 255. DISPLAY_IDENTIFIER FMY_FRF_4_ENVD_CUS_SET_2_CMN_3_ ECU_ADDRESS 0x7fbeec FORMAT "%3.0" /end MEASUREMENT
/begin MEASUREMENT tbl_frf[3].envd.cus_set[1][3] "" UBYTE _CNV_A_R_LINEAR_____0_CM 1 0. 0. 255. DISPLAY_IDENTIFIER FMY_FRF_4_ENVD_CUS_SET_2_CMN_4_ ECU_ADDRESS 0x7fbeed FORMAT "%3.0" /end MEASUREMENT
/begin MEASUREMENT tbl_frf[3].envd.cus_set[1][4] "" UBYTE _CNV_A_R_LINEAR_____0_CM 1 0. 0. 255. DISPLAY_IDENTIFIER FMY_FRF_4_ENVD_CUS_SET_2_CMN_5_ ECU_ADDRESS 0x7fbeee FORMAT "%3.0" /end MEASUREMENT
/begin MEASUREMENT tbl_frf[3].envd.cus_set[1][5] "" UBYTE _CNV_A_R_LINEAR_____0_CM 1 0. 0. 255. DISPLAY_IDENTIFIER FMY_FRF_4_ENVD_CUS_SET_2_CMN_6_ ECU_ADDRESS 0x7fbeef FORMAT "%3.0" /end MEASUREMENT
/begin MEASUREMENT tbl_frf[3].envd.cus_set[1][6] "" UBYTE _CNV_A_R_LINEAR_____0_CM 1 0. 0. 255. DISPLAY_IDENTIFIER FMY_FRF_4_ENVD_CUS_SET_2_SPC_1_ ECU_ADDRESS 0x7fbef0 FORMAT "%3.0" /end MEASUREMENT
/begin MEASUREMENT tbl_frf[3].envd.cus_set[1][7] "" UBYTE _CNV_A_R_LINEAR_____0_CM 1 0. 0. 255. DISPLAY_IDENTIFIER FMY_FRF_4_ENVD_CUS_SET_2_SPC_2_ ECU_ADDRESS 0x7fbef1 FORMAT "%3.0" /end MEASUREMENT
/begin MEASUREMENT tbl_frf[3].envd.cus_set[1][8] "" UBYTE _CNV_A_R_LINEAR_____0_CM 1 0. 0. 255. DISPLAY_IDENTIFIER FMY_FRF_4_ENVD_CUS_SET_2_SPC_3_ ECU_ADDRESS 0x7fbef2 FORMAT "%3.0" /end MEASUREMENT
/begin MEASUREMENT tbl_frf[3].envd.cus_set[1][9] "" UBYTE _CNV_A_R_LINEAR_____0_CM 1 0. 0. 255. DISPLAY_IDENTIFIER FMY_FRF_4_ENVD_CUS_SET_2_SPC_4_ ECU_ADDRESS 0x7fbef3 FORMAT "%3.0" /end MEASUREMENT
/begin MEASUREMENT tbl_frf[3].envd.cus_set[1][10] "" UBYTE _CNV_A_R_LINEAR_____0_CM 1 0. 0. 255. DISPLAY_IDENTIFIER FMY_FRF_4_ENVD_CUS_SET_2_SPC_5_ ECU_ADDRESS 0x7fbef4 FORMAT "%3.0" /end MEASUREMENT
/begin MEASUREMENT tbl_frf[3].envd.cus_set[1][11] "" UBYTE _CNV_A_R_LINEAR_____0_CM 1 0. 0. 255. DISPLAY_IDENTIFIER FMY_FRF_4_ENVD_CUS_SET_2_SPC_6_ ECU_ADDRESS 0x7fbef5 FORMAT "%3.0" /end MEASUREMENT
/begin MEASUREMENT tbl_frf[3].envd.cus_set[1][12] "" UBYTE _CNV_A_R_LINEAR_____0_CM 1 0. 0. 255. DISPLAY_IDENTIFIER FMY_FRF_4_ENVD_CUS_SET_2_SPC_7_ ECU_ADDRESS 0x7fbef6 FORMAT "%3.0" /end MEASUREMENT
/begin MEASUREMENT tbl_frf[3].envd.cus_set[1][13] "" UBYTE _CNV_A_R_LINEAR_____0_CM 1 0. 0. 255. DISPLAY_IDENTIFIER FMY_FRF_4_ENVD_CUS_SET_2_SPC_8_ ECU_ADDRESS 0x7fbef7 FORMAT "%3.0" /end MEASUREMENT
/begin MEASUREMENT tbl_frf[3].envd.cmn_cus[0] "" UBYTE _CNV_A_R_LINEAR_____0_CM 1 0. 0. 255. DISPLAY_IDENTIFIER FMY_FRF_4_ENVD_CUS_CMN_1_ ECU_ADDRESS 0x7fbef8 FORMAT "%3.0" /end MEASUREMENT
/begin MEASUREMENT tbl_frf[3].envd.obd[0] "" UBYTE _CNV_A_R_LINEAR_____0_CM 1 0. 0. 255. DISPLAY_IDENTIFIER FMY_FRF_4_ENVD_OBD_1_ ECU_ADDRESS 0x7fbef9 FORMAT "%3.0" /end MEASUREMENT
/begin MEASUREMENT tbl_frf[3].envd.obd[1] "" UBYTE _CNV_A_R_LINEAR_____0_CM 1 0. 0. 255. DISPLAY_IDENTIFIER FMY_FRF_4_ENVD_OBD_2_ ECU_ADDRESS 0x7fbefa FORMAT "%3.0" /end MEASUREMENT
/begin MEASUREMENT tbl_frf[3].envd.obd[2] "" UBYTE _CNV_A_R_LINEAR_____0_CM 1 0. 0. 255. DISPLAY_IDENTIFIER FMY_FRF_4_ENVD_OBD_3_ ECU_ADDRESS 0x7fbefb FORMAT "%3.0" /end MEASUREMENT
/begin MEASUREMENT tbl_frf[3].envd.obd[3] "" UBYTE _CNV_A_R_LINEAR_____0_CM 1 0. 0. 255. DISPLAY_IDENTIFIER FMY_FRF_4_ENVD_OBD_4_ ECU_ADDRESS 0x7fbefc FORMAT "%3.0" /end MEASUREMENT
/begin MEASUREMENT tbl_frf[3].envd.obd[4] "" UBYTE _CNV_A_R_LINEAR_____0_CM 1 0. 0. 255. DISPLAY_IDENTIFIER FMY_FRF_4_ENVD_OBD_5_ ECU_ADDRESS 0x7fbefd FORMAT "%3.0" /end MEASUREMENT
/begin MEASUREMENT tbl_frf[3].envd.obd[5] "" UBYTE _CNV_A_R_LINEAR_____0_CM 1 0. 0. 255. DISPLAY_IDENTIFIER FMY_FRF_4_ENVD_OBD_6_ ECU_ADDRESS 0x7fbefe FORMAT "%3.0" /end MEASUREMENT
/begin MEASUREMENT tbl_frf[3].envd.obd[6] "" UBYTE _CNV_A_R_LINEAR_____0_CM 1 0. 0. 255. DISPLAY_IDENTIFIER FMY_FRF_4_ENVD_OBD_7_ ECU_ADDRESS 0x7fbeff FORMAT "%3.0" /end MEASUREMENT
/begin MEASUREMENT tbl_frf[3].envd.obd[7] "" UBYTE _CNV_A_R_LINEAR_____0_CM 1 0. 0. 255. DISPLAY_IDENTIFIER FMY_FRF_4_ENVD_OBD_8_ ECU_ADDRESS 0x7fbf00 FORMAT "%3.0" /end MEASUREMENT
/begin MEASUREMENT tbl_frf[4].envd.header "" UBYTE _CNV_A_R_LINEAR_____0_CM 1 0. 0. 255. DISPLAY_IDENTIFIER FMY_FRF_5_ENVD_HD ECU_ADDRESS 0x7fbf01 FORMAT "%3.0" /end MEASUREMENT
/begin MEASUREMENT tbl_frf[4].envd.cus_set[0][0] "" UBYTE _CNV_A_R_LINEAR_____0_CM 1 0. 0. 255. DISPLAY_IDENTIFIER FMY_FRF_5_ENVD_CUS_SET_1_CMN_1_ ECU_ADDRESS 0x7fbf02 FORMAT "%3.0" /end MEASUREMENT
/begin MEASUREMENT tbl_frf[4].envd.cus_set[0][1] "" UBYTE _CNV_A_R_LINEAR_____0_CM 1 0. 0. 255. DISPLAY_IDENTIFIER FMY_FRF_5_ENVD_CUS_SET_1_CMN_2_ ECU_ADDRESS 0x7fbf03 FORMAT "%3.0" /end MEASUREMENT
/begin MEASUREMENT tbl_frf[4].envd.cus_set[0][2] "" UBYTE _CNV_A_R_LINEAR_____0_CM 1 0. 0. 255. DISPLAY_IDENTIFIER FMY_FRF_5_ENVD_CUS_SET_1_CMN_3_ ECU_ADDRESS 0x7fbf04 FORMAT "%3.0" /end MEASUREMENT
/begin MEASUREMENT tbl_frf[4].envd.cus_set[0][3] "" UBYTE _CNV_A_R_LINEAR_____0_CM 1 0. 0. 255. DISPLAY_IDENTIFIER FMY_FRF_5_ENVD_CUS_SET_1_CMN_4_ ECU_ADDRESS 0x7fbf05 FORMAT "%3.0" /end MEASUREMENT
/begin MEASUREMENT tbl_frf[4].envd.cus_set[0][4] "" UBYTE _CNV_A_R_LINEAR_____0_CM 1 0. 0. 255. DISPLAY_IDENTIFIER FMY_FRF_5_ENVD_CUS_SET_1_CMN_5_ ECU_ADDRESS 0x7fbf06 FORMAT "%3.0" /end MEASUREMENT
/begin MEASUREMENT tbl_frf[4].envd.cus_set[0][5] "" UBYTE _CNV_A_R_LINEAR_____0_CM 1 0. 0. 255. DISPLAY_IDENTIFIER FMY_FRF_5_ENVD_CUS_SET_1_CMN_6_ ECU_ADDRESS 0x7fbf07 FORMAT "%3.0" /end MEASUREMENT
/begin MEASUREMENT tbl_frf[4].envd.cus_set[0][6] "" UBYTE _CNV_A_R_LINEAR_____0_CM 1 0. 0. 255. DISPLAY_IDENTIFIER FMY_FRF_5_ENVD_CUS_SET_1_SPC_1_ ECU_ADDRESS 0x7fbf08 FORMAT "%3.0" /end MEASUREMENT
/begin MEASUREMENT tbl_frf[4].envd.cus_set[0][7] "" UBYTE _CNV_A_R_LINEAR_____0_CM 1 0. 0. 255. DISPLAY_IDENTIFIER FMY_FRF_5_ENVD_CUS_SET_1_SPC_2_ ECU_ADDRESS 0x7fbf09 FORMAT "%3.0" /end MEASUREMENT
/begin MEASUREMENT tbl_frf[4].envd.cus_set[0][8] "" UBYTE _CNV_A_R_LINEAR_____0_CM 1 0. 0. 255. DISPLAY_IDENTIFIER FMY_FRF_5_ENVD_CUS_SET_1_SPC_3_ ECU_ADDRESS 0x7fbf0a FORMAT "%3.0" /end MEASUREMENT
/begin MEASUREMENT tbl_frf[4].envd.cus_set[0][9] "" UBYTE _CNV_A_R_LINEAR_____0_CM 1 0. 0. 255. DISPLAY_IDENTIFIER FMY_FRF_5_ENVD_CUS_SET_1_SPC_4_ ECU_ADDRESS 0x7fbf0b FORMAT "%3.0" /end MEASUREMENT
/begin MEASUREMENT tbl_frf[4].envd.cus_set[0][10] "" UBYTE _CNV_A_R_LINEAR_____0_CM 1 0. 0. 255. DISPLAY_IDENTIFIER FMY_FRF_5_ENVD_CUS_SET_1_SPC_5_ ECU_ADDRESS 0x7fbf0c FORMAT "%3.0" /end MEASUREMENT
/begin MEASUREMENT tbl_frf[4].envd.cus_set[0][11] "" UBYTE _CNV_A_R_LINEAR_____0_CM 1 0. 0. 255. DISPLAY_IDENTIFIER FMY_FRF_5_ENVD_CUS_SET_1_SPC_6_ ECU_ADDRESS 0x7fbf0d FORMAT "%3.0" /end MEASUREMENT
/begin MEASUREMENT tbl_frf[4].envd.cus_set[0][12] "" UBYTE _CNV_A_R_LINEAR_____0_CM 1 0. 0. 255. DISPLAY_IDENTIFIER FMY_FRF_5_ENVD_CUS_SET_1_SPC_7_ ECU_ADDRESS 0x7fbf0e FORMAT "%3.0" /end MEASUREMENT
/begin MEASUREMENT tbl_frf[4].envd.cus_set[0][13] "" UBYTE _CNV_A_R_LINEAR_____0_CM 1 0. 0. 255. DISPLAY_IDENTIFIER FMY_FRF_5_ENVD_CUS_SET_1_SPC_8_ ECU_ADDRESS 0x7fbf0f FORMAT "%3.0" /end MEASUREMENT
/begin MEASUREMENT tbl_frf[4].envd.cus_set[1][0] "" UBYTE _CNV_A_R_LINEAR_____0_CM 1 0. 0. 255. DISPLAY_IDENTIFIER FMY_FRF_5_ENVD_CUS_SET_2_CMN_1_ ECU_ADDRESS 0x7fbf10 FORMAT "%3.0" /end MEASUREMENT
/begin MEASUREMENT tbl_frf[4].envd.cus_set[1][1] "" UBYTE _CNV_A_R_LINEAR_____0_CM 1 0. 0. 255. DISPLAY_IDENTIFIER FMY_FRF_5_ENVD_CUS_SET_2_CMN_2_ ECU_ADDRESS 0x7fbf11 FORMAT "%3.0" /end MEASUREMENT
/begin MEASUREMENT tbl_frf[4].envd.cus_set[1][2] "" UBYTE _CNV_A_R_LINEAR_____0_CM 1 0. 0. 255. DISPLAY_IDENTIFIER FMY_FRF_5_ENVD_CUS_SET_2_CMN_3_ ECU_ADDRESS 0x7fbf12 FORMAT "%3.0" /end MEASUREMENT
/begin MEASUREMENT tbl_frf[4].envd.cus_set[1][3] "" UBYTE _CNV_A_R_LINEAR_____0_CM 1 0. 0. 255. DISPLAY_IDENTIFIER FMY_FRF_5_ENVD_CUS_SET_2_CMN_4_ ECU_ADDRESS 0x7fbf13 FORMAT "%3.0" /end MEASUREMENT
/begin MEASUREMENT tbl_frf[4].envd.cus_set[1][4] "" UBYTE _CNV_A_R_LINEAR_____0_CM 1 0. 0. 255. DISPLAY_IDENTIFIER FMY_FRF_5_ENVD_CUS_SET_2_CMN_5_ ECU_ADDRESS 0x7fbf14 FORMAT "%3.0" /end MEASUREMENT
/begin MEASUREMENT tbl_frf[4].envd.cus_set[1][5] "" UBYTE _CNV_A_R_LINEAR_____0_CM 1 0. 0. 255. DISPLAY_IDENTIFIER FMY_FRF_5_ENVD_CUS_SET_2_CMN_6_ ECU_ADDRESS 0x7fbf15 FORMAT "%3.0" /end MEASUREMENT
/begin MEASUREMENT tbl_frf[4].envd.cus_set[1][6] "" UBYTE _CNV_A_R_LINEAR_____0_CM 1 0. 0. 255. DISPLAY_IDENTIFIER FMY_FRF_5_ENVD_CUS_SET_2_SPC_1_ ECU_ADDRESS 0x7fbf16 FORMAT "%3.0" /end MEASUREMENT
/begin MEASUREMENT tbl_frf[4].envd.cus_set[1][7] "" UBYTE _CNV_A_R_LINEAR_____0_CM 1 0. 0. 255. DISPLAY_IDENTIFIER FMY_FRF_5_ENVD_CUS_SET_2_SPC_2_ ECU_ADDRESS 0x7fbf17 FORMAT "%3.0" /end MEASUREMENT
/begin MEASUREMENT tbl_frf[4].envd.cus_set[1][8] "" UBYTE _CNV_A_R_LINEAR_____0_CM 1 0. 0. 255. DISPLAY_IDENTIFIER FMY_FRF_5_ENVD_CUS_SET_2_SPC_3_ ECU_ADDRESS 0x7fbf18 FORMAT "%3.0" /end MEASUREMENT
/begin MEASUREMENT tbl_frf[4].envd.cus_set[1][9] "" UBYTE _CNV_A_R_LINEAR_____0_CM 1 0. 0. 255. DISPLAY_IDENTIFIER FMY_FRF_5_ENVD_CUS_SET_2_SPC_4_ ECU_ADDRESS 0x7fbf19 FORMAT "%3.0" /end MEASUREMENT
/begin MEASUREMENT tbl_frf[4].envd.cus_set[1][10] "" UBYTE _CNV_A_R_LINEAR_____0_CM 1 0. 0. 255. DISPLAY_IDENTIFIER FMY_FRF_5_ENVD_CUS_SET_2_SPC_5_ ECU_ADDRESS 0x7fbf1a FORMAT "%3.0" /end MEASUREMENT
/begin MEASUREMENT tbl_frf[4].envd.cus_set[1][11] "" UBYTE _CNV_A_R_LINEAR_____0_CM 1 0. 0. 255. DISPLAY_IDENTIFIER FMY_FRF_5_ENVD_CUS_SET_2_SPC_6_ ECU_ADDRESS 0x7fbf1b FORMAT "%3.0" /end MEASUREMENT
/begin MEASUREMENT tbl_frf[4].envd.cus_set[1][12] "" UBYTE _CNV_A_R_LINEAR_____0_CM 1 0. 0. 255. DISPLAY_IDENTIFIER FMY_FRF_5_ENVD_CUS_SET_2_SPC_7_ ECU_ADDRESS 0x7fbf1c FORMAT "%3.0" /end MEASUREMENT
/begin MEASUREMENT tbl_frf[4].envd.cus_set[1][13] "" UBYTE _CNV_A_R_LINEAR_____0_CM 1 0. 0. 255. DISPLAY_IDENTIFIER FMY_FRF_5_ENVD_CUS_SET_2_SPC_8_ ECU_ADDRESS 0x7fbf1d FORMAT "%3.0" /end MEASUREMENT
/begin MEASUREMENT tbl_frf[4].envd.cmn_cus[0] "" UBYTE _CNV_A_R_LINEAR_____0_CM 1 0. 0. 255. DISPLAY_IDENTIFIER FMY_FRF_5_ENVD_CUS_CMN_1_ ECU_ADDRESS 0x7fbf1e FORMAT "%3.0" /end MEASUREMENT
/begin MEASUREMENT tbl_frf[4].envd.obd[0] "" UBYTE _CNV_A_R_LINEAR_____0_CM 1 0. 0. 255. DISPLAY_IDENTIFIER FMY_FRF_5_ENVD_OBD_1_ ECU_ADDRESS 0x7fbf1f FORMAT "%3.0" /end MEASUREMENT
/begin MEASUREMENT tbl_frf[4].envd.obd[1] "" UBYTE _CNV_A_R_LINEAR_____0_CM 1 0. 0. 255. DISPLAY_IDENTIFIER FMY_FRF_5_ENVD_OBD_2_ ECU_ADDRESS 0x7fbf20 FORMAT "%3.0" /end MEASUREMENT
/begin MEASUREMENT tbl_frf[4].envd.obd[2] "" UBYTE _CNV_A_R_LINEAR_____0_CM 1 0. 0. 255. DISPLAY_IDENTIFIER FMY_FRF_5_ENVD_OBD_3_ ECU_ADDRESS 0x7fbf21 FORMAT "%3.0" /end MEASUREMENT
/begin MEASUREMENT tbl_frf[4].envd.obd[3] "" UBYTE _CNV_A_R_LINEAR_____0_CM 1 0. 0. 255. DISPLAY_IDENTIFIER FMY_FRF_5_ENVD_OBD_4_ ECU_ADDRESS 0x7fbf22 FORMAT "%3.0" /end MEASUREMENT
/begin MEASUREMENT tbl_frf[4].envd.obd[4] "" UBYTE _CNV_A_R_LINEAR_____0_CM 1 0. 0. 255. DISPLAY_IDENTIFIER FMY_FRF_5_ENVD_OBD_5_ ECU_ADDRESS 0x7fbf23 FORMAT "%3.0" /end MEASUREMENT
/begin MEASUREMENT tbl_frf[4].envd.obd[5] "" UBYTE _CNV_A_R_LINEAR_____0_CM 1 0. 0. 255. DISPLAY_IDENTIFIER FMY_FRF_5_ENVD_OBD_6_ ECU_ADDRESS 0x7fbf24 FORMAT "%3.0" /end MEASUREMENT
/begin MEASUREMENT tbl_frf[4].envd.obd[6] "" UBYTE _CNV_A_R_LINEAR_____0_CM 1 0. 0. 255. DISPLAY_IDENTIFIER FMY_FRF_5_ENVD_OBD_7_ ECU_ADDRESS 0x7fbf25 FORMAT "%3.0" /end MEASUREMENT
/begin MEASUREMENT tbl_frf[4].envd.obd[7] "" UBYTE _CNV_A_R_LINEAR_____0_CM 1 0. 0. 255. DISPLAY_IDENTIFIER FMY_FRF_5_ENVD_OBD_8_ ECU_ADDRESS 0x7fbf26 FORMAT "%3.0" /end MEASUREMENT
/begin MEASUREMENT tbl_frf[5].envd.header "" UBYTE _CNV_A_R_LINEAR_____0_CM 1 0. 0. 255. DISPLAY_IDENTIFIER FMY_FRF_6_ENVD_HD ECU_ADDRESS 0x7fbf27 FORMAT "%3.0" /end MEASUREMENT
/begin MEASUREMENT tbl_frf[5].envd.cus_set[0][0] "" UBYTE _CNV_A_R_LINEAR_____0_CM 1 0. 0. 255. DISPLAY_IDENTIFIER FMY_FRF_6_ENVD_CUS_SET_1_CMN_1_ ECU_ADDRESS 0x7fbf28 FORMAT "%3.0" /end MEASUREMENT
/begin MEASUREMENT tbl_frf[5].envd.cus_set[0][1] "" UBYTE _CNV_A_R_LINEAR_____0_CM 1 0. 0. 255. DISPLAY_IDENTIFIER FMY_FRF_6_ENVD_CUS_SET_1_CMN_2_ ECU_ADDRESS 0x7fbf29 FORMAT "%3.0" /end MEASUREMENT
/begin MEASUREMENT tbl_frf[5].envd.cus_set[0][2] "" UBYTE _CNV_A_R_LINEAR_____0_CM 1 0. 0. 255. DISPLAY_IDENTIFIER FMY_FRF_6_ENVD_CUS_SET_1_CMN_3_ ECU_ADDRESS 0x7fbf2a FORMAT "%3.0" /end MEASUREMENT
/begin MEASUREMENT tbl_frf[5].envd.cus_set[0][3] "" UBYTE _CNV_A_R_LINEAR_____0_CM 1 0. 0. 255. DISPLAY_IDENTIFIER FMY_FRF_6_ENVD_CUS_SET_1_CMN_4_ ECU_ADDRESS 0x7fbf2b FORMAT "%3.0" /end MEASUREMENT
/begin MEASUREMENT tbl_frf[5].envd.cus_set[0][4] "" UBYTE _CNV_A_R_LINEAR_____0_CM 1 0. 0. 255. DISPLAY_IDENTIFIER FMY_FRF_6_ENVD_CUS_SET_1_CMN_5_ ECU_ADDRESS 0x7fbf2c FORMAT "%3.0" /end MEASUREMENT
/begin MEASUREMENT tbl_frf[5].envd.cus_set[0][5] "" UBYTE _CNV_A_R_LINEAR_____0_CM 1 0. 0. 255. DISPLAY_IDENTIFIER FMY_FRF_6_ENVD_CUS_SET_1_CMN_6_ ECU_ADDRESS 0x7fbf2d FORMAT "%3.0" /end MEASUREMENT
/begin MEASUREMENT tbl_frf[5].envd.cus_set[0][6] "" UBYTE _CNV_A_R_LINEAR_____0_CM 1 0. 0. 255. DISPLAY_IDENTIFIER FMY_FRF_6_ENVD_CUS_SET_1_SPC_1_ ECU_ADDRESS 0x7fbf2e FORMAT "%3.0" /end MEASUREMENT
/begin MEASUREMENT tbl_frf[5].envd.cus_set[0][7] "" UBYTE _CNV_A_R_LINEAR_____0_CM 1 0. 0. 255. DISPLAY_IDENTIFIER FMY_FRF_6_ENVD_CUS_SET_1_SPC_2_ ECU_ADDRESS 0x7fbf2f FORMAT "%3.0" /end MEASUREMENT
/begin MEASUREMENT tbl_frf[5].envd.cus_set[0][8] "" UBYTE _CNV_A_R_LINEAR_____0_CM 1 0. 0. 255. DISPLAY_IDENTIFIER FMY_FRF_6_ENVD_CUS_SET_1_SPC_3_ ECU_ADDRESS 0x7fbf30 FORMAT "%3.0" /end MEASUREMENT
/begin MEASUREMENT tbl_frf[5].envd.cus_set[0][9] "" UBYTE _CNV_A_R_LINEAR_____0_CM 1 0. 0. 255. DISPLAY_IDENTIFIER FMY_FRF_6_ENVD_CUS_SET_1_SPC_4_ ECU_ADDRESS 0x7fbf31 FORMAT "%3.0" /end MEASUREMENT
/begin MEASUREMENT tbl_frf[5].envd.cus_set[0][10] "" UBYTE _CNV_A_R_LINEAR_____0_CM 1 0. 0. 255. DISPLAY_IDENTIFIER FMY_FRF_6_ENVD_CUS_SET_1_SPC_5_ ECU_ADDRESS 0x7fbf32 FORMAT "%3.0" /end MEASUREMENT
/begin MEASUREMENT tbl_frf[5].envd.cus_set[0][11] "" UBYTE _CNV_A_R_LINEAR_____0_CM 1 0. 0. 255. DISPLAY_IDENTIFIER FMY_FRF_6_ENVD_CUS_SET_1_SPC_6_ ECU_ADDRESS 0x7fbf33 FORMAT "%3.0" /end MEASUREMENT
/begin MEASUREMENT tbl_frf[5].envd.cus_set[0][12] "" UBYTE _CNV_A_R_LINEAR_____0_CM 1 0. 0. 255. DISPLAY_IDENTIFIER FMY_FRF_6_ENVD_CUS_SET_1_SPC_7_ ECU_ADDRESS 0x7fbf34 FORMAT "%3.0" /end MEASUREMENT
/begin MEASUREMENT tbl_frf[5].envd.cus_set[0][13] "" UBYTE _CNV_A_R_LINEAR_____0_CM 1 0. 0. 255. DISPLAY_IDENTIFIER FMY_FRF_6_ENVD_CUS_SET_1_SPC_8_ ECU_ADDRESS 0x7fbf35 FORMAT "%3.0" /end MEASUREMENT
/begin MEASUREMENT tbl_frf[5].envd.cus_set[1][0] "" UBYTE _CNV_A_R_LINEAR_____0_CM 1 0. 0. 255. DISPLAY_IDENTIFIER FMY_FRF_6_ENVD_CUS_SET_2_CMN_1_ ECU_ADDRESS 0x7fbf36 FORMAT "%3.0" /end MEASUREMENT
/begin MEASUREMENT tbl_frf[5].envd.cus_set[1][1] "" UBYTE _CNV_A_R_LINEAR_____0_CM 1 0. 0. 255. DISPLAY_IDENTIFIER FMY_FRF_6_ENVD_CUS_SET_2_CMN_2_ ECU_ADDRESS 0x7fbf37 FORMAT "%3.0" /end MEASUREMENT
/begin MEASUREMENT tbl_frf[5].envd.cus_set[1][2] "" UBYTE _CNV_A_R_LINEAR_____0_CM 1 0. 0. 255. DISPLAY_IDENTIFIER FMY_FRF_6_ENVD_CUS_SET_2_CMN_3_ ECU_ADDRESS 0x7fbf38 FORMAT "%3.0" /end MEASUREMENT
/begin MEASUREMENT tbl_frf[5].envd.cus_set[1][3] "" UBYTE _CNV_A_R_LINEAR_____0_CM 1 0. 0. 255. DISPLAY_IDENTIFIER FMY_FRF_6_ENVD_CUS_SET_2_CMN_4_ ECU_ADDRESS 0x7fbf39 FORMAT "%3.0" /end MEASUREMENT
/begin MEASUREMENT tbl_frf[5].envd.cus_set[1][4] "" UBYTE _CNV_A_R_LINEAR_____0_CM 1 0. 0. 255. DISPLAY_IDENTIFIER FMY_FRF_6_ENVD_CUS_SET_2_CMN_5_ ECU_ADDRESS 0x7fbf3a FORMAT "%3.0" /end MEASUREMENT
/begin MEASUREMENT tbl_frf[5].envd.cus_set[1][5] "" UBYTE _CNV_A_R_LINEAR_____0_CM 1 0. 0. 255. DISPLAY_IDENTIFIER FMY_FRF_6_ENVD_CUS_SET_2_CMN_6_ ECU_ADDRESS 0x7fbf3b FORMAT "%3.0" /end MEASUREMENT
/begin MEASUREMENT tbl_frf[5].envd.cus_set[1][6] "" UBYTE _CNV_A_R_LINEAR_____0_CM 1 0. 0. 255. DISPLAY_IDENTIFIER FMY_FRF_6_ENVD_CUS_SET_2_SPC_1_ ECU_ADDRESS 0x7fbf3c FORMAT "%3.0" /end MEASUREMENT
/begin MEASUREMENT tbl_frf[5].envd.cus_set[1][7] "" UBYTE _CNV_A_R_LINEAR_____0_CM 1 0. 0. 255. DISPLAY_IDENTIFIER FMY_FRF_6_ENVD_CUS_SET_2_SPC_2_ ECU_ADDRESS 0x7fbf3d FORMAT "%3.0" /end MEASUREMENT
/begin MEASUREMENT tbl_frf[5].envd.cus_set[1][8] "" UBYTE _CNV_A_R_LINEAR_____0_CM 1 0. 0. 255. DISPLAY_IDENTIFIER FMY_FRF_6_ENVD_CUS_SET_2_SPC_3_ ECU_ADDRESS 0x7fbf3e FORMAT "%3.0" /end MEASUREMENT
/begin MEASUREMENT tbl_frf[5].envd.cus_set[1][9] "" UBYTE _CNV_A_R_LINEAR_____0_CM 1 0. 0. 255. DISPLAY_IDENTIFIER FMY_FRF_6_ENVD_CUS_SET_2_SPC_4_ ECU_ADDRESS 0x7fbf3f FORMAT "%3.0" /end MEASUREMENT
/begin MEASUREMENT tbl_frf[5].envd.cus_set[1][10] "" UBYTE _CNV_A_R_LINEAR_____0_CM 1 0. 0. 255. DISPLAY_IDENTIFIER FMY_FRF_6_ENVD_CUS_SET_2_SPC_5_ ECU_ADDRESS 0x7fbf40 FORMAT "%3.0" /end MEASUREMENT
/begin MEASUREMENT tbl_frf[5].envd.cus_set[1][11] "" UBYTE _CNV_A_R_LINEAR_____0_CM 1 0. 0. 255. DISPLAY_IDENTIFIER FMY_FRF_6_ENVD_CUS_SET_2_SPC_6_ ECU_ADDRESS 0x7fbf41 FORMAT "%3.0" /end MEASUREMENT
/begin MEASUREMENT tbl_frf[5].envd.cus_set[1][12] "" UBYTE _CNV_A_R_LINEAR_____0_CM 1 0. 0. 255. DISPLAY_IDENTIFIER FMY_FRF_6_ENVD_CUS_SET_2_SPC_7_ ECU_ADDRESS 0x7fbf42 FORMAT "%3.0" /end MEASUREMENT
/begin MEASUREMENT tbl_frf[5].envd.cus_set[1][13] "" UBYTE _CNV_A_R_LINEAR_____0_CM 1 0. 0. 255. DISPLAY_IDENTIFIER FMY_FRF_6_ENVD_CUS_SET_2_SPC_8_ ECU_ADDRESS 0x7fbf43 FORMAT "%3.0" /end MEASUREMENT
/begin MEASUREMENT tbl_frf[5].envd.cmn_cus[0] "" UBYTE _CNV_A_R_LINEAR_____0_CM 1 0. 0. 255. DISPLAY_IDENTIFIER FMY_FRF_6_ENVD_CUS_CMN_1_ ECU_ADDRESS 0x7fbf44 FORMAT "%3.0" /end MEASUREMENT
/begin MEASUREMENT tbl_frf[5].envd.obd[0] "" UBYTE _CNV_A_R_LINEAR_____0_CM 1 0. 0. 255. DISPLAY_IDENTIFIER FMY_FRF_6_ENVD_OBD_1_ ECU_ADDRESS 0x7fbf45 FORMAT "%3.0" /end MEASUREMENT
/begin MEASUREMENT tbl_frf[5].envd.obd[1] "" UBYTE _CNV_A_R_LINEAR_____0_CM 1 0. 0. 255. DISPLAY_IDENTIFIER FMY_FRF_6_ENVD_OBD_2_ ECU_ADDRESS 0x7fbf46 FORMAT "%3.0" /end MEASUREMENT
/begin MEASUREMENT tbl_frf[5].envd.obd[2] "" UBYTE _CNV_A_R_LINEAR_____0_CM 1 0. 0. 255. DISPLAY_IDENTIFIER FMY_FRF_6_ENVD_OBD_3_ ECU_ADDRESS 0x7fbf47 FORMAT "%3.0" /end MEASUREMENT
/begin MEASUREMENT tbl_frf[5].envd.obd[3] "" UBYTE _CNV_A_R_LINEAR_____0_CM 1 0. 0. 255. DISPLAY_IDENTIFIER FMY_FRF_6_ENVD_OBD_4_ ECU_ADDRESS 0x7fbf48 FORMAT "%3.0" /end MEASUREMENT
/begin MEASUREMENT tbl_frf[5].envd.obd[4] "" UBYTE _CNV_A_R_LINEAR_____0_CM 1 0. 0. 255. DISPLAY_IDENTIFIER FMY_FRF_6_ENVD_OBD_5_ ECU_ADDRESS 0x7fbf49 FORMAT "%3.0" /end MEASUREMENT
/begin MEASUREMENT tbl_frf[5].envd.obd[5] "" UBYTE _CNV_A_R_LINEAR_____0_CM 1 0. 0. 255. DISPLAY_IDENTIFIER FMY_FRF_6_ENVD_OBD_6_ ECU_ADDRESS 0x7fbf4a FORMAT "%3.0" /end MEASUREMENT
/begin MEASUREMENT tbl_frf[5].envd.obd[6] "" UBYTE _CNV_A_R_LINEAR_____0_CM 1 0. 0. 255. DISPLAY_IDENTIFIER FMY_FRF_6_ENVD_OBD_7_ ECU_ADDRESS 0x7fbf4b FORMAT "%3.0" /end MEASUREMENT
/begin MEASUREMENT tbl_frf[5].envd.obd[7] "" UBYTE _CNV_A_R_LINEAR_____0_CM 1 0. 0. 255. DISPLAY_IDENTIFIER FMY_FRF_6_ENVD_OBD_8_ ECU_ADDRESS 0x7fbf4c FORMAT "%3.0" /end MEASUREMENT
/begin MEASUREMENT tbl_frf[6].envd.header "" UBYTE _CNV_A_R_LINEAR_____0_CM 1 0. 0. 255. DISPLAY_IDENTIFIER FMY_FRF_7_ENVD_HD ECU_ADDRESS 0x7fbf4d FORMAT "%3.0" /end MEASUREMENT
/begin MEASUREMENT tbl_frf[6].envd.cus_set[0][0] "" UBYTE _CNV_A_R_LINEAR_____0_CM 1 0. 0. 255. DISPLAY_IDENTIFIER FMY_FRF_7_ENVD_CUS_SET_1_CMN_1_ ECU_ADDRESS 0x7fbf4e FORMAT "%3.0" /end MEASUREMENT
/begin MEASUREMENT tbl_frf[6].envd.cus_set[0][1] "" UBYTE _CNV_A_R_LINEAR_____0_CM 1 0. 0. 255. DISPLAY_IDENTIFIER FMY_FRF_7_ENVD_CUS_SET_1_CMN_2_ ECU_ADDRESS 0x7fbf4f FORMAT "%3.0" /end MEASUREMENT
/begin MEASUREMENT tbl_frf[6].envd.cus_set[0][2] "" UBYTE _CNV_A_R_LINEAR_____0_CM 1 0. 0. 255. DISPLAY_IDENTIFIER FMY_FRF_7_ENVD_CUS_SET_1_CMN_3_ ECU_ADDRESS 0x7fbf50 FORMAT "%3.0" /end MEASUREMENT
/begin MEASUREMENT tbl_frf[6].envd.cus_set[0][3] "" UBYTE _CNV_A_R_LINEAR_____0_CM 1 0. 0. 255. DISPLAY_IDENTIFIER FMY_FRF_7_ENVD_CUS_SET_1_CMN_4_ ECU_ADDRESS 0x7fbf51 FORMAT "%3.0" /end MEASUREMENT
/begin MEASUREMENT tbl_frf[6].envd.cus_set[0][4] "" UBYTE _CNV_A_R_LINEAR_____0_CM 1 0. 0. 255. DISPLAY_IDENTIFIER FMY_FRF_7_ENVD_CUS_SET_1_CMN_5_ ECU_ADDRESS 0x7fbf52 FORMAT "%3.0" /end MEASUREMENT
/begin MEASUREMENT tbl_frf[6].envd.cus_set[0][5] "" UBYTE _CNV_A_R_LINEAR_____0_CM 1 0. 0. 255. DISPLAY_IDENTIFIER FMY_FRF_7_ENVD_CUS_SET_1_CMN_6_ ECU_ADDRESS 0x7fbf53 FORMAT "%3.0" /end MEASUREMENT
/begin MEASUREMENT tbl_frf[6].envd.cus_set[0][6] "" UBYTE _CNV_A_R_LINEAR_____0_CM 1 0. 0. 255. DISPLAY_IDENTIFIER FMY_FRF_7_ENVD_CUS_SET_1_SPC_1_ ECU_ADDRESS 0x7fbf54 FORMAT "%3.0" /end MEASUREMENT
/begin MEASUREMENT tbl_frf[6].envd.cus_set[0][7] "" UBYTE _CNV_A_R_LINEAR_____0_CM 1 0. 0. 255. DISPLAY_IDENTIFIER FMY_FRF_7_ENVD_CUS_SET_1_SPC_2_ ECU_ADDRESS 0x7fbf55 FORMAT "%3.0" /end MEASUREMENT
/begin MEASUREMENT tbl_frf[6].envd.cus_set[0][8] "" UBYTE _CNV_A_R_LINEAR_____0_CM 1 0. 0. 255. DISPLAY_IDENTIFIER FMY_FRF_7_ENVD_CUS_SET_1_SPC_3_ ECU_ADDRESS 0x7fbf56 FORMAT "%3.0" /end MEASUREMENT
/begin MEASUREMENT tbl_frf[6].envd.cus_set[0][9] "" UBYTE _CNV_A_R_LINEAR_____0_CM 1 0. 0. 255. DISPLAY_IDENTIFIER FMY_FRF_7_ENVD_CUS_SET_1_SPC_4_ ECU_ADDRESS 0x7fbf57 FORMAT "%3.0" /end MEASUREMENT
/begin MEASUREMENT tbl_frf[6].envd.cus_set[0][10] "" UBYTE _CNV_A_R_LINEAR_____0_CM 1 0. 0. 255. DISPLAY_IDENTIFIER FMY_FRF_7_ENVD_CUS_SET_1_SPC_5_ ECU_ADDRESS 0x7fbf58 FORMAT "%3.0" /end MEASUREMENT
/begin MEASUREMENT tbl_frf[6].envd.cus_set[0][11] "" UBYTE _CNV_A_R_LINEAR_____0_CM 1 0. 0. 255. DISPLAY_IDENTIFIER FMY_FRF_7_ENVD_CUS_SET_1_SPC_6_ ECU_ADDRESS 0x7fbf59 FORMAT "%3.0" /end MEASUREMENT
/begin MEASUREMENT tbl_frf[6].envd.cus_set[0][12] "" UBYTE _CNV_A_R_LINEAR_____0_CM 1 0. 0. 255. DISPLAY_IDENTIFIER FMY_FRF_7_ENVD_CUS_SET_1_SPC_7_ ECU_ADDRESS 0x7fbf5a FORMAT "%3.0" /end MEASUREMENT
/begin MEASUREMENT tbl_frf[6].envd.cus_set[0][13] "" UBYTE _CNV_A_R_LINEAR_____0_CM 1 0. 0. 255. DISPLAY_IDENTIFIER FMY_FRF_7_ENVD_CUS_SET_1_SPC_8_ ECU_ADDRESS 0x7fbf5b FORMAT "%3.0" /end MEASUREMENT
/begin MEASUREMENT tbl_frf[6].envd.cus_set[1][0] "" UBYTE _CNV_A_R_LINEAR_____0_CM 1 0. 0. 255. DISPLAY_IDENTIFIER FMY_FRF_7_ENVD_CUS_SET_2_CMN_1_ ECU_ADDRESS 0x7fbf5c FORMAT "%3.0" /end MEASUREMENT
/begin MEASUREMENT tbl_frf[6].envd.cus_set[1][1] "" UBYTE _CNV_A_R_LINEAR_____0_CM 1 0. 0. 255. DISPLAY_IDENTIFIER FMY_FRF_7_ENVD_CUS_SET_2_CMN_2_ ECU_ADDRESS 0x7fbf5d FORMAT "%3.0" /end MEASUREMENT
/begin MEASUREMENT tbl_frf[6].envd.cus_set[1][2] "" UBYTE _CNV_A_R_LINEAR_____0_CM 1 0. 0. 255. DISPLAY_IDENTIFIER FMY_FRF_7_ENVD_CUS_SET_2_CMN_3_ ECU_ADDRESS 0x7fbf5e FORMAT "%3.0" /end MEASUREMENT
/begin MEASUREMENT tbl_frf[6].envd.cus_set[1][3] "" UBYTE _CNV_A_R_LINEAR_____0_CM 1 0. 0. 255. DISPLAY_IDENTIFIER FMY_FRF_7_ENVD_CUS_SET_2_CMN_4_ ECU_ADDRESS 0x7fbf5f FORMAT "%3.0" /end MEASUREMENT
/begin MEASUREMENT tbl_frf[6].envd.cus_set[1][4] "" UBYTE _CNV_A_R_LINEAR_____0_CM 1 0. 0. 255. DISPLAY_IDENTIFIER FMY_FRF_7_ENVD_CUS_SET_2_CMN_5_ ECU_ADDRESS 0x7fbf60 FORMAT "%3.0" /end MEASUREMENT
/begin MEASUREMENT tbl_frf[6].envd.cus_set[1][5] "" UBYTE _CNV_A_R_LINEAR_____0_CM 1 0. 0. 255. DISPLAY_IDENTIFIER FMY_FRF_7_ENVD_CUS_SET_2_CMN_6_ ECU_ADDRESS 0x7fbf61 FORMAT "%3.0" /end MEASUREMENT
/begin MEASUREMENT tbl_frf[6].envd.cus_set[1][6] "" UBYTE _CNV_A_R_LINEAR_____0_CM 1 0. 0. 255. DISPLAY_IDENTIFIER FMY_FRF_7_ENVD_CUS_SET_2_SPC_1_ ECU_ADDRESS 0x7fbf62 FORMAT "%3.0" /end MEASUREMENT
/begin MEASUREMENT tbl_frf[6].envd.cus_set[1][7] "" UBYTE _CNV_A_R_LINEAR_____0_CM 1 0. 0. 255. DISPLAY_IDENTIFIER FMY_FRF_7_ENVD_CUS_SET_2_SPC_2_ ECU_ADDRESS 0x7fbf63 FORMAT "%3.0" /end MEASUREMENT
/begin MEASUREMENT tbl_frf[6].envd.cus_set[1][8] "" UBYTE _CNV_A_R_LINEAR_____0_CM 1 0. 0. 255. DISPLAY_IDENTIFIER FMY_FRF_7_ENVD_CUS_SET_2_SPC_3_ ECU_ADDRESS 0x7fbf64 FORMAT "%3.0" /end MEASUREMENT
/begin MEASUREMENT tbl_frf[6].envd.cus_set[1][9] "" UBYTE _CNV_A_R_LINEAR_____0_CM 1 0. 0. 255. DISPLAY_IDENTIFIER FMY_FRF_7_ENVD_CUS_SET_2_SPC_4_ ECU_ADDRESS 0x7fbf65 FORMAT "%3.0" /end MEASUREMENT
/begin MEASUREMENT tbl_frf[6].envd.cus_set[1][10] "" UBYTE _CNV_A_R_LINEAR_____0_CM 1 0. 0. 255. DISPLAY_IDENTIFIER FMY_FRF_7_ENVD_CUS_SET_2_SPC_5_ ECU_ADDRESS 0x7fbf66 FORMAT "%3.0" /end MEASUREMENT
/begin MEASUREMENT tbl_frf[6].envd.cus_set[1][11] "" UBYTE _CNV_A_R_LINEAR_____0_CM 1 0. 0. 255. DISPLAY_IDENTIFIER FMY_FRF_7_ENVD_CUS_SET_2_SPC_6_ ECU_ADDRESS 0x7fbf67 FORMAT "%3.0" /end MEASUREMENT
/begin MEASUREMENT tbl_frf[6].envd.cus_set[1][12] "" UBYTE _CNV_A_R_LINEAR_____0_CM 1 0. 0. 255. DISPLAY_IDENTIFIER FMY_FRF_7_ENVD_CUS_SET_2_SPC_7_ ECU_ADDRESS 0x7fbf68 FORMAT "%3.0" /end MEASUREMENT
/begin MEASUREMENT tbl_frf[6].envd.cus_set[1][13] "" UBYTE _CNV_A_R_LINEAR_____0_CM 1 0. 0. 255. DISPLAY_IDENTIFIER FMY_FRF_7_ENVD_CUS_SET_2_SPC_8_ ECU_ADDRESS 0x7fbf69 FORMAT "%3.0" /end MEASUREMENT
/begin MEASUREMENT tbl_frf[6].envd.cmn_cus[0] "" UBYTE _CNV_A_R_LINEAR_____0_CM 1 0. 0. 255. DISPLAY_IDENTIFIER FMY_FRF_7_ENVD_CUS_CMN_1_ ECU_ADDRESS 0x7fbf6a FORMAT "%3.0" /end MEASUREMENT
/begin MEASUREMENT tbl_frf[6].envd.obd[0] "" UBYTE _CNV_A_R_LINEAR_____0_CM 1 0. 0. 255. DISPLAY_IDENTIFIER FMY_FRF_7_ENVD_OBD_1_ ECU_ADDRESS 0x7fbf6b FORMAT "%3.0" /end MEASUREMENT
/begin MEASUREMENT tbl_frf[6].envd.obd[1] "" UBYTE _CNV_A_R_LINEAR_____0_CM 1 0. 0. 255. DISPLAY_IDENTIFIER FMY_FRF_7_ENVD_OBD_2_ ECU_ADDRESS 0x7fbf6c FORMAT "%3.0" /end MEASUREMENT
/begin MEASUREMENT tbl_frf[6].envd.obd[2] "" UBYTE _CNV_A_R_LINEAR_____0_CM 1 0. 0. 255. DISPLAY_IDENTIFIER FMY_FRF_7_ENVD_OBD_3_ ECU_ADDRESS 0x7fbf6d FORMAT "%3.0" /end MEASUREMENT
/begin MEASUREMENT tbl_frf[6].envd.obd[3] "" UBYTE _CNV_A_R_LINEAR_____0_CM 1 0. 0. 255. DISPLAY_IDENTIFIER FMY_FRF_7_ENVD_OBD_4_ ECU_ADDRESS 0x7fbf6e FORMAT "%3.0" /end MEASUREMENT
/begin MEASUREMENT tbl_frf[6].envd.obd[4] "" UBYTE _CNV_A_R_LINEAR_____0_CM 1 0. 0. 255. DISPLAY_IDENTIFIER FMY_FRF_7_ENVD_OBD_5_ ECU_ADDRESS 0x7fbf6f FORMAT "%3.0" /end MEASUREMENT
/begin MEASUREMENT tbl_frf[6].envd.obd[5] "" UBYTE _CNV_A_R_LINEAR_____0_CM 1 0. 0. 255. DISPLAY_IDENTIFIER FMY_FRF_7_ENVD_OBD_6_ ECU_ADDRESS 0x7fbf70 FORMAT "%3.0" /end MEASUREMENT
/begin MEASUREMENT tbl_frf[6].envd.obd[6] "" UBYTE _CNV_A_R_LINEAR_____0_CM 1 0. 0. 255. DISPLAY_IDENTIFIER FMY_FRF_7_ENVD_OBD_7_ ECU_ADDRESS 0x7fbf71 FORMAT "%3.0" /end MEASUREMENT
/begin MEASUREMENT tbl_frf[6].envd.obd[7] "" UBYTE _CNV_A_R_LINEAR_____0_CM 1 0. 0. 255. DISPLAY_IDENTIFIER FMY_FRF_7_ENVD_OBD_8_ ECU_ADDRESS 0x7fbf72 FORMAT "%3.0" /end MEASUREMENT
/begin MEASUREMENT tbl_frf[7].envd.header "" UBYTE _CNV_A_R_LINEAR_____0_CM 1 0. 0. 255. DISPLAY_IDENTIFIER FMY_FRF_8_ENVD_HD ECU_ADDRESS 0x7fbf73 FORMAT "%3.0" /end MEASUREMENT
/begin MEASUREMENT tbl_frf[7].envd.cus_set[0][0] "" UBYTE _CNV_A_R_LINEAR_____0_CM 1 0. 0. 255. DISPLAY_IDENTIFIER FMY_FRF_8_ENVD_CUS_SET_1_CMN_1_ ECU_ADDRESS 0x7fbf74 FORMAT "%3.0" /end MEASUREMENT
/begin MEASUREMENT tbl_frf[7].envd.cus_set[0][1] "" UBYTE _CNV_A_R_LINEAR_____0_CM 1 0. 0. 255. DISPLAY_IDENTIFIER FMY_FRF_8_ENVD_CUS_SET_1_CMN_2_ ECU_ADDRESS 0x7fbf75 FORMAT "%3.0" /end MEASUREMENT
/begin MEASUREMENT tbl_frf[7].envd.cus_set[0][2] "" UBYTE _CNV_A_R_LINEAR_____0_CM 1 0. 0. 255. DISPLAY_IDENTIFIER FMY_FRF_8_ENVD_CUS_SET_1_CMN_3_ ECU_ADDRESS 0x7fbf76 FORMAT "%3.0" /end MEASUREMENT
/begin MEASUREMENT tbl_frf[7].envd.cus_set[0][3] "" UBYTE _CNV_A_R_LINEAR_____0_CM 1 0. 0. 255. DISPLAY_IDENTIFIER FMY_FRF_8_ENVD_CUS_SET_1_CMN_4_ ECU_ADDRESS 0x7fbf77 FORMAT "%3.0" /end MEASUREMENT
/begin MEASUREMENT tbl_frf[7].envd.cus_set[0][4] "" UBYTE _CNV_A_R_LINEAR_____0_CM 1 0. 0. 255. DISPLAY_IDENTIFIER FMY_FRF_8_ENVD_CUS_SET_1_CMN_5_ ECU_ADDRESS 0x7fbf78 FORMAT "%3.0" /end MEASUREMENT
/begin MEASUREMENT tbl_frf[7].envd.cus_set[0][5] "" UBYTE _CNV_A_R_LINEAR_____0_CM 1 0. 0. 255. DISPLAY_IDENTIFIER FMY_FRF_8_ENVD_CUS_SET_1_CMN_6_ ECU_ADDRESS 0x7fbf79 FORMAT "%3.0" /end MEASUREMENT
/begin MEASUREMENT tbl_frf[7].envd.cus_set[0][6] "" UBYTE _CNV_A_R_LINEAR_____0_CM 1 0. 0. 255. DISPLAY_IDENTIFIER FMY_FRF_8_ENVD_CUS_SET_1_SPC_1_ ECU_ADDRESS 0x7fbf7a FORMAT "%3.0" /end MEASUREMENT
/begin MEASUREMENT tbl_frf[7].envd.cus_set[0][7] "" UBYTE _CNV_A_R_LINEAR_____0_CM 1 0. 0. 255. DISPLAY_IDENTIFIER FMY_FRF_8_ENVD_CUS_SET_1_SPC_2_ ECU_ADDRESS 0x7fbf7b FORMAT "%3.0" /end MEASUREMENT
/begin MEASUREMENT tbl_frf[7].envd.cus_set[0][8] "" UBYTE _CNV_A_R_LINEAR_____0_CM 1 0. 0. 255. DISPLAY_IDENTIFIER FMY_FRF_8_ENVD_CUS_SET_1_SPC_3_ ECU_ADDRESS 0x7fbf7c FORMAT "%3.0" /end MEASUREMENT
/begin MEASUREMENT tbl_frf[7].envd.cus_set[0][9] "" UBYTE _CNV_A_R_LINEAR_____0_CM 1 0. 0. 255. DISPLAY_IDENTIFIER FMY_FRF_8_ENVD_CUS_SET_1_SPC_4_ ECU_ADDRESS 0x7fbf7d FORMAT "%3.0" /end MEASUREMENT
/begin MEASUREMENT tbl_frf[7].envd.cus_set[0][10] "" UBYTE _CNV_A_R_LINEAR_____0_CM 1 0. 0. 255. DISPLAY_IDENTIFIER FMY_FRF_8_ENVD_CUS_SET_1_SPC_5_ ECU_ADDRESS 0x7fbf7e FORMAT "%3.0" /end MEASUREMENT
/begin MEASUREMENT tbl_frf[7].envd.cus_set[0][11] "" UBYTE _CNV_A_R_LINEAR_____0_CM 1 0. 0. 255. DISPLAY_IDENTIFIER FMY_FRF_8_ENVD_CUS_SET_1_SPC_6_ ECU_ADDRESS 0x7fbf7f FORMAT "%3.0" /end MEASUREMENT
/begin MEASUREMENT tbl_frf[7].envd.cus_set[0][12] "" UBYTE _CNV_A_R_LINEAR_____0_CM 1 0. 0. 255. DISPLAY_IDENTIFIER FMY_FRF_8_ENVD_CUS_SET_1_SPC_7_ ECU_ADDRESS 0x7fbf80 FORMAT "%3.0" /end MEASUREMENT
/begin MEASUREMENT tbl_frf[7].envd.cus_set[0][13] "" UBYTE _CNV_A_R_LINEAR_____0_CM 1 0. 0. 255. DISPLAY_IDENTIFIER FMY_FRF_8_ENVD_CUS_SET_1_SPC_8_ ECU_ADDRESS 0x7fbf81 FORMAT "%3.0" /end MEASUREMENT
/begin MEASUREMENT tbl_frf[7].envd.cus_set[1][0] "" UBYTE _CNV_A_R_LINEAR_____0_CM 1 0. 0. 255. DISPLAY_IDENTIFIER FMY_FRF_8_ENVD_CUS_SET_2_CMN_1_ ECU_ADDRESS 0x7fbf82 FORMAT "%3.0" /end MEASUREMENT
/begin MEASUREMENT tbl_frf[7].envd.cus_set[1][1] "" UBYTE _CNV_A_R_LINEAR_____0_CM 1 0. 0. 255. DISPLAY_IDENTIFIER FMY_FRF_8_ENVD_CUS_SET_2_CMN_2_ ECU_ADDRESS 0x7fbf83 FORMAT "%3.0" /end MEASUREMENT
/begin MEASUREMENT tbl_frf[7].envd.cus_set[1][2] "" UBYTE _CNV_A_R_LINEAR_____0_CM 1 0. 0. 255. DISPLAY_IDENTIFIER FMY_FRF_8_ENVD_CUS_SET_2_CMN_3_ ECU_ADDRESS 0x7fbf84 FORMAT "%3.0" /end MEASUREMENT
/begin MEASUREMENT tbl_frf[7].envd.cus_set[1][3] "" UBYTE _CNV_A_R_LINEAR_____0_CM 1 0. 0. 255. DISPLAY_IDENTIFIER FMY_FRF_8_ENVD_CUS_SET_2_CMN_4_ ECU_ADDRESS 0x7fbf85 FORMAT "%3.0" /end MEASUREMENT
/begin MEASUREMENT tbl_frf[7].envd.cus_set[1][4] "" UBYTE _CNV_A_R_LINEAR_____0_CM 1 0. 0. 255. DISPLAY_IDENTIFIER FMY_FRF_8_ENVD_CUS_SET_2_CMN_5_ ECU_ADDRESS 0x7fbf86 FORMAT "%3.0" /end MEASUREMENT
/begin MEASUREMENT tbl_frf[7].envd.cus_set[1][5] "" UBYTE _CNV_A_R_LINEAR_____0_CM 1 0. 0. 255. DISPLAY_IDENTIFIER FMY_FRF_8_ENVD_CUS_SET_2_CMN_6_ ECU_ADDRESS 0x7fbf87 FORMAT "%3.0" /end MEASUREMENT
/begin MEASUREMENT tbl_frf[7].envd.cus_set[1][6] "" UBYTE _CNV_A_R_LINEAR_____0_CM 1 0. 0. 255. DISPLAY_IDENTIFIER FMY_FRF_8_ENVD_CUS_SET_2_SPC_1_ ECU_ADDRESS 0x7fbf88 FORMAT "%3.0" /end MEASUREMENT
/begin MEASUREMENT tbl_frf[7].envd.cus_set[1][7] "" UBYTE _CNV_A_R_LINEAR_____0_CM 1 0. 0. 255. DISPLAY_IDENTIFIER FMY_FRF_8_ENVD_CUS_SET_2_SPC_2_ ECU_ADDRESS 0x7fbf89 FORMAT "%3.0" /end MEASUREMENT
/begin MEASUREMENT tbl_frf[7].envd.cus_set[1][8] "" UBYTE _CNV_A_R_LINEAR_____0_CM 1 0. 0. 255. DISPLAY_IDENTIFIER FMY_FRF_8_ENVD_CUS_SET_2_SPC_3_ ECU_ADDRESS 0x7fbf8a FORMAT "%3.0" /end MEASUREMENT
/begin MEASUREMENT tbl_frf[7].envd.cus_set[1][9] "" UBYTE _CNV_A_R_LINEAR_____0_CM 1 0. 0. 255. DISPLAY_IDENTIFIER FMY_FRF_8_ENVD_CUS_SET_2_SPC_4_ ECU_ADDRESS 0x7fbf8b FORMAT "%3.0" /end MEASUREMENT
/begin MEASUREMENT tbl_frf[7].envd.cus_set[1][10] "" UBYTE _CNV_A_R_LINEAR_____0_CM 1 0. 0. 255. DISPLAY_IDENTIFIER FMY_FRF_8_ENVD_CUS_SET_2_SPC_5_ ECU_ADDRESS 0x7fbf8c FORMAT "%3.0" /end MEASUREMENT
/begin MEASUREMENT tbl_frf[7].envd.cus_set[1][11] "" UBYTE _CNV_A_R_LINEAR_____0_CM 1 0. 0. 255. DISPLAY_IDENTIFIER FMY_FRF_8_ENVD_CUS_SET_2_SPC_6_ ECU_ADDRESS 0x7fbf8d FORMAT "%3.0" /end MEASUREMENT
/begin MEASUREMENT tbl_frf[7].envd.cus_set[1][12] "" UBYTE _CNV_A_R_LINEAR_____0_CM 1 0. 0. 255. DISPLAY_IDENTIFIER FMY_FRF_8_ENVD_CUS_SET_2_SPC_7_ ECU_ADDRESS 0x7fbf8e FORMAT "%3.0" /end MEASUREMENT
/begin MEASUREMENT tbl_frf[7].envd.cus_set[1][13] "" UBYTE _CNV_A_R_LINEAR_____0_CM 1 0. 0. 255. DISPLAY_IDENTIFIER FMY_FRF_8_ENVD_CUS_SET_2_SPC_8_ ECU_ADDRESS 0x7fbf8f FORMAT "%3.0" /end MEASUREMENT
/begin MEASUREMENT tbl_frf[7].envd.cmn_cus[0] "" UBYTE _CNV_A_R_LINEAR_____0_CM 1 0. 0. 255. DISPLAY_IDENTIFIER FMY_FRF_8_ENVD_CUS_CMN_1_ ECU_ADDRESS 0x7fbf90 FORMAT "%3.0" /end MEASUREMENT
/begin MEASUREMENT tbl_frf[7].envd.obd[0] "" UBYTE _CNV_A_R_LINEAR_____0_CM 1 0. 0. 255. DISPLAY_IDENTIFIER FMY_FRF_8_ENVD_OBD_1_ ECU_ADDRESS 0x7fbf91 FORMAT "%3.0" /end MEASUREMENT
/begin MEASUREMENT tbl_frf[7].envd.obd[1] "" UBYTE _CNV_A_R_LINEAR_____0_CM 1 0. 0. 255. DISPLAY_IDENTIFIER FMY_FRF_8_ENVD_OBD_2_ ECU_ADDRESS 0x7fbf92 FORMAT "%3.0" /end MEASUREMENT
/begin MEASUREMENT tbl_frf[7].envd.obd[2] "" UBYTE _CNV_A_R_LINEAR_____0_CM 1 0. 0. 255. DISPLAY_IDENTIFIER FMY_FRF_8_ENVD_OBD_3_ ECU_ADDRESS 0x7fbf93 FORMAT "%3.0" /end MEASUREMENT
/begin MEASUREMENT tbl_frf[7].envd.obd[3] "" UBYTE _CNV_A_R_LINEAR_____0_CM 1 0. 0. 255. DISPLAY_IDENTIFIER FMY_FRF_8_ENVD_OBD_4_ ECU_ADDRESS 0x7fbf94 FORMAT "%3.0" /end MEASUREMENT
/begin MEASUREMENT tbl_frf[7].envd.obd[4] "" UBYTE _CNV_A_R_LINEAR_____0_CM 1 0. 0. 255. DISPLAY_IDENTIFIER FMY_FRF_8_ENVD_OBD_5_ ECU_ADDRESS 0x7fbf95 FORMAT "%3.0" /end MEASUREMENT
/begin MEASUREMENT tbl_frf[7].envd.obd[5] "" UBYTE _CNV_A_R_LINEAR_____0_CM 1 0. 0. 255. DISPLAY_IDENTIFIER FMY_FRF_8_ENVD_OBD_6_ ECU_ADDRESS 0x7fbf96 FORMAT "%3.0" /end MEASUREMENT
/begin MEASUREMENT tbl_frf[7].envd.obd[6] "" UBYTE _CNV_A_R_LINEAR_____0_CM 1 0. 0. 255. DISPLAY_IDENTIFIER FMY_FRF_8_ENVD_OBD_7_ ECU_ADDRESS 0x7fbf97 FORMAT "%3.0" /end MEASUREMENT
/begin MEASUREMENT tbl_frf[7].envd.obd[7] "" UBYTE _CNV_A_R_LINEAR_____0_CM 1 0. 0. 255. DISPLAY_IDENTIFIER FMY_FRF_8_ENVD_OBD_8_ ECU_ADDRESS 0x7fbf98 FORMAT "%3.0" /end MEASUREMENT
/begin MEASUREMENT tbl_frf[8].envd.header "" UBYTE _CNV_A_R_LINEAR_____0_CM 1 0. 0. 255. DISPLAY_IDENTIFIER FMY_FRF_9_ENVD_HD ECU_ADDRESS 0x7fbf99 FORMAT "%3.0" /end MEASUREMENT
/begin MEASUREMENT tbl_frf[8].envd.cus_set[0][0] "" UBYTE _CNV_A_R_LINEAR_____0_CM 1 0. 0. 255. DISPLAY_IDENTIFIER FMY_FRF_9_ENVD_CUS_SET_1_CMN_1_ ECU_ADDRESS 0x7fbf9a FORMAT "%3.0" /end MEASUREMENT
/begin MEASUREMENT tbl_frf[8].envd.cus_set[0][1] "" UBYTE _CNV_A_R_LINEAR_____0_CM 1 0. 0. 255. DISPLAY_IDENTIFIER FMY_FRF_9_ENVD_CUS_SET_1_CMN_2_ ECU_ADDRESS 0x7fbf9b FORMAT "%3.0" /end MEASUREMENT
/begin MEASUREMENT tbl_frf[8].envd.cus_set[0][2] "" UBYTE _CNV_A_R_LINEAR_____0_CM 1 0. 0. 255. DISPLAY_IDENTIFIER FMY_FRF_9_ENVD_CUS_SET_1_CMN_3_ ECU_ADDRESS 0x7fbf9c FORMAT "%3.0" /end MEASUREMENT
/begin MEASUREMENT tbl_frf[8].envd.cus_set[0][3] "" UBYTE _CNV_A_R_LINEAR_____0_CM 1 0. 0. 255. DISPLAY_IDENTIFIER FMY_FRF_9_ENVD_CUS_SET_1_CMN_4_ ECU_ADDRESS 0x7fbf9d FORMAT "%3.0" /end MEASUREMENT
/begin MEASUREMENT tbl_frf[8].envd.cus_set[0][4] "" UBYTE _CNV_A_R_LINEAR_____0_CM 1 0. 0. 255. DISPLAY_IDENTIFIER FMY_FRF_9_ENVD_CUS_SET_1_CMN_5_ ECU_ADDRESS 0x7fbf9e FORMAT "%3.0" /end MEASUREMENT
/begin MEASUREMENT tbl_frf[8].envd.cus_set[0][5] "" UBYTE _CNV_A_R_LINEAR_____0_CM 1 0. 0. 255. DISPLAY_IDENTIFIER FMY_FRF_9_ENVD_CUS_SET_1_CMN_6_ ECU_ADDRESS 0x7fbf9f FORMAT "%3.0" /end MEASUREMENT
/begin MEASUREMENT tbl_frf[8].envd.cus_set[0][6] "" UBYTE _CNV_A_R_LINEAR_____0_CM 1 0. 0. 255. DISPLAY_IDENTIFIER FMY_FRF_9_ENVD_CUS_SET_1_SPC_1_ ECU_ADDRESS 0x7fbfa0 FORMAT "%3.0" /end MEASUREMENT
/begin MEASUREMENT tbl_frf[8].envd.cus_set[0][7] "" UBYTE _CNV_A_R_LINEAR_____0_CM 1 0. 0. 255. DISPLAY_IDENTIFIER FMY_FRF_9_ENVD_CUS_SET_1_SPC_2_ ECU_ADDRESS 0x7fbfa1 FORMAT "%3.0" /end MEASUREMENT
/begin MEASUREMENT tbl_frf[8].envd.cus_set[0][8] "" UBYTE _CNV_A_R_LINEAR_____0_CM 1 0. 0. 255. DISPLAY_IDENTIFIER FMY_FRF_9_ENVD_CUS_SET_1_SPC_3_ ECU_ADDRESS 0x7fbfa2 FORMAT "%3.0" /end MEASUREMENT
/begin MEASUREMENT tbl_frf[8].envd.cus_set[0][9] "" UBYTE _CNV_A_R_LINEAR_____0_CM 1 0. 0. 255. DISPLAY_IDENTIFIER FMY_FRF_9_ENVD_CUS_SET_1_SPC_4_ ECU_ADDRESS 0x7fbfa3 FORMAT "%3.0" /end MEASUREMENT
/begin MEASUREMENT tbl_frf[8].envd.cus_set[0][10] "" UBYTE _CNV_A_R_LINEAR_____0_CM 1 0. 0. 255. DISPLAY_IDENTIFIER FMY_FRF_9_ENVD_CUS_SET_1_SPC_5_ ECU_ADDRESS 0x7fbfa4 FORMAT "%3.0" /end MEASUREMENT
/begin MEASUREMENT tbl_frf[8].envd.cus_set[0][11] "" UBYTE _CNV_A_R_LINEAR_____0_CM 1 0. 0. 255. DISPLAY_IDENTIFIER FMY_FRF_9_ENVD_CUS_SET_1_SPC_6_ ECU_ADDRESS 0x7fbfa5 FORMAT "%3.0" /end MEASUREMENT
/begin MEASUREMENT tbl_frf[8].envd.cus_set[0][12] "" UBYTE _CNV_A_R_LINEAR_____0_CM 1 0. 0. 255. DISPLAY_IDENTIFIER FMY_FRF_9_ENVD_CUS_SET_1_SPC_7_ ECU_ADDRESS 0x7fbfa6 FORMAT "%3.0" /end MEASUREMENT
/begin MEASUREMENT tbl_frf[8].envd.cus_set[0][13] "" UBYTE _CNV_A_R_LINEAR_____0_CM 1 0. 0. 255. DISPLAY_IDENTIFIER FMY_FRF_9_ENVD_CUS_SET_1_SPC_8_ ECU_ADDRESS 0x7fbfa7 FORMAT "%3.0" /end MEASUREMENT
/begin MEASUREMENT tbl_frf[8].envd.cus_set[1][0] "" UBYTE _CNV_A_R_LINEAR_____0_CM 1 0. 0. 255. DISPLAY_IDENTIFIER FMY_FRF_9_ENVD_CUS_SET_2_CMN_1_ ECU_ADDRESS 0x7fbfa8 FORMAT "%3.0" /end MEASUREMENT
/begin MEASUREMENT tbl_frf[8].envd.cus_set[1][1] "" UBYTE _CNV_A_R_LINEAR_____0_CM 1 0. 0. 255. DISPLAY_IDENTIFIER FMY_FRF_9_ENVD_CUS_SET_2_CMN_2_ ECU_ADDRESS 0x7fbfa9 FORMAT "%3.0" /end MEASUREMENT
/begin MEASUREMENT tbl_frf[8].envd.cus_set[1][2] "" UBYTE _CNV_A_R_LINEAR_____0_CM 1 0. 0. 255. DISPLAY_IDENTIFIER FMY_FRF_9_ENVD_CUS_SET_2_CMN_3_ ECU_ADDRESS 0x7fbfaa FORMAT "%3.0" /end MEASUREMENT
/begin MEASUREMENT tbl_frf[8].envd.cus_set[1][3] "" UBYTE _CNV_A_R_LINEAR_____0_CM 1 0. 0. 255. DISPLAY_IDENTIFIER FMY_FRF_9_ENVD_CUS_SET_2_CMN_4_ ECU_ADDRESS 0x7fbfab FORMAT "%3.0" /end MEASUREMENT
/begin MEASUREMENT tbl_frf[8].envd.cus_set[1][4] "" UBYTE _CNV_A_R_LINEAR_____0_CM 1 0. 0. 255. DISPLAY_IDENTIFIER FMY_FRF_9_ENVD_CUS_SET_2_CMN_5_ ECU_ADDRESS 0x7fbfac FORMAT "%3.0" /end MEASUREMENT
/begin MEASUREMENT tbl_frf[8].envd.cus_set[1][5] "" UBYTE _CNV_A_R_LINEAR_____0_CM 1 0. 0. 255. DISPLAY_IDENTIFIER FMY_FRF_9_ENVD_CUS_SET_2_CMN_6_ ECU_ADDRESS 0x7fbfad FORMAT "%3.0" /end MEASUREMENT
/begin MEASUREMENT tbl_frf[8].envd.cus_set[1][6] "" UBYTE _CNV_A_R_LINEAR_____0_CM 1 0. 0. 255. DISPLAY_IDENTIFIER FMY_FRF_9_ENVD_CUS_SET_2_SPC_1_ ECU_ADDRESS 0x7fbfae FORMAT "%3.0" /end MEASUREMENT
/begin MEASUREMENT tbl_frf[8].envd.cus_set[1][7] "" UBYTE _CNV_A_R_LINEAR_____0_CM 1 0. 0. 255. DISPLAY_IDENTIFIER FMY_FRF_9_ENVD_CUS_SET_2_SPC_2_ ECU_ADDRESS 0x7fbfaf FORMAT "%3.0" /end MEASUREMENT
/begin MEASUREMENT tbl_frf[8].envd.cus_set[1][8] "" UBYTE _CNV_A_R_LINEAR_____0_CM 1 0. 0. 255. DISPLAY_IDENTIFIER FMY_FRF_9_ENVD_CUS_SET_2_SPC_3_ ECU_ADDRESS 0x7fbfb0 FORMAT "%3.0" /end MEASUREMENT
/begin MEASUREMENT tbl_frf[8].envd.cus_set[1][9] "" UBYTE _CNV_A_R_LINEAR_____0_CM 1 0. 0. 255. DISPLAY_IDENTIFIER FMY_FRF_9_ENVD_CUS_SET_2_SPC_4_ ECU_ADDRESS 0x7fbfb1 FORMAT "%3.0" /end MEASUREMENT
/begin MEASUREMENT tbl_frf[8].envd.cus_set[1][10] "" UBYTE _CNV_A_R_LINEAR_____0_CM 1 0. 0. 255. DISPLAY_IDENTIFIER FMY_FRF_9_ENVD_CUS_SET_2_SPC_5_ ECU_ADDRESS 0x7fbfb2 FORMAT "%3.0" /end MEASUREMENT
/begin MEASUREMENT tbl_frf[8].envd.cus_set[1][11] "" UBYTE _CNV_A_R_LINEAR_____0_CM 1 0. 0. 255. DISPLAY_IDENTIFIER FMY_FRF_9_ENVD_CUS_SET_2_SPC_6_ ECU_ADDRESS 0x7fbfb3 FORMAT "%3.0" /end MEASUREMENT
/begin MEASUREMENT tbl_frf[8].envd.cus_set[1][12] "" UBYTE _CNV_A_R_LINEAR_____0_CM 1 0. 0. 255. DISPLAY_IDENTIFIER FMY_FRF_9_ENVD_CUS_SET_2_SPC_7_ ECU_ADDRESS 0x7fbfb4 FORMAT "%3.0" /end MEASUREMENT
/begin MEASUREMENT tbl_frf[8].envd.cus_set[1][13] "" UBYTE _CNV_A_R_LINEAR_____0_CM 1 0. 0. 255. DISPLAY_IDENTIFIER FMY_FRF_9_ENVD_CUS_SET_2_SPC_8_ ECU_ADDRESS 0x7fbfb5 FORMAT "%3.0" /end MEASUREMENT
/begin MEASUREMENT tbl_frf[8].envd.cmn_cus[0] "" UBYTE _CNV_A_R_LINEAR_____0_CM 1 0. 0. 255. DISPLAY_IDENTIFIER FMY_FRF_9_ENVD_CUS_CMN_1_ ECU_ADDRESS 0x7fbfb6 FORMAT "%3.0" /end MEASUREMENT
/begin MEASUREMENT tbl_frf[8].envd.obd[0] "" UBYTE _CNV_A_R_LINEAR_____0_CM 1 0. 0. 255. DISPLAY_IDENTIFIER FMY_FRF_9_ENVD_OBD_1_ ECU_ADDRESS 0x7fbfb7 FORMAT "%3.0" /end MEASUREMENT
/begin MEASUREMENT tbl_frf[8].envd.obd[1] "" UBYTE _CNV_A_R_LINEAR_____0_CM 1 0. 0. 255. DISPLAY_IDENTIFIER FMY_FRF_9_ENVD_OBD_2_ ECU_ADDRESS 0x7fbfb8 FORMAT "%3.0" /end MEASUREMENT
/begin MEASUREMENT tbl_frf[8].envd.obd[2] "" UBYTE _CNV_A_R_LINEAR_____0_CM 1 0. 0. 255. DISPLAY_IDENTIFIER FMY_FRF_9_ENVD_OBD_3_ ECU_ADDRESS 0x7fbfb9 FORMAT "%3.0" /end MEASUREMENT
/begin MEASUREMENT tbl_frf[8].envd.obd[3] "" UBYTE _CNV_A_R_LINEAR_____0_CM 1 0. 0. 255. DISPLAY_IDENTIFIER FMY_FRF_9_ENVD_OBD_4_ ECU_ADDRESS 0x7fbfba FORMAT "%3.0" /end MEASUREMENT
/begin MEASUREMENT tbl_frf[8].envd.obd[4] "" UBYTE _CNV_A_R_LINEAR_____0_CM 1 0. 0. 255. DISPLAY_IDENTIFIER FMY_FRF_9_ENVD_OBD_5_ ECU_ADDRESS 0x7fbfbb FORMAT "%3.0" /end MEASUREMENT
/begin MEASUREMENT tbl_frf[8].envd.obd[5] "" UBYTE _CNV_A_R_LINEAR_____0_CM 1 0. 0. 255. DISPLAY_IDENTIFIER FMY_FRF_9_ENVD_OBD_6_ ECU_ADDRESS 0x7fbfbc FORMAT "%3.0" /end MEASUREMENT
/begin MEASUREMENT tbl_frf[8].envd.obd[6] "" UBYTE _CNV_A_R_LINEAR_____0_CM 1 0. 0. 255. DISPLAY_IDENTIFIER FMY_FRF_9_ENVD_OBD_7_ ECU_ADDRESS 0x7fbfbd FORMAT "%3.0" /end MEASUREMENT
/begin MEASUREMENT tbl_frf[8].envd.obd[7] "" UBYTE _CNV_A_R_LINEAR_____0_CM 1 0. 0. 255. DISPLAY_IDENTIFIER FMY_FRF_9_ENVD_OBD_8_ ECU_ADDRESS 0x7fbfbe FORMAT "%3.0" /end MEASUREMENT
/begin MEASUREMENT tbl_frf[9].envd.header "" UBYTE _CNV_A_R_LINEAR_____0_CM 1 0. 0. 255. DISPLAY_IDENTIFIER FMY_FRF_10_ENVD_HD ECU_ADDRESS 0x7fbfbf FORMAT "%3.0" /end MEASUREMENT
/begin MEASUREMENT tbl_frf[9].envd.cus_set[0][0] "" UBYTE _CNV_A_R_LINEAR_____0_CM 1 0. 0. 255. DISPLAY_IDENTIFIER FMY_FRF_10_ENVD_CUS_SET_1_CMN_1_ ECU_ADDRESS 0x7fbfc0 FORMAT "%3.0" /end MEASUREMENT
/begin MEASUREMENT tbl_frf[9].envd.cus_set[0][1] "" UBYTE _CNV_A_R_LINEAR_____0_CM 1 0. 0. 255. DISPLAY_IDENTIFIER FMY_FRF_10_ENVD_CUS_SET_1_CMN_2_ ECU_ADDRESS 0x7fbfc1 FORMAT "%3.0" /end MEASUREMENT
/begin MEASUREMENT tbl_frf[9].envd.cus_set[0][2] "" UBYTE _CNV_A_R_LINEAR_____0_CM 1 0. 0. 255. DISPLAY_IDENTIFIER FMY_FRF_10_ENVD_CUS_SET_1_CMN_3_ ECU_ADDRESS 0x7fbfc2 FORMAT "%3.0" /end MEASUREMENT
/begin MEASUREMENT tbl_frf[9].envd.cus_set[0][3] "" UBYTE _CNV_A_R_LINEAR_____0_CM 1 0. 0. 255. DISPLAY_IDENTIFIER FMY_FRF_10_ENVD_CUS_SET_1_CMN_4_ ECU_ADDRESS 0x7fbfc3 FORMAT "%3.0" /end MEASUREMENT
/begin MEASUREMENT tbl_frf[9].envd.cus_set[0][4] "" UBYTE _CNV_A_R_LINEAR_____0_CM 1 0. 0. 255. DISPLAY_IDENTIFIER FMY_FRF_10_ENVD_CUS_SET_1_CMN_5_ ECU_ADDRESS 0x7fbfc4 FORMAT "%3.0" /end MEASUREMENT
/begin MEASUREMENT tbl_frf[9].envd.cus_set[0][5] "" UBYTE _CNV_A_R_LINEAR_____0_CM 1 0. 0. 255. DISPLAY_IDENTIFIER FMY_FRF_10_ENVD_CUS_SET_1_CMN_6_ ECU_ADDRESS 0x7fbfc5 FORMAT "%3.0" /end MEASUREMENT
/begin MEASUREMENT tbl_frf[9].envd.cus_set[0][6] "" UBYTE _CNV_A_R_LINEAR_____0_CM 1 0. 0. 255. DISPLAY_IDENTIFIER FMY_FRF_10_ENVD_CUS_SET_1_SPC_1_ ECU_ADDRESS 0x7fbfc6 FORMAT "%3.0" /end MEASUREMENT
/begin MEASUREMENT tbl_frf[9].envd.cus_set[0][7] "" UBYTE _CNV_A_R_LINEAR_____0_CM 1 0. 0. 255. DISPLAY_IDENTIFIER FMY_FRF_10_ENVD_CUS_SET_1_SPC_2_ ECU_ADDRESS 0x7fbfc7 FORMAT "%3.0" /end MEASUREMENT
/begin MEASUREMENT tbl_frf[9].envd.cus_set[0][8] "" UBYTE _CNV_A_R_LINEAR_____0_CM 1 0. 0. 255. DISPLAY_IDENTIFIER FMY_FRF_10_ENVD_CUS_SET_1_SPC_3_ ECU_ADDRESS 0x7fbfc8 FORMAT "%3.0" /end MEASUREMENT
/begin MEASUREMENT tbl_frf[9].envd.cus_set[0][9] "" UBYTE _CNV_A_R_LINEAR_____0_CM 1 0. 0. 255. DISPLAY_IDENTIFIER FMY_FRF_10_ENVD_CUS_SET_1_SPC_4_ ECU_ADDRESS 0x7fbfc9 FORMAT "%3.0" /end MEASUREMENT
/begin MEASUREMENT tbl_frf[9].envd.cus_set[0][10] "" UBYTE _CNV_A_R_LINEAR_____0_CM 1 0. 0. 255. DISPLAY_IDENTIFIER FMY_FRF_10_ENVD_CUS_SET_1_SPC_5_ ECU_ADDRESS 0x7fbfca FORMAT "%3.0" /end MEASUREMENT
/begin MEASUREMENT tbl_frf[9].envd.cus_set[0][11] "" UBYTE _CNV_A_R_LINEAR_____0_CM 1 0. 0. 255. DISPLAY_IDENTIFIER FMY_FRF_10_ENVD_CUS_SET_1_SPC_6_ ECU_ADDRESS 0x7fbfcb FORMAT "%3.0" /end MEASUREMENT
/begin MEASUREMENT tbl_frf[9].envd.cus_set[0][12] "" UBYTE _CNV_A_R_LINEAR_____0_CM 1 0. 0. 255. DISPLAY_IDENTIFIER FMY_FRF_10_ENVD_CUS_SET_1_SPC_7_ ECU_ADDRESS 0x7fbfcc FORMAT "%3.0" /end MEASUREMENT
/begin MEASUREMENT tbl_frf[9].envd.cus_set[0][13] "" UBYTE _CNV_A_R_LINEAR_____0_CM 1 0. 0. 255. DISPLAY_IDENTIFIER FMY_FRF_10_ENVD_CUS_SET_1_SPC_8_ ECU_ADDRESS 0x7fbfcd FORMAT "%3.0" /end MEASUREMENT
/begin MEASUREMENT tbl_frf[9].envd.cus_set[1][0] "" UBYTE _CNV_A_R_LINEAR_____0_CM 1 0. 0. 255. DISPLAY_IDENTIFIER FMY_FRF_10_ENVD_CUS_SET_2_CMN_1_ ECU_ADDRESS 0x7fbfce FORMAT "%3.0" /end MEASUREMENT
/begin MEASUREMENT tbl_frf[9].envd.cus_set[1][1] "" UBYTE _CNV_A_R_LINEAR_____0_CM 1 0. 0. 255. DISPLAY_IDENTIFIER FMY_FRF_10_ENVD_CUS_SET_2_CMN_2_ ECU_ADDRESS 0x7fbfcf FORMAT "%3.0" /end MEASUREMENT
/begin MEASUREMENT tbl_frf[9].envd.cus_set[1][2] "" UBYTE _CNV_A_R_LINEAR_____0_CM 1 0. 0. 255. DISPLAY_IDENTIFIER FMY_FRF_10_ENVD_CUS_SET_2_CMN_3_ ECU_ADDRESS 0x7fbfd0 FORMAT "%3.0" /end MEASUREMENT
/begin MEASUREMENT tbl_frf[9].envd.cus_set[1][3] "" UBYTE _CNV_A_R_LINEAR_____0_CM 1 0. 0. 255. DISPLAY_IDENTIFIER FMY_FRF_10_ENVD_CUS_SET_2_CMN_4_ ECU_ADDRESS 0x7fbfd1 FORMAT "%3.0" /end MEASUREMENT
/begin MEASUREMENT tbl_frf[9].envd.cus_set[1][4] "" UBYTE _CNV_A_R_LINEAR_____0_CM 1 0. 0. 255. DISPLAY_IDENTIFIER FMY_FRF_10_ENVD_CUS_SET_2_CMN_5_ ECU_ADDRESS 0x7fbfd2 FORMAT "%3.0" /end MEASUREMENT
/begin MEASUREMENT tbl_frf[9].envd.cus_set[1][5] "" UBYTE _CNV_A_R_LINEAR_____0_CM 1 0. 0. 255. DISPLAY_IDENTIFIER FMY_FRF_10_ENVD_CUS_SET_2_CMN_6_ ECU_ADDRESS 0x7fbfd3 FORMAT "%3.0" /end MEASUREMENT
/begin MEASUREMENT tbl_frf[9].envd.cus_set[1][6] "" UBYTE _CNV_A_R_LINEAR_____0_CM 1 0. 0. 255. DISPLAY_IDENTIFIER FMY_FRF_10_ENVD_CUS_SET_2_SPC_1_ ECU_ADDRESS 0x7fbfd4 FORMAT "%3.0" /end MEASUREMENT
/begin MEASUREMENT tbl_frf[9].envd.cus_set[1][7] "" UBYTE _CNV_A_R_LINEAR_____0_CM 1 0. 0. 255. DISPLAY_IDENTIFIER FMY_FRF_10_ENVD_CUS_SET_2_SPC_2_ ECU_ADDRESS 0x7fbfd5 FORMAT "%3.0" /end MEASUREMENT
/begin MEASUREMENT tbl_frf[9].envd.cus_set[1][8] "" UBYTE _CNV_A_R_LINEAR_____0_CM 1 0. 0. 255. DISPLAY_IDENTIFIER FMY_FRF_10_ENVD_CUS_SET_2_SPC_3_ ECU_ADDRESS 0x7fbfd6 FORMAT "%3.0" /end MEASUREMENT
/begin MEASUREMENT tbl_frf[9].envd.cus_set[1][9] "" UBYTE _CNV_A_R_LINEAR_____0_CM 1 0. 0. 255. DISPLAY_IDENTIFIER FMY_FRF_10_ENVD_CUS_SET_2_SPC_4_ ECU_ADDRESS 0x7fbfd7 FORMAT "%3.0" /end MEASUREMENT
/begin MEASUREMENT tbl_frf[9].envd.cus_set[1][10] "" UBYTE _CNV_A_R_LINEAR_____0_CM 1 0. 0. 255. DISPLAY_IDENTIFIER FMY_FRF_10_ENVD_CUS_SET_2_SPC_5_ ECU_ADDRESS 0x7fbfd8 FORMAT "%3.0" /end MEASUREMENT
/begin MEASUREMENT tbl_frf[9].envd.cus_set[1][11] "" UBYTE _CNV_A_R_LINEAR_____0_CM 1 0. 0. 255. DISPLAY_IDENTIFIER FMY_FRF_10_ENVD_CUS_SET_2_SPC_6_ ECU_ADDRESS 0x7fbfd9 FORMAT "%3.0" /end MEASUREMENT
/begin MEASUREMENT tbl_frf[9].envd.cus_set[1][12] "" UBYTE _CNV_A_R_LINEAR_____0_CM 1 0. 0. 255. DISPLAY_IDENTIFIER FMY_FRF_10_ENVD_CUS_SET_2_SPC_7_ ECU_ADDRESS 0x7fbfda FORMAT "%3.0" /end MEASUREMENT
/begin MEASUREMENT tbl_frf[9].envd.cus_set[1][13] "" UBYTE _CNV_A_R_LINEAR_____0_CM 1 0. 0. 255. DISPLAY_IDENTIFIER FMY_FRF_10_ENVD_CUS_SET_2_SPC_8_ ECU_ADDRESS 0x7fbfdb FORMAT "%3.0" /end MEASUREMENT
/begin MEASUREMENT tbl_frf[9].envd.cmn_cus[0] "" UBYTE _CNV_A_R_LINEAR_____0_CM 1 0. 0. 255. DISPLAY_IDENTIFIER FMY_FRF_10_ENVD_CUS_CMN_1_ ECU_ADDRESS 0x7fbfdc FORMAT "%3.0" /end MEASUREMENT
/begin MEASUREMENT tbl_frf[9].envd.obd[0] "" UBYTE _CNV_A_R_LINEAR_____0_CM 1 0. 0. 255. DISPLAY_IDENTIFIER FMY_FRF_10_ENVD_OBD_1_ ECU_ADDRESS 0x7fbfdd FORMAT "%3.0" /end MEASUREMENT
/begin MEASUREMENT tbl_frf[9].envd.obd[1] "" UBYTE _CNV_A_R_LINEAR_____0_CM 1 0. 0. 255. DISPLAY_IDENTIFIER FMY_FRF_10_ENVD_OBD_2_ ECU_ADDRESS 0x7fbfde FORMAT "%3.0" /end MEASUREMENT
/begin MEASUREMENT tbl_frf[9].envd.obd[2] "" UBYTE _CNV_A_R_LINEAR_____0_CM 1 0. 0. 255. DISPLAY_IDENTIFIER FMY_FRF_10_ENVD_OBD_3_ ECU_ADDRESS 0x7fbfdf FORMAT "%3.0" /end MEASUREMENT
/begin MEASUREMENT tbl_frf[9].envd.obd[3] "" UBYTE _CNV_A_R_LINEAR_____0_CM 1 0. 0. 255. DISPLAY_IDENTIFIER FMY_FRF_10_ENVD_OBD_4_ ECU_ADDRESS 0x7fbfe0 FORMAT "%3.0" /end MEASUREMENT
/begin MEASUREMENT tbl_frf[9].envd.obd[4] "" UBYTE _CNV_A_R_LINEAR_____0_CM 1 0. 0. 255. DISPLAY_IDENTIFIER FMY_FRF_10_ENVD_OBD_5_ ECU_ADDRESS 0x7fbfe1 FORMAT "%3.0" /end MEASUREMENT
/begin MEASUREMENT tbl_frf[9].envd.obd[5] "" UBYTE _CNV_A_R_LINEAR_____0_CM 1 0. 0. 255. DISPLAY_IDENTIFIER FMY_FRF_10_ENVD_OBD_6_ ECU_ADDRESS 0x7fbfe2 FORMAT "%3.0" /end MEASUREMENT
/begin MEASUREMENT tbl_frf[9].envd.obd[6] "" UBYTE _CNV_A_R_LINEAR_____0_CM 1 0. 0. 255. DISPLAY_IDENTIFIER FMY_FRF_10_ENVD_OBD_7_ ECU_ADDRESS 0x7fbfe3 FORMAT "%3.0" /end MEASUREMENT
/begin MEASUREMENT tbl_frf[9].envd.obd[7] "" UBYTE _CNV_A_R_LINEAR_____0_CM 1 0. 0. 255. DISPLAY_IDENTIFIER FMY_FRF_10_ENVD_OBD_8_ ECU_ADDRESS 0x7fbfe4 FORMAT "%3.0" /end MEASUREMENT
/begin MEASUREMENT fmy_his[0][0] "" UBYTE _CNV_A_R_LINEAR_____0_CM 1 0. 0. 255. DISPLAY_IDENTIFIER FMY_HIS_1_1_ ECU_ADDRESS 0x7fc010 FORMAT "%3.0" /end MEASUREMENT
/begin MEASUREMENT fmy_his[0][1] "" UBYTE _CNV_A_R_LINEAR_____0_CM 1 0. 0. 255. DISPLAY_IDENTIFIER FMY_HIS_1_2_ ECU_ADDRESS 0x7fc011 FORMAT "%3.0" /end MEASUREMENT
/begin MEASUREMENT fmy_his[0][2] "" UBYTE _CNV_A_R_LINEAR_____0_CM 1 0. 0. 255. DISPLAY_IDENTIFIER FMY_HIS_1_3_ ECU_ADDRESS 0x7fc012 FORMAT "%3.0" /end MEASUREMENT
/begin MEASUREMENT fmy_his[0][3] "" UBYTE _CNV_A_R_LINEAR_____0_CM 1 0. 0. 255. DISPLAY_IDENTIFIER FMY_HIS_1_4_ ECU_ADDRESS 0x7fc013 FORMAT "%3.0" /end MEASUREMENT
/begin MEASUREMENT fmy_his[1][0] "" UBYTE _CNV_A_R_LINEAR_____0_CM 1 0. 0. 255. DISPLAY_IDENTIFIER FMY_HIS_2_1_ ECU_ADDRESS 0x7fc014 FORMAT "%3.0" /end MEASUREMENT
/begin MEASUREMENT fmy_his[1][1] "" UBYTE _CNV_A_R_LINEAR_____0_CM 1 0. 0. 255. DISPLAY_IDENTIFIER FMY_HIS_2_2_ ECU_ADDRESS 0x7fc015 FORMAT "%3.0" /end MEASUREMENT
/begin MEASUREMENT fmy_his[1][2] "" UBYTE _CNV_A_R_LINEAR_____0_CM 1 0. 0. 255. DISPLAY_IDENTIFIER FMY_HIS_2_3_ ECU_ADDRESS 0x7fc016 FORMAT "%3.0" /end MEASUREMENT
/begin MEASUREMENT fmy_his[1][3] "" UBYTE _CNV_A_R_LINEAR_____0_CM 1 0. 0. 255. DISPLAY_IDENTIFIER FMY_HIS_2_4_ ECU_ADDRESS 0x7fc017 FORMAT "%3.0" /end MEASUREMENT
/begin MEASUREMENT fmy_his[2][0] "" UBYTE _CNV_A_R_LINEAR_____0_CM 1 0. 0. 255. DISPLAY_IDENTIFIER FMY_HIS_3_1_ ECU_ADDRESS 0x7fc018 FORMAT "%3.0" /end MEASUREMENT
/begin MEASUREMENT fmy_his[2][1] "" UBYTE _CNV_A_R_LINEAR_____0_CM 1 0. 0. 255. DISPLAY_IDENTIFIER FMY_HIS_3_2_ ECU_ADDRESS 0x7fc019 FORMAT "%3.0" /end MEASUREMENT
/begin MEASUREMENT fmy_his[2][2] "" UBYTE _CNV_A_R_LINEAR_____0_CM 1 0. 0. 255. DISPLAY_IDENTIFIER FMY_HIS_3_3_ ECU_ADDRESS 0x7fc01a FORMAT "%3.0" /end MEASUREMENT
/begin MEASUREMENT fmy_his[2][3] "" UBYTE _CNV_A_R_LINEAR_____0_CM 1 0. 0. 255. DISPLAY_IDENTIFIER FMY_HIS_3_4_ ECU_ADDRESS 0x7fc01b FORMAT "%3.0" /end MEASUREMENT
/begin MEASUREMENT fmy_his[3][0] "" UBYTE _CNV_A_R_LINEAR_____0_CM 1 0. 0. 255. DISPLAY_IDENTIFIER FMY_HIS_4_1_ ECU_ADDRESS 0x7fc01c FORMAT "%3.0" /end MEASUREMENT
/begin MEASUREMENT fmy_his[3][1] "" UBYTE _CNV_A_R_LINEAR_____0_CM 1 0. 0. 255. DISPLAY_IDENTIFIER FMY_HIS_4_2_ ECU_ADDRESS 0x7fc01d FORMAT "%3.0" /end MEASUREMENT
/begin MEASUREMENT fmy_his[3][2] "" UBYTE _CNV_A_R_LINEAR_____0_CM 1 0. 0. 255. DISPLAY_IDENTIFIER FMY_HIS_4_3_ ECU_ADDRESS 0x7fc01e FORMAT "%3.0" /end MEASUREMENT
/begin MEASUREMENT fmy_his[3][3] "" UBYTE _CNV_A_R_LINEAR_____0_CM 1 0. 0. 255. DISPLAY_IDENTIFIER FMY_HIS_4_4_ ECU_ADDRESS 0x7fc01f FORMAT "%3.0" /end MEASUREMENT
/begin MEASUREMENT fmy_his[4][0] "" UBYTE _CNV_A_R_LINEAR_____0_CM 1 0. 0. 255. DISPLAY_IDENTIFIER FMY_HIS_5_1_ ECU_ADDRESS 0x7fc020 FORMAT "%3.0" /end MEASUREMENT
/begin MEASUREMENT fmy_his[4][1] "" UBYTE _CNV_A_R_LINEAR_____0_CM 1 0. 0. 255. DISPLAY_IDENTIFIER FMY_HIS_5_2_ ECU_ADDRESS 0x7fc021 FORMAT "%3.0" /end MEASUREMENT
/begin MEASUREMENT fmy_his[4][2] "" UBYTE _CNV_A_R_LINEAR_____0_CM 1 0. 0. 255. DISPLAY_IDENTIFIER FMY_HIS_5_3_ ECU_ADDRESS 0x7fc022 FORMAT "%3.0" /end MEASUREMENT
/begin MEASUREMENT fmy_his[4][3] "" UBYTE _CNV_A_R_LINEAR_____0_CM 1 0. 0. 255. DISPLAY_IDENTIFIER FMY_HIS_5_4_ ECU_ADDRESS 0x7fc023 FORMAT "%3.0" /end MEASUREMENT
/begin MEASUREMENT fmy_his[5][0] "" UBYTE _CNV_A_R_LINEAR_____0_CM 1 0. 0. 255. DISPLAY_IDENTIFIER FMY_HIS_6_1_ ECU_ADDRESS 0x7fc024 FORMAT "%3.0" /end MEASUREMENT
/begin MEASUREMENT fmy_his[5][1] "" UBYTE _CNV_A_R_LINEAR_____0_CM 1 0. 0. 255. DISPLAY_IDENTIFIER FMY_HIS_6_2_ ECU_ADDRESS 0x7fc025 FORMAT "%3.0" /end MEASUREMENT
/begin MEASUREMENT fmy_his[5][2] "" UBYTE _CNV_A_R_LINEAR_____0_CM 1 0. 0. 255. DISPLAY_IDENTIFIER FMY_HIS_6_3_ ECU_ADDRESS 0x7fc026 FORMAT "%3.0" /end MEASUREMENT
/begin MEASUREMENT fmy_his[5][3] "" UBYTE _CNV_A_R_LINEAR_____0_CM 1 0. 0. 255. DISPLAY_IDENTIFIER FMY_HIS_6_4_ ECU_ADDRESS 0x7fc027 FORMAT "%3.0" /end MEASUREMENT
/begin MEASUREMENT fmy_his[6][0] "" UBYTE _CNV_A_R_LINEAR_____0_CM 1 0. 0. 255. DISPLAY_IDENTIFIER FMY_HIS_7_1_ ECU_ADDRESS 0x7fc028 FORMAT "%3.0" /end MEASUREMENT
/begin MEASUREMENT fmy_his[6][1] "" UBYTE _CNV_A_R_LINEAR_____0_CM 1 0. 0. 255. DISPLAY_IDENTIFIER FMY_HIS_7_2_ ECU_ADDRESS 0x7fc029 FORMAT "%3.0" /end MEASUREMENT
/begin MEASUREMENT fmy_his[6][2] "" UBYTE _CNV_A_R_LINEAR_____0_CM 1 0. 0. 255. DISPLAY_IDENTIFIER FMY_HIS_7_3_ ECU_ADDRESS 0x7fc02a FORMAT "%3.0" /end MEASUREMENT
/begin MEASUREMENT fmy_his[6][3] "" UBYTE _CNV_A_R_LINEAR_____0_CM 1 0. 0. 255. DISPLAY_IDENTIFIER FMY_HIS_7_4_ ECU_ADDRESS 0x7fc02b FORMAT "%3.0" /end MEASUREMENT
/begin MEASUREMENT fmy_his[7][0] "" UBYTE _CNV_A_R_LINEAR_____0_CM 1 0. 0. 255. DISPLAY_IDENTIFIER FMY_HIS_8_1_ ECU_ADDRESS 0x7fc02c FORMAT "%3.0" /end MEASUREMENT
/begin MEASUREMENT fmy_his[7][1] "" UBYTE _CNV_A_R_LINEAR_____0_CM 1 0. 0. 255. DISPLAY_IDENTIFIER FMY_HIS_8_2_ ECU_ADDRESS 0x7fc02d FORMAT "%3.0" /end MEASUREMENT
/begin MEASUREMENT fmy_his[7][2] "" UBYTE _CNV_A_R_LINEAR_____0_CM 1 0. 0. 255. DISPLAY_IDENTIFIER FMY_HIS_8_3_ ECU_ADDRESS 0x7fc02e FORMAT "%3.0" /end MEASUREMENT
/begin MEASUREMENT fmy_his[7][3] "" UBYTE _CNV_A_R_LINEAR_____0_CM 1 0. 0. 255. DISPLAY_IDENTIFIER FMY_HIS_8_4_ ECU_ADDRESS 0x7fc02f FORMAT "%3.0" /end MEASUREMENT
/begin MEASUREMENT fmy_his[8][0] "" UBYTE _CNV_A_R_LINEAR_____0_CM 1 0. 0. 255. DISPLAY_IDENTIFIER FMY_HIS_9_1_ ECU_ADDRESS 0x7fc030 FORMAT "%3.0" /end MEASUREMENT
/begin MEASUREMENT fmy_his[8][1] "" UBYTE _CNV_A_R_LINEAR_____0_CM 1 0. 0. 255. DISPLAY_IDENTIFIER FMY_HIS_9_2_ ECU_ADDRESS 0x7fc031 FORMAT "%3.0" /end MEASUREMENT
/begin MEASUREMENT fmy_his[8][2] "" UBYTE _CNV_A_R_LINEAR_____0_CM 1 0. 0. 255. DISPLAY_IDENTIFIER FMY_HIS_9_3_ ECU_ADDRESS 0x7fc032 FORMAT "%3.0" /end MEASUREMENT
/begin MEASUREMENT fmy_his[8][3] "" UBYTE _CNV_A_R_LINEAR_____0_CM 1 0. 0. 255. DISPLAY_IDENTIFIER FMY_HIS_9_4_ ECU_ADDRESS 0x7fc033 FORMAT "%3.0" /end MEASUREMENT
/begin MEASUREMENT fmy_his[9][0] "" UBYTE _CNV_A_R_LINEAR_____0_CM 1 0. 0. 255. DISPLAY_IDENTIFIER FMY_HIS_10_1_ ECU_ADDRESS 0x7fc034 FORMAT "%3.0" /end MEASUREMENT
/begin MEASUREMENT fmy_his[9][1] "" UBYTE _CNV_A_R_LINEAR_____0_CM 1 0. 0. 255. DISPLAY_IDENTIFIER FMY_HIS_10_2_ ECU_ADDRESS 0x7fc035 FORMAT "%3.0" /end MEASUREMENT
/begin MEASUREMENT fmy_his[9][2] "" UBYTE _CNV_A_R_LINEAR_____0_CM 1 0. 0. 255. DISPLAY_IDENTIFIER FMY_HIS_10_3_ ECU_ADDRESS 0x7fc036 FORMAT "%3.0" /end MEASUREMENT
/begin MEASUREMENT fmy_his[9][3] "" UBYTE _CNV_A_R_LINEAR_____0_CM 1 0. 0. 255. DISPLAY_IDENTIFIER FMY_HIS_10_4_ ECU_ADDRESS 0x7fc037 FORMAT "%3.0" /end MEASUREMENT
/begin MEASUREMENT fmy_his_cod[0] "DTC of failure in history memory" UWORD _CNV_A_R_LINEAR_____0_CM 1 0. 0. 65535. DISPLAY_IDENTIFIER FMY_HIS_1_COD ECU_ADDRESS 0x7fbffc BYTE_ORDER MSB_LAST FORMAT "%5.0" /end MEASUREMENT
/begin MEASUREMENT fmy_his_cod[1] "DTC of failure in history memory" UWORD _CNV_A_R_LINEAR_____0_CM 1 0. 0. 65535. DISPLAY_IDENTIFIER FMY_HIS_2_COD ECU_ADDRESS 0x7fbffe BYTE_ORDER MSB_LAST FORMAT "%5.0" /end MEASUREMENT
/begin MEASUREMENT fmy_his_cod[2] "DTC of failure in history memory" UWORD _CNV_A_R_LINEAR_____0_CM 1 0. 0. 65535. DISPLAY_IDENTIFIER FMY_HIS_3_COD ECU_ADDRESS 0x7fc000 BYTE_ORDER MSB_LAST FORMAT "%5.0" /end MEASUREMENT
/begin MEASUREMENT fmy_his_cod[3] "DTC of failure in history memory" UWORD _CNV_A_R_LINEAR_____0_CM 1 0. 0. 65535. DISPLAY_IDENTIFIER FMY_HIS_4_COD ECU_ADDRESS 0x7fc002 BYTE_ORDER MSB_LAST FORMAT "%5.0" /end MEASUREMENT
/begin MEASUREMENT fmy_his_cod[4] "DTC of failure in history memory" UWORD _CNV_A_R_LINEAR_____0_CM 1 0. 0. 65535. DISPLAY_IDENTIFIER FMY_HIS_5_COD ECU_ADDRESS 0x7fc004 BYTE_ORDER MSB_LAST FORMAT "%5.0" /end MEASUREMENT
/begin MEASUREMENT fmy_his_cod[5] "DTC of failure in history memory" UWORD _CNV_A_R_LINEAR_____0_CM 1 0. 0. 65535. DISPLAY_IDENTIFIER FMY_HIS_6_COD ECU_ADDRESS 0x7fc006 BYTE_ORDER MSB_LAST FORMAT "%5.0" /end MEASUREMENT
/begin MEASUREMENT fmy_his_cod[6] "DTC of failure in history memory" UWORD _CNV_A_R_LINEAR_____0_CM 1 0. 0. 65535. DISPLAY_IDENTIFIER FMY_HIS_7_COD ECU_ADDRESS 0x7fc008 BYTE_ORDER MSB_LAST FORMAT "%5.0" /end MEASUREMENT
/begin MEASUREMENT fmy_his_cod[7] "DTC of failure in history memory" UWORD _CNV_A_R_LINEAR_____0_CM 1 0. 0. 65535. DISPLAY_IDENTIFIER FMY_HIS_8_COD ECU_ADDRESS 0x7fc00a BYTE_ORDER MSB_LAST FORMAT "%5.0" /end MEASUREMENT
/begin MEASUREMENT fmy_his_cod[8] "DTC of failure in history memory" UWORD _CNV_A_R_LINEAR_____0_CM 1 0. 0. 65535. DISPLAY_IDENTIFIER FMY_HIS_9_COD ECU_ADDRESS 0x7fc00c BYTE_ORDER MSB_LAST FORMAT "%5.0" /end MEASUREMENT
/begin MEASUREMENT fmy_his_cod[9] "DTC of failure in history memory" UWORD _CNV_A_R_LINEAR_____0_CM 1 0. 0. 65535. DISPLAY_IDENTIFIER FMY_HIS_10_COD ECU_ADDRESS 0x7fc00e BYTE_ORDER MSB_LAST FORMAT "%5.0" /end MEASUREMENT
/begin MEASUREMENT lv_dc "" UBYTE _CNV_S_2_RANGE______28_CM 1 0. 0. 1. DISPLAY_IDENTIFIER LV_DC ECU_ADDRESS 0x7fbe66 /end MEASUREMENT
/begin MEASUREMENT lv_state_wup "" UBYTE _CNV_S_2_RANGE______3_CM 1 0. 0. 1. DISPLAY_IDENTIFIER LV_STATE_WUP ECU_ADDRESS 0x7fbe67 /end MEASUREMENT
/begin MEASUREMENT lv_wup_cyc "" UBYTE _CNV_S_2_RANGE______28_CM 1 0. 0. 1. DISPLAY_IDENTIFIER LV_WUP_CYC ECU_ADDRESS 0x7fbe68 /end MEASUREMENT
/begin MEASUREMENT dly_mil_ready "Delay time to unable MIL blinking during pre-drive check mode" UWORD _CNV_A_R_LINEAR_____6_CM 1 0. 0. 32767500. DISPLAY_IDENTIFIER DLY_MIL_READY ECU_ADDRESS 0x7fc046 BYTE_ORDER MSB_LAST FORMAT "%8.0" /end MEASUREMENT
/begin MEASUREMENT state_mil "State of WAL_2 illumination commanded by error management" UBYTE _CNV_S_3_RANGE______29_CM 1 0. 0. 2. DISPLAY_IDENTIFIER STATE_MIL ECU_ADDRESS 0x7fc03c /end MEASUREMENT
/begin MEASUREMENT state_wal_1 "State of WAL_1 illumination commanded by error management" UBYTE _CNV_S_2_RANGE______11_CM 1 0. 0. 1. DISPLAY_IDENTIFIER STATE_WAL_1 ECU_ADDRESS 0x7fc03f /end MEASUREMENT
/begin MEASUREMENT state_wal_2 "State of WAL_2 illumination commanded by error management" UBYTE _CNV_S_2_RANGE______11_CM 1 0. 0. 1. DISPLAY_IDENTIFIER STATE_WAL_2 ECU_ADDRESS 0x7fc042 /end MEASUREMENT
/begin MEASUREMENT obd_state_1 "Readiness Code completion status 1" UBYTE _CNV_A_R_LINEAR_____1_CM 1 0. 0. 255. DISPLAY_IDENTIFIER OBD_STATE_1 ECU_ADDRESS 0x7fc894 FORMAT "%3.0" /end MEASUREMENT
/begin MEASUREMENT obd_state_2 "Readiness Code completion status 2" UBYTE _CNV_A_R_LINEAR_____1_CM 1 0. 0. 255. DISPLAY_IDENTIFIER OBD_STATE_2 ECU_ADDRESS 0x7fc895 FORMAT "%3.0" /end MEASUREMENT
/begin MEASUREMENT lv_wal_1 "Boolean indicating WAL_1 physical output" UBYTE _CNV_S_2_RANGE______11_CM 1 0. 0. 1. DISPLAY_IDENTIFIER LV_WAL_1 ECU_ADDRESS 0x7fc03d /end MEASUREMENT
/begin MEASUREMENT lv_wal_2 "Boolean indicating WAL_2 physical output" UBYTE _CNV_S_2_RANGE______11_CM 1 0. 0. 1. DISPLAY_IDENTIFIER LV_WAL_2 ECU_ADDRESS 0x7fc040 /end MEASUREMENT
/begin MEASUREMENT lv_mil_fll_ready "Boolean indicating MIL shall blink during pre-drive check mode phase 2" UBYTE _CNV_S_2_RANGE______11_CM 1 0. 0. 1. DISPLAY_IDENTIFIER LV_MIL_FLL_READY ECU_ADDRESS 0x7fc044 /end MEASUREMENT
/begin MEASUREMENT t_dtc_clr "Time since diagnostic trouble codes cleared." UWORD _CNV_A_R_LINEAR_____30_CM 1 0. 0. 65535. DISPLAY_IDENTIFIER T_DTC_CLR ECU_ADDRESS 0x7fc06e BYTE_ORDER MSB_LAST FORMAT "%5.0" /end MEASUREMENT
/begin MEASUREMENT state_ena_obd "Monitor enable status for the current driving cycle" UWORD _CNV_A_R_LINEAR_____1_CM 1 0. 0. 65535. DISPLAY_IDENTIFIER STATE_ENA_OBD ECU_ADDRESS 0x7fc072 BYTE_ORDER MSB_LAST FORMAT "%5.0" /end MEASUREMENT
/begin MEASUREMENT state_cmpl_obd "Monitor completion status for the current driving cycle" UWORD _CNV_A_R_LINEAR_____1_CM 1 0. 0. 65535. DISPLAY_IDENTIFIER STATE_CMPL_OBD ECU_ADDRESS 0x7fc070 BYTE_ORDER MSB_LAST FORMAT "%5.0" /end MEASUREMENT
/begin MEASUREMENT dist_act_wal_1 "Global distance traveled while the WAL_1 is illuminated." UWORD _CNV_A_R_LINEAR_____31_CM 1 0. 0. 65535. DISPLAY_IDENTIFIER DIST_ACT_WAL_1 ECU_ADDRESS 0x7fc05e BYTE_ORDER MSB_LAST FORMAT "%5.0" /end MEASUREMENT
/begin MEASUREMENT dist_act_wal_2 "Global distance traveled while the WAL_2 is illuminated." UWORD _CNV_A_R_LINEAR_____31_CM 1 0. 0. 65535. DISPLAY_IDENTIFIER DIST_ACT_WAL_2 ECU_ADDRESS 0x7fc064 BYTE_ORDER MSB_LAST FORMAT "%5.0" /end MEASUREMENT
/begin MEASUREMENT dist_act_mil "Global distance traveled while the MIL is illuminated." UWORD _CNV_A_R_LINEAR_____31_CM 1 0. 0. 65535. DISPLAY_IDENTIFIER DIST_ACT_MIL ECU_ADDRESS 0x7fc054 BYTE_ORDER MSB_LAST FORMAT "%5.0" /end MEASUREMENT
/begin MEASUREMENT t_act_mil "Minutes run by the engine while MIL activated" UWORD _CNV_A_R_LINEAR_____30_CM 1 0. 0. 65535. DISPLAY_IDENTIFIER T_ACT_MIL ECU_ADDRESS 0x7fc05a BYTE_ORDER MSB_LAST FORMAT "%5.0" /end MEASUREMENT
/begin MEASUREMENT t_act_mil_60 "Seconds run by the engine while MIL activated fot t_act_mil calculation." UBYTE _CNV_A_R_LINEAR_____32_CM 1 0. 0. 60. DISPLAY_IDENTIFIER T_ACT_MIL_60 ECU_ADDRESS 0x7fc058 FORMAT "%2.0" /end MEASUREMENT
/begin MEASUREMENT dist_dtc_clr "Distance since DTC cleared." UWORD _CNV_A_R_LINEAR_____31_CM 1 0. 0. 65535. DISPLAY_IDENTIFIER DIST_DTC_CLR ECU_ADDRESS 0x7fc06a BYTE_ORDER MSB_LAST FORMAT "%5.0" /end MEASUREMENT
/begin MEASUREMENT dist_rel_dtc_clr "Distance at following event : DTC cleared." UWORD _CNV_A_R_LINEAR_____31_CM 1 0. 0. 65535. DISPLAY_IDENTIFIER DIST_REL_DTC_CLR ECU_ADDRESS 0x7fc06c BYTE_ORDER MSB_LAST FORMAT "%5.0" /end MEASUREMENT
/begin MEASUREMENT ctr_wup_dtc_clr "Number of warms-up since DTC cleared" UBYTE _CNV_A_R_LINEAR_____1_CM 1 0. 0. 255. DISPLAY_IDENTIFIER CTR_WUP_DTC_CLR ECU_ADDRESS 0x7fc068 FORMAT "%3.0" /end MEASUREMENT
/begin MEASUREMENT lv_abc_inh "" UBYTE _CNV_S_2_RANGE______28_CM 1 0. 0. 1. DISPLAY_IDENTIFIER LV_ABC_INH ECU_ADDRESS 0x7fc0ce /end MEASUREMENT
/begin MEASUREMENT lv_inh_wup_cyc "" UBYTE _CNV_S_2_RANGE______28_CM 1 0. 0. 1. DISPLAY_IDENTIFIER LV_INH_WUP_CYC ECU_ADDRESS 0x7fc0cf /end MEASUREMENT
/begin MEASUREMENT lv_err_pvs_pred "" UBYTE _CNV_S_2_RANGE______11_CM 1 0. 0. 1. DISPLAY_IDENTIFIER LV_ERR_PVS_PRED ECU_ADDRESS 0x7fc9f3 /end MEASUREMENT
/begin MEASUREMENT lv_err_pvs_1 "" UBYTE _CNV_S_2_RANGE______11_CM 1 0. 0. 1. DISPLAY_IDENTIFIER LV_ERR_PVS_1 ECU_ADDRESS 0x7fc9f1 /end MEASUREMENT
/begin MEASUREMENT lv_err_pvs_2 "" UBYTE _CNV_S_2_RANGE______11_CM 1 0. 0. 1. DISPLAY_IDENTIFIER LV_ERR_PVS_2 ECU_ADDRESS 0x7fc9f2 /end MEASUREMENT
/begin MEASUREMENT lv_lih_pvs_move "" UBYTE _CNV_S_2_RANGE______11_CM 1 0. 0. 1. DISPLAY_IDENTIFIER LV_LIH_PVS_MOVE ECU_ADDRESS 0x7fc9f4 /end MEASUREMENT
/begin MEASUREMENT lv_act_pvs_lih "" UBYTE _CNV_S_2_RANGE______11_CM 1 0. 0. 1. DISPLAY_IDENTIFIER LV_ACT_PVS_LIH ECU_ADDRESS 0x7fc9fa /end MEASUREMENT
/begin MEASUREMENT lv_pvs_bls_bts_plaus "" UBYTE _CNV_S_2_RANGE______11_CM 1 0. 0. 1. DISPLAY_IDENTIFIER LV_PVS_BLS_BTS_PLAUS ECU_ADDRESS 0x7fc9f6 /end MEASUREMENT
/begin MEASUREMENT lv_pvs_h_r "" UBYTE _CNV_S_2_RANGE______11_CM 1 0. 0. 1. DISPLAY_IDENTIFIER LV_PVS_H_R ECU_ADDRESS 0x7fca06 /end MEASUREMENT
/begin MEASUREMENT lv_pvs_h_r_1 "" UBYTE _CNV_S_2_RANGE______11_CM 1 0. 0. 1. DISPLAY_IDENTIFIER LV_PVS_H_R_1 ECU_ADDRESS 0x7fca04 /end MEASUREMENT
/begin MEASUREMENT lv_pvs_h_r_2 "" UBYTE _CNV_S_2_RANGE______11_CM 1 0. 0. 1. DISPLAY_IDENTIFIER LV_PVS_H_R_2 ECU_ADDRESS 0x7fca05 /end MEASUREMENT
/begin MEASUREMENT v_pvs_min "" UWORD _CNV_A_R_LINEAR_____33_CM 1 0. 0. 4.9951171875 DISPLAY_IDENTIFIER V_PVS_MIN ECU_ADDRESS 0x7fc904 BYTE_ORDER MSB_LAST FORMAT "%3.2" /end MEASUREMENT
/begin MEASUREMENT v_pvs_mmv_1 "" UWORD _CNV_A_R_LINEAR_____33_CM 1 0. 0. 4.9951171875 DISPLAY_IDENTIFIER V_PVS_MMV_1 ECU_ADDRESS 0x7fc906 BYTE_ORDER MSB_LAST FORMAT "%3.2" /end MEASUREMENT
/begin MEASUREMENT v_pvs_mmv_2 "" UWORD _CNV_A_R_LINEAR_____33_CM 1 0. 0. 4.9951171875 DISPLAY_IDENTIFIER V_PVS_MMV_2 ECU_ADDRESS 0x7fc908 BYTE_ORDER MSB_LAST FORMAT "%3.2" /end MEASUREMENT
/begin MEASUREMENT ctr_move "" UBYTE _CNV_A_R_LINEAR_____0_CM 1 0. 0. 255. DISPLAY_IDENTIFIER CTR_MOVE ECU_ADDRESS 0x7fc9fc FORMAT "%3.0" /end MEASUREMENT
/begin MEASUREMENT lv_err_pvs "" UBYTE _CNV_S_2_RANGE______11_CM 1 0. 0. 1. DISPLAY_IDENTIFIER LV_ERR_PVS ECU_ADDRESS 0x7fc9f0 /end MEASUREMENT
/begin MEASUREMENT lv_err_vcc_pvs_1 "" UBYTE _CNV_S_2_RANGE______28_CM 1 0. 0. 1. DISPLAY_IDENTIFIER LV_ERR_VCC_PVS_1 ECU_ADDRESS 0x7fc9f8 /end MEASUREMENT
/begin MEASUREMENT lv_err_vcc_pvs_2 "" UBYTE _CNV_S_2_RANGE______28_CM 1 0. 0. 1. DISPLAY_IDENTIFIER LV_ERR_VCC_PVS_2 ECU_ADDRESS 0x7fc9f9 /end MEASUREMENT
/begin MEASUREMENT lv_lih_bls_bts "" UBYTE _CNV_S_2_RANGE______11_CM 1 0. 0. 1. DISPLAY_IDENTIFIER LV_LIH_BLS_BTS ECU_ADDRESS 0x7fc9f5 /end MEASUREMENT
/begin MEASUREMENT vcc_1 "" UWORD _CNV_A_R_LINEAR_____41_CM 1 0. 0. 9.990233999999999 DISPLAY_IDENTIFIER VCC_1 ECU_ADDRESS 0x7f97b2 BYTE_ORDER MSB_LAST FORMAT "%3.2" /end MEASUREMENT
/begin MEASUREMENT vcc_2 "" UWORD _CNV_A_R_LINEAR_____41_CM 1 0. 0. 9.990233999999999 DISPLAY_IDENTIFIER VCC_2 ECU_ADDRESS 0x7f97b4 BYTE_ORDER MSB_LAST FORMAT "%3.2" /end MEASUREMENT
/begin MEASUREMENT amp "" UWORD _CNV_A_R_LINEAR_____21_CM 1 0. 0. 5434. DISPLAY_IDENTIFIER AMP ECU_ADDRESS 0x7fa07c BYTE_ORDER MSB_LAST FORMAT "%4.3" /end MEASUREMENT
/begin MEASUREMENT amp_mes "" UWORD _CNV_A_R_LINEAR_____21_CM 1 0. 0. 5434. DISPLAY_IDENTIFIER AMP_MES ECU_ADDRESS 0x7fa07e BYTE_ORDER MSB_LAST FORMAT "%4.3" /end MEASUREMENT
/begin MEASUREMENT v_amp "" UWORD _CNV_A_R_LINEAR_____33_CM 1 0. 0. 4.9951171875 DISPLAY_IDENTIFIER V_AMP ECU_ADDRESS 0x7fa080 BYTE_ORDER MSB_LAST FORMAT "%3.2" /end MEASUREMENT
/begin MEASUREMENT lv_err_tfu_mes "" UBYTE _CNV_S_2_RANGE______28_CM 1 0. 0. 1. DISPLAY_IDENTIFIER LV_ERR_TFU_MES ECU_ADDRESS 0x7fca87 /end MEASUREMENT
/begin MEASUREMENT tfu "" UBYTE _CNV_A_R_LINEAR_____18_CM 1 0. -50. 205. DISPLAY_IDENTIFIER TFU ECU_ADDRESS 0x7fca85 FORMAT "%3.0" /end MEASUREMENT
/begin MEASUREMENT tfu_mes "" UBYTE _CNV_A_R_LINEAR_____18_CM 1 0. -50. 205. DISPLAY_IDENTIFIER TFU_MES ECU_ADDRESS 0x7fca84 FORMAT "%3.0" /end MEASUREMENT
/begin MEASUREMENT v_tfu "" UWORD _CNV_A_R_LINEAR_____33_CM 1 0. 0. 4.9951171875 DISPLAY_IDENTIFIER V_TFU ECU_ADDRESS 0x7fc99c BYTE_ORDER MSB_LAST FORMAT "%3.2" /end MEASUREMENT
/begin MEASUREMENT tco_sp_ect "" UBYTE _CNV_A_R_LINEAR_____18_CM 1 0. -50. 205. DISPLAY_IDENTIFIER TCO_SP_ECT ECU_ADDRESS 0x7fbb32 FORMAT "%3.0" /end MEASUREMENT
/begin MEASUREMENT ctr_bas_cyl_bal[0] "" UBYTE _CNV_A_R_LINEAR_____0_CM 1 0. 0. 255. DISPLAY_IDENTIFIER CTR_BAS_CYL_BAL_0_ ECU_ADDRESS 0x7fb456 FORMAT "%3.0" /end MEASUREMENT
/begin MEASUREMENT ctr_bas_cyl_bal[1] "" UBYTE _CNV_A_R_LINEAR_____0_CM 1 0. 0. 255. DISPLAY_IDENTIFIER CTR_BAS_CYL_BAL_1_ ECU_ADDRESS 0x7fb457 FORMAT "%3.0" /end MEASUREMENT
/begin MEASUREMENT ctr_bas_cyl_bal[2] "" UBYTE _CNV_A_R_LINEAR_____0_CM 1 0. 0. 255. DISPLAY_IDENTIFIER CTR_BAS_CYL_BAL_2_ ECU_ADDRESS 0x7fb458 FORMAT "%3.0" /end MEASUREMENT
/begin MEASUREMENT ctr_eve_cyl_bal[0] "" UBYTE _CNV_A_R_LINEAR_____0_CM 1 0. 0. 255. DISPLAY_IDENTIFIER CTR_EVE_CYL_BAL_0_ ECU_ADDRESS 0x7fb45a FORMAT "%3.0" /end MEASUREMENT
/begin MEASUREMENT ctr_eve_cyl_bal[1] "" UBYTE _CNV_A_R_LINEAR_____0_CM 1 0. 0. 255. DISPLAY_IDENTIFIER CTR_EVE_CYL_BAL_1_ ECU_ADDRESS 0x7fb45b FORMAT "%3.0" /end MEASUREMENT
/begin MEASUREMENT ctr_eve_cyl_bal[2] "" UBYTE _CNV_A_R_LINEAR_____0_CM 1 0. 0. 255. DISPLAY_IDENTIFIER CTR_EVE_CYL_BAL_2_ ECU_ADDRESS 0x7fb45c FORMAT "%3.0" /end MEASUREMENT
/begin MEASUREMENT fac_is_fil "" UWORD _CNV_A_R_LINEAR_____14_CM 1 0. 0. 0.9999847412109381 DISPLAY_IDENTIFIER FAC_IS_FIL ECU_ADDRESS 0x7fa8e0 BYTE_ORDER MSB_LAST FORMAT "%5.3" /end MEASUREMENT
/begin MEASUREMENT lv_act_is_fil_is "" UBYTE _CNV_S_2_RANGE______28_CM 1 0. 0. 1. DISPLAY_IDENTIFIER LV_ACT_IS_FIL_IS ECU_ADDRESS 0x7fbaac /end MEASUREMENT
/begin MEASUREMENT n_sp_is_fil "" UWORD _CNV_A_R_LINEAR_____5_CM 1 0. 0. 6375. DISPLAY_IDENTIFIER N_SP_IS_FIL ECU_ADDRESS 0x7f9c0e BYTE_ORDER MSB_LAST FORMAT "%4.0" /end MEASUREMENT
/begin MEASUREMENT vs_n_grd "" SWORD _CNV_A_R_LINEAR_____72_CM 1 0. -5.e-002 4.9998474e-002 DISPLAY_IDENTIFIER VS_N_GRD ECU_ADDRESS 0x7fb026 BYTE_ORDER MSB_LAST FORMAT "%7.6" /end MEASUREMENT
/begin MEASUREMENT vs_n_grd_fil "" SWORD _CNV_A_R_LINEAR_____72_CM 1 0. -5.e-002 4.9998474e-002 DISPLAY_IDENTIFIER VS_N_GRD_FIL ECU_ADDRESS 0x7fb028 BYTE_ORDER MSB_LAST FORMAT "%7.6" /end MEASUREMENT
/begin MEASUREMENT lv_dt "" UBYTE _CNV_S_2_RANGE______11_CM 1 0. 0. 1. DISPLAY_IDENTIFIER LV_DT ECU_ADDRESS 0x7fb75e /end MEASUREMENT
/begin MEASUREMENT lv_vs_n_con "" UBYTE _CNV_S_2_RANGE______11_CM 1 0. 0. 1. DISPLAY_IDENTIFIER LV_VS_N_CON ECU_ADDRESS 0x7fb760 /end MEASUREMENT
/begin MEASUREMENT dri "" UBYTE _CNV_P_8_TABLE_______71_CM 1 0. 0. 15. DISPLAY_IDENTIFIER DRI ECU_ADDRESS 0x7fb75d FORMAT "%2.0" /end MEASUREMENT
/begin MEASUREMENT gear "" UBYTE _CNV_P_8_TABLE_______71_CM 1 0. 0. 15. DISPLAY_IDENTIFIER GEAR ECU_ADDRESS 0x7fb75f FORMAT "%2.0" /end MEASUREMENT
/begin MEASUREMENT vs "" UBYTE _CNV_A_R_LINEAR_____39_CM 1 0. 0. 255. DISPLAY_IDENTIFIER VS ECU_ADDRESS 0x7fca8a FORMAT "%3.0" /end MEASUREMENT
/begin MEASUREMENT vs_h_res "" UWORD _CNV_A_R_LINEAR_____74_CM 1 0. 0. 655.35 DISPLAY_IDENTIFIER VS_H_RES ECU_ADDRESS 0x7fc9a2 BYTE_ORDER MSB_LAST FORMAT "%5.2" /end MEASUREMENT
/begin MEASUREMENT vs_bas "" UWORD _CNV_A_R_LINEAR_____74_CM 1 0. 0. 655.35 DISPLAY_IDENTIFIER VS_BAS ECU_ADDRESS 0x7fc9a4 BYTE_ORDER MSB_LAST FORMAT "%5.2" /end MEASUREMENT
/begin MEASUREMENT lv_vs_run "" UBYTE _CNV_S_2_RANGE______11_CM 1 0. 0. 1. DISPLAY_IDENTIFIER LV_VS_RUN ECU_ADDRESS 0x7fca91 /end MEASUREMENT
/begin MEASUREMENT vs_n "" UWORD _CNV_A_R_LINEAR_____73_CM 1 0. 0. 0.1 DISPLAY_IDENTIFIER VS_N ECU_ADDRESS 0x7fc9a6 BYTE_ORDER MSB_LAST FORMAT "%6.5" /end MEASUREMENT
/begin MEASUREMENT n_mv_vs_sens "" UWORD _CNV_A_R_LINEAR_____5_CM 1 0. 0. 6375. DISPLAY_IDENTIFIER N_MV_VS_SENS ECU_ADDRESS 0x7fc9ae BYTE_ORDER MSB_LAST FORMAT "%4.0" /end MEASUREMENT
/begin MEASUREMENT vs_fil "" UWORD _CNV_A_R_LINEAR_____74_CM 1 0. 0. 655.35 DISPLAY_IDENTIFIER VS_FIL ECU_ADDRESS 0x7fc9a8 BYTE_ORDER MSB_LAST FORMAT "%5.2" /end MEASUREMENT
/begin MEASUREMENT vs_ac "" UBYTE _CNV_A_R_LINEAR_____75_CM 1 0. -14. 6.4 DISPLAY_IDENTIFIER VS_AC ECU_ADDRESS 0x7fca8b FORMAT "%5.2" /end MEASUREMENT
/begin MEASUREMENT t_vs_cor_diag "" UWORD _CNV_A_R_LINEAR_____19_CM 1 0. 0. 6553.5 DISPLAY_IDENTIFIER T_VS_COR_DIAG ECU_ADDRESS 0x7fa594 BYTE_ORDER MSB_LAST FORMAT "%5.1" /end MEASUREMENT
/begin MEASUREMENT fac_vs_adj "" UWORD _CNV_A_R_LINEAR_____79_CM 1 0. 0. 65535. DISPLAY_IDENTIFIER FAC_VS_ADJ ECU_ADDRESS 0x7fa0d2 BYTE_ORDER MSB_LAST FORMAT "%5.0" /end MEASUREMENT
/begin MEASUREMENT vs_conf "" UBYTE _CNV_A_R_LINEAR_____0_CM 1 0. 0. 15. DISPLAY_IDENTIFIER VS_CONF ECU_ADDRESS 0x7fb778 FORMAT "%2.0" /end MEASUREMENT
/begin MEASUREMENT lv_can_vs_abs "" UBYTE _CNV_A_R_LINEAR_____0_CM 1 0. 0. 1. DISPLAY_IDENTIFIER LV_CAN_VS_ABS ECU_ADDRESS 0x7fb779 FORMAT "%1.0" /end MEASUREMENT
/begin MEASUREMENT lv_can_ac_abs "" UBYTE _CNV_A_R_LINEAR_____0_CM 1 0. 0. 1. DISPLAY_IDENTIFIER LV_CAN_AC_ABS ECU_ADDRESS 0x7fb77a FORMAT "%1.0" /end MEASUREMENT
/begin MEASUREMENT lv_can_dist_abs "" UBYTE _CNV_A_R_LINEAR_____0_CM 1 0. 0. 1. DISPLAY_IDENTIFIER LV_CAN_DIST_ABS ECU_ADDRESS 0x7fb77b FORMAT "%1.0" /end MEASUREMENT
/begin MEASUREMENT tq_conv "" SWORD _CNV_A_R_LINEAR_____62_CM 1 0. -1024. 1023.96875 DISPLAY_IDENTIFIER TQ_CONV ECU_ADDRESS 0x7fa222 BYTE_ORDER MSB_LAST FORMAT "%7.2" /end MEASUREMENT
/begin MEASUREMENT tqi_n_max "" SWORD _CNV_A_R_LINEAR_____62_CM 1 0. 0. 1023.96875 DISPLAY_IDENTIFIER TQI_N_MAX ECU_ADDRESS 0x7fa03e BYTE_ORDER MSB_LAST FORMAT "%7.2" /end MEASUREMENT
/begin MEASUREMENT tqi_p_max "" SWORD _CNV_A_R_LINEAR_____62_CM 1 0. -1024. 1023.96875 DISPLAY_IDENTIFIER TQI_P_MAX ECU_ADDRESS 0x7fa224 BYTE_ORDER MSB_LAST FORMAT "%7.2" /end MEASUREMENT
/begin MEASUREMENT tqi_vs_max "" SWORD _CNV_A_R_LINEAR_____62_CM 1 0. -1024. 1023.96875 DISPLAY_IDENTIFIER TQI_VS_MAX ECU_ADDRESS 0x7fa226 BYTE_ORDER MSB_LAST FORMAT "%7.2" /end MEASUREMENT
/begin MEASUREMENT eff_bas "" UWORD _CNV_A_R_LINEAR_____53_CM 1 0. 0. 1.9999696 DISPLAY_IDENTIFIER EFF_BAS ECU_ADDRESS 0x7fa228 BYTE_ORDER MSB_LAST FORMAT "%5.4" /end MEASUREMENT
/begin MEASUREMENT tq_dif_is_ad "" SWORD _CNV_A_R_LINEAR_____62_CM 1 0. -1024. 1023.96875 DISPLAY_IDENTIFIER TQ_DIF_IS_AD ECU_ADDRESS 0x7fa22c BYTE_ORDER MSB_LAST FORMAT "%7.2" /end MEASUREMENT
/begin MEASUREMENT tq_dif_is_ad_acc "Low Pass filtered ACC torque adaptation for ACC and convertor torque adaptation" SWORD _CNV_A_R_LINEAR_____62_CM 1 0. -1024. 1023.96875 DISPLAY_IDENTIFIER TQ_DIF_IS_AD_ACC ECU_ADDRESS 0x7fa230 BYTE_ORDER MSB_LAST FORMAT "%8.4" /end MEASUREMENT
/begin MEASUREMENT tq_loss "" SWORD _CNV_A_R_LINEAR_____62_CM 1 0. -1024. 1023.96875 DISPLAY_IDENTIFIER TQ_LOSS ECU_ADDRESS 0x7fc9e6 BYTE_ORDER MSB_LAST FORMAT "%7.2" /end MEASUREMENT
/begin MEASUREMENT tqfr_mmv "" SWORD _CNV_A_R_LINEAR_____62_CM 1 0. -1024. 1023.96875 DISPLAY_IDENTIFIER TQFR_MMV ECU_ADDRESS 0x7fc9de BYTE_ORDER MSB_LAST FORMAT "%7.2" /end MEASUREMENT
/begin MEASUREMENT tqfr_bas "" SWORD _CNV_A_R_LINEAR_____62_CM 1 0. -1024. 1023.96875 DISPLAY_IDENTIFIER TQFR_BAS ECU_ADDRESS 0x7fc9d6 BYTE_ORDER MSB_LAST FORMAT "%7.2" /end MEASUREMENT
/begin MEASUREMENT tqfr_add_toil "" SWORD _CNV_A_R_LINEAR_____62_CM 1 0. -1024. 1023.96875 DISPLAY_IDENTIFIER TQFR_ADD_TOIL ECU_ADDRESS 0x7fc9dc BYTE_ORDER MSB_LAST FORMAT "%7.2" /end MEASUREMENT
/begin MEASUREMENT tqfr_add_tco "" SWORD _CNV_A_R_LINEAR_____62_CM 1 0. -1024. 1023.96875 DISPLAY_IDENTIFIER TQFR_ADD_TCO ECU_ADDRESS 0x7fc9da BYTE_ORDER MSB_LAST FORMAT "%7.2" /end MEASUREMENT
/begin MEASUREMENT tqfr_add_env "" SWORD _CNV_A_R_LINEAR_____62_CM 1 0. -1024. 1023.96875 DISPLAY_IDENTIFIER TQFR_ADD_ENV ECU_ADDRESS 0x7fc9d8 BYTE_ORDER MSB_LAST FORMAT "%7.2" /end MEASUREMENT
/begin MEASUREMENT tq_max_sca "" SWORD _CNV_A_R_LINEAR_____62_CM 1 0. -1024. 1023.96875 DISPLAY_IDENTIFIER TQ_MAX_SCA ECU_ADDRESS 0x7fa1fe BYTE_ORDER MSB_LAST FORMAT "%7.2" /end MEASUREMENT
/begin MEASUREMENT tq_max_clu "" SWORD _CNV_A_R_LINEAR_____62_CM 1 0. -1024. 1023.96875 DISPLAY_IDENTIFIER TQ_MAX_CLU ECU_ADDRESS 0x7fa1fc BYTE_ORDER MSB_LAST FORMAT "%7.2" /end MEASUREMENT
/begin MEASUREMENT tq_min_clu "" SWORD _CNV_A_R_LINEAR_____62_CM 1 0. -1024. 1023.96875 DISPLAY_IDENTIFIER TQ_MIN_CLU ECU_ADDRESS 0x7fa200 BYTE_ORDER MSB_LAST FORMAT "%7.2" /end MEASUREMENT
/begin MEASUREMENT tq_min_sca "" SWORD _CNV_A_R_LINEAR_____62_CM 1 0. -1024. 1023.96875 DISPLAY_IDENTIFIER TQ_MIN_SCA ECU_ADDRESS 0x7fa202 BYTE_ORDER MSB_LAST FORMAT "%7.2" /end MEASUREMENT
/begin MEASUREMENT fac_tq_req_clu_cor "o v" UWORD _CNV_A_R_LINEAR_____53_CM 1 0. 0. 1.9999696 DISPLAY_IDENTIFIER FAC_TQ_REQ_CLU_COR ECU_ADDRESS 0x7fa204 BYTE_ORDER MSB_LAST FORMAT "%6.5" /end MEASUREMENT
/begin MEASUREMENT tq_req_clu "o v" SWORD _CNV_A_R_LINEAR_____62_CM 1 0. -1024. 1023.96875 DISPLAY_IDENTIFIER TQ_REQ_CLU ECU_ADDRESS 0x7fa206 BYTE_ORDER MSB_LAST FORMAT "%6.2" /end MEASUREMENT
/begin MEASUREMENT tq_dif_req "o v" SWORD _CNV_A_R_LINEAR_____62_CM 1 0. -1024. 1023.96875 DISPLAY_IDENTIFIER TQ_DIF_REQ ECU_ADDRESS 0x7fa208 BYTE_ORDER MSB_LAST FORMAT "%6.2" /end MEASUREMENT
/begin MEASUREMENT fac_tq_tra "o v" UWORD _CNV_A_R_LINEAR_____53_CM 1 0. 0. 1.9999696 DISPLAY_IDENTIFIER FAC_TQ_TRA ECU_ADDRESS 0x7fa20a BYTE_ORDER MSB_LAST FORMAT "%6.5" /end MEASUREMENT
/begin MEASUREMENT fac_pv_av "v" UWORD _CNV_A_R_LINEAR_____53_CM 1 0. 0. 1.9999696 DISPLAY_IDENTIFIER FAC_PV_AV ECU_ADDRESS 0x7fb0c8 BYTE_ORDER MSB_LAST FORMAT "%6.5" /end MEASUREMENT
/begin MEASUREMENT fac_n_dif "v" UWORD _CNV_A_R_LINEAR_____53_CM 1 0. 0. 1.9999696 DISPLAY_IDENTIFIER FAC_N_DIF ECU_ADDRESS 0x7fb0ca BYTE_ORDER MSB_LAST FORMAT "%6.5" /end MEASUREMENT
/begin MEASUREMENT lv_tq_tcs_req_inc_inter "" UBYTE _CNV_S_2_RANGE______11_CM 1 0. 0. 1. DISPLAY_IDENTIFIER LV_TQ_TCS_REQ_INC_INTER ECU_ADDRESS 0x7fbbd8 /end MEASUREMENT
/begin MEASUREMENT lv_tq_tcs_req_dec_inter "" UBYTE _CNV_S_2_RANGE______11_CM 1 0. 0. 1. DISPLAY_IDENTIFIER LV_TQ_TCS_REQ_DEC_INTER ECU_ADDRESS 0x7fbbd7 /end MEASUREMENT
/begin MEASUREMENT lv_tq_tcs_req_dec_it "" UBYTE _CNV_S_2_RANGE______11_CM 1 0. 0. 1. DISPLAY_IDENTIFIER LV_TQ_TCS_REQ_DEC_IT ECU_ADDRESS 0x7fbbd9 /end MEASUREMENT
/begin MEASUREMENT lv_tq_tcs_req_inc_it "" UBYTE _CNV_S_2_RANGE______11_CM 1 0. 0. 1. DISPLAY_IDENTIFIER LV_TQ_TCS_REQ_INC_IT ECU_ADDRESS 0x7fbbda /end MEASUREMENT
/begin MEASUREMENT lv_tcs_dec_ena "" UBYTE _CNV_S_2_RANGE______11_CM 1 0. 0. 1. DISPLAY_IDENTIFIER LV_TCS_DEC_ENA ECU_ADDRESS 0x7fbbce /end MEASUREMENT
/begin MEASUREMENT lv_tcs_inc_ena "" UBYTE _CNV_S_2_RANGE______11_CM 1 0. 0. 1. DISPLAY_IDENTIFIER LV_TCS_INC_ENA ECU_ADDRESS 0x7fbbcf /end MEASUREMENT
/begin MEASUREMENT tqi_esp_sub "" SWORD _CNV_A_R_LINEAR_____62_CM 1 0. -1024. 1023.96875 DISPLAY_IDENTIFIER TQI_ESP_SUB ECU_ADDRESS 0x7fa254 BYTE_ORDER MSB_LAST FORMAT "%7.2" /end MEASUREMENT
/begin MEASUREMENT tq_esp_sub "" SWORD _CNV_A_R_LINEAR_____62_CM 1 0. -1024. 1023.96875 DISPLAY_IDENTIFIER TQ_ESP_SUB ECU_ADDRESS 0x7fa252 BYTE_ORDER MSB_LAST FORMAT "%7.2" /end MEASUREMENT
/begin MEASUREMENT lv_tq_esp_req_min "" UBYTE _CNV_S_2_RANGE______11_CM 1 0. 0. 1. DISPLAY_IDENTIFIER LV_TQ_ESP_REQ_MIN ECU_ADDRESS 0x7fb7f8 /end MEASUREMENT
/begin MEASUREMENT lv_tq_esp_req_max "" UBYTE _CNV_S_2_RANGE______11_CM 1 0. 0. 1. DISPLAY_IDENTIFIER LV_TQ_ESP_REQ_MAX ECU_ADDRESS 0x7fb7f9 /end MEASUREMENT
/begin MEASUREMENT lv_tq_esp_act "" UBYTE _CNV_S_2_RANGE______11_CM 1 0. 0. 1. DISPLAY_IDENTIFIER LV_TQ_ESP_ACT ECU_ADDRESS 0x7fb7f7 /end MEASUREMENT
/begin COMPU_METHOD _CNV_A_R_LINEAR_____0_CM "" RAT_FUNC "%6.3" "[-]" COEFFS 0 1. 0. 0 0 1 /end COMPU_METHOD
/begin COMPU_METHOD _CNV_A_R_LINEAR_____1_CM "" RAT_FUNC "%6.3" "-" COEFFS 0 1. 0. 0 0 1 /end COMPU_METHOD
/begin COMPU_METHOD _CNV_A_R_ZYL_ID_2_CM "" RAT_FUNC "%6.3" "[-]" COEFFS 0 1. -1. 0 0 1 /end COMPU_METHOD
/begin COMPU_METHOD _CNV_S_2_RANGE______3_CM "" TAB_VERB "%6.3" "[-]" COMPU_TAB_REF _CNV_S_2_RANGE______3 /end COMPU_METHOD
/begin COMPU_VTAB _CNV_S_2_RANGE______3 "" TAB_VERB 2 0 "" 1 "1" /end COMPU_VTAB
/begin COMPU_METHOD _CNV_A_R_LINEAR_____5_CM "" RAT_FUNC "%6.3" "[rpm]" COEFFS 0 1. 0. 0 0 1 /end COMPU_METHOD
/begin COMPU_METHOD _CNV_A_R_LINEAR_____6_CM "" RAT_FUNC "%6.3" "[ms]" COEFFS 0 2.e-003 0. 0 0 1 /end COMPU_METHOD
/begin COMPU_METHOD _CNV_A_R_LINEAR_____7_CM "" RAT_FUNC "%6.3" "[cm^2]" COEFFS 0 839.3314549180328 0. 0 0 1 /end COMPU_METHOD
/begin COMPU_METHOD _CNV_A_R_LINEAR_____8_CM "" RAT_FUNC "%6.3" "[%]" COEFFS 0 655.3599999999997 0. 0 0 1 /end COMPU_METHOD
/begin COMPU_METHOD _CNV_A_R_LINEAR_____9_CM "" RAT_FUNC "%6.3" "[%]" COEFFS 0 327.6799971199561 -2.880043939512689e-004 0 0 1 /end COMPU_METHOD
/begin COMPU_METHOD _CNV_A_R_LINEAR_____10_CM "" RAT_FUNC "%6.3" "[hPa]" COEFFS 0 12.06017666543982 2.864369889721274e-006 0 0 1 /end COMPU_METHOD
/begin COMPU_METHOD _CNV_S_2_RANGE______11_CM "" TAB_VERB "%6.3" "[-]" COMPU_TAB_REF _CNV_S_2_RANGE______11 /end COMPU_METHOD
/begin COMPU_VTAB _CNV_S_2_RANGE______11 "" TAB_VERB 2 0 "0" 1 "1" /end COMPU_VTAB
/begin COMPU_METHOD _CNV_A_R_LINEAR_____12_CM "" RAT_FUNC "%6.3" "[%]" COEFFS 0 327.6800000003072 3.071909304708242e-008 0 0 1 /end COMPU_METHOD
/begin COMPU_METHOD _CNV_A_R_LINEAR_____13_CM "" RAT_FUNC "%6.3" "[-]" COEFFS 0 4096.000220003369 0. 0 0 1 /end COMPU_METHOD
/begin COMPU_METHOD _CNV_A_R_LINEAR_____14_CM "" RAT_FUNC "%6.3" "[-]" COEFFS 0 65535.99999999996 0. 0 0 1 /end COMPU_METHOD
/begin COMPU_METHOD _CNV_A_R_LINEAR_____15_CM "" RAT_FUNC "%6.3" "[-]" COEFFS 0 16384. 0. 0 0 1 /end COMPU_METHOD
/begin COMPU_METHOD _CNV_A_R_LINEAR_____18_CM "" RAT_FUNC "%6.3" "[°C]" COEFFS 0 1. 50. 0 0 1 /end COMPU_METHOD
/begin COMPU_METHOD _CNV_A_R_LINEAR_____19_CM "" RAT_FUNC "%6.3" "[s]" COEFFS 0 10. 0. 0 0 1 /end COMPU_METHOD
/begin COMPU_METHOD _CNV_A_R_LINEAR_____21_CM "" RAT_FUNC "%6.3" "[hPa]" COEFFS 0 12.06017666543982 0. 0 0 1 /end COMPU_METHOD
/begin COMPU_METHOD _CNV_S_173_CONV_DIAG__26_CM "" TAB_VERB "%6.3" "[-]" COMPU_TAB_REF _CNV_S_173_CONV_DIAG__26 /end COMPU_METHOD
/begin COMPU_VTAB _CNV_S_173_CONV_DIAG__26 "" TAB_VERB 173 0 "NO_ERROR" 1 "IMOB" 2 "ECU_4" 3 "ECU_2" 4 "V_DCDC_RNG" 5 "PVS_L_1" 6 "PVS_L_2" 7 "PVS_H_1" 8 "PVS_H_2" 9 "PVS_RATIO" 10 "PVS_MOVE" 11 "PVS_BLS_BTS" 12 "VCC_1" 13 "VCC_2" 14 "V_DIP_PF_RNG" 15 "DIP_PF_MES_ES" 16 "DIP_PF_MES_ERU" 17 "V_TCO_1_RNG" 18 "V_TCO_2_RNG" 19 "TCO_1_MES_GRD" 20 "TCO_2_MES_GRD" 21 "TCO_MES_PLAUS" 22 "EGR_CTL_MIN" 23 "EGR_CTL_MAX" 24 "V_AMP_RNG" 25 "AMP_MES_GRD" 26 "V_TFU_RNG" 27 "TFU_MES_GRD" 28 "V_MAP_RNG" 29 "MAP_AMP_OFS" 30 "MAP_IS_OFS" 31 "MAP_MES_GRD" 32 "MAF_KGH_PLAUS" 33 "MAF_0_RNG" 34 "V_TPC_RNG" 35 "TPC_MES_PLAUS" 36 "V_TAC_RNG" 37 "TAC_MES_PLAUS" 38 "MF_IS_OBD" 39 "CYL_BAL_0" 40 "CYL_BAL_1" 41 "CYL_BAL_2" 42 "CYL_BAL_3" 43 "EGRV_0_CTL" 44 "V_EGRV_0_BOL_AD" 45 "THR_0_CTL" 46 "V_THR_0_BOL_AD" 47 "BPA_0_CTL" 48 "V_BPA_0_BOL_AD" 49 "BYP_0_CTL" 50 "V_BYP_0_BOL_AD" 51 "MAP_CTL_MIN" 52 "MAP_CTL_MAX" 53 "EGR_IS_SLOW_OBD" 54 "MAF_EGR_THR_OBD" 55 "MAF_DIF_EGR_THR_OBD" 56 "MAP_DIF_EGR_THR_OBD" 57 "VS" 58 "CS" 59 "BLS" 60 "BLS_BTS_DECE" 61 "BLS_BTS_PLAUS" 62 "CAN_TCS" 63 "CAN_TCU" 64 "CAN_ACU" 65 "CAN_CCU" 66 "CAN_ICL" 67 "CAN_VECU" 68 "CAN_SMLS" 69 "CAN_BOFF" 70 "CAN_BEM" 71 "CAN_IF_CFT" 72 "CAN_TOT" 73 "VARCOD" 74 "ACP_MES_RNG" 75 "ACP_MES_GRD" 76 "V_TBA_RNG" 77 "TBA_MES_GRD" 78 "DUCY_ALTER_PWM_RNG" 79 "DUCY_ALTER_PWM_GRD" 80 "V_EGRV_0_RNG" 81 "V_EGRV_1_RNG" 82 "V_EGRV_0_GRD" 83 "V_EGRV_1_GRD" 84 "GES_MAF_0_MAX" 85 "TCO_1_2_PLAUS" 86 "EFP_RLY_DPS" 87 "EFP_RLY_PLAUS_1" 88 "EFP_RLY_PLAUS_2" 89 "SPI_MPS" 90 "SPI_OCT" 91 "SPI_QPS" 92 "EGR_BYP_DPS" 93 "EGRV_0" 94 "PPS_INI_0" 95 "PPS_INI_TOUT_0" 96 "PPS_PLAUS_0" 97 "PPS_CAL_0" 98 "PPS_V_INJ_0" 99 "PPS_WDT_0" 100 "PPS_FSM_0" 101 "PPS_OC_0" 102 "PPS_OC_1" 103 "PPS_OC_2" 104 "PPS_OC_3" 105 "PPS_SC_H_L_0" 106 "PPS_SC_H_L_1" 107 "PPS_SC_H_L_2" 108 "PPS_SC_H_L_3" 109 "PPS_SC_H_0" 110 "PPS_SC_L_0" 111 "BPA" 112 "EGRV" 113 "FSD_1" 114 "GL_RLY_DPS" 115 "MIS_A" 116 "MIS_B1" 117 "MIS_B4" 118 "PCV_1" 119 "PCV_2" 120 "PCV_3" 121 "RLY_MAIN" 122 "RLY_POWER" 123 "THR" 124 "VAR_COD" 125 "VB" 126 "VCV_1" 127 "VCV_2" 128 "VCV_3" 129 "CONV_MON_1" 130 "N_32_MON_1" 131 "PVS_MON_1" 132 "FCUT_MON_1" 133 "TQI_N_MAX_MON_1" 134 "SERV_MON_1" 135 "POST_INH_MON" 136 "CRU_INH_MON" 137 "CAN_INH_MON" 138 "MON_3" 139 "PER_CAM_IN_1" 140 "SYN_CAM_IN_1" 141 "REF_CRK_CAM_IN_1" 142 "CRK_TOOTH" 143 "CRK_TOOTH_PER" 144 "CRK_SYN" 145 "CRK_PLAUS" 146 "PLAUS_CAM_IN_1" 147 "SYN_CRK_CAM_IN_1" 148 "LSH_UP_1" 149 "LSH_DOWN_1" 150 "SCG_LS_DOWN_1" 151 "SCP_LS_DOWN_1" 152 "OC_LS_DOWN_1" 153 "OBD_LSH_DOWN_1" 154 "LAM_ADJ_1" 155 "CHK_LS_DOWN_1" 156 "PUC_LS_DOWN_1" 157 "FL_LS_DOWN_1" 158 "EL_LSL_UP_1" 159 "OC_LSL_UP_1" 160 "LSL_UP_IF_1" 161 "AIR_LSL_UP_1" 162 "TTIP_OBD_LS_UP_1" 163 "DYN_VLD_LS_UP_1" 164 "PUC_VLD_LS_UP_1" 165 "OBD_VLD_LSH_UP_1" 166 "SHIFT_AFL_LSL_UP_1" 167 "SHIFT_AFR_LSL_UP_1" 168 "LSH_LSL_UP_1" 169 "SWT_LS_DOWN_1" 170 "PUE_LS_DOWN_1" 171 "CHG_LS_UP" 172 "CHG_LS_DOWN" /end COMPU_VTAB
/begin COMPU_METHOD _CNV_S_6_CONV_ERRM__27_CM "" TAB_VERB "%6.3" "[-]" COMPU_TAB_REF _CNV_S_6_CONV_ERRM__27 /end COMPU_METHOD
/begin COMPU_VTAB _CNV_S_6_CONV_ERRM__27 "" TAB_VERB 6 0 "NO_SYM" 1 "SYM_0" 2 "SYM_1" 4 "SYM_2" 8 "SYM_3" 15 "BENCH_MODE" /end COMPU_VTAB
/begin COMPU_METHOD _CNV_S_2_RANGE______28_CM "" TAB_VERB "%6.3" "[-]" COMPU_TAB_REF _CNV_S_2_RANGE______28 /end COMPU_METHOD
/begin COMPU_VTAB _CNV_S_2_RANGE______28 "" TAB_VERB 2 0 "passive" 1 "active" /end COMPU_VTAB
/begin COMPU_METHOD _CNV_S_3_RANGE______29_CM "" TAB_VERB "%6.3" "[-]" COMPU_TAB_REF _CNV_S_3_RANGE______29 /end COMPU_METHOD
/begin COMPU_VTAB _CNV_S_3_RANGE______29 "" TAB_VERB 3 0 "MIL OFF" 1 "MIL ON" 2 "MIL BLINKING" /end COMPU_VTAB
/begin COMPU_METHOD _CNV_A_R_LINEAR_____30_CM "" RAT_FUNC "%6.3" "min" COEFFS 0 1. 0. 0 0 1 /end COMPU_METHOD
/begin COMPU_METHOD _CNV_A_R_LINEAR_____31_CM "" RAT_FUNC "%6.3" "km" COEFFS 0 1. 0. 0 0 1 /end COMPU_METHOD
/begin COMPU_METHOD _CNV_A_R_LINEAR_____32_CM "" RAT_FUNC "%6.3" "s" COEFFS 0 1. 0. 0 0 1 /end COMPU_METHOD
/begin COMPU_METHOD _CNV_A_R_LINEAR_____33_CM "" RAT_FUNC "%6.3" "[V]" COEFFS 0 204.8 0. 0 0 1 /end COMPU_METHOD
/begin COMPU_METHOD _CNV_A_R_LINEAR_____39_CM "" RAT_FUNC "%6.3" "[km/h]" COEFFS 0 1. 0. 0 0 1 /end COMPU_METHOD
/begin COMPU_METHOD _CNV_A_R_LINEAR_____41_CM "" RAT_FUNC "%6.3" "[V]" COEFFS 0 102.4000038437538 0. 0 0 1 /end COMPU_METHOD
/begin COMPU_METHOD _CNV_A_R_LINEAR_____53_CM "" RAT_FUNC "%6.3" "[-]" COEFFS 0 32767.99807357072 0. 0 0 1 /end COMPU_METHOD
/begin COMPU_METHOD _CNV_A_R_LINEAR_____62_CM "" RAT_FUNC "%6.3" "[Nm]" COEFFS 0 32. 0. 0 0 1 /end COMPU_METHOD
/begin COMPU_METHOD _CNV_P_8_TABLE_______71_CM "" TAB_NOINTP "%6.3" "[-]" COMPU_TAB_REF _CNV_P_8_TABLE_______71 /end COMPU_METHOD
/begin COMPU_TAB _CNV_P_8_TABLE_______71 "" TAB_NOINTP 8 0 0. 1 1. 2 2. 3 3. 4 4. 5 5. 6 6. 15 15. /end COMPU_TAB
/begin COMPU_METHOD _CNV_A_R_LINEAR_____72_CM "" RAT_FUNC "%6.3" "[(km/h)/rpm]" COEFFS 0 655360.0007936121 3.96806062781252e-005 0 0 1 /end COMPU_METHOD
/begin COMPU_METHOD _CNV_A_R_LINEAR_____73_CM "" RAT_FUNC "%6.3" "[(km/h)/rpm]" COEFFS 0 655350. 0. 0 0 1 /end COMPU_METHOD
/begin COMPU_METHOD _CNV_A_R_LINEAR_____74_CM "" RAT_FUNC "%6.3" "[km/h]" COEFFS 0 100. 0. 0 0 1 /end COMPU_METHOD
/begin COMPU_METHOD _CNV_A_R_LINEAR_____75_CM "" RAT_FUNC "%6.3" "[m/(s*s)]" COEFFS 0 12.5 175. 0 0 1 /end COMPU_METHOD
/begin COMPU_METHOD _CNV_A_R_LINEAR_____79_CM "" RAT_FUNC "%6.3" "[1/km]" COEFFS 0 1. 0. 0 0 1 /end COMPU_METHOD
/begin FUNCTION ATIC_20_timing "" /end FUNCTION
/begin FUNCTION CR_Generic ""
 /begin OUT_MEASUREMENT cyl_id_sam_trig lv_mil ar_egrv_pctl_the_bas maf_rel maf_rel_sp bpapwm_dyn map_sp_lim_grd lv_dir_v_hbr[0] lv_dir_v_hbr[1] abs_hbr_pwm[0] abs_hbr_pwm[1] dir_hbr[0] dir_hbr[1] inp_hbr[0] inp_hbr[1] fac_cor_hbr[0] fac_cor_hbr[1] ar_egrv_pctl_the pq_egrv_sp abs_hbr_pwm_tmp[0] abs_hbr_pwm_tmp[1] ctr_err_dyn_nr ctr_err_his_nr fmy_ram_dyn[0].dtc_cod fmy_ram_dyn[0].ctr_frc fmy_ram_dyn[0].ctr_wup_cyc fmy_ram_dyn[0].ctr_dc fmy_ram_dyn[0].diag_inst fmy_ram_dyn[0].idx_frf fmy_ram_dyn[0].err_info_dyn.lv_err_mkd fmy_ram_dyn[0].err_info_dyn.lv_dc_max fmy_ram_dyn[0].err_info_dyn.lv_err_disa fmy_ram_dyn[0].err_info_dyn.lv_err_cfm fmy_ram_dyn[0].err_info_dyn.lv_err_tmp fmy_ram_dyn[0].err_info_dyn.lv_err_dc fmy_ram_dyn[0].err_info_dyn.err_sym_mem fmy_ram_dyn[0].err_info_dyn.err_sym_lst fmy_ram_dyn[0].err_info_dyn.lv_err_pnd fmy_ram_dyn[0].err_info_dyn.lv_cdn_diag_dc fmy_ram_dyn[0].ctr_dc_err_det fmy_ram_dyn[0].ctr_dc_err_det_diag_cdn fmy_ram_dyn[0].ctr_dc_err_det_diag_cmpl fmy_ram_dyn[0].ctr_wup_act_mil fmy_ram_dyn[1].dtc_cod fmy_ram_dyn[1].ctr_frc fmy_ram_dyn[1].ctr_wup_cyc fmy_ram_dyn[1].ctr_dc fmy_ram_dyn[1].diag_inst fmy_ram_dyn[1].idx_frf fmy_ram_dyn[1].err_info_dyn.lv_err_mkd fmy_ram_dyn[1].err_info_dyn.lv_dc_max fmy_ram_dyn[1].err_info_dyn.lv_err_disa fmy_ram_dyn[1].err_info_dyn.lv_err_cfm fmy_ram_dyn[1].err_info_dyn.lv_err_tmp fmy_ram_dyn[1].err_info_dyn.lv_err_dc fmy_ram_dyn[1].err_info_dyn.err_sym_mem fmy_ram_dyn[1].err_info_dyn.err_sym_lst fmy_ram_dyn[1].err_info_dyn.lv_err_pnd fmy_ram_dyn[1].err_info_dyn.lv_cdn_diag_dc fmy_ram_dyn[1].ctr_dc_err_det fmy_ram_dyn[1].ctr_dc_err_det_diag_cdn fmy_ram_dyn[1].ctr_dc_err_det_diag_cmpl fmy_ram_dyn[1].ctr_wup_act_mil fmy_ram_dyn[2].dtc_cod fmy_ram_dyn[2].ctr_frc fmy_ram_dyn[2].ctr_wup_cyc fmy_ram_dyn[2].ctr_dc fmy_ram_dyn[2].diag_inst fmy_ram_dyn[2].idx_frf fmy_ram_dyn[2].err_info_dyn.lv_err_mkd fmy_ram_dyn[2].err_info_dyn.lv_dc_max fmy_ram_dyn[2].err_info_dyn.lv_err_disa fmy_ram_dyn[2].err_info_dyn.lv_err_cfm fmy_ram_dyn[2].err_info_dyn.lv_err_tmp fmy_ram_dyn[2].err_info_dyn.lv_err_dc fmy_ram_dyn[2].err_info_dyn.err_sym_mem fmy_ram_dyn[2].err_info_dyn.err_sym_lst fmy_ram_dyn[2].err_info_dyn.lv_err_pnd fmy_ram_dyn[2].err_info_dyn.lv_cdn_diag_dc fmy_ram_dyn[2].ctr_dc_err_det fmy_ram_dyn[2].ctr_dc_err_det_diag_cdn fmy_ram_dyn[2].ctr_dc_err_det_diag_cmpl fmy_ram_dyn[2].ctr_wup_act_mil fmy_ram_dyn[3].dtc_cod fmy_ram_dyn[3].ctr_frc fmy_ram_dyn[3].ctr_wup_cyc fmy_ram_dyn[3].ctr_dc fmy_ram_dyn[3].diag_inst fmy_ram_dyn[3].idx_frf fmy_ram_dyn[3].err_info_dyn.lv_err_mkd fmy_ram_dyn[3].err_info_dyn.lv_dc_max fmy_ram_dyn[3].err_info_dyn.lv_err_disa fmy_ram_dyn[3].err_info_dyn.lv_err_cfm fmy_ram_dyn[3].err_info_dyn.lv_err_tmp fmy_ram_dyn[3].err_info_dyn.lv_err_dc fmy_ram_dyn[3].err_info_dyn.err_sym_mem fmy_ram_dyn[3].err_info_dyn.err_sym_lst fmy_ram_dyn[3].err_info_dyn.lv_err_pnd fmy_ram_dyn[3].err_info_dyn.lv_cdn_diag_dc fmy_ram_dyn[3].ctr_dc_err_det fmy_ram_dyn[3].ctr_dc_err_det_diag_cdn fmy_ram_dyn[3].ctr_dc_err_det_diag_cmpl fmy_ram_dyn[3].ctr_wup_act_mil fmy_ram_dyn[4].dtc_cod fmy_ram_dyn[4].ctr_frc fmy_ram_dyn[4].ctr_wup_cyc fmy_ram_dyn[4].ctr_dc fmy_ram_dyn[4].diag_inst fmy_ram_dyn[4].idx_frf fmy_ram_dyn[4].err_info_dyn.lv_err_mkd fmy_ram_dyn[4].err_info_dyn.lv_dc_max fmy_ram_dyn[4].err_info_dyn.lv_err_disa fmy_ram_dyn[4].err_info_dyn.lv_err_cfm fmy_ram_dyn[4].err_info_dyn.lv_err_tmp fmy_ram_dyn[4].err_info_dyn.lv_err_dc fmy_ram_dyn[4].err_info_dyn.err_sym_mem fmy_ram_dyn[4].err_info_dyn.err_sym_lst fmy_ram_dyn[4].err_info_dyn.lv_err_pnd fmy_ram_dyn[4].err_info_dyn.lv_cdn_diag_dc fmy_ram_dyn[4].ctr_dc_err_det fmy_ram_dyn[4].ctr_dc_err_det_diag_cdn fmy_ram_dyn[4].ctr_dc_err_det_diag_cmpl fmy_ram_dyn[4].ctr_wup_act_mil fmy_ram_dyn[5].dtc_cod fmy_ram_dyn[5].ctr_frc fmy_ram_dyn[5].ctr_wup_cyc fmy_ram_dyn[5].ctr_dc fmy_ram_dyn[5].diag_inst fmy_ram_dyn[5].idx_frf fmy_ram_dyn[5].err_info_dyn.lv_err_mkd fmy_ram_dyn[5].err_info_dyn.lv_dc_max fmy_ram_dyn[5].err_info_dyn.lv_err_disa fmy_ram_dyn[5].err_info_dyn.lv_err_cfm fmy_ram_dyn[5].err_info_dyn.lv_err_tmp fmy_ram_dyn[5].err_info_dyn.lv_err_dc fmy_ram_dyn[5].err_info_dyn.err_sym_mem fmy_ram_dyn[5].err_info_dyn.err_sym_lst fmy_ram_dyn[5].err_info_dyn.lv_err_pnd fmy_ram_dyn[5].err_info_dyn.lv_cdn_diag_dc fmy_ram_dyn[5].ctr_dc_err_det fmy_ram_dyn[5].ctr_dc_err_det_diag_cdn fmy_ram_dyn[5].ctr_dc_err_det_diag_cmpl fmy_ram_dyn[5].ctr_wup_act_mil fmy_ram_dyn[6].dtc_cod fmy_ram_dyn[6].ctr_frc fmy_ram_dyn[6].ctr_wup_cyc fmy_ram_dyn[6].ctr_dc fmy_ram_dyn[6].diag_inst fmy_ram_dyn[6].idx_frf fmy_ram_dyn[6].err_info_dyn.lv_err_mkd fmy_ram_dyn[6].err_info_dyn.lv_dc_max fmy_ram_dyn[6].err_info_dyn.lv_err_disa fmy_ram_dyn[6].err_info_dyn.lv_err_cfm fmy_ram_dyn[6].err_info_dyn.lv_err_tmp fmy_ram_dyn[6].err_info_dyn.lv_err_dc fmy_ram_dyn[6].err_info_dyn.err_sym_mem fmy_ram_dyn[6].err_info_dyn.err_sym_lst fmy_ram_dyn[6].err_info_dyn.lv_err_pnd fmy_ram_dyn[6].err_info_dyn.lv_cdn_diag_dc fmy_ram_dyn[6].ctr_dc_err_det fmy_ram_dyn[6].ctr_dc_err_det_diag_cdn fmy_ram_dyn[6].ctr_dc_err_det_diag_cmpl fmy_ram_dyn[6].ctr_wup_act_mil fmy_ram_dyn[7].dtc_cod fmy_ram_dyn[7].ctr_frc fmy_ram_dyn[7].ctr_wup_cyc fmy_ram_dyn[7].ctr_dc fmy_ram_dyn[7].diag_inst fmy_ram_dyn[7].idx_frf fmy_ram_dyn[7].err_info_dyn.lv_err_mkd fmy_ram_dyn[7].err_info_dyn.lv_dc_max fmy_ram_dyn[7].err_info_dyn.lv_err_disa fmy_ram_dyn[7].err_info_dyn.lv_err_cfm fmy_ram_dyn[7].err_info_dyn.lv_err_tmp fmy_ram_dyn[7].err_info_dyn.lv_err_dc fmy_ram_dyn[7].err_info_dyn.err_sym_mem fmy_ram_dyn[7].err_info_dyn.err_sym_lst fmy_ram_dyn[7].err_info_dyn.lv_err_pnd fmy_ram_dyn[7].err_info_dyn.lv_cdn_diag_dc fmy_ram_dyn[7].ctr_dc_err_det fmy_ram_dyn[7].ctr_dc_err_det_diag_cdn fmy_ram_dyn[7].ctr_dc_err_det_diag_cmpl fmy_ram_dyn[7].ctr_wup_act_mil fmy_ram_dyn[8].dtc_cod fmy_ram_dyn[8].ctr_frc fmy_ram_dyn[8].ctr_wup_cyc fmy_ram_dyn[8].ctr_dc fmy_ram_dyn[8].diag_inst fmy_ram_dyn[8].idx_frf fmy_ram_dyn[8].err_info_dyn.lv_err_mkd fmy_ram_dyn[8].err_info_dyn.lv_dc_max fmy_ram_dyn[8].err_info_dyn.lv_err_disa fmy_ram_dyn[8].err_info_dyn.lv_err_cfm fmy_ram_dyn[8].err_info_dyn.lv_err_tmp fmy_ram_dyn[8].err_info_dyn.lv_err_dc fmy_ram_dyn[8].err_info_dyn.err_sym_mem fmy_ram_dyn[8].err_info_dyn.err_sym_lst fmy_ram_dyn[8].err_info_dyn.lv_err_pnd fmy_ram_dyn[8].err_info_dyn.lv_cdn_diag_dc fmy_ram_dyn[8].ctr_dc_err_det fmy_ram_dyn[8].ctr_dc_err_det_diag_cdn fmy_ram_dyn[8].ctr_dc_err_det_diag_cmpl fmy_ram_dyn[8].ctr_wup_act_mil fmy_ram_dyn[9].dtc_cod fmy_ram_dyn[9].ctr_frc fmy_ram_dyn[9].ctr_wup_cyc fmy_ram_dyn[9].ctr_dc fmy_ram_dyn[9].diag_inst fmy_ram_dyn[9].idx_frf fmy_ram_dyn[9].err_info_dyn.lv_err_mkd fmy_ram_dyn[9].err_info_dyn.lv_dc_max fmy_ram_dyn[9].err_info_dyn.lv_err_disa fmy_ram_dyn[9].err_info_dyn.lv_err_cfm fmy_ram_dyn[9].err_info_dyn.lv_err_tmp fmy_ram_dyn[9].err_info_dyn.lv_err_dc fmy_ram_dyn[9].err_info_dyn.err_sym_mem fmy_ram_dyn[9].err_info_dyn.err_sym_lst fmy_ram_dyn[9].err_info_dyn.lv_err_pnd fmy_ram_dyn[9].err_info_dyn.lv_cdn_diag_dc fmy_ram_dyn[9].ctr_dc_err_det fmy_ram_dyn[9].ctr_dc_err_det_diag_cdn fmy_ram_dyn[9].ctr_dc_err_det_diag_cmpl fmy_ram_dyn[9].ctr_wup_act_mil tbl_frf[0].envd.header tbl_frf[0].envd.cus_set[0][0] tbl_frf[0].envd.cus_set[0][1] tbl_frf[0].envd.cus_set[0][2] tbl_frf[0].envd.cus_set[0][3] tbl_frf[0].envd.cus_set[0][4] tbl_frf[0].envd.cus_set[0][5] tbl_frf[0].envd.cus_set[0][6] tbl_frf[0].envd.cus_set[0][7] tbl_frf[0].envd.cus_set[0][8] tbl_frf[0].envd.cus_set[0][9] tbl_frf[0].envd.cus_set[0][10] tbl_frf[0].envd.cus_set[0][11] tbl_frf[0].envd.cus_set[0][12] tbl_frf[0].envd.cus_set[0][13] tbl_frf[0].envd.cus_set[1][0] tbl_frf[0].envd.cus_set[1][1] tbl_frf[0].envd.cus_set[1][2] tbl_frf[0].envd.cus_set[1][3] tbl_frf[0].envd.cus_set[1][4] tbl_frf[0].envd.cus_set[1][5] tbl_frf[0].envd.cus_set[1][6] tbl_frf[0].envd.cus_set[1][7] tbl_frf[0].envd.cus_set[1][8] tbl_frf[0].envd.cus_set[1][9] tbl_frf[0].envd.cus_set[1][10] tbl_frf[0].envd.cus_set[1][11] tbl_frf[0].envd.cus_set[1][12] tbl_frf[0].envd.cus_set[1][13] tbl_frf[0].envd.cmn_cus[0] tbl_frf[0].envd.obd[0] tbl_frf[0].envd.obd[1] tbl_frf[0].envd.obd[2] tbl_frf[0].envd.obd[3] tbl_frf[0].envd.obd[4] tbl_frf[0].envd.obd[5] tbl_frf[0].envd.obd[6] tbl_frf[0].envd.obd[7] tbl_frf[1].envd.header tbl_frf[1].envd.cus_set[0][0] tbl_frf[1].envd.cus_set[0][1] tbl_frf[1].envd.cus_set[0][2] tbl_frf[1].envd.cus_set[0][3] tbl_frf[1].envd.cus_set[0][4] tbl_frf[1].envd.cus_set[0][5] tbl_frf[1].envd.cus_set[0][6] tbl_frf[1].envd.cus_set[0][7] tbl_frf[1].envd.cus_set[0][8] tbl_frf[1].envd.cus_set[0][9] tbl_frf[1].envd.cus_set[0][10] tbl_frf[1].envd.cus_set[0][11] tbl_frf[1].envd.cus_set[0][12] tbl_frf[1].envd.cus_set[0][13] tbl_frf[1].envd.cus_set[1][0] tbl_frf[1].envd.cus_set[1][1] tbl_frf[1].envd.cus_set[1][2] tbl_frf[1].envd.cus_set[1][3] tbl_frf[1].envd.cus_set[1][4] tbl_frf[1].envd.cus_set[1][5] tbl_frf[1].envd.cus_set[1][6] tbl_frf[1].envd.cus_set[1][7] tbl_frf[1].envd.cus_set[1][8] tbl_frf[1].envd.cus_set[1][9] tbl_frf[1].envd.cus_set[1][10] tbl_frf[1].envd.cus_set[1][11] tbl_frf[1].envd.cus_set[1][12] tbl_frf[1].envd.cus_set[1][13] tbl_frf[1].envd.cmn_cus[0] tbl_frf[1].envd.obd[0] tbl_frf[1].envd.obd[1] tbl_frf[1].envd.obd[2] tbl_frf[1].envd.obd[3] tbl_frf[1].envd.obd[4] tbl_frf[1].envd.obd[5] tbl_frf[1].envd.obd[6] tbl_frf[1].envd.obd[7] tbl_frf[2].envd.header tbl_frf[2].envd.cus_set[0][0] tbl_frf[2].envd.cus_set[0][1] tbl_frf[2].envd.cus_set[0][2] tbl_frf[2].envd.cus_set[0][3] tbl_frf[2].envd.cus_set[0][4] tbl_frf[2].envd.cus_set[0][5] tbl_frf[2].envd.cus_set[0][6] tbl_frf[2].envd.cus_set[0][7] tbl_frf[2].envd.cus_set[0][8] tbl_frf[2].envd.cus_set[0][9] tbl_frf[2].envd.cus_set[0][10] tbl_frf[2].envd.cus_set[0][11] tbl_frf[2].envd.cus_set[0][12] tbl_frf[2].envd.cus_set[0][13] tbl_frf[2].envd.cus_set[1][0] tbl_frf[2].envd.cus_set[1][1] tbl_frf[2].envd.cus_set[1][2] tbl_frf[2].envd.cus_set[1][3] tbl_frf[2].envd.cus_set[1][4] tbl_frf[2].envd.cus_set[1][5] tbl_frf[2].envd.cus_set[1][6] tbl_frf[2].envd.cus_set[1][7] tbl_frf[2].envd.cus_set[1][8] tbl_frf[2].envd.cus_set[1][9] tbl_frf[2].envd.cus_set[1][10] tbl_frf[2].envd.cus_set[1][11] tbl_frf[2].envd.cus_set[1][12] tbl_frf[2].envd.cus_set[1][13] tbl_frf[2].envd.cmn_cus[0] tbl_frf[2].envd.obd[0] tbl_frf[2].envd.obd[1] tbl_frf[2].envd.obd[2] tbl_frf[2].envd.obd[3] tbl_frf[2].envd.obd[4] tbl_frf[2].envd.obd[5] tbl_frf[2].envd.obd[6] tbl_frf[2].envd.obd[7] tbl_frf[3].envd.header tbl_frf[3].envd.cus_set[0][0] tbl_frf[3].envd.cus_set[0][1] tbl_frf[3].envd.cus_set[0][2] tbl_frf[3].envd.cus_set[0][3] tbl_frf[3].envd.cus_set[0][4] tbl_frf[3].envd.cus_set[0][5] tbl_frf[3].envd.cus_set[0][6] tbl_frf[3].envd.cus_set[0][7] tbl_frf[3].envd.cus_set[0][8] tbl_frf[3].envd.cus_set[0][9] tbl_frf[3].envd.cus_set[0][10] tbl_frf[3].envd.cus_set[0][11] tbl_frf[3].envd.cus_set[0][12] tbl_frf[3].envd.cus_set[0][13] tbl_frf[3].envd.cus_set[1][0] tbl_frf[3].envd.cus_set[1][1] tbl_frf[3].envd.cus_set[1][2] tbl_frf[3].envd.cus_set[1][3] tbl_frf[3].envd.cus_set[1][4] tbl_frf[3].envd.cus_set[1][5] tbl_frf[3].envd.cus_set[1][6] tbl_frf[3].envd.cus_set[1][7] tbl_frf[3].envd.cus_set[1][8] tbl_frf[3].envd.cus_set[1][9] tbl_frf[3].envd.cus_set[1][10] tbl_frf[3].envd.cus_set[1][11] tbl_frf[3].envd.cus_set[1][12] tbl_frf[3].envd.cus_set[1][13] tbl_frf[3].envd.cmn_cus[0] tbl_frf[3].envd.obd[0] tbl_frf[3].envd.obd[1] tbl_frf[3].envd.obd[2] tbl_frf[3].envd.obd[3] tbl_frf[3].envd.obd[4] tbl_frf[3].envd.obd[5] tbl_frf[3].envd.obd[6] tbl_frf[3].envd.obd[7] tbl_frf[4].envd.header tbl_frf[4].envd.cus_set[0][0] tbl_frf[4].envd.cus_set[0][1] tbl_frf[4].envd.cus_set[0][2] tbl_frf[4].envd.cus_set[0][3] tbl_frf[4].envd.cus_set[0][4] tbl_frf[4].envd.cus_set[0][5] tbl_frf[4].envd.cus_set[0][6] tbl_frf[4].envd.cus_set[0][7] tbl_frf[4].envd.cus_set[0][8] tbl_frf[4].envd.cus_set[0][9] tbl_frf[4].envd.cus_set[0][10] tbl_frf[4].envd.cus_set[0][11] tbl_frf[4].envd.cus_set[0][12] tbl_frf[4].envd.cus_set[0][13] tbl_frf[4].envd.cus_set[1][0] tbl_frf[4].envd.cus_set[1][1] tbl_frf[4].envd.cus_set[1][2] tbl_frf[4].envd.cus_set[1][3] tbl_frf[4].envd.cus_set[1][4] tbl_frf[4].envd.cus_set[1][5] tbl_frf[4].envd.cus_set[1][6] tbl_frf[4].envd.cus_set[1][7] tbl_frf[4].envd.cus_set[1][8] tbl_frf[4].envd.cus_set[1][9] tbl_frf[4].envd.cus_set[1][10] tbl_frf[4].envd.cus_set[1][11] tbl_frf[4].envd.cus_set[1][12] tbl_frf[4].envd.cus_set[1][13] tbl_frf[4].envd.cmn_cus[0] tbl_frf[4].envd.obd[0] tbl_frf[4].envd.obd[1] tbl_frf[4].envd.obd[2] tbl_frf[4].envd.obd[3] tbl_frf[4].envd.obd[4] tbl_frf[4].envd.obd[5] tbl_frf[4].envd.obd[6] tbl_frf[4].envd.obd[7] tbl_frf[5].envd.header tbl_frf[5].envd.cus_set[0][0] tbl_frf[5].envd.cus_set[0][1] tbl_frf[5].envd.cus_set[0][2] tbl_frf[5].envd.cus_set[0][3] tbl_frf[5].envd.cus_set[0][4] tbl_frf[5].envd.cus_set[0][5] tbl_frf[5].envd.cus_set[0][6] tbl_frf[5].envd.cus_set[0][7] tbl_frf[5].envd.cus_set[0][8] tbl_frf[5].envd.cus_set[0][9] tbl_frf[5].envd.cus_set[0][10] tbl_frf[5].envd.cus_set[0][11] tbl_frf[5].envd.cus_set[0][12] tbl_frf[5].envd.cus_set[0][13] tbl_frf[5].envd.cus_set[1][0] tbl_frf[5].envd.cus_set[1][1] tbl_frf[5].envd.cus_set[1][2] tbl_frf[5].envd.cus_set[1][3] tbl_frf[5].envd.cus_set[1][4] tbl_frf[5].envd.cus_set[1][5] tbl_frf[5].envd.cus_set[1][6] tbl_frf[5].envd.cus_set[1][7] tbl_frf[5].envd.cus_set[1][8] tbl_frf[5].envd.cus_set[1][9] tbl_frf[5].envd.cus_set[1][10] tbl_frf[5].envd.cus_set[1][11] tbl_frf[5].envd.cus_set[1][12] tbl_frf[5].envd.cus_set[1][13] tbl_frf[5].envd.cmn_cus[0] tbl_frf[5].envd.obd[0] tbl_frf[5].envd.obd[1] tbl_frf[5].envd.obd[2] tbl_frf[5].envd.obd[3] tbl_frf[5].envd.obd[4] tbl_frf[5].envd.obd[5] tbl_frf[5].envd.obd[6] tbl_frf[5].envd.obd[7] tbl_frf[6].envd.header tbl_frf[6].envd.cus_set[0][0] tbl_frf[6].envd.cus_set[0][1] tbl_frf[6].envd.cus_set[0][2] tbl_frf[6].envd.cus_set[0][3] tbl_frf[6].envd.cus_set[0][4] tbl_frf[6].envd.cus_set[0][5] tbl_frf[6].envd.cus_set[0][6] tbl_frf[6].envd.cus_set[0][7] tbl_frf[6].envd.cus_set[0][8] tbl_frf[6].envd.cus_set[0][9] tbl_frf[6].envd.cus_set[0][10] tbl_frf[6].envd.cus_set[0][11] tbl_frf[6].envd.cus_set[0][12] tbl_frf[6].envd.cus_set[0][13] tbl_frf[6].envd.cus_set[1][0] tbl_frf[6].envd.cus_set[1][1] tbl_frf[6].envd.cus_set[1][2] tbl_frf[6].envd.cus_set[1][3] tbl_frf[6].envd.cus_set[1][4] tbl_frf[6].envd.cus_set[1][5] tbl_frf[6].envd.cus_set[1][6] tbl_frf[6].envd.cus_set[1][7] tbl_frf[6].envd.cus_set[1][8] tbl_frf[6].envd.cus_set[1][9] tbl_frf[6].envd.cus_set[1][10] tbl_frf[6].envd.cus_set[1][11] tbl_frf[6].envd.cus_set[1][12] tbl_frf[6].envd.cus_set[1][13] tbl_frf[6].envd.cmn_cus[0] tbl_frf[6].envd.obd[0] tbl_frf[6].envd.obd[1] tbl_frf[6].envd.obd[2] tbl_frf[6].envd.obd[3] tbl_frf[6].envd.obd[4] tbl_frf[6].envd.obd[5] tbl_frf[6].envd.obd[6] tbl_frf[6].envd.obd[7] tbl_frf[7].envd.header tbl_frf[7].envd.cus_set[0][0] tbl_frf[7].envd.cus_set[0][1] tbl_frf[7].envd.cus_set[0][2] tbl_frf[7].envd.cus_set[0][3] tbl_frf[7].envd.cus_set[0][4] tbl_frf[7].envd.cus_set[0][5] tbl_frf[7].envd.cus_set[0][6] tbl_frf[7].envd.cus_set[0][7] tbl_frf[7].envd.cus_set[0][8] tbl_frf[7].envd.cus_set[0][9] tbl_frf[7].envd.cus_set[0][10] tbl_frf[7].envd.cus_set[0][11] tbl_frf[7].envd.cus_set[0][12] tbl_frf[7].envd.cus_set[0][13] tbl_frf[7].envd.cus_set[1][0] tbl_frf[7].envd.cus_set[1][1] tbl_frf[7].envd.cus_set[1][2] tbl_frf[7].envd.cus_set[1][3] tbl_frf[7].envd.cus_set[1][4] tbl_frf[7].envd.cus_set[1][5] tbl_frf[7].envd.cus_set[1][6] tbl_frf[7].envd.cus_set[1][7] tbl_frf[7].envd.cus_set[1][8] tbl_frf[7].envd.cus_set[1][9] tbl_frf[7].envd.cus_set[1][10] tbl_frf[7].envd.cus_set[1][11] tbl_frf[7].envd.cus_set[1][12] tbl_frf[7].envd.cus_set[1][13] tbl_frf[7].envd.cmn_cus[0] tbl_frf[7].envd.obd[0] tbl_frf[7].envd.obd[1] tbl_frf[7].envd.obd[2] tbl_frf[7].envd.obd[3] tbl_frf[7].envd.obd[4] tbl_frf[7].envd.obd[5] tbl_frf[7].envd.obd[6] tbl_frf[7].envd.obd[7] tbl_frf[8].envd.header tbl_frf[8].envd.cus_set[0][0] tbl_frf[8].envd.cus_set[0][1] tbl_frf[8].envd.cus_set[0][2] tbl_frf[8].envd.cus_set[0][3] tbl_frf[8].envd.cus_set[0][4] tbl_frf[8].envd.cus_set[0][5] tbl_frf[8].envd.cus_set[0][6] tbl_frf[8].envd.cus_set[0][7] tbl_frf[8].envd.cus_set[0][8] tbl_frf[8].envd.cus_set[0][9] tbl_frf[8].envd.cus_set[0][10] tbl_frf[8].envd.cus_set[0][11] tbl_frf[8].envd.cus_set[0][12] tbl_frf[8].envd.cus_set[0][13] tbl_frf[8].envd.cus_set[1][0] tbl_frf[8].envd.cus_set[1][1] tbl_frf[8].envd.cus_set[1][2] tbl_frf[8].envd.cus_set[1][3] tbl_frf[8].envd.cus_set[1][4] tbl_frf[8].envd.cus_set[1][5] tbl_frf[8].envd.cus_set[1][6] tbl_frf[8].envd.cus_set[1][7] tbl_frf[8].envd.cus_set[1][8] tbl_frf[8].envd.cus_set[1][9] tbl_frf[8].envd.cus_set[1][10] tbl_frf[8].envd.cus_set[1][11] tbl_frf[8].envd.cus_set[1][12] tbl_frf[8].envd.cus_set[1][13] tbl_frf[8].envd.cmn_cus[0] tbl_frf[8].envd.obd[0] tbl_frf[8].envd.obd[1] tbl_frf[8].envd.obd[2] tbl_frf[8].envd.obd[3] tbl_frf[8].envd.obd[4] tbl_frf[8].envd.obd[5] tbl_frf[8].envd.obd[6] tbl_frf[8].envd.obd[7] tbl_frf[9].envd.header tbl_frf[9].envd.cus_set[0][0] tbl_frf[9].envd.cus_set[0][1] tbl_frf[9].envd.cus_set[0][2] tbl_frf[9].envd.cus_set[0][3] tbl_frf[9].envd.cus_set[0][4] tbl_frf[9].envd.cus_set[0][5] tbl_frf[9].envd.cus_set[0][6] tbl_frf[9].envd.cus_set[0][7] tbl_frf[9].envd.cus_set[0][8] tbl_frf[9].envd.cus_set[0][9] tbl_frf[9].envd.cus_set[0][10] tbl_frf[9].envd.cus_set[0][11] tbl_frf[9].envd.cus_set[0][12] tbl_frf[9].envd.cus_set[0][13] tbl_frf[9].envd.cus_set[1][0] tbl_frf[9].envd.cus_set[1][1] tbl_frf[9].envd.cus_set[1][2] tbl_frf[9].envd.cus_set[1][3] tbl_frf[9].envd.cus_set[1][4] tbl_frf[9].envd.cus_set[1][5] tbl_frf[9].envd.cus_set[1][6] tbl_frf[9].envd.cus_set[1][7] tbl_frf[9].envd.cus_set[1][8] tbl_frf[9].envd.cus_set[1][9] tbl_frf[9].envd.cus_set[1][10] tbl_frf[9].envd.cus_set[1][11] tbl_frf[9].envd.cus_set[1][12] tbl_frf[9].envd.cus_set[1][13] tbl_frf[9].envd.cmn_cus[0] tbl_frf[9].envd.obd[0] tbl_frf[9].envd.obd[1] tbl_frf[9].envd.obd[2] tbl_frf[9].envd.obd[3] tbl_frf[9].envd.obd[4] tbl_frf[9].envd.obd[5] tbl_frf[9].envd.obd[6] tbl_frf[9].envd.obd[7] fmy_his[0][0] fmy_his[0][1] fmy_his[0][2] fmy_his[0][3] fmy_his[1][0] fmy_his[1][1] fmy_his[1][2] fmy_his[1][3] fmy_his[2][0] fmy_his[2][1] fmy_his[2][2] fmy_his[2][3] fmy_his[3][0] fmy_his[3][1] fmy_his[3][2] fmy_his[3][3] fmy_his[4][0] fmy_his[4][1] fmy_his[4][2] fmy_his[4][3] fmy_his[5][0] fmy_his[5][1] fmy_his[5][2] fmy_his[5][3] fmy_his[6][0] fmy_his[6][1] fmy_his[6][2] fmy_his[6][3] fmy_his[7][0] fmy_his[7][1] fmy_his[7][2] fmy_his[7][3] fmy_his[8][0] fmy_his[8][1] fmy_his[8][2] fmy_his[8][3] fmy_his[9][0] fmy_his[9][1] fmy_his[9][2] fmy_his[9][3] fmy_his_cod[0] fmy_his_cod[1] fmy_his_cod[2] fmy_his_cod[3] fmy_his_cod[4] fmy_his_cod[5] fmy_his_cod[6] fmy_his_cod[7] fmy_his_cod[8] fmy_his_cod[9] lv_dc lv_state_wup lv_wup_cyc dly_mil_ready state_mil state_wal_1 state_wal_2 obd_state_1 obd_state_2 lv_wal_1 lv_wal_2 lv_mil_fll_ready t_dtc_clr state_ena_obd state_cmpl_obd dist_act_wal_1 dist_act_wal_2 dist_act_mil t_act_mil t_act_mil_60 dist_dtc_clr dist_rel_dtc_clr ctr_wup_dtc_clr lv_abc_inh lv_inh_wup_cyc lv_err_pvs_pred lv_err_pvs_1 lv_err_pvs_2 lv_lih_pvs_move lv_act_pvs_lih lv_pvs_bls_bts_plaus lv_pvs_h_r lv_pvs_h_r_1 lv_pvs_h_r_2 v_pvs_min v_pvs_mmv_1 v_pvs_mmv_2 ctr_move lv_err_pvs lv_err_vcc_pvs_1 lv_err_vcc_pvs_2 lv_lih_bls_bts vcc_1 vcc_2 amp amp_mes v_amp lv_err_tfu_mes tfu tfu_mes v_tfu tco_sp_ect ctr_bas_cyl_bal[0] ctr_bas_cyl_bal[1] ctr_bas_cyl_bal[2] ctr_eve_cyl_bal[0] ctr_eve_cyl_bal[1] ctr_eve_cyl_bal[2] fac_is_fil lv_act_is_fil_is n_sp_is_fil vs_n_grd vs_n_grd_fil lv_dt lv_vs_n_con dri gear vs vs_h_res vs_bas lv_vs_run vs_n n_mv_vs_sens vs_fil vs_ac t_vs_cor_diag fac_vs_adj vs_conf lv_can_vs_abs lv_can_ac_abs lv_can_dist_abs tq_conv tqi_n_max tqi_p_max tqi_vs_max eff_bas tq_dif_is_ad tq_dif_is_ad_acc tq_loss tqfr_mmv tqfr_bas tqfr_add_toil tqfr_add_tco tqfr_add_env tq_max_sca tq_max_clu tq_min_clu tq_min_sca fac_tq_req_clu_cor tq_req_clu tq_dif_req fac_tq_tra fac_pv_av fac_n_dif lv_tq_tcs_req_inc_inter lv_tq_tcs_req_dec_inter lv_tq_tcs_req_dec_it lv_tq_tcs_req_inc_it lv_tcs_dec_ena lv_tcs_inc_ena tqi_esp_sub tq_esp_sub lv_tq_esp_req_min lv_tq_esp_req_max lv_tq_esp_act /end OUT_MEASUREMENT
/end FUNCTION
/end MODULE
/end PROJECT
/* -------------------------------------------------------------------------
ETAS - Data Declaration System (DDS)
Quality FE<0> NCE<0> E<185> W<322>
Quantity Maps <1264> Parameter<2769> Axes<1002> Online<6817>
------------------------------------------------------------------------- */
