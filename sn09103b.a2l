ASAP2_VERSION 1 41
/begin PROJECT SN0 "SIMOS PPD"
/begin HEADER "_default_HeaderComment" PROJECT_NO PRJ_NUM /end HEADER
/begin MODULE _default_ModuleName "_default_ModuleLongIdentifier"
/begin MOD_COMMON "_default_ModCommonComment" DEPOSIT ABSOLUTE BYTE_ORDER MSB_FIRST ALIGNMENT_BYTE 1 ALIGNMENT_WORD 2 ALIGNMENT_LONG 4 ALIGNMENT_FLOAT32_IEEE 4 ALIGNMENT_FLOAT64_IEEE 8 /end MOD_COMMON
/begin MEASUREMENT err_intm_diag_inst[0] "array of diagnosis instances for intermittent failures" ULONG _CNV_S_173_CONV_DIAG__26_CM 1 0. 0. 172. DISPLAY_IDENTIFIER ERR_INTM_0_DIAG_INST ECU_ADDRESS 0x7fc090 BYTE_ORDER MSB_LAST /end MEASUREMENT
/begin MEASUREMENT err_intm_diag_inst[1] "array of diagnosis instances for intermittent failures" ULONG _CNV_S_173_CONV_DIAG__26_CM 1 0. 0. 172. DISPLAY_IDENTIFIER ERR_INTM_1_DIAG_INST ECU_ADDRESS 0x7fc094 BYTE_ORDER MSB_LAST /end MEASUREMENT
/begin MEASUREMENT err_intm_diag_inst[2] "array of diagnosis instances for intermittent failures" ULONG _CNV_S_173_CONV_DIAG__26_CM 1 0. 0. 172. DISPLAY_IDENTIFIER ERR_INTM_2_DIAG_INST ECU_ADDRESS 0x7fc098 BYTE_ORDER MSB_LAST /end MEASUREMENT
/begin MEASUREMENT err_intm_diag_inst[3] "array of diagnosis instances for intermittent failures" ULONG _CNV_S_173_CONV_DIAG__26_CM 1 0. 0. 172. DISPLAY_IDENTIFIER ERR_INTM_3_DIAG_INST ECU_ADDRESS 0x7fc09c BYTE_ORDER MSB_LAST /end MEASUREMENT
/begin MEASUREMENT err_intm_diag_inst[4] "array of diagnosis instances for intermittent failures" ULONG _CNV_S_173_CONV_DIAG__26_CM 1 0. 0. 172. DISPLAY_IDENTIFIER ERR_INTM_4_DIAG_INST ECU_ADDRESS 0x7fc0a0 BYTE_ORDER MSB_LAST /end MEASUREMENT
/begin MEASUREMENT err_intm_diag_inst[5] "array of diagnosis instances for intermittent failures" ULONG _CNV_S_173_CONV_DIAG__26_CM 1 0. 0. 172. DISPLAY_IDENTIFIER ERR_INTM_5_DIAG_INST ECU_ADDRESS 0x7fc0a4 BYTE_ORDER MSB_LAST /end MEASUREMENT
/begin MEASUREMENT err_intm_diag_inst[6] "array of diagnosis instances for intermittent failures" ULONG _CNV_S_173_CONV_DIAG__26_CM 1 0. 0. 172. DISPLAY_IDENTIFIER ERR_INTM_6_DIAG_INST ECU_ADDRESS 0x7fc0a8 BYTE_ORDER MSB_LAST /end MEASUREMENT
/begin MEASUREMENT err_intm_diag_inst[7] "array of diagnosis instances for intermittent failures" ULONG _CNV_S_173_CONV_DIAG__26_CM 1 0. 0. 172. DISPLAY_IDENTIFIER ERR_INTM_7_DIAG_INST ECU_ADDRESS 0x7fc0ac BYTE_ORDER MSB_LAST /end MEASUREMENT
/begin MEASUREMENT err_intm_diag_inst[8] "array of diagnosis instances for intermittent failures" ULONG _CNV_S_173_CONV_DIAG__26_CM 1 0. 0. 172. DISPLAY_IDENTIFIER ERR_INTM_8_DIAG_INST ECU_ADDRESS 0x7fc0b0 BYTE_ORDER MSB_LAST /end MEASUREMENT
/begin MEASUREMENT err_intm_diag_inst[9] "array of diagnosis instances for intermittent failures" ULONG _CNV_S_173_CONV_DIAG__26_CM 1 0. 0. 172. DISPLAY_IDENTIFIER ERR_INTM_9_DIAG_INST ECU_ADDRESS 0x7fc0b4 BYTE_ORDER MSB_LAST /end MEASUREMENT
/begin MEASUREMENT err_intm_ctr_frc[0] "frequency of reappearence of failure stored in intermittente memory" UBYTE _CNV_A_R_LINEAR_____0_CM 1 0. 0. 255. DISPLAY_IDENTIFIER ERR_INTM_0_CTR_FRC ECU_ADDRESS 0x7fc0b8 FORMAT "%3.0" /end MEASUREMENT
/begin MEASUREMENT err_intm_ctr_frc[1] "frequency of reappearence of failure stored in intermittente memory" UBYTE _CNV_A_R_LINEAR_____0_CM 1 0. 0. 255. DISPLAY_IDENTIFIER ERR_INTM_1_CTR_FRC ECU_ADDRESS 0x7fc0b9 FORMAT "%3.0" /end MEASUREMENT
/begin MEASUREMENT err_intm_ctr_frc[2] "frequency of reappearence of failure stored in intermittente memory" UBYTE _CNV_A_R_LINEAR_____0_CM 1 0. 0. 255. DISPLAY_IDENTIFIER ERR_INTM_2_CTR_FRC ECU_ADDRESS 0x7fc0ba FORMAT "%3.0" /end MEASUREMENT
/begin MEASUREMENT err_intm_ctr_frc[3] "frequency of reappearence of failure stored in intermittente memory" UBYTE _CNV_A_R_LINEAR_____0_CM 1 0. 0. 255. DISPLAY_IDENTIFIER ERR_INTM_3_CTR_FRC ECU_ADDRESS 0x7fc0bb FORMAT "%3.0" /end MEASUREMENT
/begin MEASUREMENT err_intm_ctr_frc[4] "frequency of reappearence of failure stored in intermittente memory" UBYTE _CNV_A_R_LINEAR_____0_CM 1 0. 0. 255. DISPLAY_IDENTIFIER ERR_INTM_4_CTR_FRC ECU_ADDRESS 0x7fc0bc FORMAT "%3.0" /end MEASUREMENT
/begin MEASUREMENT err_intm_ctr_frc[5] "frequency of reappearence of failure stored in intermittente memory" UBYTE _CNV_A_R_LINEAR_____0_CM 1 0. 0. 255. DISPLAY_IDENTIFIER ERR_INTM_5_CTR_FRC ECU_ADDRESS 0x7fc0bd FORMAT "%3.0" /end MEASUREMENT
/begin MEASUREMENT err_intm_ctr_frc[6] "frequency of reappearence of failure stored in intermittente memory" UBYTE _CNV_A_R_LINEAR_____0_CM 1 0. 0. 255. DISPLAY_IDENTIFIER ERR_INTM_6_CTR_FRC ECU_ADDRESS 0x7fc0be FORMAT "%3.0" /end MEASUREMENT
/begin MEASUREMENT err_intm_ctr_frc[7] "frequency of reappearence of failure stored in intermittente memory" UBYTE _CNV_A_R_LINEAR_____0_CM 1 0. 0. 255. DISPLAY_IDENTIFIER ERR_INTM_7_CTR_FRC ECU_ADDRESS 0x7fc0bf FORMAT "%3.0" /end MEASUREMENT
/begin MEASUREMENT err_intm_ctr_frc[8] "frequency of reappearence of failure stored in intermittente memory" UBYTE _CNV_A_R_LINEAR_____0_CM 1 0. 0. 255. DISPLAY_IDENTIFIER ERR_INTM_8_CTR_FRC ECU_ADDRESS 0x7fc0c0 FORMAT "%3.0" /end MEASUREMENT
/begin MEASUREMENT err_intm_ctr_frc[9] "frequency of reappearence of failure stored in intermittente memory" UBYTE _CNV_A_R_LINEAR_____0_CM 1 0. 0. 255. DISPLAY_IDENTIFIER ERR_INTM_9_CTR_FRC ECU_ADDRESS 0x7fc0c1 FORMAT "%3.0" /end MEASUREMENT
/begin MEASUREMENT ctr_err_intm_nr "actual number of failures stored in intermittent memory" UBYTE _CNV_A_R_LINEAR_____0_CM 1 0. 0. 255. DISPLAY_IDENTIFIER CTR_ERR_INTM_NR ECU_ADDRESS 0x7fc0c2 FORMAT "%3.0" /end MEASUREMENT
/begin MEASUREMENT lv_vs_n_con_diag "" UBYTE _CNV_S_2_RANGE______11_CM 1 0. 0. 1. DISPLAY_IDENTIFIER LV_VS_N_CON_DIAG ECU_ADDRESS 0x7fb761 /end MEASUREMENT
/begin MEASUREMENT tq_req_clu_cor "" SWORD _CNV_A_R_LINEAR_____62_CM 1 0. -1024. 1023.96875 DISPLAY_IDENTIFIER TQ_REQ_CLU_COR ECU_ADDRESS 0x7fa22a BYTE_ORDER MSB_LAST FORMAT "%7.2" /end MEASUREMENT
/begin MEASUREMENT lv_tcs_hold "" UBYTE _CNV_S_2_RANGE______11_CM 1 0. 0. 1. DISPLAY_IDENTIFIER LV_TCS_HOLD ECU_ADDRESS 0x7fb7fc /end MEASUREMENT
/begin MEASUREMENT lv_err_can_tcs_all "" UBYTE _CNV_S_2_RANGE__0___88_CM 1 0. 0. 1. DISPLAY_IDENTIFIER LV_ERR_CAN_TCS_ALL ECU_ADDRESS 0x7fb9a5 BIT_MASK 0x1 /end MEASUREMENT
/begin MEASUREMENT lv_err_can_acu_all "" UBYTE _CNV_S_2_RANGE__0___88_CM 1 0. 0. 1. DISPLAY_IDENTIFIER LV_ERR_CAN_ACU_ALL ECU_ADDRESS 0x7fb9a7 BIT_MASK 0x1 /end MEASUREMENT
/begin MEASUREMENT lv_err_can_ccu_all "" UBYTE _CNV_S_2_RANGE__0___88_CM 1 0. 0. 1. DISPLAY_IDENTIFIER LV_ERR_CAN_CCU_ALL ECU_ADDRESS 0x7fb9a8 BIT_MASK 0x1 /end MEASUREMENT
/begin MEASUREMENT lv_err_can_icl_all "" UBYTE _CNV_S_2_RANGE__0___88_CM 1 0. 0. 1. DISPLAY_IDENTIFIER LV_ERR_CAN_ICL_ALL ECU_ADDRESS 0x7fb9a9 BIT_MASK 0x1 /end MEASUREMENT
/begin MEASUREMENT lv_err_can_smls_all "" UBYTE _CNV_S_2_RANGE__0___88_CM 1 0. 0. 1. DISPLAY_IDENTIFIER LV_ERR_CAN_SMLS_ALL ECU_ADDRESS 0x7fb9ab BIT_MASK 0x1 /end MEASUREMENT
/begin MEASUREMENT lv_err_can_tcu_all "" UBYTE _CNV_S_2_RANGE__0___88_CM 1 0. 0. 1. DISPLAY_IDENTIFIER LV_ERR_CAN_TCU_ALL ECU_ADDRESS 0x7fb9a6 BIT_MASK 0x1 /end MEASUREMENT
/begin MEASUREMENT lv_err_can_if_cft_all "" UBYTE _CNV_S_2_RANGE__0___88_CM 1 0. 0. 1. DISPLAY_IDENTIFIER LV_ERR_CAN_IF_CFT_ALL ECU_ADDRESS 0x7fb9ad BIT_MASK 0x1 /end MEASUREMENT
/begin MEASUREMENT tqi_av "" SWORD _CNV_A_R_LINEAR_____62_CM 1 0. -1024. 1023.96875 DISPLAY_IDENTIFIER TQI_AV ECU_ADDRESS 0x7f9756 BYTE_ORDER MSB_LAST FORMAT "%4.2" /end MEASUREMENT
/begin MEASUREMENT tqi_ems "" SWORD _CNV_A_R_LINEAR_____62_CM 1 0. -1024. 1023.96875 DISPLAY_IDENTIFIER TQI_EMS ECU_ADDRESS 0x7f9758 BYTE_ORDER MSB_LAST /end MEASUREMENT
/begin MEASUREMENT tqi_ref_max "" SWORD _CNV_A_R_LINEAR_____62_CM 1 0. -1024. 1023.96875 DISPLAY_IDENTIFIER TQI_REF_MAX ECU_ADDRESS 0x7f975a BYTE_ORDER MSB_LAST /end MEASUREMENT
/begin MEASUREMENT eff_iga_bas_cor "" UWORD _CNV_A_R_LINEAR_____53_CM 1 0. 0. 1.9999696 DISPLAY_IDENTIFIER EFF_IGA_BAS_COR ECU_ADDRESS 0x7f975c BYTE_ORDER MSB_LAST /end MEASUREMENT
/begin MEASUREMENT tqi_ref_iga_min_lamb "" SWORD _CNV_A_R_LINEAR_____62_CM 1 0. -1024. 1023.96875 DISPLAY_IDENTIFIER TQI_REF_IGA_MIN_LAMB ECU_ADDRESS 0x7f975e BYTE_ORDER MSB_LAST /end MEASUREMENT
/begin MEASUREMENT vs_high_res "Fahrzeuggeschwindigkeit" UWORD _CNV_A_R_LINEAR_____74_CM 1 0. 0. 327.67 DISPLAY_IDENTIFIER VS_HIGH_RES ECU_ADDRESS 0x7f9762 BYTE_ORDER MSB_LAST /end MEASUREMENT
/begin MEASUREMENT tps_av "Drosselklappenwinkel" UWORD _CNV_A_R_LINEAR_____231_CM 1 0. 0. 119.5 DISPLAY_IDENTIFIER TPS_AV ECU_ADDRESS 0x7f9764 BYTE_ORDER MSB_LAST /end MEASUREMENT
/begin MEASUREMENT tqi_bas "" SWORD _CNV_A_R_LINEAR_____62_CM 1 0. -1024. 1023.96875 DISPLAY_IDENTIFIER TQI_BAS ECU_ADDRESS 0x7f9760 BYTE_ORDER MSB_LAST /end MEASUREMENT
/begin MEASUREMENT amp_ad "" UWORD _CNV_A_R_LINEAR_____21_CM 1 0. 0. 5434. DISPLAY_IDENTIFIER AMP_AD ECU_ADDRESS 0x7f9766 BYTE_ORDER MSB_LAST /end MEASUREMENT
/begin MEASUREMENT lv_ct "Leergasinformation" UBYTE _CNV_A_R_LINEAR_____0_CM 1 0. 0. 1. DISPLAY_IDENTIFIER LV_CT ECU_ADDRESS 0x7fb3f0 FORMAT "%1.0" /end MEASUREMENT
/begin MEASUREMENT lv_ac_cru_sp_ena "GRA-Bremseingriff Freigabe" UBYTE _CNV_S_2_RANGE__0___88_CM 1 0. 0. 1. DISPLAY_IDENTIFIER LV_AC_CRU_SP_ENA ECU_ADDRESS 0x7fb3f1 BIT_MASK 0x1 /end MEASUREMENT
/begin MEASUREMENT lv_acc_red_cmd "Leistungsreduzierung Klimakompressor" UBYTE _CNV_S_2_RANGE__0___88_CM 1 0. 0. 1. DISPLAY_IDENTIFIER LV_ACC_RED_CMD ECU_ADDRESS 0x7fb3f3 BIT_MASK 0x1 /end MEASUREMENT
/begin MEASUREMENT lv_temp_pwal "heissleuchtenvorwarnung" UBYTE _CNV_S_2_RANGE__0___88_CM 1 0. 0. 1. DISPLAY_IDENTIFIER LV_TEMP_PWAL ECU_ADDRESS 0x7fb3f4 BIT_MASK 0x1 /end MEASUREMENT
/begin MEASUREMENT gen_load_resp_ems1 "Motor Wunschdrehzahl Prioritaet" UBYTE _CNV_A_R_LINEAR_____0_CM 1 0. 0. 3. DISPLAY_IDENTIFIER GEN_LOAD_RESP_EMS1 ECU_ADDRESS 0x7fb3ed FORMAT "%2.0" BIT_MASK 0x1 /end MEASUREMENT
/begin MEASUREMENT alter_inh "lastabwurf generatorspannung" UBYTE _CNV_A_R_LINEAR_____0_CM 1 0. 0. 3. DISPLAY_IDENTIFIER ALTER_INH ECU_ADDRESS 0x7fb3ee FORMAT "%2.0" BIT_MASK 0x1 /end MEASUREMENT
/begin MEASUREMENT lv_alter_act "einschalten generator" UBYTE _CNV_S_2_RANGE__0___88_CM 1 0. 0. 1. DISPLAY_IDENTIFIER LV_ALTER_ACT ECU_ADDRESS 0x7fb3f5 BIT_MASK 0x1 /end MEASUREMENT
/begin MEASUREMENT lv_heat_inh "lastabwurf heizsysteme" UBYTE _CNV_S_2_RANGE__0___88_CM 1 0. 0. 1. DISPLAY_IDENTIFIER LV_HEAT_INH ECU_ADDRESS 0x7fb3f6 BIT_MASK 0x1 /end MEASUREMENT
/begin MEASUREMENT lv_vs_lim_act "geschwindigkeitsbegrenzung aktiv" UBYTE _CNV_S_2_RANGE__0___88_CM 1 0. 0. 1. DISPLAY_IDENTIFIER LV_VS_LIM_ACT ECU_ADDRESS 0x7fb3f7 BIT_MASK 0x1 /end MEASUREMENT
/begin MEASUREMENT lv_tqi_stnd "doppelte momente" UBYTE _CNV_S_2_RANGE__0___88_CM 1 0. 0. 1. DISPLAY_IDENTIFIER LV_TQI_STND ECU_ADDRESS 0x7fb3f8 BIT_MASK 0x1 /end MEASUREMENT
/begin MEASUREMENT lv_err_amp "fehler umgebungsluftdruck" UBYTE _CNV_S_2_RANGE__0___88_CM 1 0. 0. 1. DISPLAY_IDENTIFIER LV_ERR_AMP ECU_ADDRESS 0x7fb3f9 BIT_MASK 0x1 /end MEASUREMENT
/begin MEASUREMENT lv_n_max_req_tcu "Motor Wunschdrehzahl Prioritaet" UBYTE _CNV_S_2_RANGE__0___88_CM 1 0. 0. 1. DISPLAY_IDENTIFIER LV_N_MAX_REQ_TCU ECU_ADDRESS 0x7fb3f2 BIT_MASK 0x1 /end MEASUREMENT
/begin MEASUREMENT n_max_req_tcu "motor wunschdrehzahl (FFh=fehlerwert)" UBYTE _CNV_A_R_LINEAR_____232_CM 1 0. 0. 6350. DISPLAY_IDENTIFIER N_MAX_REQ_TCU ECU_ADDRESS 0x7fb3ec FORMAT "%4.0" BIT_MASK 0x1 /end MEASUREMENT
/begin MEASUREMENT tco_stop "TCO threshold for cancellation of power latch pahse 2" UBYTE _CNV_A_R_LINEAR_____235_CM 1 0. -48. 142.5 DISPLAY_IDENTIFIER TCO_STOP ECU_ADDRESS 0x7fb820 FORMAT "%5.1" /end MEASUREMENT
/begin MEASUREMENT tco_warn "Coolant temperature for overheating protection" UBYTE _CNV_A_R_LINEAR_____235_CM 1 0. -48. 142.5 DISPLAY_IDENTIFIER TCO_WARN ECU_ADDRESS 0x7fb822 FORMAT "%5.1" /end MEASUREMENT
/begin MEASUREMENT t_ast_stop "Time after exit start to after start saved in the non-volatile memory at engine shut down" UWORD _CNV_A_R_LINEAR_____234_CM 1 0. 0. 6553.5 DISPLAY_IDENTIFIER T_AST_STOP ECU_ADDRESS 0x7fa286 BYTE_ORDER MSB_LAST FORMAT "%6.1" /end MEASUREMENT
/begin MEASUREMENT v_hvr "Heater request (Poti)" UWORD _CNV_A_R_LINEAR_____33_CM 1 0. 0. 4.9951171875 DISPLAY_IDENTIFIER V_HVR ECU_ADDRESS 0x7fa280 BYTE_ORDER MSB_LAST FORMAT "%6.5" /end MEASUREMENT
/begin MEASUREMENT tqi_req_slow "Torque request" SWORD _CNV_A_R_LINEAR_____62_CM 1 0. -1024. 1023.96875 DISPLAY_IDENTIFIER TQI_REQ_SLOW ECU_ADDRESS 0x7fa282 BYTE_ORDER MSB_LAST FORMAT "%8.4" /end MEASUREMENT
/begin MEASUREMENT tqi_req_tra "Torque request" SWORD _CNV_A_R_LINEAR_____62_CM 1 0. -1024. 1023.96875 DISPLAY_IDENTIFIER TQI_REQ_TRA ECU_ADDRESS 0x7fa284 BYTE_ORDER MSB_LAST FORMAT "%8.4" /end MEASUREMENT
/begin MEASUREMENT lv_accin_on "Air conditioning on" UBYTE _CNV_S_2_RANGE__0___88_CM 1 0. 0. 1. DISPLAY_IDENTIFIER LV_ACCIN_ON ECU_ADDRESS 0x7fb821 BIT_MASK 0x1 /end MEASUREMENT
/begin MEASUREMENT toil_mdl "Model For Oil Temperature" UBYTE _CNV_A_R_LINEAR_____295_CM 1 0. -60. 195. DISPLAY_IDENTIFIER TOIL_MDL ECU_ADDRESS 0x7fb777 FORMAT "%3.0" /end MEASUREMENT
/begin MEASUREMENT mff_sp_mv "Mass fuel flow set point after combustoin selection" UWORD _CNV_A_R_LINEAR_____23_CM 1 0. 0. 1389. DISPLAY_IDENTIFIER MFF_SP_MV ECU_ADDRESS 0x7fa290 BYTE_ORDER MSB_LAST FORMAT "%4.0" /end MEASUREMENT
/begin MEASUREMENT eff_scc_av "Actual authorized efficiency fuel cut off" UWORD _CNV_A_R_LINEAR_____314_CM 1 0. 0. 1.999969 DISPLAY_IDENTIFIER EFF_SCC_AV ECU_ADDRESS 0x7fa292 BYTE_ORDER MSB_LAST FORMAT "%1.6" /end MEASUREMENT
/begin MEASUREMENT vs_used "used vehicle speed signal" UBYTE _CNV_A_R_LINEAR_____1_CM 1 0. 0. 4. DISPLAY_IDENTIFIER VS_USED ECU_ADDRESS 0x7fb77e FORMAT "%1.0" /end MEASUREMENT
/begin MEASUREMENT fac_cyl_bal_fdout_mf "correction of cylinder balancing factors as function of fuelmass" UWORD _CNV_A_R_LINEAR_____372_CM 1 0. 0. 1. DISPLAY_IDENTIFIER FAC_CYL_BAL_FDOUT_MF ECU_ADDRESS 0x7fa56a BYTE_ORDER MSB_LAST FORMAT "%5.4" /end MEASUREMENT
/begin MEASUREMENT lv_vb_jump "jump start recognition status" UBYTE _CNV_S_2_RANGE______392_CM 1 0. 0. 255. DISPLAY_IDENTIFIER LV_VB_JUMP ECU_ADDRESS 0x7fb759 /end MEASUREMENT
/begin MEASUREMENT lv_vs_whl_lim_can "Geschwindigkeitsbegrenzung" UBYTE _CNV_S_2_RANGE__0___88_CM 1 0. 0. 1. DISPLAY_IDENTIFIER LV_VS_WHL_LIM_CAN ECU_ADDRESS 0x7fb3fd /end MEASUREMENT
/begin MEASUREMENT lv_whl_can_vld "Flag fuer 'Allrad 1'-Botschaft gueltig " UBYTE _CNV_S_2_RANGE__0___88_CM 1 0. 0. 1. DISPLAY_IDENTIFIER LV_WHL_CAN_VLD ECU_ADDRESS 0x7fb3fe /end MEASUREMENT
/begin MEASUREMENT lv_tcu_conf_can "getriebesteuergeraet im CAN netwerk" UBYTE _CNV_S_2_RANGE__0___88_CM 1 0. 0. 1. DISPLAY_IDENTIFIER LV_TCU_CONF_CAN ECU_ADDRESS 0x7fb40c BIT_MASK 0x1 /end MEASUREMENT
/begin MEASUREMENT lv_clima_conf_can "klimasteuergeraet komfort im CAN netwerk" UBYTE _CNV_S_2_RANGE__0___88_CM 1 0. 0. 1. DISPLAY_IDENTIFIER LV_CLIMA_CONF_CAN ECU_ADDRESS 0x7fb40e BIT_MASK 0x1 /end MEASUREMENT
/begin MEASUREMENT lv_nom_sys_can_vld "flag fuer 'sollverbauliste_neu'  botschaft gueltig " UBYTE _CNV_S_2_RANGE__0___88_CM 1 0. 0. 1. DISPLAY_IDENTIFIER LV_NOM_SYS_CAN_VLD ECU_ADDRESS 0x7fb40d BIT_MASK 0x1 /end MEASUREMENT
/begin MEASUREMENT lv_conf_info_vld "Verbauinformation gueltig" UBYTE _CNV_S_2_RANGE__0___88_CM 1 0. 0. 1. DISPLAY_IDENTIFIER LV_CONF_INFO_VLD ECU_ADDRESS 0x7fb3ff BIT_MASK 0x1 /end MEASUREMENT
/begin MEASUREMENT lv_sys_info_can_vld "Flag fuer 'Systeminfo 1'-Botschaft gueltig " UBYTE _CNV_S_2_RANGE__0___88_CM 1 0. 0. 1. DISPLAY_IDENTIFIER LV_SYS_INFO_CAN_VLD ECU_ADDRESS 0x7fb400 BIT_MASK 0x1 /end MEASUREMENT
/begin MEASUREMENT lv_err_imob "" UBYTE _CNV_S_2_RANGE__0___88_CM 1 0. 0. 1. DISPLAY_IDENTIFIER LV_ERR_IMOB ECU_ADDRESS 0x7fb4d7 BIT_MASK 0x1 /end MEASUREMENT
/begin MEASUREMENT lv_imob_inj_off "" UBYTE _CNV_S_2_RANGE__0___88_CM 1 0. 0. 1. DISPLAY_IDENTIFIER LV_IMOB_INJ_OFF ECU_ADDRESS 0x7fb6c1 BIT_MASK 0x1 /end MEASUREMENT
/begin MEASUREMENT lv_imob_igc_off "" UBYTE _CNV_S_2_RANGE__0___88_CM 1 0. 0. 1. DISPLAY_IDENTIFIER LV_IMOB_IGC_OFF ECU_ADDRESS 0x7fb6c2 BIT_MASK 0x1 /end MEASUREMENT
/begin MEASUREMENT burst_mes_mode "burst measurement mode" UBYTE _CNV_A_R_LINEAR_____0_CM 1 0. 0. 5. DISPLAY_IDENTIFIER BURST_MES_MODE ECU_ADDRESS 0x7fb6dd FORMAT "%1.0" /end MEASUREMENT
/begin MEASUREMENT burst_mes_mode_[0] "burst measurement mode (cylinder individual)" UBYTE _CNV_A_R_LINEAR_____0_CM 1 0. 0. 5. DISPLAY_IDENTIFIER BURST_MES_MODE__0_ ECU_ADDRESS 0x7fb6de FORMAT "%1.0" /end MEASUREMENT
/begin MEASUREMENT burst_mes_mode_[1] "burst measurement mode (cylinder individual)" UBYTE _CNV_A_R_LINEAR_____0_CM 1 0. 0. 5. DISPLAY_IDENTIFIER BURST_MES_MODE__1_ ECU_ADDRESS 0x7fb6df FORMAT "%1.0" /end MEASUREMENT
/begin MEASUREMENT burst_mes_mode_[2] "burst measurement mode (cylinder individual)" UBYTE _CNV_A_R_LINEAR_____0_CM 1 0. 0. 5. DISPLAY_IDENTIFIER BURST_MES_MODE__2_ ECU_ADDRESS 0x7fb6e0 FORMAT "%1.0" /end MEASUREMENT
/begin MEASUREMENT burst_mes_mode_[3] "burst measurement mode (cylinder individual)" UBYTE _CNV_A_R_LINEAR_____0_CM 1 0. 0. 5. DISPLAY_IDENTIFIER BURST_MES_MODE__3_ ECU_ADDRESS 0x7fb6e1 FORMAT "%1.0" /end MEASUREMENT
/begin MEASUREMENT sf_t_iv_close_ctl_sel "status word for injection valve close controller selection" UWORD _CNV_A_R_LINEAR_____0_CM 1 0. 0. 65535. DISPLAY_IDENTIFIER SF_T_IV_CLOSE_CTL_SEL ECU_ADDRESS 0x7f9e46 BYTE_ORDER MSB_LAST FORMAT "%5.0" /end MEASUREMENT
/begin MEASUREMENT sf_iv_foc_ctl_sel "status word for thrust controller selection" UWORD _CNV_A_R_LINEAR_____0_CM 1 0. 0. 65535. DISPLAY_IDENTIFIER SF_IV_FOC_CTL_SEL ECU_ADDRESS 0x7f9e50 BYTE_ORDER MSB_LAST FORMAT "%5.0" /end MEASUREMENT
/begin MEASUREMENT sf_pui_acq_sel "status word for peco data acquisition selection" UWORD _CNV_A_R_LINEAR_____0_CM 1 0. 0. 65535. DISPLAY_IDENTIFIER SF_PUI_ACQ_SEL ECU_ADDRESS 0x7f9e4e BYTE_ORDER MSB_LAST FORMAT "%5.0" /end MEASUREMENT
/begin MEASUREMENT sf_egy_ctl_sel "status word for energy controller selection" UWORD _CNV_A_R_LINEAR_____0_CM 1 0. 0. 65535. DISPLAY_IDENTIFIER SF_EGY_CTL_SEL ECU_ADDRESS 0x7f9e4a BYTE_ORDER MSB_LAST FORMAT "%5.0" /end MEASUREMENT
/begin MEASUREMENT sf_egy_mes_sel "status word for energy measurement selection" UWORD _CNV_A_R_LINEAR_____0_CM 1 0. 0. 65535. DISPLAY_IDENTIFIER SF_EGY_MES_SEL ECU_ADDRESS 0x7f9e48 BYTE_ORDER MSB_LAST FORMAT "%5.0" /end MEASUREMENT
/begin MEASUREMENT sf_stk_ctl_sel "status word for stroke controller selection" UWORD _CNV_A_R_LINEAR_____0_CM 1 0. 0. 65535. DISPLAY_IDENTIFIER SF_STK_CTL_SEL ECU_ADDRESS 0x7f9e4c BYTE_ORDER MSB_LAST FORMAT "%5.0" /end MEASUREMENT
/begin MEASUREMENT seg_nr_peco_cord "actual segment number of peco coordinator" UBYTE _CNV_A_R_LINEAR_____0_CM 1 0. 0. 15. DISPLAY_IDENTIFIER SEG_NR_PECO_CORD ECU_ADDRESS 0x7fbaf3 FORMAT "%1.0" /end MEASUREMENT
/begin MEASUREMENT sf_eng_state_[0] "cylinder individual engine states (01: ES; 02: ST; 04: IS; 08: PL)" UBYTE _CNV_S_4_Engine_Sta_339_CM 1 0. 1. 8. DISPLAY_IDENTIFIER SF_ENG_STATE__0_ ECU_ADDRESS 0x7fb6e2 /end MEASUREMENT
/begin MEASUREMENT sf_eng_state_[1] "cylinder individual engine states (01: ES; 02: ST; 04: IS; 08: PL)" UBYTE _CNV_S_4_Engine_Sta_339_CM 1 0. 1. 8. DISPLAY_IDENTIFIER SF_ENG_STATE__1_ ECU_ADDRESS 0x7fb6e3 /end MEASUREMENT
/begin MEASUREMENT sf_eng_state_[2] "cylinder individual engine states (01: ES; 02: ST; 04: IS; 08: PL)" UBYTE _CNV_S_4_Engine_Sta_339_CM 1 0. 1. 8. DISPLAY_IDENTIFIER SF_ENG_STATE__2_ ECU_ADDRESS 0x7fb6e4 /end MEASUREMENT
/begin MEASUREMENT sf_eng_state_[3] "cylinder individual engine states (01: ES; 02: ST; 04: IS; 08: PL)" UBYTE _CNV_S_4_Engine_Sta_339_CM 1 0. 1. 8. DISPLAY_IDENTIFIER SF_ENG_STATE__3_ ECU_ADDRESS 0x7fb6e5 /end MEASUREMENT
/begin MEASUREMENT v_inj_burst_mon "PECO Monitoring" UWORD _CNV_A_R_LINEAR_____123_CM 1 0. 0. 255. DISPLAY_IDENTIFIER V_INJ_BURST_MON ECU_ADDRESS 0x7faa2e BYTE_ORDER MSB_LAST FORMAT "%4.1" /end MEASUREMENT
/begin MEASUREMENT v_inj_mon_ctr "PECO Monitoring" UWORD _CNV_A_R_LINEAR_____123_CM 1 0. 0. 255. DISPLAY_IDENTIFIER V_INJ_MON_CTR ECU_ADDRESS 0x7fa964 BYTE_ORDER MSB_LAST FORMAT "%4.1" /end MEASUREMENT
/begin MEASUREMENT v_inj_burst_mon_[0] "PECO Monitoring" UWORD _CNV_A_R_LINEAR_____128_CM 1 0. 0. 255. DISPLAY_IDENTIFIER V_INJ_BURST_MON__0_ ECU_ADDRESS 0x7fa966 BYTE_ORDER MSB_LAST FORMAT "%4.1" /end MEASUREMENT
/begin MEASUREMENT v_inj_burst_mon_[1] "PECO Monitoring" UWORD _CNV_A_R_LINEAR_____128_CM 1 0. 0. 255. DISPLAY_IDENTIFIER V_INJ_BURST_MON__1_ ECU_ADDRESS 0x7fa968 BYTE_ORDER MSB_LAST FORMAT "%4.1" /end MEASUREMENT
/begin MEASUREMENT v_inj_burst_mon_[2] "PECO Monitoring" UWORD _CNV_A_R_LINEAR_____128_CM 1 0. 0. 255. DISPLAY_IDENTIFIER V_INJ_BURST_MON__2_ ECU_ADDRESS 0x7fa96a BYTE_ORDER MSB_LAST FORMAT "%4.1" /end MEASUREMENT
/begin MEASUREMENT v_inj_burst_mon_[3] "PECO Monitoring" UWORD _CNV_A_R_LINEAR_____128_CM 1 0. 0. 255. DISPLAY_IDENTIFIER V_INJ_BURST_MON__3_ ECU_ADDRESS 0x7fa96c BYTE_ORDER MSB_LAST FORMAT "%4.1" /end MEASUREMENT
/begin MEASUREMENT v_inj_burst_mon_[4] "PECO Monitoring" UWORD _CNV_A_R_LINEAR_____128_CM 1 0. 0. 255. DISPLAY_IDENTIFIER V_INJ_BURST_MON__4_ ECU_ADDRESS 0x7fa96e BYTE_ORDER MSB_LAST FORMAT "%4.1" /end MEASUREMENT
/begin MEASUREMENT v_inj_burst_mon_[5] "PECO Monitoring" UWORD _CNV_A_R_LINEAR_____128_CM 1 0. 0. 255. DISPLAY_IDENTIFIER V_INJ_BURST_MON__5_ ECU_ADDRESS 0x7fa970 BYTE_ORDER MSB_LAST FORMAT "%4.1" /end MEASUREMENT
/begin MEASUREMENT v_inj_burst_mon_[6] "PECO Monitoring" UWORD _CNV_A_R_LINEAR_____128_CM 1 0. 0. 255. DISPLAY_IDENTIFIER V_INJ_BURST_MON__6_ ECU_ADDRESS 0x7fa972 BYTE_ORDER MSB_LAST FORMAT "%4.1" /end MEASUREMENT
/begin MEASUREMENT v_inj_burst_mon_[7] "PECO Monitoring" UWORD _CNV_A_R_LINEAR_____128_CM 1 0. 0. 255. DISPLAY_IDENTIFIER V_INJ_BURST_MON__7_ ECU_ADDRESS 0x7fa974 BYTE_ORDER MSB_LAST FORMAT "%4.1" /end MEASUREMENT
/begin MEASUREMENT v_inj_burst_mon_[8] "PECO Monitoring" UWORD _CNV_A_R_LINEAR_____128_CM 1 0. 0. 255. DISPLAY_IDENTIFIER V_INJ_BURST_MON__8_ ECU_ADDRESS 0x7fa976 BYTE_ORDER MSB_LAST FORMAT "%4.1" /end MEASUREMENT
/begin MEASUREMENT v_inj_burst_mon_[9] "PECO Monitoring" UWORD _CNV_A_R_LINEAR_____128_CM 1 0. 0. 255. DISPLAY_IDENTIFIER V_INJ_BURST_MON__9_ ECU_ADDRESS 0x7fa978 BYTE_ORDER MSB_LAST FORMAT "%4.1" /end MEASUREMENT
/begin MEASUREMENT v_inj_burst_mon_[10] "PECO Monitoring" UWORD _CNV_A_R_LINEAR_____128_CM 1 0. 0. 255. DISPLAY_IDENTIFIER V_INJ_BURST_MON__10_ ECU_ADDRESS 0x7fa97a BYTE_ORDER MSB_LAST FORMAT "%4.1" /end MEASUREMENT
/begin MEASUREMENT v_inj_burst_mon_[11] "PECO Monitoring" UWORD _CNV_A_R_LINEAR_____128_CM 1 0. 0. 255. DISPLAY_IDENTIFIER V_INJ_BURST_MON__11_ ECU_ADDRESS 0x7fa97c BYTE_ORDER MSB_LAST FORMAT "%4.1" /end MEASUREMENT
/begin MEASUREMENT v_inj_burst_mon_[12] "PECO Monitoring" UWORD _CNV_A_R_LINEAR_____128_CM 1 0. 0. 255. DISPLAY_IDENTIFIER V_INJ_BURST_MON__12_ ECU_ADDRESS 0x7fa97e BYTE_ORDER MSB_LAST FORMAT "%4.1" /end MEASUREMENT
/begin MEASUREMENT v_inj_burst_mon_[13] "PECO Monitoring" UWORD _CNV_A_R_LINEAR_____128_CM 1 0. 0. 255. DISPLAY_IDENTIFIER V_INJ_BURST_MON__13_ ECU_ADDRESS 0x7fa980 BYTE_ORDER MSB_LAST FORMAT "%4.1" /end MEASUREMENT
/begin MEASUREMENT v_inj_burst_mon_[14] "PECO Monitoring" UWORD _CNV_A_R_LINEAR_____128_CM 1 0. 0. 255. DISPLAY_IDENTIFIER V_INJ_BURST_MON__14_ ECU_ADDRESS 0x7fa982 BYTE_ORDER MSB_LAST FORMAT "%4.1" /end MEASUREMENT
/begin MEASUREMENT v_inj_burst_mon_[15] "PECO Monitoring" UWORD _CNV_A_R_LINEAR_____128_CM 1 0. 0. 255. DISPLAY_IDENTIFIER V_INJ_BURST_MON__15_ ECU_ADDRESS 0x7fa984 BYTE_ORDER MSB_LAST FORMAT "%4.1" /end MEASUREMENT
/begin MEASUREMENT v_inj_burst_mon_[16] "PECO Monitoring" UWORD _CNV_A_R_LINEAR_____128_CM 1 0. 0. 255. DISPLAY_IDENTIFIER V_INJ_BURST_MON__16_ ECU_ADDRESS 0x7fa986 BYTE_ORDER MSB_LAST FORMAT "%4.1" /end MEASUREMENT
/begin MEASUREMENT v_inj_burst_mon_[17] "PECO Monitoring" UWORD _CNV_A_R_LINEAR_____128_CM 1 0. 0. 255. DISPLAY_IDENTIFIER V_INJ_BURST_MON__17_ ECU_ADDRESS 0x7fa988 BYTE_ORDER MSB_LAST FORMAT "%4.1" /end MEASUREMENT
/begin MEASUREMENT v_inj_burst_mon_[18] "PECO Monitoring" UWORD _CNV_A_R_LINEAR_____128_CM 1 0. 0. 255. DISPLAY_IDENTIFIER V_INJ_BURST_MON__18_ ECU_ADDRESS 0x7fa98a BYTE_ORDER MSB_LAST FORMAT "%4.1" /end MEASUREMENT
/begin MEASUREMENT v_inj_burst_mon_[19] "PECO Monitoring" UWORD _CNV_A_R_LINEAR_____128_CM 1 0. 0. 255. DISPLAY_IDENTIFIER V_INJ_BURST_MON__19_ ECU_ADDRESS 0x7fa98c BYTE_ORDER MSB_LAST FORMAT "%4.1" /end MEASUREMENT
/begin MEASUREMENT v_inj_burst_mon_[20] "PECO Monitoring" UWORD _CNV_A_R_LINEAR_____128_CM 1 0. 0. 255. DISPLAY_IDENTIFIER V_INJ_BURST_MON__20_ ECU_ADDRESS 0x7fa98e BYTE_ORDER MSB_LAST FORMAT "%4.1" /end MEASUREMENT
/begin MEASUREMENT v_inj_burst_mon_[21] "PECO Monitoring" UWORD _CNV_A_R_LINEAR_____128_CM 1 0. 0. 255. DISPLAY_IDENTIFIER V_INJ_BURST_MON__21_ ECU_ADDRESS 0x7fa990 BYTE_ORDER MSB_LAST FORMAT "%4.1" /end MEASUREMENT
/begin MEASUREMENT v_inj_burst_mon_[22] "PECO Monitoring" UWORD _CNV_A_R_LINEAR_____128_CM 1 0. 0. 255. DISPLAY_IDENTIFIER V_INJ_BURST_MON__22_ ECU_ADDRESS 0x7fa992 BYTE_ORDER MSB_LAST FORMAT "%4.1" /end MEASUREMENT
/begin MEASUREMENT v_inj_burst_mon_[23] "PECO Monitoring" UWORD _CNV_A_R_LINEAR_____128_CM 1 0. 0. 255. DISPLAY_IDENTIFIER V_INJ_BURST_MON__23_ ECU_ADDRESS 0x7fa994 BYTE_ORDER MSB_LAST FORMAT "%4.1" /end MEASUREMENT
/begin MEASUREMENT v_inj_burst_mon_[24] "PECO Monitoring" UWORD _CNV_A_R_LINEAR_____128_CM 1 0. 0. 255. DISPLAY_IDENTIFIER V_INJ_BURST_MON__24_ ECU_ADDRESS 0x7fa996 BYTE_ORDER MSB_LAST FORMAT "%4.1" /end MEASUREMENT
/begin MEASUREMENT v_inj_burst_mon_[25] "PECO Monitoring" UWORD _CNV_A_R_LINEAR_____128_CM 1 0. 0. 255. DISPLAY_IDENTIFIER V_INJ_BURST_MON__25_ ECU_ADDRESS 0x7fa998 BYTE_ORDER MSB_LAST FORMAT "%4.1" /end MEASUREMENT
/begin MEASUREMENT v_inj_burst_mon_[26] "PECO Monitoring" UWORD _CNV_A_R_LINEAR_____128_CM 1 0. 0. 255. DISPLAY_IDENTIFIER V_INJ_BURST_MON__26_ ECU_ADDRESS 0x7fa99a BYTE_ORDER MSB_LAST FORMAT "%4.1" /end MEASUREMENT
/begin MEASUREMENT v_inj_burst_mon_[27] "PECO Monitoring" UWORD _CNV_A_R_LINEAR_____128_CM 1 0. 0. 255. DISPLAY_IDENTIFIER V_INJ_BURST_MON__27_ ECU_ADDRESS 0x7fa99c BYTE_ORDER MSB_LAST FORMAT "%4.1" /end MEASUREMENT
/begin MEASUREMENT v_inj_burst_mon_[28] "PECO Monitoring" UWORD _CNV_A_R_LINEAR_____128_CM 1 0. 0. 255. DISPLAY_IDENTIFIER V_INJ_BURST_MON__28_ ECU_ADDRESS 0x7fa99e BYTE_ORDER MSB_LAST FORMAT "%4.1" /end MEASUREMENT
/begin MEASUREMENT v_inj_burst_mon_[29] "PECO Monitoring" UWORD _CNV_A_R_LINEAR_____128_CM 1 0. 0. 255. DISPLAY_IDENTIFIER V_INJ_BURST_MON__29_ ECU_ADDRESS 0x7fa9a0 BYTE_ORDER MSB_LAST FORMAT "%4.1" /end MEASUREMENT
/begin MEASUREMENT v_inj_burst_mon_[30] "PECO Monitoring" UWORD _CNV_A_R_LINEAR_____128_CM 1 0. 0. 255. DISPLAY_IDENTIFIER V_INJ_BURST_MON__30_ ECU_ADDRESS 0x7fa9a2 BYTE_ORDER MSB_LAST FORMAT "%4.1" /end MEASUREMENT
/begin MEASUREMENT v_inj_burst_mon_[31] "PECO Monitoring" UWORD _CNV_A_R_LINEAR_____128_CM 1 0. 0. 255. DISPLAY_IDENTIFIER V_INJ_BURST_MON__31_ ECU_ADDRESS 0x7fa9a4 BYTE_ORDER MSB_LAST FORMAT "%4.1" /end MEASUREMENT
/begin MEASUREMENT v_inj_burst_mon_[32] "PECO Monitoring" UWORD _CNV_A_R_LINEAR_____128_CM 1 0. 0. 255. DISPLAY_IDENTIFIER V_INJ_BURST_MON__32_ ECU_ADDRESS 0x7fa9a6 BYTE_ORDER MSB_LAST FORMAT "%4.1" /end MEASUREMENT
/begin MEASUREMENT v_inj_burst_mon_[33] "PECO Monitoring" UWORD _CNV_A_R_LINEAR_____128_CM 1 0. 0. 255. DISPLAY_IDENTIFIER V_INJ_BURST_MON__33_ ECU_ADDRESS 0x7fa9a8 BYTE_ORDER MSB_LAST FORMAT "%4.1" /end MEASUREMENT
/begin MEASUREMENT v_inj_burst_mon_[34] "PECO Monitoring" UWORD _CNV_A_R_LINEAR_____128_CM 1 0. 0. 255. DISPLAY_IDENTIFIER V_INJ_BURST_MON__34_ ECU_ADDRESS 0x7fa9aa BYTE_ORDER MSB_LAST FORMAT "%4.1" /end MEASUREMENT
/begin MEASUREMENT v_inj_burst_mon_[35] "PECO Monitoring" UWORD _CNV_A_R_LINEAR_____128_CM 1 0. 0. 255. DISPLAY_IDENTIFIER V_INJ_BURST_MON__35_ ECU_ADDRESS 0x7fa9ac BYTE_ORDER MSB_LAST FORMAT "%4.1" /end MEASUREMENT
/begin MEASUREMENT v_inj_burst_mon_[36] "PECO Monitoring" UWORD _CNV_A_R_LINEAR_____128_CM 1 0. 0. 255. DISPLAY_IDENTIFIER V_INJ_BURST_MON__36_ ECU_ADDRESS 0x7fa9ae BYTE_ORDER MSB_LAST FORMAT "%4.1" /end MEASUREMENT
/begin MEASUREMENT v_inj_burst_mon_[37] "PECO Monitoring" UWORD _CNV_A_R_LINEAR_____128_CM 1 0. 0. 255. DISPLAY_IDENTIFIER V_INJ_BURST_MON__37_ ECU_ADDRESS 0x7fa9b0 BYTE_ORDER MSB_LAST FORMAT "%4.1" /end MEASUREMENT
/begin MEASUREMENT v_inj_burst_mon_[38] "PECO Monitoring" UWORD _CNV_A_R_LINEAR_____128_CM 1 0. 0. 255. DISPLAY_IDENTIFIER V_INJ_BURST_MON__38_ ECU_ADDRESS 0x7fa9b2 BYTE_ORDER MSB_LAST FORMAT "%4.1" /end MEASUREMENT
/begin MEASUREMENT v_inj_burst_mon_[39] "PECO Monitoring" UWORD _CNV_A_R_LINEAR_____128_CM 1 0. 0. 255. DISPLAY_IDENTIFIER V_INJ_BURST_MON__39_ ECU_ADDRESS 0x7fa9b4 BYTE_ORDER MSB_LAST FORMAT "%4.1" /end MEASUREMENT
/begin MEASUREMENT v_inj_burst_mon_[40] "PECO Monitoring" UWORD _CNV_A_R_LINEAR_____128_CM 1 0. 0. 255. DISPLAY_IDENTIFIER V_INJ_BURST_MON__40_ ECU_ADDRESS 0x7fa9b6 BYTE_ORDER MSB_LAST FORMAT "%4.1" /end MEASUREMENT
/begin MEASUREMENT v_inj_burst_mon_[41] "PECO Monitoring" UWORD _CNV_A_R_LINEAR_____128_CM 1 0. 0. 255. DISPLAY_IDENTIFIER V_INJ_BURST_MON__41_ ECU_ADDRESS 0x7fa9b8 BYTE_ORDER MSB_LAST FORMAT "%4.1" /end MEASUREMENT
/begin MEASUREMENT v_inj_burst_mon_[42] "PECO Monitoring" UWORD _CNV_A_R_LINEAR_____128_CM 1 0. 0. 255. DISPLAY_IDENTIFIER V_INJ_BURST_MON__42_ ECU_ADDRESS 0x7fa9ba BYTE_ORDER MSB_LAST FORMAT "%4.1" /end MEASUREMENT
/begin MEASUREMENT v_inj_burst_mon_[43] "PECO Monitoring" UWORD _CNV_A_R_LINEAR_____128_CM 1 0. 0. 255. DISPLAY_IDENTIFIER V_INJ_BURST_MON__43_ ECU_ADDRESS 0x7fa9bc BYTE_ORDER MSB_LAST FORMAT "%4.1" /end MEASUREMENT
/begin MEASUREMENT v_inj_burst_mon_[44] "PECO Monitoring" UWORD _CNV_A_R_LINEAR_____128_CM 1 0. 0. 255. DISPLAY_IDENTIFIER V_INJ_BURST_MON__44_ ECU_ADDRESS 0x7fa9be BYTE_ORDER MSB_LAST FORMAT "%4.1" /end MEASUREMENT
/begin MEASUREMENT v_inj_burst_mon_[45] "PECO Monitoring" UWORD _CNV_A_R_LINEAR_____128_CM 1 0. 0. 255. DISPLAY_IDENTIFIER V_INJ_BURST_MON__45_ ECU_ADDRESS 0x7fa9c0 BYTE_ORDER MSB_LAST FORMAT "%4.1" /end MEASUREMENT
/begin MEASUREMENT v_inj_burst_mon_[46] "PECO Monitoring" UWORD _CNV_A_R_LINEAR_____128_CM 1 0. 0. 255. DISPLAY_IDENTIFIER V_INJ_BURST_MON__46_ ECU_ADDRESS 0x7fa9c2 BYTE_ORDER MSB_LAST FORMAT "%4.1" /end MEASUREMENT
/begin MEASUREMENT v_inj_burst_mon_[47] "PECO Monitoring" UWORD _CNV_A_R_LINEAR_____128_CM 1 0. 0. 255. DISPLAY_IDENTIFIER V_INJ_BURST_MON__47_ ECU_ADDRESS 0x7fa9c4 BYTE_ORDER MSB_LAST FORMAT "%4.1" /end MEASUREMENT
/begin MEASUREMENT v_inj_burst_mon_[48] "PECO Monitoring" UWORD _CNV_A_R_LINEAR_____128_CM 1 0. 0. 255. DISPLAY_IDENTIFIER V_INJ_BURST_MON__48_ ECU_ADDRESS 0x7fa9c6 BYTE_ORDER MSB_LAST FORMAT "%4.1" /end MEASUREMENT
/begin MEASUREMENT v_inj_burst_mon_[49] "PECO Monitoring" UWORD _CNV_A_R_LINEAR_____128_CM 1 0. 0. 255. DISPLAY_IDENTIFIER V_INJ_BURST_MON__49_ ECU_ADDRESS 0x7fa9c8 BYTE_ORDER MSB_LAST FORMAT "%4.1" /end MEASUREMENT
/begin MEASUREMENT v_inj_burst_mon_[50] "PECO Monitoring" UWORD _CNV_A_R_LINEAR_____128_CM 1 0. 0. 255. DISPLAY_IDENTIFIER V_INJ_BURST_MON__50_ ECU_ADDRESS 0x7fa9ca BYTE_ORDER MSB_LAST FORMAT "%4.1" /end MEASUREMENT
/begin MEASUREMENT v_inj_burst_mon_[51] "PECO Monitoring" UWORD _CNV_A_R_LINEAR_____128_CM 1 0. 0. 255. DISPLAY_IDENTIFIER V_INJ_BURST_MON__51_ ECU_ADDRESS 0x7fa9cc BYTE_ORDER MSB_LAST FORMAT "%4.1" /end MEASUREMENT
/begin MEASUREMENT v_inj_burst_mon_[52] "PECO Monitoring" UWORD _CNV_A_R_LINEAR_____128_CM 1 0. 0. 255. DISPLAY_IDENTIFIER V_INJ_BURST_MON__52_ ECU_ADDRESS 0x7fa9ce BYTE_ORDER MSB_LAST FORMAT "%4.1" /end MEASUREMENT
/begin MEASUREMENT v_inj_burst_mon_[53] "PECO Monitoring" UWORD _CNV_A_R_LINEAR_____128_CM 1 0. 0. 255. DISPLAY_IDENTIFIER V_INJ_BURST_MON__53_ ECU_ADDRESS 0x7fa9d0 BYTE_ORDER MSB_LAST FORMAT "%4.1" /end MEASUREMENT
/begin MEASUREMENT v_inj_burst_mon_[54] "PECO Monitoring" UWORD _CNV_A_R_LINEAR_____128_CM 1 0. 0. 255. DISPLAY_IDENTIFIER V_INJ_BURST_MON__54_ ECU_ADDRESS 0x7fa9d2 BYTE_ORDER MSB_LAST FORMAT "%4.1" /end MEASUREMENT
/begin MEASUREMENT v_inj_burst_mon_[55] "PECO Monitoring" UWORD _CNV_A_R_LINEAR_____128_CM 1 0. 0. 255. DISPLAY_IDENTIFIER V_INJ_BURST_MON__55_ ECU_ADDRESS 0x7fa9d4 BYTE_ORDER MSB_LAST FORMAT "%4.1" /end MEASUREMENT
/begin MEASUREMENT v_inj_burst_mon_[56] "PECO Monitoring" UWORD _CNV_A_R_LINEAR_____128_CM 1 0. 0. 255. DISPLAY_IDENTIFIER V_INJ_BURST_MON__56_ ECU_ADDRESS 0x7fa9d6 BYTE_ORDER MSB_LAST FORMAT "%4.1" /end MEASUREMENT
/begin MEASUREMENT v_inj_burst_mon_[57] "PECO Monitoring" UWORD _CNV_A_R_LINEAR_____128_CM 1 0. 0. 255. DISPLAY_IDENTIFIER V_INJ_BURST_MON__57_ ECU_ADDRESS 0x7fa9d8 BYTE_ORDER MSB_LAST FORMAT "%4.1" /end MEASUREMENT
/begin MEASUREMENT v_inj_burst_mon_[58] "PECO Monitoring" UWORD _CNV_A_R_LINEAR_____128_CM 1 0. 0. 255. DISPLAY_IDENTIFIER V_INJ_BURST_MON__58_ ECU_ADDRESS 0x7fa9da BYTE_ORDER MSB_LAST FORMAT "%4.1" /end MEASUREMENT
/begin MEASUREMENT v_inj_burst_mon_[59] "PECO Monitoring" UWORD _CNV_A_R_LINEAR_____128_CM 1 0. 0. 255. DISPLAY_IDENTIFIER V_INJ_BURST_MON__59_ ECU_ADDRESS 0x7fa9dc BYTE_ORDER MSB_LAST FORMAT "%4.1" /end MEASUREMENT
/begin MEASUREMENT v_inj_burst_mon_[60] "PECO Monitoring" UWORD _CNV_A_R_LINEAR_____128_CM 1 0. 0. 255. DISPLAY_IDENTIFIER V_INJ_BURST_MON__60_ ECU_ADDRESS 0x7fa9de BYTE_ORDER MSB_LAST FORMAT "%4.1" /end MEASUREMENT
/begin MEASUREMENT v_inj_burst_mon_[61] "PECO Monitoring" UWORD _CNV_A_R_LINEAR_____128_CM 1 0. 0. 255. DISPLAY_IDENTIFIER V_INJ_BURST_MON__61_ ECU_ADDRESS 0x7fa9e0 BYTE_ORDER MSB_LAST FORMAT "%4.1" /end MEASUREMENT
/begin MEASUREMENT v_inj_burst_mon_[62] "PECO Monitoring" UWORD _CNV_A_R_LINEAR_____128_CM 1 0. 0. 255. DISPLAY_IDENTIFIER V_INJ_BURST_MON__62_ ECU_ADDRESS 0x7fa9e2 BYTE_ORDER MSB_LAST FORMAT "%4.1" /end MEASUREMENT
/begin MEASUREMENT v_inj_burst_mon_[63] "PECO Monitoring" UWORD _CNV_A_R_LINEAR_____128_CM 1 0. 0. 255. DISPLAY_IDENTIFIER V_INJ_BURST_MON__63_ ECU_ADDRESS 0x7fa9e4 BYTE_ORDER MSB_LAST FORMAT "%4.1" /end MEASUREMENT
/begin MEASUREMENT v_inj_burst_mon_[64] "PECO Monitoring" UWORD _CNV_A_R_LINEAR_____128_CM 1 0. 0. 255. DISPLAY_IDENTIFIER V_INJ_BURST_MON__64_ ECU_ADDRESS 0x7fa9e6 BYTE_ORDER MSB_LAST FORMAT "%4.1" /end MEASUREMENT
/begin MEASUREMENT v_inj_burst_mon_[65] "PECO Monitoring" UWORD _CNV_A_R_LINEAR_____128_CM 1 0. 0. 255. DISPLAY_IDENTIFIER V_INJ_BURST_MON__65_ ECU_ADDRESS 0x7fa9e8 BYTE_ORDER MSB_LAST FORMAT "%4.1" /end MEASUREMENT
/begin MEASUREMENT v_inj_burst_mon_[66] "PECO Monitoring" UWORD _CNV_A_R_LINEAR_____128_CM 1 0. 0. 255. DISPLAY_IDENTIFIER V_INJ_BURST_MON__66_ ECU_ADDRESS 0x7fa9ea BYTE_ORDER MSB_LAST FORMAT "%4.1" /end MEASUREMENT
/begin MEASUREMENT v_inj_burst_mon_[67] "PECO Monitoring" UWORD _CNV_A_R_LINEAR_____128_CM 1 0. 0. 255. DISPLAY_IDENTIFIER V_INJ_BURST_MON__67_ ECU_ADDRESS 0x7fa9ec BYTE_ORDER MSB_LAST FORMAT "%4.1" /end MEASUREMENT
/begin MEASUREMENT v_inj_burst_mon_[68] "PECO Monitoring" UWORD _CNV_A_R_LINEAR_____128_CM 1 0. 0. 255. DISPLAY_IDENTIFIER V_INJ_BURST_MON__68_ ECU_ADDRESS 0x7fa9ee BYTE_ORDER MSB_LAST FORMAT "%4.1" /end MEASUREMENT
/begin MEASUREMENT v_inj_burst_mon_[69] "PECO Monitoring" UWORD _CNV_A_R_LINEAR_____128_CM 1 0. 0. 255. DISPLAY_IDENTIFIER V_INJ_BURST_MON__69_ ECU_ADDRESS 0x7fa9f0 BYTE_ORDER MSB_LAST FORMAT "%4.1" /end MEASUREMENT
/begin MEASUREMENT v_inj_burst_mon_[70] "PECO Monitoring" UWORD _CNV_A_R_LINEAR_____128_CM 1 0. 0. 255. DISPLAY_IDENTIFIER V_INJ_BURST_MON__70_ ECU_ADDRESS 0x7fa9f2 BYTE_ORDER MSB_LAST FORMAT "%4.1" /end MEASUREMENT
/begin MEASUREMENT v_inj_burst_mon_[71] "PECO Monitoring" UWORD _CNV_A_R_LINEAR_____128_CM 1 0. 0. 255. DISPLAY_IDENTIFIER V_INJ_BURST_MON__71_ ECU_ADDRESS 0x7fa9f4 BYTE_ORDER MSB_LAST FORMAT "%4.1" /end MEASUREMENT
/begin MEASUREMENT v_inj_burst_mon_[72] "PECO Monitoring" UWORD _CNV_A_R_LINEAR_____128_CM 1 0. 0. 255. DISPLAY_IDENTIFIER V_INJ_BURST_MON__72_ ECU_ADDRESS 0x7fa9f6 BYTE_ORDER MSB_LAST FORMAT "%4.1" /end MEASUREMENT
/begin MEASUREMENT v_inj_burst_mon_[73] "PECO Monitoring" UWORD _CNV_A_R_LINEAR_____128_CM 1 0. 0. 255. DISPLAY_IDENTIFIER V_INJ_BURST_MON__73_ ECU_ADDRESS 0x7fa9f8 BYTE_ORDER MSB_LAST FORMAT "%4.1" /end MEASUREMENT
/begin MEASUREMENT v_inj_burst_mon_[74] "PECO Monitoring" UWORD _CNV_A_R_LINEAR_____128_CM 1 0. 0. 255. DISPLAY_IDENTIFIER V_INJ_BURST_MON__74_ ECU_ADDRESS 0x7fa9fa BYTE_ORDER MSB_LAST FORMAT "%4.1" /end MEASUREMENT
/begin MEASUREMENT v_inj_burst_mon_[75] "PECO Monitoring" UWORD _CNV_A_R_LINEAR_____128_CM 1 0. 0. 255. DISPLAY_IDENTIFIER V_INJ_BURST_MON__75_ ECU_ADDRESS 0x7fa9fc BYTE_ORDER MSB_LAST FORMAT "%4.1" /end MEASUREMENT
/begin MEASUREMENT v_inj_burst_mon_[76] "PECO Monitoring" UWORD _CNV_A_R_LINEAR_____128_CM 1 0. 0. 255. DISPLAY_IDENTIFIER V_INJ_BURST_MON__76_ ECU_ADDRESS 0x7fa9fe BYTE_ORDER MSB_LAST FORMAT "%4.1" /end MEASUREMENT
/begin MEASUREMENT v_inj_burst_mon_[77] "PECO Monitoring" UWORD _CNV_A_R_LINEAR_____128_CM 1 0. 0. 255. DISPLAY_IDENTIFIER V_INJ_BURST_MON__77_ ECU_ADDRESS 0x7faa00 BYTE_ORDER MSB_LAST FORMAT "%4.1" /end MEASUREMENT
/begin MEASUREMENT v_inj_burst_mon_[78] "PECO Monitoring" UWORD _CNV_A_R_LINEAR_____128_CM 1 0. 0. 255. DISPLAY_IDENTIFIER V_INJ_BURST_MON__78_ ECU_ADDRESS 0x7faa02 BYTE_ORDER MSB_LAST FORMAT "%4.1" /end MEASUREMENT
/begin MEASUREMENT v_inj_burst_mon_[79] "PECO Monitoring" UWORD _CNV_A_R_LINEAR_____128_CM 1 0. 0. 255. DISPLAY_IDENTIFIER V_INJ_BURST_MON__79_ ECU_ADDRESS 0x7faa04 BYTE_ORDER MSB_LAST FORMAT "%4.1" /end MEASUREMENT
/begin MEASUREMENT v_inj_burst_mon_[80] "PECO Monitoring" UWORD _CNV_A_R_LINEAR_____128_CM 1 0. 0. 255. DISPLAY_IDENTIFIER V_INJ_BURST_MON__80_ ECU_ADDRESS 0x7faa06 BYTE_ORDER MSB_LAST FORMAT "%4.1" /end MEASUREMENT
/begin MEASUREMENT v_inj_burst_mon_[81] "PECO Monitoring" UWORD _CNV_A_R_LINEAR_____128_CM 1 0. 0. 255. DISPLAY_IDENTIFIER V_INJ_BURST_MON__81_ ECU_ADDRESS 0x7faa08 BYTE_ORDER MSB_LAST FORMAT "%4.1" /end MEASUREMENT
/begin MEASUREMENT v_inj_burst_mon_[82] "PECO Monitoring" UWORD _CNV_A_R_LINEAR_____128_CM 1 0. 0. 255. DISPLAY_IDENTIFIER V_INJ_BURST_MON__82_ ECU_ADDRESS 0x7faa0a BYTE_ORDER MSB_LAST FORMAT "%4.1" /end MEASUREMENT
/begin MEASUREMENT v_inj_burst_mon_[83] "PECO Monitoring" UWORD _CNV_A_R_LINEAR_____128_CM 1 0. 0. 255. DISPLAY_IDENTIFIER V_INJ_BURST_MON__83_ ECU_ADDRESS 0x7faa0c BYTE_ORDER MSB_LAST FORMAT "%4.1" /end MEASUREMENT
/begin MEASUREMENT v_inj_burst_mon_[84] "PECO Monitoring" UWORD _CNV_A_R_LINEAR_____128_CM 1 0. 0. 255. DISPLAY_IDENTIFIER V_INJ_BURST_MON__84_ ECU_ADDRESS 0x7faa0e BYTE_ORDER MSB_LAST FORMAT "%4.1" /end MEASUREMENT
/begin MEASUREMENT v_inj_burst_mon_[85] "PECO Monitoring" UWORD _CNV_A_R_LINEAR_____128_CM 1 0. 0. 255. DISPLAY_IDENTIFIER V_INJ_BURST_MON__85_ ECU_ADDRESS 0x7faa10 BYTE_ORDER MSB_LAST FORMAT "%4.1" /end MEASUREMENT
/begin MEASUREMENT v_inj_burst_mon_[86] "PECO Monitoring" UWORD _CNV_A_R_LINEAR_____128_CM 1 0. 0. 255. DISPLAY_IDENTIFIER V_INJ_BURST_MON__86_ ECU_ADDRESS 0x7faa12 BYTE_ORDER MSB_LAST FORMAT "%4.1" /end MEASUREMENT
/begin MEASUREMENT v_inj_burst_mon_[87] "PECO Monitoring" UWORD _CNV_A_R_LINEAR_____128_CM 1 0. 0. 255. DISPLAY_IDENTIFIER V_INJ_BURST_MON__87_ ECU_ADDRESS 0x7faa14 BYTE_ORDER MSB_LAST FORMAT "%4.1" /end MEASUREMENT
/begin MEASUREMENT v_inj_burst_mon_[88] "PECO Monitoring" UWORD _CNV_A_R_LINEAR_____128_CM 1 0. 0. 255. DISPLAY_IDENTIFIER V_INJ_BURST_MON__88_ ECU_ADDRESS 0x7faa16 BYTE_ORDER MSB_LAST FORMAT "%4.1" /end MEASUREMENT
/begin MEASUREMENT v_inj_burst_mon_[89] "PECO Monitoring" UWORD _CNV_A_R_LINEAR_____128_CM 1 0. 0. 255. DISPLAY_IDENTIFIER V_INJ_BURST_MON__89_ ECU_ADDRESS 0x7faa18 BYTE_ORDER MSB_LAST FORMAT "%4.1" /end MEASUREMENT
/begin MEASUREMENT v_inj_burst_mon_[90] "PECO Monitoring" UWORD _CNV_A_R_LINEAR_____128_CM 1 0. 0. 255. DISPLAY_IDENTIFIER V_INJ_BURST_MON__90_ ECU_ADDRESS 0x7faa1a BYTE_ORDER MSB_LAST FORMAT "%4.1" /end MEASUREMENT
/begin MEASUREMENT v_inj_burst_mon_[91] "PECO Monitoring" UWORD _CNV_A_R_LINEAR_____128_CM 1 0. 0. 255. DISPLAY_IDENTIFIER V_INJ_BURST_MON__91_ ECU_ADDRESS 0x7faa1c BYTE_ORDER MSB_LAST FORMAT "%4.1" /end MEASUREMENT
/begin MEASUREMENT v_inj_burst_mon_[92] "PECO Monitoring" UWORD _CNV_A_R_LINEAR_____128_CM 1 0. 0. 255. DISPLAY_IDENTIFIER V_INJ_BURST_MON__92_ ECU_ADDRESS 0x7faa1e BYTE_ORDER MSB_LAST FORMAT "%4.1" /end MEASUREMENT
/begin MEASUREMENT v_inj_burst_mon_[93] "PECO Monitoring" UWORD _CNV_A_R_LINEAR_____128_CM 1 0. 0. 255. DISPLAY_IDENTIFIER V_INJ_BURST_MON__93_ ECU_ADDRESS 0x7faa20 BYTE_ORDER MSB_LAST FORMAT "%4.1" /end MEASUREMENT
/begin MEASUREMENT v_inj_burst_mon_[94] "PECO Monitoring" UWORD _CNV_A_R_LINEAR_____128_CM 1 0. 0. 255. DISPLAY_IDENTIFIER V_INJ_BURST_MON__94_ ECU_ADDRESS 0x7faa22 BYTE_ORDER MSB_LAST FORMAT "%4.1" /end MEASUREMENT
/begin MEASUREMENT v_inj_burst_mon_[95] "PECO Monitoring" UWORD _CNV_A_R_LINEAR_____128_CM 1 0. 0. 255. DISPLAY_IDENTIFIER V_INJ_BURST_MON__95_ ECU_ADDRESS 0x7faa24 BYTE_ORDER MSB_LAST FORMAT "%4.1" /end MEASUREMENT
/begin MEASUREMENT v_inj_burst_mon_[96] "PECO Monitoring" UWORD _CNV_A_R_LINEAR_____128_CM 1 0. 0. 255. DISPLAY_IDENTIFIER V_INJ_BURST_MON__96_ ECU_ADDRESS 0x7faa26 BYTE_ORDER MSB_LAST FORMAT "%4.1" /end MEASUREMENT
/begin MEASUREMENT v_inj_burst_mon_[97] "PECO Monitoring" UWORD _CNV_A_R_LINEAR_____128_CM 1 0. 0. 255. DISPLAY_IDENTIFIER V_INJ_BURST_MON__97_ ECU_ADDRESS 0x7faa28 BYTE_ORDER MSB_LAST FORMAT "%4.1" /end MEASUREMENT
/begin MEASUREMENT v_inj_burst_mon_[98] "PECO Monitoring" UWORD _CNV_A_R_LINEAR_____128_CM 1 0. 0. 255. DISPLAY_IDENTIFIER V_INJ_BURST_MON__98_ ECU_ADDRESS 0x7faa2a BYTE_ORDER MSB_LAST FORMAT "%4.1" /end MEASUREMENT
/begin MEASUREMENT v_inj_burst_mon_[99] "PECO Monitoring" UWORD _CNV_A_R_LINEAR_____128_CM 1 0. 0. 255. DISPLAY_IDENTIFIER V_INJ_BURST_MON__99_ ECU_ADDRESS 0x7faa2c BYTE_ORDER MSB_LAST FORMAT "%4.1" /end MEASUREMENT
/begin MEASUREMENT lv_num_stk_ast_act "number of strokes after start exceeds limit value" UBYTE _CNV_S_2_RANGE______11_CM 1 0. 0. 1. DISPLAY_IDENTIFIER LV_NUM_STK_AST_ACT ECU_ADDRESS 0x7fb6e6 /end MEASUREMENT
/begin MEASUREMENT t_dcha_test_pls "Discharging time of test pulse" UBYTE _CNV_A_R_LINEAR_____220_CM 1 0. 0. 0.31 DISPLAY_IDENTIFIER T_DCHA_TEST_PLS ECU_ADDRESS 0x7fb6e9 FORMAT "%3.2" /end MEASUREMENT
/begin MEASUREMENT t_cha_test_pls "Charging time of test pulse" UBYTE _CNV_A_R_LINEAR_____220_CM 1 0. 0. 0.31 DISPLAY_IDENTIFIER T_CHA_TEST_PLS ECU_ADDRESS 0x7fb6e8 FORMAT "%3.2" /end MEASUREMENT
/begin MEASUREMENT sf_test_pls_act "indicates active test pulse generation of each injector" UWORD _CNV_A_R_LINEAR_____0_CM 1 0. 0. 65535. DISPLAY_IDENTIFIER SF_TEST_PLS_ACT ECU_ADDRESS 0x7f9e60 BYTE_ORDER MSB_LAST FORMAT "%5.0" /end MEASUREMENT
/begin MEASUREMENT lv_test_pls_act "indicates active test pulse generation" UBYTE _CNV_S_2_RANGE______11_CM 1 0. 0. 1. DISPLAY_IDENTIFIER LV_TEST_PLS_ACT ECU_ADDRESS 0x7fb6e7 /end MEASUREMENT
/begin MEASUREMENT t_soi_burst_mes_dly "burst measurement delay after test pulse SOI (mode 2 and 3)" UWORD _CNV_A_R_LINEAR_____208_CM 1 0. 0. 32.767 DISPLAY_IDENTIFIER T_SOI_BURST_MES_DLY ECU_ADDRESS 0x7f9e62 BYTE_ORDER MSB_LAST FORMAT "%5.3" /end MEASUREMENT
/begin MEASUREMENT t_eoi_burst_mes_dly "burst measurement delay after test pulse EOI (mode 1 and 3)" UWORD _CNV_A_R_LINEAR_____208_CM 1 0. 0. 32.767 DISPLAY_IDENTIFIER T_EOI_BURST_MES_DLY ECU_ADDRESS 0x7f9e64 BYTE_ORDER MSB_LAST FORMAT "%5.3" /end MEASUREMENT
/begin MEASUREMENT seg_nr_test_pls "actual segment number for module PECO_TEPL" UBYTE _CNV_A_R_LINEAR_____0_CM 1 0. 0. 15. DISPLAY_IDENTIFIER SEG_NR_TEST_PLS ECU_ADDRESS 0x7fbaf6 FORMAT "%1.0" /end MEASUREMENT
/begin MEASUREMENT test_pls_act_ctr "working cycle counter (when test pulse is enabled)" UBYTE _CNV_A_R_LINEAR_____0_CM 1 0. 0. 255. DISPLAY_IDENTIFIER TEST_PLS_ACT_CTR ECU_ADDRESS 0x7fbaf7 FORMAT "%3.0" /end MEASUREMENT
/begin MEASUREMENT test_pls_wait_ctr "working cycle counter (when test pulse is disabled)" UBYTE _CNV_A_R_LINEAR_____0_CM 1 0. 0. 255. DISPLAY_IDENTIFIER TEST_PLS_WAIT_CTR ECU_ADDRESS 0x7fbaf8 FORMAT "%3.0" /end MEASUREMENT
/begin MEASUREMENT lv_test_pls_vld "engine and activation conditions for test pulse generation are valid (1), else (0)" UBYTE _CNV_S_2_RANGE______11_CM 1 0. 0. 1. DISPLAY_IDENTIFIER LV_TEST_PLS_VLD ECU_ADDRESS 0x7fbafe /end MEASUREMENT
/begin MEASUREMENT fac_pwm_dcha_[0] "cylinder individual PWM discharge factor" UWORD _CNV_A_R_LINEAR_____63_CM 1 0. 0. 3.99998471 DISPLAY_IDENTIFIER FAC_PWM_DCHA__0_ ECU_ADDRESS 0x7f9eba BYTE_ORDER MSB_LAST FORMAT "%6.5" /end MEASUREMENT
/begin MEASUREMENT fac_pwm_dcha_[1] "cylinder individual PWM discharge factor" UWORD _CNV_A_R_LINEAR_____63_CM 1 0. 0. 3.99998471 DISPLAY_IDENTIFIER FAC_PWM_DCHA__1_ ECU_ADDRESS 0x7f9ebc BYTE_ORDER MSB_LAST FORMAT "%6.5" /end MEASUREMENT
/begin MEASUREMENT fac_pwm_dcha_[2] "cylinder individual PWM discharge factor" UWORD _CNV_A_R_LINEAR_____63_CM 1 0. 0. 3.99998471 DISPLAY_IDENTIFIER FAC_PWM_DCHA__2_ ECU_ADDRESS 0x7f9ebe BYTE_ORDER MSB_LAST FORMAT "%6.5" /end MEASUREMENT
/begin MEASUREMENT fac_pwm_dcha_[3] "cylinder individual PWM discharge factor" UWORD _CNV_A_R_LINEAR_____63_CM 1 0. 0. 3.99998471 DISPLAY_IDENTIFIER FAC_PWM_DCHA__3_ ECU_ADDRESS 0x7f9ec0 BYTE_ORDER MSB_LAST FORMAT "%6.5" /end MEASUREMENT
/begin MEASUREMENT step_nr_cha_frze_prev1_ctl_[0] "cylinder individual number of charge steps for pulse FROM ZERO PREV1" UBYTE _CNV_A_R_LINEAR_____0_CM 1 0. 0. 30. DISPLAY_IDENTIFIER STEP_NR_CHA_FRZE_PREV1_CTL__0_ ECU_ADDRESS 0x7fb6ea FORMAT "%2.0" /end MEASUREMENT
/begin MEASUREMENT step_nr_cha_frze_prev1_ctl_[1] "cylinder individual number of charge steps for pulse FROM ZERO PREV1" UBYTE _CNV_A_R_LINEAR_____0_CM 1 0. 0. 30. DISPLAY_IDENTIFIER STEP_NR_CHA_FRZE_PREV1_CTL__1_ ECU_ADDRESS 0x7fb6eb FORMAT "%2.0" /end MEASUREMENT
/begin MEASUREMENT step_nr_cha_frze_prev1_ctl_[2] "cylinder individual number of charge steps for pulse FROM ZERO PREV1" UBYTE _CNV_A_R_LINEAR_____0_CM 1 0. 0. 30. DISPLAY_IDENTIFIER STEP_NR_CHA_FRZE_PREV1_CTL__2_ ECU_ADDRESS 0x7fb6ec FORMAT "%2.0" /end MEASUREMENT
/begin MEASUREMENT step_nr_cha_frze_prev1_ctl_[3] "cylinder individual number of charge steps for pulse FROM ZERO PREV1" UBYTE _CNV_A_R_LINEAR_____0_CM 1 0. 0. 30. DISPLAY_IDENTIFIER STEP_NR_CHA_FRZE_PREV1_CTL__3_ ECU_ADDRESS 0x7fb6ed FORMAT "%2.0" /end MEASUREMENT
/begin MEASUREMENT step_nr_cha_frze_main1_ctl_[0] "cylinder individual number of charge steps for pulse FROM ZERO MAIN1" UBYTE _CNV_A_R_LINEAR_____0_CM 1 0. 0. 30. DISPLAY_IDENTIFIER STEP_NR_CHA_FRZE_MAIN1_CTL__0_ ECU_ADDRESS 0x7fb6f2 FORMAT "%2.0" /end MEASUREMENT
/begin MEASUREMENT step_nr_cha_frze_main1_ctl_[1] "cylinder individual number of charge steps for pulse FROM ZERO MAIN1" UBYTE _CNV_A_R_LINEAR_____0_CM 1 0. 0. 30. DISPLAY_IDENTIFIER STEP_NR_CHA_FRZE_MAIN1_CTL__1_ ECU_ADDRESS 0x7fb6f3 FORMAT "%2.0" /end MEASUREMENT
/begin MEASUREMENT step_nr_cha_frze_main1_ctl_[2] "cylinder individual number of charge steps for pulse FROM ZERO MAIN1" UBYTE _CNV_A_R_LINEAR_____0_CM 1 0. 0. 30. DISPLAY_IDENTIFIER STEP_NR_CHA_FRZE_MAIN1_CTL__2_ ECU_ADDRESS 0x7fb6f4 FORMAT "%2.0" /end MEASUREMENT
/begin MEASUREMENT step_nr_cha_frze_main1_ctl_[3] "cylinder individual number of charge steps for pulse FROM ZERO MAIN1" UBYTE _CNV_A_R_LINEAR_____0_CM 1 0. 0. 30. DISPLAY_IDENTIFIER STEP_NR_CHA_FRZE_MAIN1_CTL__3_ ECU_ADDRESS 0x7fb6f5 FORMAT "%2.0" /end MEASUREMENT
/begin MEASUREMENT step_nr_cha_frze_post1_ctl_[0] "cylinder individual number of charge steps for pulse FROM ZERO POST1" UBYTE _CNV_A_R_LINEAR_____0_CM 1 0. 0. 30. DISPLAY_IDENTIFIER STEP_NR_CHA_FRZE_POST1_CTL__0_ ECU_ADDRESS 0x7fb6fa FORMAT "%2.0" /end MEASUREMENT
/begin MEASUREMENT step_nr_cha_frze_post1_ctl_[1] "cylinder individual number of charge steps for pulse FROM ZERO POST1" UBYTE _CNV_A_R_LINEAR_____0_CM 1 0. 0. 30. DISPLAY_IDENTIFIER STEP_NR_CHA_FRZE_POST1_CTL__1_ ECU_ADDRESS 0x7fb6fb FORMAT "%2.0" /end MEASUREMENT
/begin MEASUREMENT step_nr_cha_frze_post1_ctl_[2] "cylinder individual number of charge steps for pulse FROM ZERO POST1" UBYTE _CNV_A_R_LINEAR_____0_CM 1 0. 0. 30. DISPLAY_IDENTIFIER STEP_NR_CHA_FRZE_POST1_CTL__2_ ECU_ADDRESS 0x7fb6fc FORMAT "%2.0" /end MEASUREMENT
/begin MEASUREMENT step_nr_cha_frze_post1_ctl_[3] "cylinder individual number of charge steps for pulse FROM ZERO POST1" UBYTE _CNV_A_R_LINEAR_____0_CM 1 0. 0. 30. DISPLAY_IDENTIFIER STEP_NR_CHA_FRZE_POST1_CTL__3_ ECU_ADDRESS 0x7fb6fd FORMAT "%2.0" /end MEASUREMENT
/begin MEASUREMENT t_hld_frze_prev1_ctl_[0] "cylinder individual hold time of pulse FROM ZERO PREV1" UWORD _CNV_A_R_LINEAR_____208_CM 1 0. 0. 32.767 DISPLAY_IDENTIFIER T_HLD_FRZE_PREV1_CTL__0_ ECU_ADDRESS 0x7f9e7e BYTE_ORDER MSB_LAST FORMAT "%5.3" /end MEASUREMENT
/begin MEASUREMENT t_hld_frze_prev1_ctl_[1] "cylinder individual hold time of pulse FROM ZERO PREV1" UWORD _CNV_A_R_LINEAR_____208_CM 1 0. 0. 32.767 DISPLAY_IDENTIFIER T_HLD_FRZE_PREV1_CTL__1_ ECU_ADDRESS 0x7f9e80 BYTE_ORDER MSB_LAST FORMAT "%5.3" /end MEASUREMENT
/begin MEASUREMENT t_hld_frze_prev1_ctl_[2] "cylinder individual hold time of pulse FROM ZERO PREV1" UWORD _CNV_A_R_LINEAR_____208_CM 1 0. 0. 32.767 DISPLAY_IDENTIFIER T_HLD_FRZE_PREV1_CTL__2_ ECU_ADDRESS 0x7f9e82 BYTE_ORDER MSB_LAST FORMAT "%5.3" /end MEASUREMENT
/begin MEASUREMENT t_hld_frze_prev1_ctl_[3] "cylinder individual hold time of pulse FROM ZERO PREV1" UWORD _CNV_A_R_LINEAR_____208_CM 1 0. 0. 32.767 DISPLAY_IDENTIFIER T_HLD_FRZE_PREV1_CTL__3_ ECU_ADDRESS 0x7f9e84 BYTE_ORDER MSB_LAST FORMAT "%5.3" /end MEASUREMENT
/begin MEASUREMENT t_hld_frze_main1_ctl_[0] "cylinder individual hold time of pulse FROM ZERO MAIN1" UWORD _CNV_A_R_LINEAR_____208_CM 1 0. 0. 32.767 DISPLAY_IDENTIFIER T_HLD_FRZE_MAIN1_CTL__0_ ECU_ADDRESS 0x7f9e8e BYTE_ORDER MSB_LAST FORMAT "%5.3" /end MEASUREMENT
/begin MEASUREMENT t_hld_frze_main1_ctl_[1] "cylinder individual hold time of pulse FROM ZERO MAIN1" UWORD _CNV_A_R_LINEAR_____208_CM 1 0. 0. 32.767 DISPLAY_IDENTIFIER T_HLD_FRZE_MAIN1_CTL__1_ ECU_ADDRESS 0x7f9e90 BYTE_ORDER MSB_LAST FORMAT "%5.3" /end MEASUREMENT
/begin MEASUREMENT t_hld_frze_main1_ctl_[2] "cylinder individual hold time of pulse FROM ZERO MAIN1" UWORD _CNV_A_R_LINEAR_____208_CM 1 0. 0. 32.767 DISPLAY_IDENTIFIER T_HLD_FRZE_MAIN1_CTL__2_ ECU_ADDRESS 0x7f9e92 BYTE_ORDER MSB_LAST FORMAT "%5.3" /end MEASUREMENT
/begin MEASUREMENT t_hld_frze_main1_ctl_[3] "cylinder individual hold time of pulse FROM ZERO MAIN1" UWORD _CNV_A_R_LINEAR_____208_CM 1 0. 0. 32.767 DISPLAY_IDENTIFIER T_HLD_FRZE_MAIN1_CTL__3_ ECU_ADDRESS 0x7f9e94 BYTE_ORDER MSB_LAST FORMAT "%5.3" /end MEASUREMENT
/begin MEASUREMENT t_hld_frze_post1_ctl_[0] "cylinder individual hold time of pulse FROM ZERO POST1" UWORD _CNV_A_R_LINEAR_____208_CM 1 0. 0. 32.767 DISPLAY_IDENTIFIER T_HLD_FRZE_POST1_CTL__0_ ECU_ADDRESS 0x7f9e9e BYTE_ORDER MSB_LAST FORMAT "%5.3" /end MEASUREMENT
/begin MEASUREMENT t_hld_frze_post1_ctl_[1] "cylinder individual hold time of pulse FROM ZERO POST1" UWORD _CNV_A_R_LINEAR_____208_CM 1 0. 0. 32.767 DISPLAY_IDENTIFIER T_HLD_FRZE_POST1_CTL__1_ ECU_ADDRESS 0x7f9ea0 BYTE_ORDER MSB_LAST FORMAT "%5.3" /end MEASUREMENT
/begin MEASUREMENT t_hld_frze_post1_ctl_[2] "cylinder individual hold time of pulse FROM ZERO POST1" UWORD _CNV_A_R_LINEAR_____208_CM 1 0. 0. 32.767 DISPLAY_IDENTIFIER T_HLD_FRZE_POST1_CTL__2_ ECU_ADDRESS 0x7f9ea2 BYTE_ORDER MSB_LAST FORMAT "%5.3" /end MEASUREMENT
/begin MEASUREMENT t_hld_frze_post1_ctl_[3] "cylinder individual hold time of pulse FROM ZERO POST1" UWORD _CNV_A_R_LINEAR_____208_CM 1 0. 0. 32.767 DISPLAY_IDENTIFIER T_HLD_FRZE_POST1_CTL__3_ ECU_ADDRESS 0x7f9ea4 BYTE_ORDER MSB_LAST FORMAT "%5.3" /end MEASUREMENT
/begin MEASUREMENT step_nr_dcha_prev1_ctl_[0] "cylinder individual number of discharge steps for pulse PREV1" UBYTE _CNV_A_R_LINEAR_____0_CM 1 0. 0. 30. DISPLAY_IDENTIFIER STEP_NR_DCHA_PREV1_CTL__0_ ECU_ADDRESS 0x7fb6ee FORMAT "%2.0" /end MEASUREMENT
/begin MEASUREMENT step_nr_dcha_prev1_ctl_[1] "cylinder individual number of discharge steps for pulse PREV1" UBYTE _CNV_A_R_LINEAR_____0_CM 1 0. 0. 30. DISPLAY_IDENTIFIER STEP_NR_DCHA_PREV1_CTL__1_ ECU_ADDRESS 0x7fb6ef FORMAT "%2.0" /end MEASUREMENT
/begin MEASUREMENT step_nr_dcha_prev1_ctl_[2] "cylinder individual number of discharge steps for pulse PREV1" UBYTE _CNV_A_R_LINEAR_____0_CM 1 0. 0. 30. DISPLAY_IDENTIFIER STEP_NR_DCHA_PREV1_CTL__2_ ECU_ADDRESS 0x7fb6f0 FORMAT "%2.0" /end MEASUREMENT
/begin MEASUREMENT step_nr_dcha_prev1_ctl_[3] "cylinder individual number of discharge steps for pulse PREV1" UBYTE _CNV_A_R_LINEAR_____0_CM 1 0. 0. 30. DISPLAY_IDENTIFIER STEP_NR_DCHA_PREV1_CTL__3_ ECU_ADDRESS 0x7fb6f1 FORMAT "%2.0" /end MEASUREMENT
/begin MEASUREMENT step_nr_dcha_main1_ctl_[0] "cylinder individual number of discharge steps for pulse MAIN1" UBYTE _CNV_A_R_LINEAR_____0_CM 1 0. 0. 30. DISPLAY_IDENTIFIER STEP_NR_DCHA_MAIN1_CTL__0_ ECU_ADDRESS 0x7fb6f6 FORMAT "%2.0" /end MEASUREMENT
/begin MEASUREMENT step_nr_dcha_main1_ctl_[1] "cylinder individual number of discharge steps for pulse MAIN1" UBYTE _CNV_A_R_LINEAR_____0_CM 1 0. 0. 30. DISPLAY_IDENTIFIER STEP_NR_DCHA_MAIN1_CTL__1_ ECU_ADDRESS 0x7fb6f7 FORMAT "%2.0" /end MEASUREMENT
/begin MEASUREMENT step_nr_dcha_main1_ctl_[2] "cylinder individual number of discharge steps for pulse MAIN1" UBYTE _CNV_A_R_LINEAR_____0_CM 1 0. 0. 30. DISPLAY_IDENTIFIER STEP_NR_DCHA_MAIN1_CTL__2_ ECU_ADDRESS 0x7fb6f8 FORMAT "%2.0" /end MEASUREMENT
/begin MEASUREMENT step_nr_dcha_main1_ctl_[3] "cylinder individual number of discharge steps for pulse MAIN1" UBYTE _CNV_A_R_LINEAR_____0_CM 1 0. 0. 30. DISPLAY_IDENTIFIER STEP_NR_DCHA_MAIN1_CTL__3_ ECU_ADDRESS 0x7fb6f9 FORMAT "%2.0" /end MEASUREMENT
/begin MEASUREMENT step_nr_dcha_post1_ctl_[0] "cylinder individual number of discharge steps for pulse POST1" UBYTE _CNV_A_R_LINEAR_____0_CM 1 0. 0. 30. DISPLAY_IDENTIFIER STEP_NR_DCHA_POST1_CTL__0_ ECU_ADDRESS 0x7fb6fe FORMAT "%2.0" /end MEASUREMENT
/begin MEASUREMENT step_nr_dcha_post1_ctl_[1] "cylinder individual number of discharge steps for pulse POST1" UBYTE _CNV_A_R_LINEAR_____0_CM 1 0. 0. 30. DISPLAY_IDENTIFIER STEP_NR_DCHA_POST1_CTL__1_ ECU_ADDRESS 0x7fb6ff FORMAT "%2.0" /end MEASUREMENT
/begin MEASUREMENT step_nr_dcha_post1_ctl_[2] "cylinder individual number of discharge steps for pulse POST1" UBYTE _CNV_A_R_LINEAR_____0_CM 1 0. 0. 30. DISPLAY_IDENTIFIER STEP_NR_DCHA_POST1_CTL__2_ ECU_ADDRESS 0x7fb700 FORMAT "%2.0" /end MEASUREMENT
/begin MEASUREMENT step_nr_dcha_post1_ctl_[3] "cylinder individual number of discharge steps for pulse POST1" UBYTE _CNV_A_R_LINEAR_____0_CM 1 0. 0. 30. DISPLAY_IDENTIFIER STEP_NR_DCHA_POST1_CTL__3_ ECU_ADDRESS 0x7fb701 FORMAT "%2.0" /end MEASUREMENT
/begin MEASUREMENT t_hld_toze_prev1_ctl_[0] "cylinder individual hold time of pulse TO ZERO PREV1" UWORD _CNV_A_R_LINEAR_____208_CM 1 0. 0. 32.767 DISPLAY_IDENTIFIER T_HLD_TOZE_PREV1_CTL__0_ ECU_ADDRESS 0x7f9e86 BYTE_ORDER MSB_LAST FORMAT "%5.3" /end MEASUREMENT
/begin MEASUREMENT t_hld_toze_prev1_ctl_[1] "cylinder individual hold time of pulse TO ZERO PREV1" UWORD _CNV_A_R_LINEAR_____208_CM 1 0. 0. 32.767 DISPLAY_IDENTIFIER T_HLD_TOZE_PREV1_CTL__1_ ECU_ADDRESS 0x7f9e88 BYTE_ORDER MSB_LAST FORMAT "%5.3" /end MEASUREMENT
/begin MEASUREMENT t_hld_toze_prev1_ctl_[2] "cylinder individual hold time of pulse TO ZERO PREV1" UWORD _CNV_A_R_LINEAR_____208_CM 1 0. 0. 32.767 DISPLAY_IDENTIFIER T_HLD_TOZE_PREV1_CTL__2_ ECU_ADDRESS 0x7f9e8a BYTE_ORDER MSB_LAST FORMAT "%5.3" /end MEASUREMENT
/begin MEASUREMENT t_hld_toze_prev1_ctl_[3] "cylinder individual hold time of pulse TO ZERO PREV1" UWORD _CNV_A_R_LINEAR_____208_CM 1 0. 0. 32.767 DISPLAY_IDENTIFIER T_HLD_TOZE_PREV1_CTL__3_ ECU_ADDRESS 0x7f9e8c BYTE_ORDER MSB_LAST FORMAT "%5.3" /end MEASUREMENT
/begin MEASUREMENT t_hld_toze_main1_ctl_[0] "cylinder individual hold time of pulse TO ZERO MAIN1" UWORD _CNV_A_R_LINEAR_____208_CM 1 0. 0. 32.767 DISPLAY_IDENTIFIER T_HLD_TOZE_MAIN1_CTL__0_ ECU_ADDRESS 0x7f9e96 BYTE_ORDER MSB_LAST FORMAT "%5.3" /end MEASUREMENT
/begin MEASUREMENT t_hld_toze_main1_ctl_[1] "cylinder individual hold time of pulse TO ZERO MAIN1" UWORD _CNV_A_R_LINEAR_____208_CM 1 0. 0. 32.767 DISPLAY_IDENTIFIER T_HLD_TOZE_MAIN1_CTL__1_ ECU_ADDRESS 0x7f9e98 BYTE_ORDER MSB_LAST FORMAT "%5.3" /end MEASUREMENT
/begin MEASUREMENT t_hld_toze_main1_ctl_[2] "cylinder individual hold time of pulse TO ZERO MAIN1" UWORD _CNV_A_R_LINEAR_____208_CM 1 0. 0. 32.767 DISPLAY_IDENTIFIER T_HLD_TOZE_MAIN1_CTL__2_ ECU_ADDRESS 0x7f9e9a BYTE_ORDER MSB_LAST FORMAT "%5.3" /end MEASUREMENT
/begin MEASUREMENT t_hld_toze_main1_ctl_[3] "cylinder individual hold time of pulse TO ZERO MAIN1" UWORD _CNV_A_R_LINEAR_____208_CM 1 0. 0. 32.767 DISPLAY_IDENTIFIER T_HLD_TOZE_MAIN1_CTL__3_ ECU_ADDRESS 0x7f9e9c BYTE_ORDER MSB_LAST FORMAT "%5.3" /end MEASUREMENT
/begin MEASUREMENT t_hld_toze_post1_ctl_[0] "cylinder individual hold time of pulse TO ZERO POST1" UWORD _CNV_A_R_LINEAR_____208_CM 1 0. 0. 32.767 DISPLAY_IDENTIFIER T_HLD_TOZE_POST1_CTL__0_ ECU_ADDRESS 0x7f9ea6 BYTE_ORDER MSB_LAST FORMAT "%5.3" /end MEASUREMENT
/begin MEASUREMENT t_hld_toze_post1_ctl_[1] "cylinder individual hold time of pulse TO ZERO POST1" UWORD _CNV_A_R_LINEAR_____208_CM 1 0. 0. 32.767 DISPLAY_IDENTIFIER T_HLD_TOZE_POST1_CTL__1_ ECU_ADDRESS 0x7f9ea8 BYTE_ORDER MSB_LAST FORMAT "%5.3" /end MEASUREMENT
/begin MEASUREMENT t_hld_toze_post1_ctl_[2] "cylinder individual hold time of pulse TO ZERO POST1" UWORD _CNV_A_R_LINEAR_____208_CM 1 0. 0. 32.767 DISPLAY_IDENTIFIER T_HLD_TOZE_POST1_CTL__2_ ECU_ADDRESS 0x7f9eaa BYTE_ORDER MSB_LAST FORMAT "%5.3" /end MEASUREMENT
/begin MEASUREMENT t_hld_toze_post1_ctl_[3] "cylinder individual hold time of pulse TO ZERO POST1" UWORD _CNV_A_R_LINEAR_____208_CM 1 0. 0. 32.767 DISPLAY_IDENTIFIER T_HLD_TOZE_POST1_CTL__3_ ECU_ADDRESS 0x7f9eac BYTE_ORDER MSB_LAST FORMAT "%5.3" /end MEASUREMENT
/begin MEASUREMENT seg_nr_stk_mes "actual segment number for measurement of stroke controller" UBYTE _CNV_A_R_LINEAR_____0_CM 1 0. 0. 15. DISPLAY_IDENTIFIER SEG_NR_STK_MES ECU_ADDRESS 0x7fbb04 FORMAT "%2.0" /end MEASUREMENT
/begin MEASUREMENT t_hld_frze_mv "hold time of a partial charge stroke (mean value)" UWORD _CNV_A_R_LINEAR_____208_CM 1 0. 0. 32.767 DISPLAY_IDENTIFIER T_HLD_FRZE_MV ECU_ADDRESS 0x7f9eb6 BYTE_ORDER MSB_LAST FORMAT "%5.3" /end MEASUREMENT
/begin MEASUREMENT t_hld_toze_mv "hold time of a partial discharge stroke (mean value)" UWORD _CNV_A_R_LINEAR_____208_CM 1 0. 0. 32.767 DISPLAY_IDENTIFIER T_HLD_TOZE_MV ECU_ADDRESS 0x7f9eb8 BYTE_ORDER MSB_LAST FORMAT "%5.3" /end MEASUREMENT
/begin MEASUREMENT seg_nr_stk_ctl "actual segment number for stroke controller" UBYTE _CNV_A_R_LINEAR_____0_CM 1 0. 0. 15. DISPLAY_IDENTIFIER SEG_NR_STK_CTL ECU_ADDRESS 0x7fbb05 FORMAT "%2.0" /end MEASUREMENT
/begin MEASUREMENT t_per_stk_dcha "cycle duration of the first period of a discharge partial stroke" UWORD _CNV_A_R_LINEAR_____208_CM 1 0. 0. 32.767 DISPLAY_IDENTIFIER T_PER_STK_DCHA ECU_ADDRESS 0x7f9eae BYTE_ORDER MSB_LAST FORMAT "%5.3" /end MEASUREMENT
/begin MEASUREMENT v_ampl_stk_dcha "amplitude of the first period of a discharge partial stroke" UWORD _CNV_A_R_LINEAR_____532_CM 1 0. 0. 255. DISPLAY_IDENTIFIER V_AMPL_STK_DCHA ECU_ADDRESS 0x7f9eb0 BYTE_ORDER MSB_LAST /end MEASUREMENT
/begin MEASUREMENT step_nr_cha_frze_ctl_bas "number of charge steps of a partial stroke (base value)" UBYTE _CNV_A_R_LINEAR_____0_CM 1 0. 0. 30. DISPLAY_IDENTIFIER STEP_NR_CHA_FRZE_CTL_BAS ECU_ADDRESS 0x7fbb06 FORMAT "%2.0" /end MEASUREMENT
/begin MEASUREMENT step_nr_dcha_ctl_bas "number of discharge steps of a partial stroke (base value)" UBYTE _CNV_A_R_LINEAR_____0_CM 1 0. 0. 30. DISPLAY_IDENTIFIER STEP_NR_DCHA_CTL_BAS ECU_ADDRESS 0x7fbb07 FORMAT "%2.0" /end MEASUREMENT
/begin MEASUREMENT t_iv_opg_min "minimal discharge time so that the injection valve closes" UWORD _CNV_A_R_LINEAR_____533_CM 1 0. 0. 0.512 DISPLAY_IDENTIFIER T_IV_OPG_MIN ECU_ADDRESS 0x7f9eb2 BYTE_ORDER MSB_LAST FORMAT "%4.3" /end MEASUREMENT
/begin MEASUREMENT t_iv_close_mv_mv "mean value of T_IV_CLOSE_MV_x averaged over all NC_CYL_NR cylinders" UWORD _CNV_A_R_LINEAR_____533_CM 1 0. 0. 0.512 DISPLAY_IDENTIFIER T_IV_CLOSE_MV_MV ECU_ADDRESS 0x7f9eb4 BYTE_ORDER MSB_LAST FORMAT "%4.3" /end MEASUREMENT
/begin MEASUREMENT pwm_cha_[0] "PPS charging PWM output (cylinder individual)" UWORD _CNV_A_R_LINEAR_____8_CM 1 0. 0. 99.99847412109381 DISPLAY_IDENTIFIER PWM_CHA__0_ ECU_ADDRESS 0x7f9e6e BYTE_ORDER MSB_LAST FORMAT "%5.3" /end MEASUREMENT
/begin MEASUREMENT pwm_cha_[1] "PPS charging PWM output (cylinder individual)" UWORD _CNV_A_R_LINEAR_____8_CM 1 0. 0. 99.99847412109381 DISPLAY_IDENTIFIER PWM_CHA__1_ ECU_ADDRESS 0x7f9e70 BYTE_ORDER MSB_LAST FORMAT "%5.3" /end MEASUREMENT
/begin MEASUREMENT pwm_cha_[2] "PPS charging PWM output (cylinder individual)" UWORD _CNV_A_R_LINEAR_____8_CM 1 0. 0. 99.99847412109381 DISPLAY_IDENTIFIER PWM_CHA__2_ ECU_ADDRESS 0x7f9e72 BYTE_ORDER MSB_LAST FORMAT "%5.3" /end MEASUREMENT
/begin MEASUREMENT pwm_cha_[3] "PPS charging PWM output (cylinder individual)" UWORD _CNV_A_R_LINEAR_____8_CM 1 0. 0. 99.99847412109381 DISPLAY_IDENTIFIER PWM_CHA__3_ ECU_ADDRESS 0x7f9e74 BYTE_ORDER MSB_LAST FORMAT "%5.3" /end MEASUREMENT
/begin MEASUREMENT pwm_dcha_[0] "PPS discharging PWM output (cylinder individual)" UWORD _CNV_A_R_LINEAR_____8_CM 1 0. 0. 99.99847412109381 DISPLAY_IDENTIFIER PWM_DCHA__0_ ECU_ADDRESS 0x7f9e76 BYTE_ORDER MSB_LAST FORMAT "%5.3" /end MEASUREMENT
/begin MEASUREMENT pwm_dcha_[1] "PPS discharging PWM output (cylinder individual)" UWORD _CNV_A_R_LINEAR_____8_CM 1 0. 0. 99.99847412109381 DISPLAY_IDENTIFIER PWM_DCHA__1_ ECU_ADDRESS 0x7f9e78 BYTE_ORDER MSB_LAST FORMAT "%5.3" /end MEASUREMENT
/begin MEASUREMENT pwm_dcha_[2] "PPS discharging PWM output (cylinder individual)" UWORD _CNV_A_R_LINEAR_____8_CM 1 0. 0. 99.99847412109381 DISPLAY_IDENTIFIER PWM_DCHA__2_ ECU_ADDRESS 0x7f9e7a BYTE_ORDER MSB_LAST FORMAT "%5.3" /end MEASUREMENT
/begin MEASUREMENT pwm_dcha_[3] "PPS discharging PWM output (cylinder individual)" UWORD _CNV_A_R_LINEAR_____8_CM 1 0. 0. 99.99847412109381 DISPLAY_IDENTIFIER PWM_DCHA__3_ ECU_ADDRESS 0x7f9e7c BYTE_ORDER MSB_LAST FORMAT "%5.3" /end MEASUREMENT
/begin MEASUREMENT t_eoi_ofs_ctl_[0] "cylinder individual EOI correction for all injections" SWORD _CNV_A_R_LINEAR_____533_CM 1 0. -32.768 32.767 DISPLAY_IDENTIFIER T_EOI_OFS_CTL__0_ ECU_ADDRESS 0x7f9e66 BYTE_ORDER MSB_LAST FORMAT "%5.3" /end MEASUREMENT
/begin MEASUREMENT t_eoi_ofs_ctl_[1] "cylinder individual EOI correction for all injections" SWORD _CNV_A_R_LINEAR_____533_CM 1 0. -32.768 32.767 DISPLAY_IDENTIFIER T_EOI_OFS_CTL__1_ ECU_ADDRESS 0x7f9e68 BYTE_ORDER MSB_LAST FORMAT "%5.3" /end MEASUREMENT
/begin MEASUREMENT t_eoi_ofs_ctl_[2] "cylinder individual EOI correction for all injections" SWORD _CNV_A_R_LINEAR_____533_CM 1 0. -32.768 32.767 DISPLAY_IDENTIFIER T_EOI_OFS_CTL__2_ ECU_ADDRESS 0x7f9e6a BYTE_ORDER MSB_LAST FORMAT "%5.3" /end MEASUREMENT
/begin MEASUREMENT t_eoi_ofs_ctl_[3] "cylinder individual EOI correction for all injections" SWORD _CNV_A_R_LINEAR_____533_CM 1 0. -32.768 32.767 DISPLAY_IDENTIFIER T_EOI_OFS_CTL__3_ ECU_ADDRESS 0x7f9e6c BYTE_ORDER MSB_LAST FORMAT "%5.3" /end MEASUREMENT
/begin MEASUREMENT sf_pi_ctl_egy_max "maximum limit of energy controller´s integrator reached" UWORD _CNV_A_R_LINEAR_____0_CM 1 0. 0. 65535. DISPLAY_IDENTIFIER SF_PI_CTL_EGY_MAX ECU_ADDRESS 0x7faa34 BYTE_ORDER MSB_LAST FORMAT "%5.0" /end MEASUREMENT
/begin MEASUREMENT egy_inj_sp_[0] "energy controller set point (cylinder individual)" UWORD _CNV_A_R_LINEAR_____534_CM 1 0. 0. 522.7750632 DISPLAY_IDENTIFIER EGY_INJ_SP__0_ ECU_ADDRESS 0x7faa36 BYTE_ORDER MSB_LAST /end MEASUREMENT
/begin MEASUREMENT egy_inj_sp_[1] "energy controller set point (cylinder individual)" UWORD _CNV_A_R_LINEAR_____534_CM 1 0. 0. 522.7750632 DISPLAY_IDENTIFIER EGY_INJ_SP__1_ ECU_ADDRESS 0x7faa38 BYTE_ORDER MSB_LAST /end MEASUREMENT
/begin MEASUREMENT egy_inj_sp_[2] "energy controller set point (cylinder individual)" UWORD _CNV_A_R_LINEAR_____534_CM 1 0. 0. 522.7750632 DISPLAY_IDENTIFIER EGY_INJ_SP__2_ ECU_ADDRESS 0x7faa3a BYTE_ORDER MSB_LAST /end MEASUREMENT
/begin MEASUREMENT egy_inj_sp_[3] "energy controller set point (cylinder individual)" UWORD _CNV_A_R_LINEAR_____534_CM 1 0. 0. 522.7750632 DISPLAY_IDENTIFIER EGY_INJ_SP__3_ ECU_ADDRESS 0x7faa3c BYTE_ORDER MSB_LAST /end MEASUREMENT
/begin MEASUREMENT lv_egy_ctl_act "energy closed loop controller active" UBYTE _CNV_S_2_RANGE______11_CM 1 0. 0. 1. DISPLAY_IDENTIFIER LV_EGY_CTL_ACT ECU_ADDRESS 0x7fbb01 /end MEASUREMENT
/begin MEASUREMENT lv_egy_ctl_ini "energy controller initialising or manual mode" UBYTE _CNV_S_2_RANGE______11_CM 1 0. 0. 1. DISPLAY_IDENTIFIER LV_EGY_CTL_INI ECU_ADDRESS 0x7fbb02 /end MEASUREMENT
/begin MEASUREMENT lv_dcha_ctl_on "discharge control off (0) / on (1)" UBYTE _CNV_S_2_RANGE______11_CM 1 0. 0. 1. DISPLAY_IDENTIFIER LV_DCHA_CTL_ON ECU_ADDRESS 0x7fbb03 /end MEASUREMENT
/begin MEASUREMENT egy_step_sp_[0] "energy controller set point divided by number of CC PPS steps (cylinder individual)" UWORD _CNV_A_R_LINEAR_____534_CM 1 0. 0. 522.7750632 DISPLAY_IDENTIFIER EGY_STEP_SP__0_ ECU_ADDRESS 0x7faa3e BYTE_ORDER MSB_LAST /end MEASUREMENT
/begin MEASUREMENT egy_step_sp_[1] "energy controller set point divided by number of CC PPS steps (cylinder individual)" UWORD _CNV_A_R_LINEAR_____534_CM 1 0. 0. 522.7750632 DISPLAY_IDENTIFIER EGY_STEP_SP__1_ ECU_ADDRESS 0x7faa40 BYTE_ORDER MSB_LAST /end MEASUREMENT
/begin MEASUREMENT egy_step_sp_[2] "energy controller set point divided by number of CC PPS steps (cylinder individual)" UWORD _CNV_A_R_LINEAR_____534_CM 1 0. 0. 522.7750632 DISPLAY_IDENTIFIER EGY_STEP_SP__2_ ECU_ADDRESS 0x7faa42 BYTE_ORDER MSB_LAST /end MEASUREMENT
/begin MEASUREMENT egy_step_sp_[3] "energy controller set point divided by number of CC PPS steps (cylinder individual)" UWORD _CNV_A_R_LINEAR_____534_CM 1 0. 0. 522.7750632 DISPLAY_IDENTIFIER EGY_STEP_SP__3_ ECU_ADDRESS 0x7faa44 BYTE_ORDER MSB_LAST /end MEASUREMENT
/begin MEASUREMENT egy_inj_sp_pctl_[0] "energy controller set point for energy pre control (cylinder individual)" UWORD _CNV_A_R_LINEAR_____534_CM 1 0. 0. 522.7750632 DISPLAY_IDENTIFIER EGY_INJ_SP_PCTL__0_ ECU_ADDRESS 0x7faa46 BYTE_ORDER MSB_LAST /end MEASUREMENT
/begin MEASUREMENT egy_inj_sp_pctl_[1] "energy controller set point for energy pre control (cylinder individual)" UWORD _CNV_A_R_LINEAR_____534_CM 1 0. 0. 522.7750632 DISPLAY_IDENTIFIER EGY_INJ_SP_PCTL__1_ ECU_ADDRESS 0x7faa48 BYTE_ORDER MSB_LAST /end MEASUREMENT
/begin MEASUREMENT egy_inj_sp_pctl_[2] "energy controller set point for energy pre control (cylinder individual)" UWORD _CNV_A_R_LINEAR_____534_CM 1 0. 0. 522.7750632 DISPLAY_IDENTIFIER EGY_INJ_SP_PCTL__2_ ECU_ADDRESS 0x7faa4a BYTE_ORDER MSB_LAST /end MEASUREMENT
/begin MEASUREMENT egy_inj_sp_pctl_[3] "energy controller set point for energy pre control (cylinder individual)" UWORD _CNV_A_R_LINEAR_____534_CM 1 0. 0. 522.7750632 DISPLAY_IDENTIFIER EGY_INJ_SP_PCTL__3_ ECU_ADDRESS 0x7faa4c BYTE_ORDER MSB_LAST /end MEASUREMENT
/begin MEASUREMENT seg_nr_egy_ctl "actual segment number of energy control" UBYTE _CNV_A_R_LINEAR_____0_CM 1 0. 0. 15. DISPLAY_IDENTIFIER SEG_NR_EGY_CTL ECU_ADDRESS 0x7fbaff FORMAT "%2.0" /end MEASUREMENT
/begin MEASUREMENT pwm_cha_ctl_[0] "energy controller output (cylinder individual)" UWORD _CNV_A_R_LINEAR_____8_CM 1 0. 0. 99.99847412109381 DISPLAY_IDENTIFIER PWM_CHA_CTL__0_ ECU_ADDRESS 0x7faa4e BYTE_ORDER MSB_LAST FORMAT "%5.3" /end MEASUREMENT
/begin MEASUREMENT pwm_cha_ctl_[1] "energy controller output (cylinder individual)" UWORD _CNV_A_R_LINEAR_____8_CM 1 0. 0. 99.99847412109381 DISPLAY_IDENTIFIER PWM_CHA_CTL__1_ ECU_ADDRESS 0x7faa50 BYTE_ORDER MSB_LAST FORMAT "%5.3" /end MEASUREMENT
/begin MEASUREMENT pwm_cha_ctl_[2] "energy controller output (cylinder individual)" UWORD _CNV_A_R_LINEAR_____8_CM 1 0. 0. 99.99847412109381 DISPLAY_IDENTIFIER PWM_CHA_CTL__2_ ECU_ADDRESS 0x7faa52 BYTE_ORDER MSB_LAST FORMAT "%5.3" /end MEASUREMENT
/begin MEASUREMENT pwm_cha_ctl_[3] "energy controller output (cylinder individual)" UWORD _CNV_A_R_LINEAR_____8_CM 1 0. 0. 99.99847412109381 DISPLAY_IDENTIFIER PWM_CHA_CTL__3_ ECU_ADDRESS 0x7faa54 BYTE_ORDER MSB_LAST FORMAT "%5.3" /end MEASUREMENT
/begin MEASUREMENT pwm_cha_err_ctl_[0] "closed loop energy controller´s error correction/PI controller output (cylinder individual)" SWORD _CNV_A_R_LINEAR_____138_CM 1 0. -50. 49.99847412 DISPLAY_IDENTIFIER PWM_CHA_ERR_CTL__0_ ECU_ADDRESS 0x7faa56 BYTE_ORDER MSB_LAST FORMAT "%5.3" /end MEASUREMENT
/begin MEASUREMENT pwm_cha_err_ctl_[1] "closed loop energy controller´s error correction/PI controller output (cylinder individual)" SWORD _CNV_A_R_LINEAR_____138_CM 1 0. -50. 49.99847412 DISPLAY_IDENTIFIER PWM_CHA_ERR_CTL__1_ ECU_ADDRESS 0x7faa58 BYTE_ORDER MSB_LAST FORMAT "%5.3" /end MEASUREMENT
/begin MEASUREMENT pwm_cha_err_ctl_[2] "closed loop energy controller´s error correction/PI controller output (cylinder individual)" SWORD _CNV_A_R_LINEAR_____138_CM 1 0. -50. 49.99847412 DISPLAY_IDENTIFIER PWM_CHA_ERR_CTL__2_ ECU_ADDRESS 0x7faa5a BYTE_ORDER MSB_LAST FORMAT "%5.3" /end MEASUREMENT
/begin MEASUREMENT pwm_cha_err_ctl_[3] "closed loop energy controller´s error correction/PI controller output (cylinder individual)" SWORD _CNV_A_R_LINEAR_____138_CM 1 0. -50. 49.99847412 DISPLAY_IDENTIFIER PWM_CHA_ERR_CTL__3_ ECU_ADDRESS 0x7faa5c BYTE_ORDER MSB_LAST FORMAT "%5.3" /end MEASUREMENT
/begin MEASUREMENT p_ctl_egy_[0] "proportional part of closed loop energy controller (cylinder individual)" SWORD _CNV_A_R_LINEAR_____138_CM 1 0. -50. 49.99847412 DISPLAY_IDENTIFIER P_CTL_EGY__0_ ECU_ADDRESS 0x7faa5e BYTE_ORDER MSB_LAST FORMAT "%5.3" /end MEASUREMENT
/begin MEASUREMENT p_ctl_egy_[1] "proportional part of closed loop energy controller (cylinder individual)" SWORD _CNV_A_R_LINEAR_____138_CM 1 0. -50. 49.99847412 DISPLAY_IDENTIFIER P_CTL_EGY__1_ ECU_ADDRESS 0x7faa60 BYTE_ORDER MSB_LAST FORMAT "%5.3" /end MEASUREMENT
/begin MEASUREMENT p_ctl_egy_[2] "proportional part of closed loop energy controller (cylinder individual)" SWORD _CNV_A_R_LINEAR_____138_CM 1 0. -50. 49.99847412 DISPLAY_IDENTIFIER P_CTL_EGY__2_ ECU_ADDRESS 0x7faa62 BYTE_ORDER MSB_LAST FORMAT "%5.3" /end MEASUREMENT
/begin MEASUREMENT p_ctl_egy_[3] "proportional part of closed loop energy controller (cylinder individual)" SWORD _CNV_A_R_LINEAR_____138_CM 1 0. -50. 49.99847412 DISPLAY_IDENTIFIER P_CTL_EGY__3_ ECU_ADDRESS 0x7faa64 BYTE_ORDER MSB_LAST FORMAT "%5.3" /end MEASUREMENT
/begin MEASUREMENT i_ctl_egy_[0] "integral part of closed loop energy controller (cylinder individual)" SWORD _CNV_A_R_LINEAR_____138_CM 1 0. -50. 49.99847412 DISPLAY_IDENTIFIER I_CTL_EGY__0_ ECU_ADDRESS 0x7faa66 BYTE_ORDER MSB_LAST FORMAT "%5.3" /end MEASUREMENT
/begin MEASUREMENT i_ctl_egy_[1] "integral part of closed loop energy controller (cylinder individual)" SWORD _CNV_A_R_LINEAR_____138_CM 1 0. -50. 49.99847412 DISPLAY_IDENTIFIER I_CTL_EGY__1_ ECU_ADDRESS 0x7faa68 BYTE_ORDER MSB_LAST FORMAT "%5.3" /end MEASUREMENT
/begin MEASUREMENT i_ctl_egy_[2] "integral part of closed loop energy controller (cylinder individual)" SWORD _CNV_A_R_LINEAR_____138_CM 1 0. -50. 49.99847412 DISPLAY_IDENTIFIER I_CTL_EGY__2_ ECU_ADDRESS 0x7faa6a BYTE_ORDER MSB_LAST FORMAT "%5.3" /end MEASUREMENT
/begin MEASUREMENT i_ctl_egy_[3] "integral part of closed loop energy controller (cylinder individual)" SWORD _CNV_A_R_LINEAR_____138_CM 1 0. -50. 49.99847412 DISPLAY_IDENTIFIER I_CTL_EGY__3_ ECU_ADDRESS 0x7faa6c BYTE_ORDER MSB_LAST FORMAT "%5.3" /end MEASUREMENT
/begin MEASUREMENT sf_pi_ctl_egy_min "minimum limit of energy controller´s integrator reached" UWORD _CNV_A_R_LINEAR_____0_CM 1 0. 0. 65535. DISPLAY_IDENTIFIER SF_PI_CTL_EGY_MIN ECU_ADDRESS 0x7faa32 BYTE_ORDER MSB_LAST FORMAT "%5.0" /end MEASUREMENT
/begin MEASUREMENT egy_inj_dif_[0] "energy controller deviation = set point - controlled variable (cylinder individual)" SWORD _CNV_A_R_LINEAR_____535_CM 1 0. -261.3875315 261.3875315 DISPLAY_IDENTIFIER EGY_INJ_DIF__0_ ECU_ADDRESS 0x7faa6e BYTE_ORDER MSB_LAST /end MEASUREMENT
/begin MEASUREMENT egy_inj_dif_[1] "energy controller deviation = set point - controlled variable (cylinder individual)" SWORD _CNV_A_R_LINEAR_____535_CM 1 0. -261.3875315 261.3875315 DISPLAY_IDENTIFIER EGY_INJ_DIF__1_ ECU_ADDRESS 0x7faa70 BYTE_ORDER MSB_LAST /end MEASUREMENT
/begin MEASUREMENT egy_inj_dif_[2] "energy controller deviation = set point - controlled variable (cylinder individual)" SWORD _CNV_A_R_LINEAR_____535_CM 1 0. -261.3875315 261.3875315 DISPLAY_IDENTIFIER EGY_INJ_DIF__2_ ECU_ADDRESS 0x7faa72 BYTE_ORDER MSB_LAST /end MEASUREMENT
/begin MEASUREMENT egy_inj_dif_[3] "energy controller deviation = set point - controlled variable (cylinder individual)" SWORD _CNV_A_R_LINEAR_____535_CM 1 0. -261.3875315 261.3875315 DISPLAY_IDENTIFIER EGY_INJ_DIF__3_ ECU_ADDRESS 0x7faa74 BYTE_ORDER MSB_LAST /end MEASUREMENT
/begin MEASUREMENT dummy_peco "dummy peco" UWORD _CNV_A_R_LINEAR_____0_CM 1 0. 0. 65535. DISPLAY_IDENTIFIER DUMMY_PECO ECU_ADDRESS 0x7f9e52 BYTE_ORDER MSB_LAST FORMAT "%5.0" /end MEASUREMENT
/begin MEASUREMENT egy_sp_bas_iv_foc_ctl_[0] "set point for energy controller computed by IV_FOC controller (cylinder individual)" UWORD _CNV_A_R_LINEAR_____534_CM 1 0. 0. 522.7750632 DISPLAY_IDENTIFIER EGY_SP_BAS_IV_FOC_CTL__0_ ECU_ADDRESS 0x7f9ec2 BYTE_ORDER MSB_LAST /end MEASUREMENT
/begin MEASUREMENT egy_sp_bas_iv_foc_ctl_[1] "set point for energy controller computed by IV_FOC controller (cylinder individual)" UWORD _CNV_A_R_LINEAR_____534_CM 1 0. 0. 522.7750632 DISPLAY_IDENTIFIER EGY_SP_BAS_IV_FOC_CTL__1_ ECU_ADDRESS 0x7f9ec4 BYTE_ORDER MSB_LAST /end MEASUREMENT
/begin MEASUREMENT egy_sp_bas_iv_foc_ctl_[2] "set point for energy controller computed by IV_FOC controller (cylinder individual)" UWORD _CNV_A_R_LINEAR_____534_CM 1 0. 0. 522.7750632 DISPLAY_IDENTIFIER EGY_SP_BAS_IV_FOC_CTL__2_ ECU_ADDRESS 0x7f9ec6 BYTE_ORDER MSB_LAST /end MEASUREMENT
/begin MEASUREMENT egy_sp_bas_iv_foc_ctl_[3] "set point for energy controller computed by IV_FOC controller (cylinder individual)" UWORD _CNV_A_R_LINEAR_____534_CM 1 0. 0. 522.7750632 DISPLAY_IDENTIFIER EGY_SP_BAS_IV_FOC_CTL__3_ ECU_ADDRESS 0x7f9ec8 BYTE_ORDER MSB_LAST /end MEASUREMENT
/begin MEASUREMENT sf_egy_sp_man_iv_foc_ctl "status word for manual energy set point computed by IV_FOC controller" UWORD _CNV_A_R_LINEAR_____0_CM 1 0. 0. 65535. DISPLAY_IDENTIFIER SF_EGY_SP_MAN_IV_FOC_CTL ECU_ADDRESS 0x7f9eca BYTE_ORDER MSB_LAST FORMAT "%5.0" /end MEASUREMENT
/begin MEASUREMENT egy_sp_err_iv_foc_ctl_[0] "closed loop IV_FOC controller´s output (cylinder individual)" SWORD _CNV_A_R_LINEAR_____535_CM 1 0. -261.3875315 261.3875315 DISPLAY_IDENTIFIER EGY_SP_ERR_IV_FOC_CTL__0_ ECU_ADDRESS 0x7faa76 BYTE_ORDER MSB_LAST /end MEASUREMENT
/begin MEASUREMENT egy_sp_err_iv_foc_ctl_[1] "closed loop IV_FOC controller´s output (cylinder individual)" SWORD _CNV_A_R_LINEAR_____535_CM 1 0. -261.3875315 261.3875315 DISPLAY_IDENTIFIER EGY_SP_ERR_IV_FOC_CTL__1_ ECU_ADDRESS 0x7faa78 BYTE_ORDER MSB_LAST /end MEASUREMENT
/begin MEASUREMENT egy_sp_err_iv_foc_ctl_[2] "closed loop IV_FOC controller´s output (cylinder individual)" SWORD _CNV_A_R_LINEAR_____535_CM 1 0. -261.3875315 261.3875315 DISPLAY_IDENTIFIER EGY_SP_ERR_IV_FOC_CTL__2_ ECU_ADDRESS 0x7faa7a BYTE_ORDER MSB_LAST /end MEASUREMENT
/begin MEASUREMENT egy_sp_err_iv_foc_ctl_[3] "closed loop IV_FOC controller´s output (cylinder individual)" SWORD _CNV_A_R_LINEAR_____535_CM 1 0. -261.3875315 261.3875315 DISPLAY_IDENTIFIER EGY_SP_ERR_IV_FOC_CTL__3_ ECU_ADDRESS 0x7faa7c BYTE_ORDER MSB_LAST /end MEASUREMENT
/begin MEASUREMENT i_ctl_iv_foc_[0] "integral part of IV_FOC controller (cylinder individual)" SWORD _CNV_A_R_LINEAR_____535_CM 1 0. -261.3875315 261.3875315 DISPLAY_IDENTIFIER I_CTL_IV_FOC__0_ ECU_ADDRESS 0x7faa7e BYTE_ORDER MSB_LAST /end MEASUREMENT
/begin MEASUREMENT i_ctl_iv_foc_[1] "integral part of IV_FOC controller (cylinder individual)" SWORD _CNV_A_R_LINEAR_____535_CM 1 0. -261.3875315 261.3875315 DISPLAY_IDENTIFIER I_CTL_IV_FOC__1_ ECU_ADDRESS 0x7faa80 BYTE_ORDER MSB_LAST /end MEASUREMENT
/begin MEASUREMENT i_ctl_iv_foc_[2] "integral part of IV_FOC controller (cylinder individual)" SWORD _CNV_A_R_LINEAR_____535_CM 1 0. -261.3875315 261.3875315 DISPLAY_IDENTIFIER I_CTL_IV_FOC__2_ ECU_ADDRESS 0x7faa82 BYTE_ORDER MSB_LAST /end MEASUREMENT
/begin MEASUREMENT i_ctl_iv_foc_[3] "integral part of IV_FOC controller (cylinder individual)" SWORD _CNV_A_R_LINEAR_____535_CM 1 0. -261.3875315 261.3875315 DISPLAY_IDENTIFIER I_CTL_IV_FOC__3_ ECU_ADDRESS 0x7faa84 BYTE_ORDER MSB_LAST /end MEASUREMENT
/begin MEASUREMENT p_ctl_iv_foc_[0] "proportional part of IV_FOC controller (cylinder individual)" SWORD _CNV_A_R_LINEAR_____535_CM 1 0. -261.3875315 261.3875315 DISPLAY_IDENTIFIER P_CTL_IV_FOC__0_ ECU_ADDRESS 0x7faa86 BYTE_ORDER MSB_LAST /end MEASUREMENT
/begin MEASUREMENT p_ctl_iv_foc_[1] "proportional part of IV_FOC controller (cylinder individual)" SWORD _CNV_A_R_LINEAR_____535_CM 1 0. -261.3875315 261.3875315 DISPLAY_IDENTIFIER P_CTL_IV_FOC__1_ ECU_ADDRESS 0x7faa88 BYTE_ORDER MSB_LAST /end MEASUREMENT
/begin MEASUREMENT p_ctl_iv_foc_[2] "proportional part of IV_FOC controller (cylinder individual)" SWORD _CNV_A_R_LINEAR_____535_CM 1 0. -261.3875315 261.3875315 DISPLAY_IDENTIFIER P_CTL_IV_FOC__2_ ECU_ADDRESS 0x7faa8a BYTE_ORDER MSB_LAST /end MEASUREMENT
/begin MEASUREMENT p_ctl_iv_foc_[3] "proportional part of IV_FOC controller (cylinder individual)" SWORD _CNV_A_R_LINEAR_____535_CM 1 0. -261.3875315 261.3875315 DISPLAY_IDENTIFIER P_CTL_IV_FOC__3_ ECU_ADDRESS 0x7faa8c BYTE_ORDER MSB_LAST /end MEASUREMENT
/begin MEASUREMENT seg_nr_iv_foc_ctl "actual segment number of IV_FOC controller" UBYTE _CNV_A_R_LINEAR_____0_CM 1 0. 0. 15. DISPLAY_IDENTIFIER SEG_NR_IV_FOC_CTL ECU_ADDRESS 0x7fbb08 FORMAT "%2.0" /end MEASUREMENT
/begin MEASUREMENT sf_iv_foc_ctl_act "status word for active IV_FOC controller" UWORD _CNV_A_R_LINEAR_____0_CM 1 0. 0. 65535. DISPLAY_IDENTIFIER SF_IV_FOC_CTL_ACT ECU_ADDRESS 0x7faa8e BYTE_ORDER MSB_LAST FORMAT "%5.0" /end MEASUREMENT
/begin MEASUREMENT sf_mes_iv_foc_vld "status word for valid IV_FOC measurement" UWORD _CNV_A_R_LINEAR_____0_CM 1 0. 0. 65535. DISPLAY_IDENTIFIER SF_MES_IV_FOC_VLD ECU_ADDRESS 0x7faa90 BYTE_ORDER MSB_LAST FORMAT "%5.0" /end MEASUREMENT
/begin MEASUREMENT sf_pi_ctl_iv_foc_max "status word for max reached in IV_FOC controller" UWORD _CNV_A_R_LINEAR_____0_CM 1 0. 0. 65535. DISPLAY_IDENTIFIER SF_PI_CTL_IV_FOC_MAX ECU_ADDRESS 0x7faa92 BYTE_ORDER MSB_LAST FORMAT "%5.0" /end MEASUREMENT
/begin MEASUREMENT sf_pi_ctl_iv_foc_min "status word for min reached in IV_FOC controller" UWORD _CNV_A_R_LINEAR_____0_CM 1 0. 0. 65535. DISPLAY_IDENTIFIER SF_PI_CTL_IV_FOC_MIN ECU_ADDRESS 0x7faa94 BYTE_ORDER MSB_LAST FORMAT "%5.0" /end MEASUREMENT
/begin MEASUREMENT v_delta_dif_[0] "control deviation of IV_FOC controller (cylinder individual)" SWORD _CNV_A_R_LINEAR_____542_CM 1 0. -128. 127.9960938 DISPLAY_IDENTIFIER V_DELTA_DIF__0_ ECU_ADDRESS 0x7faa96 BYTE_ORDER MSB_LAST /end MEASUREMENT
/begin MEASUREMENT v_delta_dif_[1] "control deviation of IV_FOC controller (cylinder individual)" SWORD _CNV_A_R_LINEAR_____542_CM 1 0. -128. 127.9960938 DISPLAY_IDENTIFIER V_DELTA_DIF__1_ ECU_ADDRESS 0x7faa98 BYTE_ORDER MSB_LAST /end MEASUREMENT
/begin MEASUREMENT v_delta_dif_[2] "control deviation of IV_FOC controller (cylinder individual)" SWORD _CNV_A_R_LINEAR_____542_CM 1 0. -128. 127.9960938 DISPLAY_IDENTIFIER V_DELTA_DIF__2_ ECU_ADDRESS 0x7faa9a BYTE_ORDER MSB_LAST /end MEASUREMENT
/begin MEASUREMENT v_delta_dif_[3] "control deviation of IV_FOC controller (cylinder individual)" SWORD _CNV_A_R_LINEAR_____542_CM 1 0. -128. 127.9960938 DISPLAY_IDENTIFIER V_DELTA_DIF__3_ ECU_ADDRESS 0x7faa9c BYTE_ORDER MSB_LAST /end MEASUREMENT
/begin MEASUREMENT v_delta_mv_[0] "measurement value for IV_FOC controller (filtered, cylinder individual)" UWORD _CNV_A_R_LINEAR_____532_CM 1 0. 0. 255. DISPLAY_IDENTIFIER V_DELTA_MV__0_ ECU_ADDRESS 0x7faa9e BYTE_ORDER MSB_LAST /end MEASUREMENT
/begin MEASUREMENT v_delta_mv_[1] "measurement value for IV_FOC controller (filtered, cylinder individual)" UWORD _CNV_A_R_LINEAR_____532_CM 1 0. 0. 255. DISPLAY_IDENTIFIER V_DELTA_MV__1_ ECU_ADDRESS 0x7faaa0 BYTE_ORDER MSB_LAST /end MEASUREMENT
/begin MEASUREMENT v_delta_mv_[2] "measurement value for IV_FOC controller (filtered, cylinder individual)" UWORD _CNV_A_R_LINEAR_____532_CM 1 0. 0. 255. DISPLAY_IDENTIFIER V_DELTA_MV__2_ ECU_ADDRESS 0x7faaa2 BYTE_ORDER MSB_LAST /end MEASUREMENT
/begin MEASUREMENT v_delta_mv_[3] "measurement value for IV_FOC controller (filtered, cylinder individual)" UWORD _CNV_A_R_LINEAR_____532_CM 1 0. 0. 255. DISPLAY_IDENTIFIER V_DELTA_MV__3_ ECU_ADDRESS 0x7faaa4 BYTE_ORDER MSB_LAST /end MEASUREMENT
/begin MEASUREMENT v_delta_sp_mv_[0] "set point for IV_FOC controller (filtered, cylinder individual)" UWORD _CNV_A_R_LINEAR_____532_CM 1 0. 0. 255. DISPLAY_IDENTIFIER V_DELTA_SP_MV__0_ ECU_ADDRESS 0x7faaa6 BYTE_ORDER MSB_LAST /end MEASUREMENT
/begin MEASUREMENT v_delta_sp_mv_[1] "set point for IV_FOC controller (filtered, cylinder individual)" UWORD _CNV_A_R_LINEAR_____532_CM 1 0. 0. 255. DISPLAY_IDENTIFIER V_DELTA_SP_MV__1_ ECU_ADDRESS 0x7faaa8 BYTE_ORDER MSB_LAST /end MEASUREMENT
/begin MEASUREMENT v_delta_sp_mv_[2] "set point for IV_FOC controller (filtered, cylinder individual)" UWORD _CNV_A_R_LINEAR_____532_CM 1 0. 0. 255. DISPLAY_IDENTIFIER V_DELTA_SP_MV__2_ ECU_ADDRESS 0x7faaaa BYTE_ORDER MSB_LAST /end MEASUREMENT
/begin MEASUREMENT v_delta_sp_mv_[3] "set point for IV_FOC controller (filtered, cylinder individual)" UWORD _CNV_A_R_LINEAR_____532_CM 1 0. 0. 255. DISPLAY_IDENTIFIER V_DELTA_SP_MV__3_ ECU_ADDRESS 0x7faaac BYTE_ORDER MSB_LAST /end MEASUREMENT
/begin MEASUREMENT t_soi_ofs_ctl_[0] "cylinder individual SOI correction for all injections" SWORD _CNV_A_R_LINEAR_____533_CM 1 0. -32.768 32.767 DISPLAY_IDENTIFIER T_SOI_OFS_CTL__0_ ECU_ADDRESS 0x7f9ecc BYTE_ORDER MSB_LAST FORMAT "%5.3" /end MEASUREMENT
/begin MEASUREMENT t_soi_ofs_ctl_[1] "cylinder individual SOI correction for all injections" SWORD _CNV_A_R_LINEAR_____533_CM 1 0. -32.768 32.767 DISPLAY_IDENTIFIER T_SOI_OFS_CTL__1_ ECU_ADDRESS 0x7f9ece BYTE_ORDER MSB_LAST FORMAT "%5.3" /end MEASUREMENT
/begin MEASUREMENT t_soi_ofs_ctl_[2] "cylinder individual SOI correction for all injections" SWORD _CNV_A_R_LINEAR_____533_CM 1 0. -32.768 32.767 DISPLAY_IDENTIFIER T_SOI_OFS_CTL__2_ ECU_ADDRESS 0x7f9ed0 BYTE_ORDER MSB_LAST FORMAT "%5.3" /end MEASUREMENT
/begin MEASUREMENT t_soi_ofs_ctl_[3] "cylinder individual SOI correction for all injections" SWORD _CNV_A_R_LINEAR_____533_CM 1 0. -32.768 32.767 DISPLAY_IDENTIFIER T_SOI_OFS_CTL__3_ ECU_ADDRESS 0x7f9ed2 BYTE_ORDER MSB_LAST FORMAT "%5.3" /end MEASUREMENT
/begin MEASUREMENT lv_iv_foc_iv_close_ctl_sel "selected kind of IV control (1: IV_FOC_CTL and SOI_CTL, 0: only IV_CLOSE_CTL)" UBYTE _CNV_S_2_RANGE______11_CM 1 0. 0. 1. DISPLAY_IDENTIFIER LV_IV_FOC_IV_CLOSE_CTL_SEL ECU_ADDRESS 0x7fb702 /end MEASUREMENT
/begin MEASUREMENT egy_sp_bas_iv_close_ctl_[0] "base set point value for energy controller computed by IV_CLOSE controller (cylinder individual)" UWORD _CNV_A_R_LINEAR_____534_CM 1 0. 0. 522.7750632 DISPLAY_IDENTIFIER EGY_SP_BAS_IV_CLOSE_CTL__0_ ECU_ADDRESS 0x7f9ed4 BYTE_ORDER MSB_LAST /end MEASUREMENT
/begin MEASUREMENT egy_sp_bas_iv_close_ctl_[1] "base set point value for energy controller computed by IV_CLOSE controller (cylinder individual)" UWORD _CNV_A_R_LINEAR_____534_CM 1 0. 0. 522.7750632 DISPLAY_IDENTIFIER EGY_SP_BAS_IV_CLOSE_CTL__1_ ECU_ADDRESS 0x7f9ed6 BYTE_ORDER MSB_LAST /end MEASUREMENT
/begin MEASUREMENT egy_sp_bas_iv_close_ctl_[2] "base set point value for energy controller computed by IV_CLOSE controller (cylinder individual)" UWORD _CNV_A_R_LINEAR_____534_CM 1 0. 0. 522.7750632 DISPLAY_IDENTIFIER EGY_SP_BAS_IV_CLOSE_CTL__2_ ECU_ADDRESS 0x7f9ed8 BYTE_ORDER MSB_LAST /end MEASUREMENT
/begin MEASUREMENT egy_sp_bas_iv_close_ctl_[3] "base set point value for energy controller computed by IV_CLOSE controller (cylinder individual)" UWORD _CNV_A_R_LINEAR_____534_CM 1 0. 0. 522.7750632 DISPLAY_IDENTIFIER EGY_SP_BAS_IV_CLOSE_CTL__3_ ECU_ADDRESS 0x7f9eda BYTE_ORDER MSB_LAST /end MEASUREMENT
/begin MEASUREMENT sf_egy_sp_man_iv_close_ctl "status word for manual energy set point computed by IV_CLOSE controller" UWORD _CNV_A_R_LINEAR_____0_CM 1 0. 0. 65535. DISPLAY_IDENTIFIER SF_EGY_SP_MAN_IV_CLOSE_CTL ECU_ADDRESS 0x7f9edc BYTE_ORDER MSB_LAST FORMAT "%5.0" /end MEASUREMENT
/begin MEASUREMENT t_iv_close_mv_[0] "cylinder individual mean value of the injection valve closing time" UWORD _CNV_A_R_LINEAR_____533_CM 1 0. 0. 0.512 DISPLAY_IDENTIFIER T_IV_CLOSE_MV__0_ ECU_ADDRESS 0x7f9ede BYTE_ORDER MSB_LAST FORMAT "%4.3" /end MEASUREMENT
/begin MEASUREMENT t_iv_close_mv_[1] "cylinder individual mean value of the injection valve closing time" UWORD _CNV_A_R_LINEAR_____533_CM 1 0. 0. 0.512 DISPLAY_IDENTIFIER T_IV_CLOSE_MV__1_ ECU_ADDRESS 0x7f9ee0 BYTE_ORDER MSB_LAST FORMAT "%4.3" /end MEASUREMENT
/begin MEASUREMENT t_iv_close_mv_[2] "cylinder individual mean value of the injection valve closing time" UWORD _CNV_A_R_LINEAR_____533_CM 1 0. 0. 0.512 DISPLAY_IDENTIFIER T_IV_CLOSE_MV__2_ ECU_ADDRESS 0x7f9ee2 BYTE_ORDER MSB_LAST FORMAT "%4.3" /end MEASUREMENT
/begin MEASUREMENT t_iv_close_mv_[3] "cylinder individual mean value of the injection valve closing time" UWORD _CNV_A_R_LINEAR_____533_CM 1 0. 0. 0.512 DISPLAY_IDENTIFIER T_IV_CLOSE_MV__3_ ECU_ADDRESS 0x7f9ee4 BYTE_ORDER MSB_LAST FORMAT "%4.3" /end MEASUREMENT
/begin MEASUREMENT sf_mes_iv_close_vld "status word for injection valve close controller measurement valid" UWORD _CNV_A_R_LINEAR_____0_CM 1 0. 0. 65535. DISPLAY_IDENTIFIER SF_MES_IV_CLOSE_VLD ECU_ADDRESS 0x7f9ee6 BYTE_ORDER MSB_LAST FORMAT "%5.0" /end MEASUREMENT
/begin MEASUREMENT egy_sp_err_t_iv_close_ctl_[0] "closed loop T_IV_CLOSE controller´s output (cylinder individual)" SWORD _CNV_A_R_LINEAR_____535_CM 1 0. -261.3875315 261.3875315 DISPLAY_IDENTIFIER EGY_SP_ERR_T_IV_CLOSE_CTL__0_ ECU_ADDRESS 0x7faaae BYTE_ORDER MSB_LAST /end MEASUREMENT
/begin MEASUREMENT egy_sp_err_t_iv_close_ctl_[1] "closed loop T_IV_CLOSE controller´s output (cylinder individual)" SWORD _CNV_A_R_LINEAR_____535_CM 1 0. -261.3875315 261.3875315 DISPLAY_IDENTIFIER EGY_SP_ERR_T_IV_CLOSE_CTL__1_ ECU_ADDRESS 0x7faab0 BYTE_ORDER MSB_LAST /end MEASUREMENT
/begin MEASUREMENT egy_sp_err_t_iv_close_ctl_[2] "closed loop T_IV_CLOSE controller´s output (cylinder individual)" SWORD _CNV_A_R_LINEAR_____535_CM 1 0. -261.3875315 261.3875315 DISPLAY_IDENTIFIER EGY_SP_ERR_T_IV_CLOSE_CTL__2_ ECU_ADDRESS 0x7faab2 BYTE_ORDER MSB_LAST /end MEASUREMENT
/begin MEASUREMENT egy_sp_err_t_iv_close_ctl_[3] "closed loop T_IV_CLOSE controller´s output (cylinder individual)" SWORD _CNV_A_R_LINEAR_____535_CM 1 0. -261.3875315 261.3875315 DISPLAY_IDENTIFIER EGY_SP_ERR_T_IV_CLOSE_CTL__3_ ECU_ADDRESS 0x7faab4 BYTE_ORDER MSB_LAST /end MEASUREMENT
/begin MEASUREMENT i_ctl_iv_close_[0] "integral part of T_IV_CLOSE controller (cylinder individual)" SWORD _CNV_A_R_LINEAR_____535_CM 1 0. -261.3875315 261.3875315 DISPLAY_IDENTIFIER I_CTL_IV_CLOSE__0_ ECU_ADDRESS 0x7faab6 BYTE_ORDER MSB_LAST /end MEASUREMENT
/begin MEASUREMENT i_ctl_iv_close_[1] "integral part of T_IV_CLOSE controller (cylinder individual)" SWORD _CNV_A_R_LINEAR_____535_CM 1 0. -261.3875315 261.3875315 DISPLAY_IDENTIFIER I_CTL_IV_CLOSE__1_ ECU_ADDRESS 0x7faab8 BYTE_ORDER MSB_LAST /end MEASUREMENT
/begin MEASUREMENT i_ctl_iv_close_[2] "integral part of T_IV_CLOSE controller (cylinder individual)" SWORD _CNV_A_R_LINEAR_____535_CM 1 0. -261.3875315 261.3875315 DISPLAY_IDENTIFIER I_CTL_IV_CLOSE__2_ ECU_ADDRESS 0x7faaba BYTE_ORDER MSB_LAST /end MEASUREMENT
/begin MEASUREMENT i_ctl_iv_close_[3] "integral part of T_IV_CLOSE controller (cylinder individual)" SWORD _CNV_A_R_LINEAR_____535_CM 1 0. -261.3875315 261.3875315 DISPLAY_IDENTIFIER I_CTL_IV_CLOSE__3_ ECU_ADDRESS 0x7faabc BYTE_ORDER MSB_LAST /end MEASUREMENT
/begin MEASUREMENT i_ctl_soi_[0] "integral part of SOI controller (cylinder individual)" SWORD _CNV_A_R_LINEAR_____533_CM 1 0. -32.768 32.767 DISPLAY_IDENTIFIER I_CTL_SOI__0_ ECU_ADDRESS 0x7faabe BYTE_ORDER MSB_LAST FORMAT "%5.3" /end MEASUREMENT
/begin MEASUREMENT i_ctl_soi_[1] "integral part of SOI controller (cylinder individual)" SWORD _CNV_A_R_LINEAR_____533_CM 1 0. -32.768 32.767 DISPLAY_IDENTIFIER I_CTL_SOI__1_ ECU_ADDRESS 0x7faac0 BYTE_ORDER MSB_LAST FORMAT "%5.3" /end MEASUREMENT
/begin MEASUREMENT i_ctl_soi_[2] "integral part of SOI controller (cylinder individual)" SWORD _CNV_A_R_LINEAR_____533_CM 1 0. -32.768 32.767 DISPLAY_IDENTIFIER I_CTL_SOI__2_ ECU_ADDRESS 0x7faac2 BYTE_ORDER MSB_LAST FORMAT "%5.3" /end MEASUREMENT
/begin MEASUREMENT i_ctl_soi_[3] "integral part of SOI controller (cylinder individual)" SWORD _CNV_A_R_LINEAR_____533_CM 1 0. -32.768 32.767 DISPLAY_IDENTIFIER I_CTL_SOI__3_ ECU_ADDRESS 0x7faac4 BYTE_ORDER MSB_LAST FORMAT "%5.3" /end MEASUREMENT
/begin MEASUREMENT p_ctl_iv_close_[0] "proportional part of T_IV_CLOSE controller (cylinder individual)" SWORD _CNV_A_R_LINEAR_____535_CM 1 0. -261.3875315 261.3875315 DISPLAY_IDENTIFIER P_CTL_IV_CLOSE__0_ ECU_ADDRESS 0x7faac6 BYTE_ORDER MSB_LAST /end MEASUREMENT
/begin MEASUREMENT p_ctl_iv_close_[1] "proportional part of T_IV_CLOSE controller (cylinder individual)" SWORD _CNV_A_R_LINEAR_____535_CM 1 0. -261.3875315 261.3875315 DISPLAY_IDENTIFIER P_CTL_IV_CLOSE__1_ ECU_ADDRESS 0x7faac8 BYTE_ORDER MSB_LAST /end MEASUREMENT
/begin MEASUREMENT p_ctl_iv_close_[2] "proportional part of T_IV_CLOSE controller (cylinder individual)" SWORD _CNV_A_R_LINEAR_____535_CM 1 0. -261.3875315 261.3875315 DISPLAY_IDENTIFIER P_CTL_IV_CLOSE__2_ ECU_ADDRESS 0x7faaca BYTE_ORDER MSB_LAST /end MEASUREMENT
/begin MEASUREMENT p_ctl_iv_close_[3] "proportional part of T_IV_CLOSE controller (cylinder individual)" SWORD _CNV_A_R_LINEAR_____535_CM 1 0. -261.3875315 261.3875315 DISPLAY_IDENTIFIER P_CTL_IV_CLOSE__3_ ECU_ADDRESS 0x7faacc BYTE_ORDER MSB_LAST /end MEASUREMENT
/begin MEASUREMENT p_ctl_soi_[0] "proportional part of SOI controller (cylinder individual)" SWORD _CNV_A_R_LINEAR_____533_CM 1 0. -32.768 32.767 DISPLAY_IDENTIFIER P_CTL_SOI__0_ ECU_ADDRESS 0x7faace BYTE_ORDER MSB_LAST FORMAT "%5.3" /end MEASUREMENT
/begin MEASUREMENT p_ctl_soi_[1] "proportional part of SOI controller (cylinder individual)" SWORD _CNV_A_R_LINEAR_____533_CM 1 0. -32.768 32.767 DISPLAY_IDENTIFIER P_CTL_SOI__1_ ECU_ADDRESS 0x7faad0 BYTE_ORDER MSB_LAST FORMAT "%5.3" /end MEASUREMENT
/begin MEASUREMENT p_ctl_soi_[2] "proportional part of SOI controller (cylinder individual)" SWORD _CNV_A_R_LINEAR_____533_CM 1 0. -32.768 32.767 DISPLAY_IDENTIFIER P_CTL_SOI__2_ ECU_ADDRESS 0x7faad2 BYTE_ORDER MSB_LAST FORMAT "%5.3" /end MEASUREMENT
/begin MEASUREMENT p_ctl_soi_[3] "proportional part of SOI controller (cylinder individual)" SWORD _CNV_A_R_LINEAR_____533_CM 1 0. -32.768 32.767 DISPLAY_IDENTIFIER P_CTL_SOI__3_ ECU_ADDRESS 0x7faad4 BYTE_ORDER MSB_LAST FORMAT "%5.3" /end MEASUREMENT
/begin MEASUREMENT seg_nr_t_iv_close_ctl "actual segment number of T_IV_CLOSE controller" UBYTE _CNV_A_R_LINEAR_____0_CM 1 0. 0. 15. DISPLAY_IDENTIFIER SEG_NR_T_IV_CLOSE_CTL ECU_ADDRESS 0x7fbb09 FORMAT "%2.0" /end MEASUREMENT
/begin MEASUREMENT sf_iv_close_ctl_act "status word for active T_IV_CLOSE controller" UWORD _CNV_A_R_LINEAR_____0_CM 1 0. 0. 65535. DISPLAY_IDENTIFIER SF_IV_CLOSE_CTL_ACT ECU_ADDRESS 0x7faad6 BYTE_ORDER MSB_LAST FORMAT "%5.0" /end MEASUREMENT
/begin MEASUREMENT sf_pi_ctl_iv_close_max "status word for max reached in T_IV_CLOSE controller" UWORD _CNV_A_R_LINEAR_____0_CM 1 0. 0. 65535. DISPLAY_IDENTIFIER SF_PI_CTL_IV_CLOSE_MAX ECU_ADDRESS 0x7faad8 BYTE_ORDER MSB_LAST FORMAT "%5.0" /end MEASUREMENT
/begin MEASUREMENT sf_pi_ctl_iv_close_min "status word for min reached in T_IV_CLOSE controller" UWORD _CNV_A_R_LINEAR_____0_CM 1 0. 0. 65535. DISPLAY_IDENTIFIER SF_PI_CTL_IV_CLOSE_MIN ECU_ADDRESS 0x7faada BYTE_ORDER MSB_LAST FORMAT "%5.0" /end MEASUREMENT
/begin MEASUREMENT sf_pi_ctl_soi_max "status word for max reached in SOI controller" UWORD _CNV_A_R_LINEAR_____0_CM 1 0. 0. 65535. DISPLAY_IDENTIFIER SF_PI_CTL_SOI_MAX ECU_ADDRESS 0x7faadc BYTE_ORDER MSB_LAST FORMAT "%5.0" /end MEASUREMENT
/begin MEASUREMENT sf_pi_ctl_soi_min "status word for min reached in SOI controller" UWORD _CNV_A_R_LINEAR_____0_CM 1 0. 0. 65535. DISPLAY_IDENTIFIER SF_PI_CTL_SOI_MIN ECU_ADDRESS 0x7faade BYTE_ORDER MSB_LAST FORMAT "%5.0" /end MEASUREMENT
/begin MEASUREMENT sf_soi_ctl_act "status word for active SOI controller" UWORD _CNV_A_R_LINEAR_____0_CM 1 0. 0. 65535. DISPLAY_IDENTIFIER SF_SOI_CTL_ACT ECU_ADDRESS 0x7faae0 BYTE_ORDER MSB_LAST FORMAT "%5.0" /end MEASUREMENT
/begin MEASUREMENT t_iv_close_dif_[0] "control deviation of T_IV_CLOSE controller (cylinder individual)" SWORD _CNV_A_R_LINEAR_____533_CM 1 0. -0.512 0.512 DISPLAY_IDENTIFIER T_IV_CLOSE_DIF__0_ ECU_ADDRESS 0x7faae2 BYTE_ORDER MSB_LAST FORMAT "%4.3" /end MEASUREMENT
/begin MEASUREMENT t_iv_close_dif_[1] "control deviation of T_IV_CLOSE controller (cylinder individual)" SWORD _CNV_A_R_LINEAR_____533_CM 1 0. -0.512 0.512 DISPLAY_IDENTIFIER T_IV_CLOSE_DIF__1_ ECU_ADDRESS 0x7faae4 BYTE_ORDER MSB_LAST FORMAT "%4.3" /end MEASUREMENT
/begin MEASUREMENT t_iv_close_dif_[2] "control deviation of T_IV_CLOSE controller (cylinder individual)" SWORD _CNV_A_R_LINEAR_____533_CM 1 0. -0.512 0.512 DISPLAY_IDENTIFIER T_IV_CLOSE_DIF__2_ ECU_ADDRESS 0x7faae6 BYTE_ORDER MSB_LAST FORMAT "%4.3" /end MEASUREMENT
/begin MEASUREMENT t_iv_close_dif_[3] "control deviation of T_IV_CLOSE controller (cylinder individual)" SWORD _CNV_A_R_LINEAR_____533_CM 1 0. -0.512 0.512 DISPLAY_IDENTIFIER T_IV_CLOSE_DIF__3_ ECU_ADDRESS 0x7faae8 BYTE_ORDER MSB_LAST FORMAT "%4.3" /end MEASUREMENT
/begin MEASUREMENT t_iv_close_soi_ctl_dif_[0] "control deviation of SOI controller (cylinder individual)" SWORD _CNV_A_R_LINEAR_____533_CM 1 0. -32.768 32.767 DISPLAY_IDENTIFIER T_IV_CLOSE_SOI_CTL_DIF__0_ ECU_ADDRESS 0x7faaea BYTE_ORDER MSB_LAST FORMAT "%5.3" /end MEASUREMENT
/begin MEASUREMENT t_iv_close_soi_ctl_dif_[1] "control deviation of SOI controller (cylinder individual)" SWORD _CNV_A_R_LINEAR_____533_CM 1 0. -32.768 32.767 DISPLAY_IDENTIFIER T_IV_CLOSE_SOI_CTL_DIF__1_ ECU_ADDRESS 0x7faaec BYTE_ORDER MSB_LAST FORMAT "%5.3" /end MEASUREMENT
/begin MEASUREMENT t_iv_close_soi_ctl_dif_[2] "control deviation of SOI controller (cylinder individual)" SWORD _CNV_A_R_LINEAR_____533_CM 1 0. -32.768 32.767 DISPLAY_IDENTIFIER T_IV_CLOSE_SOI_CTL_DIF__2_ ECU_ADDRESS 0x7faaee BYTE_ORDER MSB_LAST FORMAT "%5.3" /end MEASUREMENT
/begin MEASUREMENT t_iv_close_soi_ctl_dif_[3] "control deviation of SOI controller (cylinder individual)" SWORD _CNV_A_R_LINEAR_____533_CM 1 0. -32.768 32.767 DISPLAY_IDENTIFIER T_IV_CLOSE_SOI_CTL_DIF__3_ ECU_ADDRESS 0x7faaf0 BYTE_ORDER MSB_LAST FORMAT "%5.3" /end MEASUREMENT
/begin MEASUREMENT t_iv_close_sp_mv_[0] "cylinder individual mean value of the injection valve closing time set point" UWORD _CNV_A_R_LINEAR_____533_CM 1 0. 0. 0.512 DISPLAY_IDENTIFIER T_IV_CLOSE_SP_MV__0_ ECU_ADDRESS 0x7faaf2 BYTE_ORDER MSB_LAST FORMAT "%4.3" /end MEASUREMENT
/begin MEASUREMENT t_iv_close_sp_mv_[1] "cylinder individual mean value of the injection valve closing time set point" UWORD _CNV_A_R_LINEAR_____533_CM 1 0. 0. 0.512 DISPLAY_IDENTIFIER T_IV_CLOSE_SP_MV__1_ ECU_ADDRESS 0x7faaf4 BYTE_ORDER MSB_LAST FORMAT "%4.3" /end MEASUREMENT
/begin MEASUREMENT t_iv_close_sp_mv_[2] "cylinder individual mean value of the injection valve closing time set point" UWORD _CNV_A_R_LINEAR_____533_CM 1 0. 0. 0.512 DISPLAY_IDENTIFIER T_IV_CLOSE_SP_MV__2_ ECU_ADDRESS 0x7faaf6 BYTE_ORDER MSB_LAST FORMAT "%4.3" /end MEASUREMENT
/begin MEASUREMENT t_iv_close_sp_mv_[3] "cylinder individual mean value of the injection valve closing time set point" UWORD _CNV_A_R_LINEAR_____533_CM 1 0. 0. 0.512 DISPLAY_IDENTIFIER T_IV_CLOSE_SP_MV__3_ ECU_ADDRESS 0x7faaf8 BYTE_ORDER MSB_LAST FORMAT "%4.3" /end MEASUREMENT
/begin MEASUREMENT t_iv_close_[0] "injector valve closing time (cylinder individual)" UWORD _CNV_A_R_LINEAR_____533_CM 1 0. 0. 0.512 DISPLAY_IDENTIFIER T_IV_CLOSE__0_ ECU_ADDRESS 0x7f9ee8 BYTE_ORDER MSB_LAST FORMAT "%4.3" /end MEASUREMENT
/begin MEASUREMENT t_iv_close_[1] "injector valve closing time (cylinder individual)" UWORD _CNV_A_R_LINEAR_____533_CM 1 0. 0. 0.512 DISPLAY_IDENTIFIER T_IV_CLOSE__1_ ECU_ADDRESS 0x7f9eea BYTE_ORDER MSB_LAST FORMAT "%4.3" /end MEASUREMENT
/begin MEASUREMENT t_iv_close_[2] "injector valve closing time (cylinder individual)" UWORD _CNV_A_R_LINEAR_____533_CM 1 0. 0. 0.512 DISPLAY_IDENTIFIER T_IV_CLOSE__2_ ECU_ADDRESS 0x7f9eec BYTE_ORDER MSB_LAST FORMAT "%4.3" /end MEASUREMENT
/begin MEASUREMENT t_iv_close_[3] "injector valve closing time (cylinder individual)" UWORD _CNV_A_R_LINEAR_____533_CM 1 0. 0. 0.512 DISPLAY_IDENTIFIER T_IV_CLOSE__3_ ECU_ADDRESS 0x7f9eee BYTE_ORDER MSB_LAST FORMAT "%4.3" /end MEASUREMENT
/begin MEASUREMENT v_delta_iv_foc_[0] "difference of injector voltage at detection point and last point (cylinder individual)" UWORD _CNV_A_R_LINEAR_____123_CM 1 0. 0. 255. DISPLAY_IDENTIFIER V_DELTA_IV_FOC__0_ ECU_ADDRESS 0x7f9ef0 BYTE_ORDER MSB_LAST FORMAT "%4.1" /end MEASUREMENT
/begin MEASUREMENT v_delta_iv_foc_[1] "difference of injector voltage at detection point and last point (cylinder individual)" UWORD _CNV_A_R_LINEAR_____123_CM 1 0. 0. 255. DISPLAY_IDENTIFIER V_DELTA_IV_FOC__1_ ECU_ADDRESS 0x7f9ef2 BYTE_ORDER MSB_LAST FORMAT "%4.1" /end MEASUREMENT
/begin MEASUREMENT v_delta_iv_foc_[2] "difference of injector voltage at detection point and last point (cylinder individual)" UWORD _CNV_A_R_LINEAR_____123_CM 1 0. 0. 255. DISPLAY_IDENTIFIER V_DELTA_IV_FOC__2_ ECU_ADDRESS 0x7f9ef4 BYTE_ORDER MSB_LAST FORMAT "%4.1" /end MEASUREMENT
/begin MEASUREMENT v_delta_iv_foc_[3] "difference of injector voltage at detection point and last point (cylinder individual)" UWORD _CNV_A_R_LINEAR_____123_CM 1 0. 0. 255. DISPLAY_IDENTIFIER V_DELTA_IV_FOC__3_ ECU_ADDRESS 0x7f9ef6 BYTE_ORDER MSB_LAST FORMAT "%4.1" /end MEASUREMENT
/begin MEASUREMENT v_delta_iv_foc_rel_[0] "difference of injector voltage at detection point and last point divided by voltage at detection point (cyl. individual)" UWORD _CNV_A_R_LINEAR_____361_CM 1 0. 0. 255. DISPLAY_IDENTIFIER V_DELTA_IV_FOC_REL__0_ ECU_ADDRESS 0x7f9ef8 BYTE_ORDER MSB_LAST /end MEASUREMENT
/begin MEASUREMENT v_delta_iv_foc_rel_[1] "difference of injector voltage at detection point and last point divided by voltage at detection point (cyl. individual)" UWORD _CNV_A_R_LINEAR_____361_CM 1 0. 0. 255. DISPLAY_IDENTIFIER V_DELTA_IV_FOC_REL__1_ ECU_ADDRESS 0x7f9efa BYTE_ORDER MSB_LAST /end MEASUREMENT
/begin MEASUREMENT v_delta_iv_foc_rel_[2] "difference of injector voltage at detection point and last point divided by voltage at detection point (cyl. individual)" UWORD _CNV_A_R_LINEAR_____361_CM 1 0. 0. 255. DISPLAY_IDENTIFIER V_DELTA_IV_FOC_REL__2_ ECU_ADDRESS 0x7f9efc BYTE_ORDER MSB_LAST /end MEASUREMENT
/begin MEASUREMENT v_delta_iv_foc_rel_[3] "difference of injector voltage at detection point and last point divided by voltage at detection point (cyl. individual)" UWORD _CNV_A_R_LINEAR_____361_CM 1 0. 0. 255. DISPLAY_IDENTIFIER V_DELTA_IV_FOC_REL__3_ ECU_ADDRESS 0x7f9efe BYTE_ORDER MSB_LAST /end MEASUREMENT
/begin MEASUREMENT egy_inj_det_dif_fil_[0] "injector energy between last and detection point (filtered, cylinder individual)" UWORD _CNV_A_R_LINEAR_____534_CM 1 0. 0. 522.7750632 DISPLAY_IDENTIFIER EGY_INJ_DET_DIF_FIL__0_ ECU_ADDRESS 0x7faafa BYTE_ORDER MSB_LAST /end MEASUREMENT
/begin MEASUREMENT egy_inj_det_dif_fil_[1] "injector energy between last and detection point (filtered, cylinder individual)" UWORD _CNV_A_R_LINEAR_____534_CM 1 0. 0. 522.7750632 DISPLAY_IDENTIFIER EGY_INJ_DET_DIF_FIL__1_ ECU_ADDRESS 0x7faafc BYTE_ORDER MSB_LAST /end MEASUREMENT
/begin MEASUREMENT egy_inj_det_dif_fil_[2] "injector energy between last and detection point (filtered, cylinder individual)" UWORD _CNV_A_R_LINEAR_____534_CM 1 0. 0. 522.7750632 DISPLAY_IDENTIFIER EGY_INJ_DET_DIF_FIL__2_ ECU_ADDRESS 0x7faafe BYTE_ORDER MSB_LAST /end MEASUREMENT
/begin MEASUREMENT egy_inj_det_dif_fil_[3] "injector energy between last and detection point (filtered, cylinder individual)" UWORD _CNV_A_R_LINEAR_____534_CM 1 0. 0. 522.7750632 DISPLAY_IDENTIFIER EGY_INJ_DET_DIF_FIL__3_ ECU_ADDRESS 0x7fab00 BYTE_ORDER MSB_LAST /end MEASUREMENT
/begin MEASUREMENT egy_inj_det_dif_[0] "injector energy between last and detection point (cylinder individual)" UWORD _CNV_A_R_LINEAR_____534_CM 1 0. 0. 522.7750632 DISPLAY_IDENTIFIER EGY_INJ_DET_DIF__0_ ECU_ADDRESS 0x7fab02 BYTE_ORDER MSB_LAST /end MEASUREMENT
/begin MEASUREMENT egy_inj_det_dif_[1] "injector energy between last and detection point (cylinder individual)" UWORD _CNV_A_R_LINEAR_____534_CM 1 0. 0. 522.7750632 DISPLAY_IDENTIFIER EGY_INJ_DET_DIF__1_ ECU_ADDRESS 0x7fab04 BYTE_ORDER MSB_LAST /end MEASUREMENT
/begin MEASUREMENT egy_inj_det_dif_[2] "injector energy between last and detection point (cylinder individual)" UWORD _CNV_A_R_LINEAR_____534_CM 1 0. 0. 522.7750632 DISPLAY_IDENTIFIER EGY_INJ_DET_DIF__2_ ECU_ADDRESS 0x7fab06 BYTE_ORDER MSB_LAST /end MEASUREMENT
/begin MEASUREMENT egy_inj_det_dif_[3] "injector energy between last and detection point (cylinder individual)" UWORD _CNV_A_R_LINEAR_____534_CM 1 0. 0. 522.7750632 DISPLAY_IDENTIFIER EGY_INJ_DET_DIF__3_ ECU_ADDRESS 0x7fab08 BYTE_ORDER MSB_LAST /end MEASUREMENT
/begin MEASUREMENT egy_inj_det_fil_[0] "injector energy at detection point (filtered, cylinder individual)" UWORD _CNV_A_R_LINEAR_____534_CM 1 0. 0. 522.7750632 DISPLAY_IDENTIFIER EGY_INJ_DET_FIL__0_ ECU_ADDRESS 0x7fab0a BYTE_ORDER MSB_LAST /end MEASUREMENT
/begin MEASUREMENT egy_inj_det_fil_[1] "injector energy at detection point (filtered, cylinder individual)" UWORD _CNV_A_R_LINEAR_____534_CM 1 0. 0. 522.7750632 DISPLAY_IDENTIFIER EGY_INJ_DET_FIL__1_ ECU_ADDRESS 0x7fab0c BYTE_ORDER MSB_LAST /end MEASUREMENT
/begin MEASUREMENT egy_inj_det_fil_[2] "injector energy at detection point (filtered, cylinder individual)" UWORD _CNV_A_R_LINEAR_____534_CM 1 0. 0. 522.7750632 DISPLAY_IDENTIFIER EGY_INJ_DET_FIL__2_ ECU_ADDRESS 0x7fab0e BYTE_ORDER MSB_LAST /end MEASUREMENT
/begin MEASUREMENT egy_inj_det_fil_[3] "injector energy at detection point (filtered, cylinder individual)" UWORD _CNV_A_R_LINEAR_____534_CM 1 0. 0. 522.7750632 DISPLAY_IDENTIFIER EGY_INJ_DET_FIL__3_ ECU_ADDRESS 0x7fab10 BYTE_ORDER MSB_LAST /end MEASUREMENT
/begin MEASUREMENT egy_inj_det_[0] "injector energy at detection point (cylinder individual)" UWORD _CNV_A_R_LINEAR_____534_CM 1 0. 0. 522.7750632 DISPLAY_IDENTIFIER EGY_INJ_DET__0_ ECU_ADDRESS 0x7fab12 BYTE_ORDER MSB_LAST /end MEASUREMENT
/begin MEASUREMENT egy_inj_det_[1] "injector energy at detection point (cylinder individual)" UWORD _CNV_A_R_LINEAR_____534_CM 1 0. 0. 522.7750632 DISPLAY_IDENTIFIER EGY_INJ_DET__1_ ECU_ADDRESS 0x7fab14 BYTE_ORDER MSB_LAST /end MEASUREMENT
/begin MEASUREMENT egy_inj_det_[2] "injector energy at detection point (cylinder individual)" UWORD _CNV_A_R_LINEAR_____534_CM 1 0. 0. 522.7750632 DISPLAY_IDENTIFIER EGY_INJ_DET__2_ ECU_ADDRESS 0x7fab16 BYTE_ORDER MSB_LAST /end MEASUREMENT
/begin MEASUREMENT egy_inj_det_[3] "injector energy at detection point (cylinder individual)" UWORD _CNV_A_R_LINEAR_____534_CM 1 0. 0. 522.7750632 DISPLAY_IDENTIFIER EGY_INJ_DET__3_ ECU_ADDRESS 0x7fab18 BYTE_ORDER MSB_LAST /end MEASUREMENT
/begin MEASUREMENT egy_inj_lst_[0] "injector energy at last point (cylinder individual)" UWORD _CNV_A_R_LINEAR_____534_CM 1 0. 0. 522.7750632 DISPLAY_IDENTIFIER EGY_INJ_LST__0_ ECU_ADDRESS 0x7fab1a BYTE_ORDER MSB_LAST /end MEASUREMENT
/begin MEASUREMENT egy_inj_lst_[1] "injector energy at last point (cylinder individual)" UWORD _CNV_A_R_LINEAR_____534_CM 1 0. 0. 522.7750632 DISPLAY_IDENTIFIER EGY_INJ_LST__1_ ECU_ADDRESS 0x7fab1c BYTE_ORDER MSB_LAST /end MEASUREMENT
/begin MEASUREMENT egy_inj_lst_[2] "injector energy at last point (cylinder individual)" UWORD _CNV_A_R_LINEAR_____534_CM 1 0. 0. 522.7750632 DISPLAY_IDENTIFIER EGY_INJ_LST__2_ ECU_ADDRESS 0x7fab1e BYTE_ORDER MSB_LAST /end MEASUREMENT
/begin MEASUREMENT egy_inj_lst_[3] "injector energy at last point (cylinder individual)" UWORD _CNV_A_R_LINEAR_____534_CM 1 0. 0. 522.7750632 DISPLAY_IDENTIFIER EGY_INJ_LST__3_ ECU_ADDRESS 0x7fab20 BYTE_ORDER MSB_LAST /end MEASUREMENT
/begin MEASUREMENT nr_v_inj_dif_det_values_[0] "positions of maximal risings in voltage burst signal" UBYTE _CNV_A_R_LINEAR_____0_CM 1 0. 0. 255. DISPLAY_IDENTIFIER NR_V_INJ_DIF_DET_VALUES__0_ ECU_ADDRESS 0x7fbb0a FORMAT "%3.0" /end MEASUREMENT
/begin MEASUREMENT nr_v_inj_dif_det_values_[1] "positions of maximal risings in voltage burst signal" UBYTE _CNV_A_R_LINEAR_____0_CM 1 0. 0. 255. DISPLAY_IDENTIFIER NR_V_INJ_DIF_DET_VALUES__1_ ECU_ADDRESS 0x7fbb0b FORMAT "%3.0" /end MEASUREMENT
/begin MEASUREMENT nr_v_inj_dif_det_values_[2] "positions of maximal risings in voltage burst signal" UBYTE _CNV_A_R_LINEAR_____0_CM 1 0. 0. 255. DISPLAY_IDENTIFIER NR_V_INJ_DIF_DET_VALUES__2_ ECU_ADDRESS 0x7fbb0c FORMAT "%3.0" /end MEASUREMENT
/begin MEASUREMENT nr_v_inj_dif_det_values_[3] "positions of maximal risings in voltage burst signal" UBYTE _CNV_A_R_LINEAR_____0_CM 1 0. 0. 255. DISPLAY_IDENTIFIER NR_V_INJ_DIF_DET_VALUES__3_ ECU_ADDRESS 0x7fbb0d FORMAT "%3.0" /end MEASUREMENT
/begin MEASUREMENT nr_v_inj_dif_det_values_[4] "positions of maximal risings in voltage burst signal" UBYTE _CNV_A_R_LINEAR_____0_CM 1 0. 0. 255. DISPLAY_IDENTIFIER NR_V_INJ_DIF_DET_VALUES__4_ ECU_ADDRESS 0x7fbb0e FORMAT "%3.0" /end MEASUREMENT
/begin MEASUREMENT nr_v_inj_dif_det_values_[5] "positions of maximal risings in voltage burst signal" UBYTE _CNV_A_R_LINEAR_____0_CM 1 0. 0. 255. DISPLAY_IDENTIFIER NR_V_INJ_DIF_DET_VALUES__5_ ECU_ADDRESS 0x7fbb0f FORMAT "%3.0" /end MEASUREMENT
/begin MEASUREMENT nr_v_inj_dif_det_value_[0] "detection point of maximum injection voltage derivation (cylinder individual)" UBYTE _CNV_A_R_LINEAR_____0_CM 1 0. 0. 255. DISPLAY_IDENTIFIER NR_V_INJ_DIF_DET_VALUE__0_ ECU_ADDRESS 0x7fbb10 FORMAT "%3.0" /end MEASUREMENT
/begin MEASUREMENT nr_v_inj_dif_det_value_[1] "detection point of maximum injection voltage derivation (cylinder individual)" UBYTE _CNV_A_R_LINEAR_____0_CM 1 0. 0. 255. DISPLAY_IDENTIFIER NR_V_INJ_DIF_DET_VALUE__1_ ECU_ADDRESS 0x7fbb11 FORMAT "%3.0" /end MEASUREMENT
/begin MEASUREMENT nr_v_inj_dif_det_value_[2] "detection point of maximum injection voltage derivation (cylinder individual)" UBYTE _CNV_A_R_LINEAR_____0_CM 1 0. 0. 255. DISPLAY_IDENTIFIER NR_V_INJ_DIF_DET_VALUE__2_ ECU_ADDRESS 0x7fbb12 FORMAT "%3.0" /end MEASUREMENT
/begin MEASUREMENT nr_v_inj_dif_det_value_[3] "detection point of maximum injection voltage derivation (cylinder individual)" UBYTE _CNV_A_R_LINEAR_____0_CM 1 0. 0. 255. DISPLAY_IDENTIFIER NR_V_INJ_DIF_DET_VALUE__3_ ECU_ADDRESS 0x7fbb13 FORMAT "%3.0" /end MEASUREMENT
/begin MEASUREMENT q_inj_burst_act_[0] "charge burst signal (prepared for detection)" UWORD _CNV_A_R_LINEAR_____124_CM 1 0. 0. 4095.9375 DISPLAY_IDENTIFIER Q_INJ_BURST_ACT__0_ ECU_ADDRESS 0x7fab22 BYTE_ORDER MSB_LAST FORMAT "%6.2" /end MEASUREMENT
/begin MEASUREMENT q_inj_burst_act_[1] "charge burst signal (prepared for detection)" UWORD _CNV_A_R_LINEAR_____124_CM 1 0. 0. 4095.9375 DISPLAY_IDENTIFIER Q_INJ_BURST_ACT__1_ ECU_ADDRESS 0x7fab24 BYTE_ORDER MSB_LAST FORMAT "%6.2" /end MEASUREMENT
/begin MEASUREMENT q_inj_burst_act_[2] "charge burst signal (prepared for detection)" UWORD _CNV_A_R_LINEAR_____124_CM 1 0. 0. 4095.9375 DISPLAY_IDENTIFIER Q_INJ_BURST_ACT__2_ ECU_ADDRESS 0x7fab26 BYTE_ORDER MSB_LAST FORMAT "%6.2" /end MEASUREMENT
/begin MEASUREMENT q_inj_burst_act_[3] "charge burst signal (prepared for detection)" UWORD _CNV_A_R_LINEAR_____124_CM 1 0. 0. 4095.9375 DISPLAY_IDENTIFIER Q_INJ_BURST_ACT__3_ ECU_ADDRESS 0x7fab28 BYTE_ORDER MSB_LAST FORMAT "%6.2" /end MEASUREMENT
/begin MEASUREMENT q_inj_burst_act_[4] "charge burst signal (prepared for detection)" UWORD _CNV_A_R_LINEAR_____124_CM 1 0. 0. 4095.9375 DISPLAY_IDENTIFIER Q_INJ_BURST_ACT__4_ ECU_ADDRESS 0x7fab2a BYTE_ORDER MSB_LAST FORMAT "%6.2" /end MEASUREMENT
/begin MEASUREMENT q_inj_burst_act_[5] "charge burst signal (prepared for detection)" UWORD _CNV_A_R_LINEAR_____124_CM 1 0. 0. 4095.9375 DISPLAY_IDENTIFIER Q_INJ_BURST_ACT__5_ ECU_ADDRESS 0x7fab2c BYTE_ORDER MSB_LAST FORMAT "%6.2" /end MEASUREMENT
/begin MEASUREMENT q_inj_burst_act_[6] "charge burst signal (prepared for detection)" UWORD _CNV_A_R_LINEAR_____124_CM 1 0. 0. 4095.9375 DISPLAY_IDENTIFIER Q_INJ_BURST_ACT__6_ ECU_ADDRESS 0x7fab2e BYTE_ORDER MSB_LAST FORMAT "%6.2" /end MEASUREMENT
/begin MEASUREMENT q_inj_burst_act_[7] "charge burst signal (prepared for detection)" UWORD _CNV_A_R_LINEAR_____124_CM 1 0. 0. 4095.9375 DISPLAY_IDENTIFIER Q_INJ_BURST_ACT__7_ ECU_ADDRESS 0x7fab30 BYTE_ORDER MSB_LAST FORMAT "%6.2" /end MEASUREMENT
/begin MEASUREMENT q_inj_burst_act_[8] "charge burst signal (prepared for detection)" UWORD _CNV_A_R_LINEAR_____124_CM 1 0. 0. 4095.9375 DISPLAY_IDENTIFIER Q_INJ_BURST_ACT__8_ ECU_ADDRESS 0x7fab32 BYTE_ORDER MSB_LAST FORMAT "%6.2" /end MEASUREMENT
/begin MEASUREMENT q_inj_burst_act_[9] "charge burst signal (prepared for detection)" UWORD _CNV_A_R_LINEAR_____124_CM 1 0. 0. 4095.9375 DISPLAY_IDENTIFIER Q_INJ_BURST_ACT__9_ ECU_ADDRESS 0x7fab34 BYTE_ORDER MSB_LAST FORMAT "%6.2" /end MEASUREMENT
/begin MEASUREMENT q_inj_burst_act_[10] "charge burst signal (prepared for detection)" UWORD _CNV_A_R_LINEAR_____124_CM 1 0. 0. 4095.9375 DISPLAY_IDENTIFIER Q_INJ_BURST_ACT__10_ ECU_ADDRESS 0x7fab36 BYTE_ORDER MSB_LAST FORMAT "%6.2" /end MEASUREMENT
/begin MEASUREMENT q_inj_burst_act_[11] "charge burst signal (prepared for detection)" UWORD _CNV_A_R_LINEAR_____124_CM 1 0. 0. 4095.9375 DISPLAY_IDENTIFIER Q_INJ_BURST_ACT__11_ ECU_ADDRESS 0x7fab38 BYTE_ORDER MSB_LAST FORMAT "%6.2" /end MEASUREMENT
/begin MEASUREMENT q_inj_burst_act_[12] "charge burst signal (prepared for detection)" UWORD _CNV_A_R_LINEAR_____124_CM 1 0. 0. 4095.9375 DISPLAY_IDENTIFIER Q_INJ_BURST_ACT__12_ ECU_ADDRESS 0x7fab3a BYTE_ORDER MSB_LAST FORMAT "%6.2" /end MEASUREMENT
/begin MEASUREMENT q_inj_burst_act_[13] "charge burst signal (prepared for detection)" UWORD _CNV_A_R_LINEAR_____124_CM 1 0. 0. 4095.9375 DISPLAY_IDENTIFIER Q_INJ_BURST_ACT__13_ ECU_ADDRESS 0x7fab3c BYTE_ORDER MSB_LAST FORMAT "%6.2" /end MEASUREMENT
/begin MEASUREMENT q_inj_burst_act_[14] "charge burst signal (prepared for detection)" UWORD _CNV_A_R_LINEAR_____124_CM 1 0. 0. 4095.9375 DISPLAY_IDENTIFIER Q_INJ_BURST_ACT__14_ ECU_ADDRESS 0x7fab3e BYTE_ORDER MSB_LAST FORMAT "%6.2" /end MEASUREMENT
/begin MEASUREMENT q_inj_burst_act_[15] "charge burst signal (prepared for detection)" UWORD _CNV_A_R_LINEAR_____124_CM 1 0. 0. 4095.9375 DISPLAY_IDENTIFIER Q_INJ_BURST_ACT__15_ ECU_ADDRESS 0x7fab40 BYTE_ORDER MSB_LAST FORMAT "%6.2" /end MEASUREMENT
/begin MEASUREMENT q_inj_burst_act_[16] "charge burst signal (prepared for detection)" UWORD _CNV_A_R_LINEAR_____124_CM 1 0. 0. 4095.9375 DISPLAY_IDENTIFIER Q_INJ_BURST_ACT__16_ ECU_ADDRESS 0x7fab42 BYTE_ORDER MSB_LAST FORMAT "%6.2" /end MEASUREMENT
/begin MEASUREMENT q_inj_burst_act_[17] "charge burst signal (prepared for detection)" UWORD _CNV_A_R_LINEAR_____124_CM 1 0. 0. 4095.9375 DISPLAY_IDENTIFIER Q_INJ_BURST_ACT__17_ ECU_ADDRESS 0x7fab44 BYTE_ORDER MSB_LAST FORMAT "%6.2" /end MEASUREMENT
/begin MEASUREMENT q_inj_burst_act_[18] "charge burst signal (prepared for detection)" UWORD _CNV_A_R_LINEAR_____124_CM 1 0. 0. 4095.9375 DISPLAY_IDENTIFIER Q_INJ_BURST_ACT__18_ ECU_ADDRESS 0x7fab46 BYTE_ORDER MSB_LAST FORMAT "%6.2" /end MEASUREMENT
/begin MEASUREMENT q_inj_burst_act_[19] "charge burst signal (prepared for detection)" UWORD _CNV_A_R_LINEAR_____124_CM 1 0. 0. 4095.9375 DISPLAY_IDENTIFIER Q_INJ_BURST_ACT__19_ ECU_ADDRESS 0x7fab48 BYTE_ORDER MSB_LAST FORMAT "%6.2" /end MEASUREMENT
/begin MEASUREMENT q_inj_burst_act_[20] "charge burst signal (prepared for detection)" UWORD _CNV_A_R_LINEAR_____124_CM 1 0. 0. 4095.9375 DISPLAY_IDENTIFIER Q_INJ_BURST_ACT__20_ ECU_ADDRESS 0x7fab4a BYTE_ORDER MSB_LAST FORMAT "%6.2" /end MEASUREMENT
/begin MEASUREMENT q_inj_burst_act_[21] "charge burst signal (prepared for detection)" UWORD _CNV_A_R_LINEAR_____124_CM 1 0. 0. 4095.9375 DISPLAY_IDENTIFIER Q_INJ_BURST_ACT__21_ ECU_ADDRESS 0x7fab4c BYTE_ORDER MSB_LAST FORMAT "%6.2" /end MEASUREMENT
/begin MEASUREMENT q_inj_burst_act_[22] "charge burst signal (prepared for detection)" UWORD _CNV_A_R_LINEAR_____124_CM 1 0. 0. 4095.9375 DISPLAY_IDENTIFIER Q_INJ_BURST_ACT__22_ ECU_ADDRESS 0x7fab4e BYTE_ORDER MSB_LAST FORMAT "%6.2" /end MEASUREMENT
/begin MEASUREMENT q_inj_burst_act_[23] "charge burst signal (prepared for detection)" UWORD _CNV_A_R_LINEAR_____124_CM 1 0. 0. 4095.9375 DISPLAY_IDENTIFIER Q_INJ_BURST_ACT__23_ ECU_ADDRESS 0x7fab50 BYTE_ORDER MSB_LAST FORMAT "%6.2" /end MEASUREMENT
/begin MEASUREMENT q_inj_burst_act_[24] "charge burst signal (prepared for detection)" UWORD _CNV_A_R_LINEAR_____124_CM 1 0. 0. 4095.9375 DISPLAY_IDENTIFIER Q_INJ_BURST_ACT__24_ ECU_ADDRESS 0x7fab52 BYTE_ORDER MSB_LAST FORMAT "%6.2" /end MEASUREMENT
/begin MEASUREMENT q_inj_burst_act_[25] "charge burst signal (prepared for detection)" UWORD _CNV_A_R_LINEAR_____124_CM 1 0. 0. 4095.9375 DISPLAY_IDENTIFIER Q_INJ_BURST_ACT__25_ ECU_ADDRESS 0x7fab54 BYTE_ORDER MSB_LAST FORMAT "%6.2" /end MEASUREMENT
/begin MEASUREMENT q_inj_burst_act_[26] "charge burst signal (prepared for detection)" UWORD _CNV_A_R_LINEAR_____124_CM 1 0. 0. 4095.9375 DISPLAY_IDENTIFIER Q_INJ_BURST_ACT__26_ ECU_ADDRESS 0x7fab56 BYTE_ORDER MSB_LAST FORMAT "%6.2" /end MEASUREMENT
/begin MEASUREMENT q_inj_burst_act_[27] "charge burst signal (prepared for detection)" UWORD _CNV_A_R_LINEAR_____124_CM 1 0. 0. 4095.9375 DISPLAY_IDENTIFIER Q_INJ_BURST_ACT__27_ ECU_ADDRESS 0x7fab58 BYTE_ORDER MSB_LAST FORMAT "%6.2" /end MEASUREMENT
/begin MEASUREMENT q_inj_burst_act_[28] "charge burst signal (prepared for detection)" UWORD _CNV_A_R_LINEAR_____124_CM 1 0. 0. 4095.9375 DISPLAY_IDENTIFIER Q_INJ_BURST_ACT__28_ ECU_ADDRESS 0x7fab5a BYTE_ORDER MSB_LAST FORMAT "%6.2" /end MEASUREMENT
/begin MEASUREMENT q_inj_burst_act_[29] "charge burst signal (prepared for detection)" UWORD _CNV_A_R_LINEAR_____124_CM 1 0. 0. 4095.9375 DISPLAY_IDENTIFIER Q_INJ_BURST_ACT__29_ ECU_ADDRESS 0x7fab5c BYTE_ORDER MSB_LAST FORMAT "%6.2" /end MEASUREMENT
/begin MEASUREMENT q_inj_burst_act_[30] "charge burst signal (prepared for detection)" UWORD _CNV_A_R_LINEAR_____124_CM 1 0. 0. 4095.9375 DISPLAY_IDENTIFIER Q_INJ_BURST_ACT__30_ ECU_ADDRESS 0x7fab5e BYTE_ORDER MSB_LAST FORMAT "%6.2" /end MEASUREMENT
/begin MEASUREMENT q_inj_burst_act_[31] "charge burst signal (prepared for detection)" UWORD _CNV_A_R_LINEAR_____124_CM 1 0. 0. 4095.9375 DISPLAY_IDENTIFIER Q_INJ_BURST_ACT__31_ ECU_ADDRESS 0x7fab60 BYTE_ORDER MSB_LAST FORMAT "%6.2" /end MEASUREMENT
/begin MEASUREMENT q_inj_burst_act_[32] "charge burst signal (prepared for detection)" UWORD _CNV_A_R_LINEAR_____124_CM 1 0. 0. 4095.9375 DISPLAY_IDENTIFIER Q_INJ_BURST_ACT__32_ ECU_ADDRESS 0x7fab62 BYTE_ORDER MSB_LAST FORMAT "%6.2" /end MEASUREMENT
/begin MEASUREMENT q_inj_burst_act_[33] "charge burst signal (prepared for detection)" UWORD _CNV_A_R_LINEAR_____124_CM 1 0. 0. 4095.9375 DISPLAY_IDENTIFIER Q_INJ_BURST_ACT__33_ ECU_ADDRESS 0x7fab64 BYTE_ORDER MSB_LAST FORMAT "%6.2" /end MEASUREMENT
/begin MEASUREMENT q_inj_burst_act_[34] "charge burst signal (prepared for detection)" UWORD _CNV_A_R_LINEAR_____124_CM 1 0. 0. 4095.9375 DISPLAY_IDENTIFIER Q_INJ_BURST_ACT__34_ ECU_ADDRESS 0x7fab66 BYTE_ORDER MSB_LAST FORMAT "%6.2" /end MEASUREMENT
/begin MEASUREMENT q_inj_burst_act_[35] "charge burst signal (prepared for detection)" UWORD _CNV_A_R_LINEAR_____124_CM 1 0. 0. 4095.9375 DISPLAY_IDENTIFIER Q_INJ_BURST_ACT__35_ ECU_ADDRESS 0x7fab68 BYTE_ORDER MSB_LAST FORMAT "%6.2" /end MEASUREMENT
/begin MEASUREMENT q_inj_burst_act_[36] "charge burst signal (prepared for detection)" UWORD _CNV_A_R_LINEAR_____124_CM 1 0. 0. 4095.9375 DISPLAY_IDENTIFIER Q_INJ_BURST_ACT__36_ ECU_ADDRESS 0x7fab6a BYTE_ORDER MSB_LAST FORMAT "%6.2" /end MEASUREMENT
/begin MEASUREMENT q_inj_burst_act_[37] "charge burst signal (prepared for detection)" UWORD _CNV_A_R_LINEAR_____124_CM 1 0. 0. 4095.9375 DISPLAY_IDENTIFIER Q_INJ_BURST_ACT__37_ ECU_ADDRESS 0x7fab6c BYTE_ORDER MSB_LAST FORMAT "%6.2" /end MEASUREMENT
/begin MEASUREMENT q_inj_burst_act_[38] "charge burst signal (prepared for detection)" UWORD _CNV_A_R_LINEAR_____124_CM 1 0. 0. 4095.9375 DISPLAY_IDENTIFIER Q_INJ_BURST_ACT__38_ ECU_ADDRESS 0x7fab6e BYTE_ORDER MSB_LAST FORMAT "%6.2" /end MEASUREMENT
/begin MEASUREMENT q_inj_burst_act_[39] "charge burst signal (prepared for detection)" UWORD _CNV_A_R_LINEAR_____124_CM 1 0. 0. 4095.9375 DISPLAY_IDENTIFIER Q_INJ_BURST_ACT__39_ ECU_ADDRESS 0x7fab70 BYTE_ORDER MSB_LAST FORMAT "%6.2" /end MEASUREMENT
/begin MEASUREMENT q_inj_burst_act_[40] "charge burst signal (prepared for detection)" UWORD _CNV_A_R_LINEAR_____124_CM 1 0. 0. 4095.9375 DISPLAY_IDENTIFIER Q_INJ_BURST_ACT__40_ ECU_ADDRESS 0x7fab72 BYTE_ORDER MSB_LAST FORMAT "%6.2" /end MEASUREMENT
/begin MEASUREMENT q_inj_burst_act_[41] "charge burst signal (prepared for detection)" UWORD _CNV_A_R_LINEAR_____124_CM 1 0. 0. 4095.9375 DISPLAY_IDENTIFIER Q_INJ_BURST_ACT__41_ ECU_ADDRESS 0x7fab74 BYTE_ORDER MSB_LAST FORMAT "%6.2" /end MEASUREMENT
/begin MEASUREMENT q_inj_burst_act_[42] "charge burst signal (prepared for detection)" UWORD _CNV_A_R_LINEAR_____124_CM 1 0. 0. 4095.9375 DISPLAY_IDENTIFIER Q_INJ_BURST_ACT__42_ ECU_ADDRESS 0x7fab76 BYTE_ORDER MSB_LAST FORMAT "%6.2" /end MEASUREMENT
/begin MEASUREMENT q_inj_burst_act_[43] "charge burst signal (prepared for detection)" UWORD _CNV_A_R_LINEAR_____124_CM 1 0. 0. 4095.9375 DISPLAY_IDENTIFIER Q_INJ_BURST_ACT__43_ ECU_ADDRESS 0x7fab78 BYTE_ORDER MSB_LAST FORMAT "%6.2" /end MEASUREMENT
/begin MEASUREMENT q_inj_burst_act_[44] "charge burst signal (prepared for detection)" UWORD _CNV_A_R_LINEAR_____124_CM 1 0. 0. 4095.9375 DISPLAY_IDENTIFIER Q_INJ_BURST_ACT__44_ ECU_ADDRESS 0x7fab7a BYTE_ORDER MSB_LAST FORMAT "%6.2" /end MEASUREMENT
/begin MEASUREMENT q_inj_burst_act_[45] "charge burst signal (prepared for detection)" UWORD _CNV_A_R_LINEAR_____124_CM 1 0. 0. 4095.9375 DISPLAY_IDENTIFIER Q_INJ_BURST_ACT__45_ ECU_ADDRESS 0x7fab7c BYTE_ORDER MSB_LAST FORMAT "%6.2" /end MEASUREMENT
/begin MEASUREMENT q_inj_burst_act_[46] "charge burst signal (prepared for detection)" UWORD _CNV_A_R_LINEAR_____124_CM 1 0. 0. 4095.9375 DISPLAY_IDENTIFIER Q_INJ_BURST_ACT__46_ ECU_ADDRESS 0x7fab7e BYTE_ORDER MSB_LAST FORMAT "%6.2" /end MEASUREMENT
/begin MEASUREMENT q_inj_burst_act_[47] "charge burst signal (prepared for detection)" UWORD _CNV_A_R_LINEAR_____124_CM 1 0. 0. 4095.9375 DISPLAY_IDENTIFIER Q_INJ_BURST_ACT__47_ ECU_ADDRESS 0x7fab80 BYTE_ORDER MSB_LAST FORMAT "%6.2" /end MEASUREMENT
/begin MEASUREMENT q_inj_burst_exp_[0] "charge burst signal (expanded)" UWORD _CNV_A_R_LINEAR_____124_CM 1 0. 0. 4095.9375 DISPLAY_IDENTIFIER Q_INJ_BURST_EXP__0_ ECU_ADDRESS 0x7fabd2 BYTE_ORDER MSB_LAST FORMAT "%6.2" /end MEASUREMENT
/begin MEASUREMENT q_inj_burst_exp_[1] "charge burst signal (expanded)" UWORD _CNV_A_R_LINEAR_____124_CM 1 0. 0. 4095.9375 DISPLAY_IDENTIFIER Q_INJ_BURST_EXP__1_ ECU_ADDRESS 0x7fabd4 BYTE_ORDER MSB_LAST FORMAT "%6.2" /end MEASUREMENT
/begin MEASUREMENT q_inj_burst_exp_[2] "charge burst signal (expanded)" UWORD _CNV_A_R_LINEAR_____124_CM 1 0. 0. 4095.9375 DISPLAY_IDENTIFIER Q_INJ_BURST_EXP__2_ ECU_ADDRESS 0x7fabd6 BYTE_ORDER MSB_LAST FORMAT "%6.2" /end MEASUREMENT
/begin MEASUREMENT q_inj_burst_exp_[3] "charge burst signal (expanded)" UWORD _CNV_A_R_LINEAR_____124_CM 1 0. 0. 4095.9375 DISPLAY_IDENTIFIER Q_INJ_BURST_EXP__3_ ECU_ADDRESS 0x7fabd8 BYTE_ORDER MSB_LAST FORMAT "%6.2" /end MEASUREMENT
/begin MEASUREMENT q_inj_burst_exp_[4] "charge burst signal (expanded)" UWORD _CNV_A_R_LINEAR_____124_CM 1 0. 0. 4095.9375 DISPLAY_IDENTIFIER Q_INJ_BURST_EXP__4_ ECU_ADDRESS 0x7fabda BYTE_ORDER MSB_LAST FORMAT "%6.2" /end MEASUREMENT
/begin MEASUREMENT q_inj_burst_exp_[5] "charge burst signal (expanded)" UWORD _CNV_A_R_LINEAR_____124_CM 1 0. 0. 4095.9375 DISPLAY_IDENTIFIER Q_INJ_BURST_EXP__5_ ECU_ADDRESS 0x7fabdc BYTE_ORDER MSB_LAST FORMAT "%6.2" /end MEASUREMENT
/begin MEASUREMENT q_inj_burst_exp_[6] "charge burst signal (expanded)" UWORD _CNV_A_R_LINEAR_____124_CM 1 0. 0. 4095.9375 DISPLAY_IDENTIFIER Q_INJ_BURST_EXP__6_ ECU_ADDRESS 0x7fabde BYTE_ORDER MSB_LAST FORMAT "%6.2" /end MEASUREMENT
/begin MEASUREMENT q_inj_burst_exp_[7] "charge burst signal (expanded)" UWORD _CNV_A_R_LINEAR_____124_CM 1 0. 0. 4095.9375 DISPLAY_IDENTIFIER Q_INJ_BURST_EXP__7_ ECU_ADDRESS 0x7fabe0 BYTE_ORDER MSB_LAST FORMAT "%6.2" /end MEASUREMENT
/begin MEASUREMENT q_inj_burst_exp_[8] "charge burst signal (expanded)" UWORD _CNV_A_R_LINEAR_____124_CM 1 0. 0. 4095.9375 DISPLAY_IDENTIFIER Q_INJ_BURST_EXP__8_ ECU_ADDRESS 0x7fabe2 BYTE_ORDER MSB_LAST FORMAT "%6.2" /end MEASUREMENT
/begin MEASUREMENT q_inj_burst_exp_[9] "charge burst signal (expanded)" UWORD _CNV_A_R_LINEAR_____124_CM 1 0. 0. 4095.9375 DISPLAY_IDENTIFIER Q_INJ_BURST_EXP__9_ ECU_ADDRESS 0x7fabe4 BYTE_ORDER MSB_LAST FORMAT "%6.2" /end MEASUREMENT
/begin MEASUREMENT q_inj_burst_exp_[10] "charge burst signal (expanded)" UWORD _CNV_A_R_LINEAR_____124_CM 1 0. 0. 4095.9375 DISPLAY_IDENTIFIER Q_INJ_BURST_EXP__10_ ECU_ADDRESS 0x7fabe6 BYTE_ORDER MSB_LAST FORMAT "%6.2" /end MEASUREMENT
/begin MEASUREMENT q_inj_burst_exp_[11] "charge burst signal (expanded)" UWORD _CNV_A_R_LINEAR_____124_CM 1 0. 0. 4095.9375 DISPLAY_IDENTIFIER Q_INJ_BURST_EXP__11_ ECU_ADDRESS 0x7fabe8 BYTE_ORDER MSB_LAST FORMAT "%6.2" /end MEASUREMENT
/begin MEASUREMENT q_inj_burst_exp_[12] "charge burst signal (expanded)" UWORD _CNV_A_R_LINEAR_____124_CM 1 0. 0. 4095.9375 DISPLAY_IDENTIFIER Q_INJ_BURST_EXP__12_ ECU_ADDRESS 0x7fabea BYTE_ORDER MSB_LAST FORMAT "%6.2" /end MEASUREMENT
/begin MEASUREMENT q_inj_burst_exp_[13] "charge burst signal (expanded)" UWORD _CNV_A_R_LINEAR_____124_CM 1 0. 0. 4095.9375 DISPLAY_IDENTIFIER Q_INJ_BURST_EXP__13_ ECU_ADDRESS 0x7fabec BYTE_ORDER MSB_LAST FORMAT "%6.2" /end MEASUREMENT
/begin MEASUREMENT q_inj_burst_exp_[14] "charge burst signal (expanded)" UWORD _CNV_A_R_LINEAR_____124_CM 1 0. 0. 4095.9375 DISPLAY_IDENTIFIER Q_INJ_BURST_EXP__14_ ECU_ADDRESS 0x7fabee BYTE_ORDER MSB_LAST FORMAT "%6.2" /end MEASUREMENT
/begin MEASUREMENT q_inj_burst_exp_[15] "charge burst signal (expanded)" UWORD _CNV_A_R_LINEAR_____124_CM 1 0. 0. 4095.9375 DISPLAY_IDENTIFIER Q_INJ_BURST_EXP__15_ ECU_ADDRESS 0x7fabf0 BYTE_ORDER MSB_LAST FORMAT "%6.2" /end MEASUREMENT
/begin MEASUREMENT q_inj_burst_exp_[16] "charge burst signal (expanded)" UWORD _CNV_A_R_LINEAR_____124_CM 1 0. 0. 4095.9375 DISPLAY_IDENTIFIER Q_INJ_BURST_EXP__16_ ECU_ADDRESS 0x7fabf2 BYTE_ORDER MSB_LAST FORMAT "%6.2" /end MEASUREMENT
/begin MEASUREMENT q_inj_burst_exp_[17] "charge burst signal (expanded)" UWORD _CNV_A_R_LINEAR_____124_CM 1 0. 0. 4095.9375 DISPLAY_IDENTIFIER Q_INJ_BURST_EXP__17_ ECU_ADDRESS 0x7fabf4 BYTE_ORDER MSB_LAST FORMAT "%6.2" /end MEASUREMENT
/begin MEASUREMENT q_inj_burst_exp_[18] "charge burst signal (expanded)" UWORD _CNV_A_R_LINEAR_____124_CM 1 0. 0. 4095.9375 DISPLAY_IDENTIFIER Q_INJ_BURST_EXP__18_ ECU_ADDRESS 0x7fabf6 BYTE_ORDER MSB_LAST FORMAT "%6.2" /end MEASUREMENT
/begin MEASUREMENT q_inj_burst_exp_[19] "charge burst signal (expanded)" UWORD _CNV_A_R_LINEAR_____124_CM 1 0. 0. 4095.9375 DISPLAY_IDENTIFIER Q_INJ_BURST_EXP__19_ ECU_ADDRESS 0x7fabf8 BYTE_ORDER MSB_LAST FORMAT "%6.2" /end MEASUREMENT
/begin MEASUREMENT q_inj_burst_exp_[20] "charge burst signal (expanded)" UWORD _CNV_A_R_LINEAR_____124_CM 1 0. 0. 4095.9375 DISPLAY_IDENTIFIER Q_INJ_BURST_EXP__20_ ECU_ADDRESS 0x7fabfa BYTE_ORDER MSB_LAST FORMAT "%6.2" /end MEASUREMENT
/begin MEASUREMENT q_inj_burst_exp_[21] "charge burst signal (expanded)" UWORD _CNV_A_R_LINEAR_____124_CM 1 0. 0. 4095.9375 DISPLAY_IDENTIFIER Q_INJ_BURST_EXP__21_ ECU_ADDRESS 0x7fabfc BYTE_ORDER MSB_LAST FORMAT "%6.2" /end MEASUREMENT
/begin MEASUREMENT q_inj_burst_exp_[22] "charge burst signal (expanded)" UWORD _CNV_A_R_LINEAR_____124_CM 1 0. 0. 4095.9375 DISPLAY_IDENTIFIER Q_INJ_BURST_EXP__22_ ECU_ADDRESS 0x7fabfe BYTE_ORDER MSB_LAST FORMAT "%6.2" /end MEASUREMENT
/begin MEASUREMENT q_inj_burst_exp_[23] "charge burst signal (expanded)" UWORD _CNV_A_R_LINEAR_____124_CM 1 0. 0. 4095.9375 DISPLAY_IDENTIFIER Q_INJ_BURST_EXP__23_ ECU_ADDRESS 0x7fac00 BYTE_ORDER MSB_LAST FORMAT "%6.2" /end MEASUREMENT
/begin MEASUREMENT q_inj_burst_exp_[24] "charge burst signal (expanded)" UWORD _CNV_A_R_LINEAR_____124_CM 1 0. 0. 4095.9375 DISPLAY_IDENTIFIER Q_INJ_BURST_EXP__24_ ECU_ADDRESS 0x7fac02 BYTE_ORDER MSB_LAST FORMAT "%6.2" /end MEASUREMENT
/begin MEASUREMENT q_inj_burst_exp_[25] "charge burst signal (expanded)" UWORD _CNV_A_R_LINEAR_____124_CM 1 0. 0. 4095.9375 DISPLAY_IDENTIFIER Q_INJ_BURST_EXP__25_ ECU_ADDRESS 0x7fac04 BYTE_ORDER MSB_LAST FORMAT "%6.2" /end MEASUREMENT
/begin MEASUREMENT q_inj_burst_exp_[26] "charge burst signal (expanded)" UWORD _CNV_A_R_LINEAR_____124_CM 1 0. 0. 4095.9375 DISPLAY_IDENTIFIER Q_INJ_BURST_EXP__26_ ECU_ADDRESS 0x7fac06 BYTE_ORDER MSB_LAST FORMAT "%6.2" /end MEASUREMENT
/begin MEASUREMENT q_inj_burst_exp_[27] "charge burst signal (expanded)" UWORD _CNV_A_R_LINEAR_____124_CM 1 0. 0. 4095.9375 DISPLAY_IDENTIFIER Q_INJ_BURST_EXP__27_ ECU_ADDRESS 0x7fac08 BYTE_ORDER MSB_LAST FORMAT "%6.2" /end MEASUREMENT
/begin MEASUREMENT q_inj_burst_exp_[28] "charge burst signal (expanded)" UWORD _CNV_A_R_LINEAR_____124_CM 1 0. 0. 4095.9375 DISPLAY_IDENTIFIER Q_INJ_BURST_EXP__28_ ECU_ADDRESS 0x7fac0a BYTE_ORDER MSB_LAST FORMAT "%6.2" /end MEASUREMENT
/begin MEASUREMENT q_inj_burst_exp_[29] "charge burst signal (expanded)" UWORD _CNV_A_R_LINEAR_____124_CM 1 0. 0. 4095.9375 DISPLAY_IDENTIFIER Q_INJ_BURST_EXP__29_ ECU_ADDRESS 0x7fac0c BYTE_ORDER MSB_LAST FORMAT "%6.2" /end MEASUREMENT
/begin MEASUREMENT q_inj_burst_exp_[30] "charge burst signal (expanded)" UWORD _CNV_A_R_LINEAR_____124_CM 1 0. 0. 4095.9375 DISPLAY_IDENTIFIER Q_INJ_BURST_EXP__30_ ECU_ADDRESS 0x7fac0e BYTE_ORDER MSB_LAST FORMAT "%6.2" /end MEASUREMENT
/begin MEASUREMENT q_inj_burst_exp_[31] "charge burst signal (expanded)" UWORD _CNV_A_R_LINEAR_____124_CM 1 0. 0. 4095.9375 DISPLAY_IDENTIFIER Q_INJ_BURST_EXP__31_ ECU_ADDRESS 0x7fac10 BYTE_ORDER MSB_LAST FORMAT "%6.2" /end MEASUREMENT
/begin MEASUREMENT q_inj_burst_exp_[32] "charge burst signal (expanded)" UWORD _CNV_A_R_LINEAR_____124_CM 1 0. 0. 4095.9375 DISPLAY_IDENTIFIER Q_INJ_BURST_EXP__32_ ECU_ADDRESS 0x7fac12 BYTE_ORDER MSB_LAST FORMAT "%6.2" /end MEASUREMENT
/begin MEASUREMENT q_inj_burst_exp_[33] "charge burst signal (expanded)" UWORD _CNV_A_R_LINEAR_____124_CM 1 0. 0. 4095.9375 DISPLAY_IDENTIFIER Q_INJ_BURST_EXP__33_ ECU_ADDRESS 0x7fac14 BYTE_ORDER MSB_LAST FORMAT "%6.2" /end MEASUREMENT
/begin MEASUREMENT q_inj_burst_exp_[34] "charge burst signal (expanded)" UWORD _CNV_A_R_LINEAR_____124_CM 1 0. 0. 4095.9375 DISPLAY_IDENTIFIER Q_INJ_BURST_EXP__34_ ECU_ADDRESS 0x7fac16 BYTE_ORDER MSB_LAST FORMAT "%6.2" /end MEASUREMENT
/begin MEASUREMENT q_inj_burst_exp_[35] "charge burst signal (expanded)" UWORD _CNV_A_R_LINEAR_____124_CM 1 0. 0. 4095.9375 DISPLAY_IDENTIFIER Q_INJ_BURST_EXP__35_ ECU_ADDRESS 0x7fac18 BYTE_ORDER MSB_LAST FORMAT "%6.2" /end MEASUREMENT
/begin MEASUREMENT q_inj_burst_exp_[36] "charge burst signal (expanded)" UWORD _CNV_A_R_LINEAR_____124_CM 1 0. 0. 4095.9375 DISPLAY_IDENTIFIER Q_INJ_BURST_EXP__36_ ECU_ADDRESS 0x7fac1a BYTE_ORDER MSB_LAST FORMAT "%6.2" /end MEASUREMENT
/begin MEASUREMENT q_inj_burst_exp_[37] "charge burst signal (expanded)" UWORD _CNV_A_R_LINEAR_____124_CM 1 0. 0. 4095.9375 DISPLAY_IDENTIFIER Q_INJ_BURST_EXP__37_ ECU_ADDRESS 0x7fac1c BYTE_ORDER MSB_LAST FORMAT "%6.2" /end MEASUREMENT
/begin MEASUREMENT q_inj_burst_exp_[38] "charge burst signal (expanded)" UWORD _CNV_A_R_LINEAR_____124_CM 1 0. 0. 4095.9375 DISPLAY_IDENTIFIER Q_INJ_BURST_EXP__38_ ECU_ADDRESS 0x7fac1e BYTE_ORDER MSB_LAST FORMAT "%6.2" /end MEASUREMENT
/begin MEASUREMENT q_inj_burst_exp_[39] "charge burst signal (expanded)" UWORD _CNV_A_R_LINEAR_____124_CM 1 0. 0. 4095.9375 DISPLAY_IDENTIFIER Q_INJ_BURST_EXP__39_ ECU_ADDRESS 0x7fac20 BYTE_ORDER MSB_LAST FORMAT "%6.2" /end MEASUREMENT
/begin MEASUREMENT q_inj_burst_exp_[40] "charge burst signal (expanded)" UWORD _CNV_A_R_LINEAR_____124_CM 1 0. 0. 4095.9375 DISPLAY_IDENTIFIER Q_INJ_BURST_EXP__40_ ECU_ADDRESS 0x7fac22 BYTE_ORDER MSB_LAST FORMAT "%6.2" /end MEASUREMENT
/begin MEASUREMENT q_inj_burst_exp_[41] "charge burst signal (expanded)" UWORD _CNV_A_R_LINEAR_____124_CM 1 0. 0. 4095.9375 DISPLAY_IDENTIFIER Q_INJ_BURST_EXP__41_ ECU_ADDRESS 0x7fac24 BYTE_ORDER MSB_LAST FORMAT "%6.2" /end MEASUREMENT
/begin MEASUREMENT q_inj_burst_exp_[42] "charge burst signal (expanded)" UWORD _CNV_A_R_LINEAR_____124_CM 1 0. 0. 4095.9375 DISPLAY_IDENTIFIER Q_INJ_BURST_EXP__42_ ECU_ADDRESS 0x7fac26 BYTE_ORDER MSB_LAST FORMAT "%6.2" /end MEASUREMENT
/begin MEASUREMENT q_inj_burst_exp_[43] "charge burst signal (expanded)" UWORD _CNV_A_R_LINEAR_____124_CM 1 0. 0. 4095.9375 DISPLAY_IDENTIFIER Q_INJ_BURST_EXP__43_ ECU_ADDRESS 0x7fac28 BYTE_ORDER MSB_LAST FORMAT "%6.2" /end MEASUREMENT
/begin MEASUREMENT q_inj_burst_exp_[44] "charge burst signal (expanded)" UWORD _CNV_A_R_LINEAR_____124_CM 1 0. 0. 4095.9375 DISPLAY_IDENTIFIER Q_INJ_BURST_EXP__44_ ECU_ADDRESS 0x7fac2a BYTE_ORDER MSB_LAST FORMAT "%6.2" /end MEASUREMENT
/begin MEASUREMENT q_inj_burst_exp_[45] "charge burst signal (expanded)" UWORD _CNV_A_R_LINEAR_____124_CM 1 0. 0. 4095.9375 DISPLAY_IDENTIFIER Q_INJ_BURST_EXP__45_ ECU_ADDRESS 0x7fac2c BYTE_ORDER MSB_LAST FORMAT "%6.2" /end MEASUREMENT
/begin MEASUREMENT q_inj_burst_exp_[46] "charge burst signal (expanded)" UWORD _CNV_A_R_LINEAR_____124_CM 1 0. 0. 4095.9375 DISPLAY_IDENTIFIER Q_INJ_BURST_EXP__46_ ECU_ADDRESS 0x7fac2e BYTE_ORDER MSB_LAST FORMAT "%6.2" /end MEASUREMENT
/begin MEASUREMENT q_inj_burst_exp_[47] "charge burst signal (expanded)" UWORD _CNV_A_R_LINEAR_____124_CM 1 0. 0. 4095.9375 DISPLAY_IDENTIFIER Q_INJ_BURST_EXP__47_ ECU_ADDRESS 0x7fac30 BYTE_ORDER MSB_LAST FORMAT "%6.2" /end MEASUREMENT
/begin MEASUREMENT q_inj_burst_intp_[0] "charge burst signal (interpolated)" UWORD _CNV_A_R_LINEAR_____124_CM 1 0. 0. 4095.9375 DISPLAY_IDENTIFIER Q_INJ_BURST_INTP__0_ ECU_ADDRESS 0x7fac82 BYTE_ORDER MSB_LAST FORMAT "%6.2" /end MEASUREMENT
/begin MEASUREMENT q_inj_burst_intp_[1] "charge burst signal (interpolated)" UWORD _CNV_A_R_LINEAR_____124_CM 1 0. 0. 4095.9375 DISPLAY_IDENTIFIER Q_INJ_BURST_INTP__1_ ECU_ADDRESS 0x7fac84 BYTE_ORDER MSB_LAST FORMAT "%6.2" /end MEASUREMENT
/begin MEASUREMENT q_inj_burst_intp_[2] "charge burst signal (interpolated)" UWORD _CNV_A_R_LINEAR_____124_CM 1 0. 0. 4095.9375 DISPLAY_IDENTIFIER Q_INJ_BURST_INTP__2_ ECU_ADDRESS 0x7fac86 BYTE_ORDER MSB_LAST FORMAT "%6.2" /end MEASUREMENT
/begin MEASUREMENT q_inj_burst_intp_[3] "charge burst signal (interpolated)" UWORD _CNV_A_R_LINEAR_____124_CM 1 0. 0. 4095.9375 DISPLAY_IDENTIFIER Q_INJ_BURST_INTP__3_ ECU_ADDRESS 0x7fac88 BYTE_ORDER MSB_LAST FORMAT "%6.2" /end MEASUREMENT
/begin MEASUREMENT q_inj_burst_intp_[4] "charge burst signal (interpolated)" UWORD _CNV_A_R_LINEAR_____124_CM 1 0. 0. 4095.9375 DISPLAY_IDENTIFIER Q_INJ_BURST_INTP__4_ ECU_ADDRESS 0x7fac8a BYTE_ORDER MSB_LAST FORMAT "%6.2" /end MEASUREMENT
/begin MEASUREMENT q_inj_burst_intp_[5] "charge burst signal (interpolated)" UWORD _CNV_A_R_LINEAR_____124_CM 1 0. 0. 4095.9375 DISPLAY_IDENTIFIER Q_INJ_BURST_INTP__5_ ECU_ADDRESS 0x7fac8c BYTE_ORDER MSB_LAST FORMAT "%6.2" /end MEASUREMENT
/begin MEASUREMENT q_inj_burst_intp_[6] "charge burst signal (interpolated)" UWORD _CNV_A_R_LINEAR_____124_CM 1 0. 0. 4095.9375 DISPLAY_IDENTIFIER Q_INJ_BURST_INTP__6_ ECU_ADDRESS 0x7fac8e BYTE_ORDER MSB_LAST FORMAT "%6.2" /end MEASUREMENT
/begin MEASUREMENT q_inj_burst_intp_[7] "charge burst signal (interpolated)" UWORD _CNV_A_R_LINEAR_____124_CM 1 0. 0. 4095.9375 DISPLAY_IDENTIFIER Q_INJ_BURST_INTP__7_ ECU_ADDRESS 0x7fac90 BYTE_ORDER MSB_LAST FORMAT "%6.2" /end MEASUREMENT
/begin MEASUREMENT q_inj_burst_intp_[8] "charge burst signal (interpolated)" UWORD _CNV_A_R_LINEAR_____124_CM 1 0. 0. 4095.9375 DISPLAY_IDENTIFIER Q_INJ_BURST_INTP__8_ ECU_ADDRESS 0x7fac92 BYTE_ORDER MSB_LAST FORMAT "%6.2" /end MEASUREMENT
/begin MEASUREMENT q_inj_burst_intp_[9] "charge burst signal (interpolated)" UWORD _CNV_A_R_LINEAR_____124_CM 1 0. 0. 4095.9375 DISPLAY_IDENTIFIER Q_INJ_BURST_INTP__9_ ECU_ADDRESS 0x7fac94 BYTE_ORDER MSB_LAST FORMAT "%6.2" /end MEASUREMENT
/begin MEASUREMENT q_inj_burst_intp_[10] "charge burst signal (interpolated)" UWORD _CNV_A_R_LINEAR_____124_CM 1 0. 0. 4095.9375 DISPLAY_IDENTIFIER Q_INJ_BURST_INTP__10_ ECU_ADDRESS 0x7fac96 BYTE_ORDER MSB_LAST FORMAT "%6.2" /end MEASUREMENT
/begin MEASUREMENT q_inj_burst_intp_[11] "charge burst signal (interpolated)" UWORD _CNV_A_R_LINEAR_____124_CM 1 0. 0. 4095.9375 DISPLAY_IDENTIFIER Q_INJ_BURST_INTP__11_ ECU_ADDRESS 0x7fac98 BYTE_ORDER MSB_LAST FORMAT "%6.2" /end MEASUREMENT
/begin MEASUREMENT q_inj_burst_intp_[12] "charge burst signal (interpolated)" UWORD _CNV_A_R_LINEAR_____124_CM 1 0. 0. 4095.9375 DISPLAY_IDENTIFIER Q_INJ_BURST_INTP__12_ ECU_ADDRESS 0x7fac9a BYTE_ORDER MSB_LAST FORMAT "%6.2" /end MEASUREMENT
/begin MEASUREMENT q_inj_burst_intp_[13] "charge burst signal (interpolated)" UWORD _CNV_A_R_LINEAR_____124_CM 1 0. 0. 4095.9375 DISPLAY_IDENTIFIER Q_INJ_BURST_INTP__13_ ECU_ADDRESS 0x7fac9c BYTE_ORDER MSB_LAST FORMAT "%6.2" /end MEASUREMENT
/begin MEASUREMENT q_inj_burst_intp_[14] "charge burst signal (interpolated)" UWORD _CNV_A_R_LINEAR_____124_CM 1 0. 0. 4095.9375 DISPLAY_IDENTIFIER Q_INJ_BURST_INTP__14_ ECU_ADDRESS 0x7fac9e BYTE_ORDER MSB_LAST FORMAT "%6.2" /end MEASUREMENT
/begin MEASUREMENT q_inj_burst_intp_[15] "charge burst signal (interpolated)" UWORD _CNV_A_R_LINEAR_____124_CM 1 0. 0. 4095.9375 DISPLAY_IDENTIFIER Q_INJ_BURST_INTP__15_ ECU_ADDRESS 0x7faca0 BYTE_ORDER MSB_LAST FORMAT "%6.2" /end MEASUREMENT
/begin MEASUREMENT q_inj_burst_intp_[16] "charge burst signal (interpolated)" UWORD _CNV_A_R_LINEAR_____124_CM 1 0. 0. 4095.9375 DISPLAY_IDENTIFIER Q_INJ_BURST_INTP__16_ ECU_ADDRESS 0x7faca2 BYTE_ORDER MSB_LAST FORMAT "%6.2" /end MEASUREMENT
/begin MEASUREMENT q_inj_burst_intp_[17] "charge burst signal (interpolated)" UWORD _CNV_A_R_LINEAR_____124_CM 1 0. 0. 4095.9375 DISPLAY_IDENTIFIER Q_INJ_BURST_INTP__17_ ECU_ADDRESS 0x7faca4 BYTE_ORDER MSB_LAST FORMAT "%6.2" /end MEASUREMENT
/begin MEASUREMENT q_inj_burst_intp_[18] "charge burst signal (interpolated)" UWORD _CNV_A_R_LINEAR_____124_CM 1 0. 0. 4095.9375 DISPLAY_IDENTIFIER Q_INJ_BURST_INTP__18_ ECU_ADDRESS 0x7faca6 BYTE_ORDER MSB_LAST FORMAT "%6.2" /end MEASUREMENT
/begin MEASUREMENT q_inj_burst_intp_[19] "charge burst signal (interpolated)" UWORD _CNV_A_R_LINEAR_____124_CM 1 0. 0. 4095.9375 DISPLAY_IDENTIFIER Q_INJ_BURST_INTP__19_ ECU_ADDRESS 0x7faca8 BYTE_ORDER MSB_LAST FORMAT "%6.2" /end MEASUREMENT
/begin MEASUREMENT q_inj_burst_intp_[20] "charge burst signal (interpolated)" UWORD _CNV_A_R_LINEAR_____124_CM 1 0. 0. 4095.9375 DISPLAY_IDENTIFIER Q_INJ_BURST_INTP__20_ ECU_ADDRESS 0x7facaa BYTE_ORDER MSB_LAST FORMAT "%6.2" /end MEASUREMENT
/begin MEASUREMENT q_inj_burst_intp_[21] "charge burst signal (interpolated)" UWORD _CNV_A_R_LINEAR_____124_CM 1 0. 0. 4095.9375 DISPLAY_IDENTIFIER Q_INJ_BURST_INTP__21_ ECU_ADDRESS 0x7facac BYTE_ORDER MSB_LAST FORMAT "%6.2" /end MEASUREMENT
/begin MEASUREMENT q_inj_burst_intp_[22] "charge burst signal (interpolated)" UWORD _CNV_A_R_LINEAR_____124_CM 1 0. 0. 4095.9375 DISPLAY_IDENTIFIER Q_INJ_BURST_INTP__22_ ECU_ADDRESS 0x7facae BYTE_ORDER MSB_LAST FORMAT "%6.2" /end MEASUREMENT
/begin MEASUREMENT q_inj_burst_intp_[23] "charge burst signal (interpolated)" UWORD _CNV_A_R_LINEAR_____124_CM 1 0. 0. 4095.9375 DISPLAY_IDENTIFIER Q_INJ_BURST_INTP__23_ ECU_ADDRESS 0x7facb0 BYTE_ORDER MSB_LAST FORMAT "%6.2" /end MEASUREMENT
/begin MEASUREMENT q_inj_burst_intp_[24] "charge burst signal (interpolated)" UWORD _CNV_A_R_LINEAR_____124_CM 1 0. 0. 4095.9375 DISPLAY_IDENTIFIER Q_INJ_BURST_INTP__24_ ECU_ADDRESS 0x7facb2 BYTE_ORDER MSB_LAST FORMAT "%6.2" /end MEASUREMENT
/begin MEASUREMENT q_inj_burst_intp_[25] "charge burst signal (interpolated)" UWORD _CNV_A_R_LINEAR_____124_CM 1 0. 0. 4095.9375 DISPLAY_IDENTIFIER Q_INJ_BURST_INTP__25_ ECU_ADDRESS 0x7facb4 BYTE_ORDER MSB_LAST FORMAT "%6.2" /end MEASUREMENT
/begin MEASUREMENT q_inj_burst_intp_[26] "charge burst signal (interpolated)" UWORD _CNV_A_R_LINEAR_____124_CM 1 0. 0. 4095.9375 DISPLAY_IDENTIFIER Q_INJ_BURST_INTP__26_ ECU_ADDRESS 0x7facb6 BYTE_ORDER MSB_LAST FORMAT "%6.2" /end MEASUREMENT
/begin MEASUREMENT q_inj_burst_intp_[27] "charge burst signal (interpolated)" UWORD _CNV_A_R_LINEAR_____124_CM 1 0. 0. 4095.9375 DISPLAY_IDENTIFIER Q_INJ_BURST_INTP__27_ ECU_ADDRESS 0x7facb8 BYTE_ORDER MSB_LAST FORMAT "%6.2" /end MEASUREMENT
/begin MEASUREMENT q_inj_burst_intp_[28] "charge burst signal (interpolated)" UWORD _CNV_A_R_LINEAR_____124_CM 1 0. 0. 4095.9375 DISPLAY_IDENTIFIER Q_INJ_BURST_INTP__28_ ECU_ADDRESS 0x7facba BYTE_ORDER MSB_LAST FORMAT "%6.2" /end MEASUREMENT
/begin MEASUREMENT q_inj_burst_intp_[29] "charge burst signal (interpolated)" UWORD _CNV_A_R_LINEAR_____124_CM 1 0. 0. 4095.9375 DISPLAY_IDENTIFIER Q_INJ_BURST_INTP__29_ ECU_ADDRESS 0x7facbc BYTE_ORDER MSB_LAST FORMAT "%6.2" /end MEASUREMENT
/begin MEASUREMENT q_inj_burst_intp_[30] "charge burst signal (interpolated)" UWORD _CNV_A_R_LINEAR_____124_CM 1 0. 0. 4095.9375 DISPLAY_IDENTIFIER Q_INJ_BURST_INTP__30_ ECU_ADDRESS 0x7facbe BYTE_ORDER MSB_LAST FORMAT "%6.2" /end MEASUREMENT
/begin MEASUREMENT q_inj_burst_intp_[31] "charge burst signal (interpolated)" UWORD _CNV_A_R_LINEAR_____124_CM 1 0. 0. 4095.9375 DISPLAY_IDENTIFIER Q_INJ_BURST_INTP__31_ ECU_ADDRESS 0x7facc0 BYTE_ORDER MSB_LAST FORMAT "%6.2" /end MEASUREMENT
/begin MEASUREMENT q_inj_burst_intp_[32] "charge burst signal (interpolated)" UWORD _CNV_A_R_LINEAR_____124_CM 1 0. 0. 4095.9375 DISPLAY_IDENTIFIER Q_INJ_BURST_INTP__32_ ECU_ADDRESS 0x7facc2 BYTE_ORDER MSB_LAST FORMAT "%6.2" /end MEASUREMENT
/begin MEASUREMENT q_inj_burst_intp_[33] "charge burst signal (interpolated)" UWORD _CNV_A_R_LINEAR_____124_CM 1 0. 0. 4095.9375 DISPLAY_IDENTIFIER Q_INJ_BURST_INTP__33_ ECU_ADDRESS 0x7facc4 BYTE_ORDER MSB_LAST FORMAT "%6.2" /end MEASUREMENT
/begin MEASUREMENT q_inj_burst_intp_[34] "charge burst signal (interpolated)" UWORD _CNV_A_R_LINEAR_____124_CM 1 0. 0. 4095.9375 DISPLAY_IDENTIFIER Q_INJ_BURST_INTP__34_ ECU_ADDRESS 0x7facc6 BYTE_ORDER MSB_LAST FORMAT "%6.2" /end MEASUREMENT
/begin MEASUREMENT q_inj_burst_intp_[35] "charge burst signal (interpolated)" UWORD _CNV_A_R_LINEAR_____124_CM 1 0. 0. 4095.9375 DISPLAY_IDENTIFIER Q_INJ_BURST_INTP__35_ ECU_ADDRESS 0x7facc8 BYTE_ORDER MSB_LAST FORMAT "%6.2" /end MEASUREMENT
/begin MEASUREMENT q_inj_burst_intp_[36] "charge burst signal (interpolated)" UWORD _CNV_A_R_LINEAR_____124_CM 1 0. 0. 4095.9375 DISPLAY_IDENTIFIER Q_INJ_BURST_INTP__36_ ECU_ADDRESS 0x7facca BYTE_ORDER MSB_LAST FORMAT "%6.2" /end MEASUREMENT
/begin MEASUREMENT q_inj_burst_intp_[37] "charge burst signal (interpolated)" UWORD _CNV_A_R_LINEAR_____124_CM 1 0. 0. 4095.9375 DISPLAY_IDENTIFIER Q_INJ_BURST_INTP__37_ ECU_ADDRESS 0x7faccc BYTE_ORDER MSB_LAST FORMAT "%6.2" /end MEASUREMENT
/begin MEASUREMENT q_inj_burst_intp_[38] "charge burst signal (interpolated)" UWORD _CNV_A_R_LINEAR_____124_CM 1 0. 0. 4095.9375 DISPLAY_IDENTIFIER Q_INJ_BURST_INTP__38_ ECU_ADDRESS 0x7facce BYTE_ORDER MSB_LAST FORMAT "%6.2" /end MEASUREMENT
/begin MEASUREMENT q_inj_burst_intp_[39] "charge burst signal (interpolated)" UWORD _CNV_A_R_LINEAR_____124_CM 1 0. 0. 4095.9375 DISPLAY_IDENTIFIER Q_INJ_BURST_INTP__39_ ECU_ADDRESS 0x7facd0 BYTE_ORDER MSB_LAST FORMAT "%6.2" /end MEASUREMENT
/begin MEASUREMENT q_inj_burst_intp_[40] "charge burst signal (interpolated)" UWORD _CNV_A_R_LINEAR_____124_CM 1 0. 0. 4095.9375 DISPLAY_IDENTIFIER Q_INJ_BURST_INTP__40_ ECU_ADDRESS 0x7facd2 BYTE_ORDER MSB_LAST FORMAT "%6.2" /end MEASUREMENT
/begin MEASUREMENT q_inj_burst_intp_[41] "charge burst signal (interpolated)" UWORD _CNV_A_R_LINEAR_____124_CM 1 0. 0. 4095.9375 DISPLAY_IDENTIFIER Q_INJ_BURST_INTP__41_ ECU_ADDRESS 0x7facd4 BYTE_ORDER MSB_LAST FORMAT "%6.2" /end MEASUREMENT
/begin MEASUREMENT q_inj_burst_intp_[42] "charge burst signal (interpolated)" UWORD _CNV_A_R_LINEAR_____124_CM 1 0. 0. 4095.9375 DISPLAY_IDENTIFIER Q_INJ_BURST_INTP__42_ ECU_ADDRESS 0x7facd6 BYTE_ORDER MSB_LAST FORMAT "%6.2" /end MEASUREMENT
/begin MEASUREMENT q_inj_burst_intp_[43] "charge burst signal (interpolated)" UWORD _CNV_A_R_LINEAR_____124_CM 1 0. 0. 4095.9375 DISPLAY_IDENTIFIER Q_INJ_BURST_INTP__43_ ECU_ADDRESS 0x7facd8 BYTE_ORDER MSB_LAST FORMAT "%6.2" /end MEASUREMENT
/begin MEASUREMENT q_inj_burst_intp_[44] "charge burst signal (interpolated)" UWORD _CNV_A_R_LINEAR_____124_CM 1 0. 0. 4095.9375 DISPLAY_IDENTIFIER Q_INJ_BURST_INTP__44_ ECU_ADDRESS 0x7facda BYTE_ORDER MSB_LAST FORMAT "%6.2" /end MEASUREMENT
/begin MEASUREMENT q_inj_burst_intp_[45] "charge burst signal (interpolated)" UWORD _CNV_A_R_LINEAR_____124_CM 1 0. 0. 4095.9375 DISPLAY_IDENTIFIER Q_INJ_BURST_INTP__45_ ECU_ADDRESS 0x7facdc BYTE_ORDER MSB_LAST FORMAT "%6.2" /end MEASUREMENT
/begin MEASUREMENT q_inj_burst_intp_[46] "charge burst signal (interpolated)" UWORD _CNV_A_R_LINEAR_____124_CM 1 0. 0. 4095.9375 DISPLAY_IDENTIFIER Q_INJ_BURST_INTP__46_ ECU_ADDRESS 0x7facde BYTE_ORDER MSB_LAST FORMAT "%6.2" /end MEASUREMENT
/begin MEASUREMENT q_inj_burst_intp_[47] "charge burst signal (interpolated)" UWORD _CNV_A_R_LINEAR_____124_CM 1 0. 0. 4095.9375 DISPLAY_IDENTIFIER Q_INJ_BURST_INTP__47_ ECU_ADDRESS 0x7face0 BYTE_ORDER MSB_LAST FORMAT "%6.2" /end MEASUREMENT
/begin MEASUREMENT q_inj_det_[0] "injector charge at detection point (cylinder individual)" UWORD _CNV_A_R_LINEAR_____124_CM 1 0. 0. 4095.9375 DISPLAY_IDENTIFIER Q_INJ_DET__0_ ECU_ADDRESS 0x7fad32 BYTE_ORDER MSB_LAST FORMAT "%6.2" /end MEASUREMENT
/begin MEASUREMENT q_inj_det_[1] "injector charge at detection point (cylinder individual)" UWORD _CNV_A_R_LINEAR_____124_CM 1 0. 0. 4095.9375 DISPLAY_IDENTIFIER Q_INJ_DET__1_ ECU_ADDRESS 0x7fad34 BYTE_ORDER MSB_LAST FORMAT "%6.2" /end MEASUREMENT
/begin MEASUREMENT q_inj_det_[2] "injector charge at detection point (cylinder individual)" UWORD _CNV_A_R_LINEAR_____124_CM 1 0. 0. 4095.9375 DISPLAY_IDENTIFIER Q_INJ_DET__2_ ECU_ADDRESS 0x7fad36 BYTE_ORDER MSB_LAST FORMAT "%6.2" /end MEASUREMENT
/begin MEASUREMENT q_inj_det_[3] "injector charge at detection point (cylinder individual)" UWORD _CNV_A_R_LINEAR_____124_CM 1 0. 0. 4095.9375 DISPLAY_IDENTIFIER Q_INJ_DET__3_ ECU_ADDRESS 0x7fad38 BYTE_ORDER MSB_LAST FORMAT "%6.2" /end MEASUREMENT
/begin MEASUREMENT seg_nr_pui_acq "actual segment number of PECO data acquisition" UBYTE _CNV_A_R_LINEAR_____0_CM 1 0. 0. 15. DISPLAY_IDENTIFIER SEG_NR_PUI_ACQ ECU_ADDRESS 0x7fbb14 FORMAT "%2.0" /end MEASUREMENT
/begin MEASUREMENT v_inj_burst_act_max_[0] "injector voltage at last point (cylinder individual)" UWORD _CNV_A_R_LINEAR_____123_CM 1 0. 0. 255. DISPLAY_IDENTIFIER V_INJ_BURST_ACT_MAX__0_ ECU_ADDRESS 0x7fad3a BYTE_ORDER MSB_LAST FORMAT "%4.1" /end MEASUREMENT
/begin MEASUREMENT v_inj_burst_act_max_[1] "injector voltage at last point (cylinder individual)" UWORD _CNV_A_R_LINEAR_____123_CM 1 0. 0. 255. DISPLAY_IDENTIFIER V_INJ_BURST_ACT_MAX__1_ ECU_ADDRESS 0x7fad3c BYTE_ORDER MSB_LAST FORMAT "%4.1" /end MEASUREMENT
/begin MEASUREMENT v_inj_burst_act_max_[2] "injector voltage at last point (cylinder individual)" UWORD _CNV_A_R_LINEAR_____123_CM 1 0. 0. 255. DISPLAY_IDENTIFIER V_INJ_BURST_ACT_MAX__2_ ECU_ADDRESS 0x7fad3e BYTE_ORDER MSB_LAST FORMAT "%4.1" /end MEASUREMENT
/begin MEASUREMENT v_inj_burst_act_max_[3] "injector voltage at last point (cylinder individual)" UWORD _CNV_A_R_LINEAR_____123_CM 1 0. 0. 255. DISPLAY_IDENTIFIER V_INJ_BURST_ACT_MAX__3_ ECU_ADDRESS 0x7fad40 BYTE_ORDER MSB_LAST FORMAT "%4.1" /end MEASUREMENT
/begin MEASUREMENT v_inj_burst_act_[0] "voltage burst signal (choosen for detection)" UWORD _CNV_A_R_LINEAR_____123_CM 1 0. 0. 255. DISPLAY_IDENTIFIER V_INJ_BURST_ACT__0_ ECU_ADDRESS 0x7fad42 BYTE_ORDER MSB_LAST FORMAT "%4.1" /end MEASUREMENT
/begin MEASUREMENT v_inj_burst_act_[1] "voltage burst signal (choosen for detection)" UWORD _CNV_A_R_LINEAR_____123_CM 1 0. 0. 255. DISPLAY_IDENTIFIER V_INJ_BURST_ACT__1_ ECU_ADDRESS 0x7fad44 BYTE_ORDER MSB_LAST FORMAT "%4.1" /end MEASUREMENT
/begin MEASUREMENT v_inj_burst_act_[2] "voltage burst signal (choosen for detection)" UWORD _CNV_A_R_LINEAR_____123_CM 1 0. 0. 255. DISPLAY_IDENTIFIER V_INJ_BURST_ACT__2_ ECU_ADDRESS 0x7fad46 BYTE_ORDER MSB_LAST FORMAT "%4.1" /end MEASUREMENT
/begin MEASUREMENT v_inj_burst_act_[3] "voltage burst signal (choosen for detection)" UWORD _CNV_A_R_LINEAR_____123_CM 1 0. 0. 255. DISPLAY_IDENTIFIER V_INJ_BURST_ACT__3_ ECU_ADDRESS 0x7fad48 BYTE_ORDER MSB_LAST FORMAT "%4.1" /end MEASUREMENT
/begin MEASUREMENT v_inj_burst_act_[4] "voltage burst signal (choosen for detection)" UWORD _CNV_A_R_LINEAR_____123_CM 1 0. 0. 255. DISPLAY_IDENTIFIER V_INJ_BURST_ACT__4_ ECU_ADDRESS 0x7fad4a BYTE_ORDER MSB_LAST FORMAT "%4.1" /end MEASUREMENT
/begin MEASUREMENT v_inj_burst_act_[5] "voltage burst signal (choosen for detection)" UWORD _CNV_A_R_LINEAR_____123_CM 1 0. 0. 255. DISPLAY_IDENTIFIER V_INJ_BURST_ACT__5_ ECU_ADDRESS 0x7fad4c BYTE_ORDER MSB_LAST FORMAT "%4.1" /end MEASUREMENT
/begin MEASUREMENT v_inj_burst_act_[6] "voltage burst signal (choosen for detection)" UWORD _CNV_A_R_LINEAR_____123_CM 1 0. 0. 255. DISPLAY_IDENTIFIER V_INJ_BURST_ACT__6_ ECU_ADDRESS 0x7fad4e BYTE_ORDER MSB_LAST FORMAT "%4.1" /end MEASUREMENT
/begin MEASUREMENT v_inj_burst_act_[7] "voltage burst signal (choosen for detection)" UWORD _CNV_A_R_LINEAR_____123_CM 1 0. 0. 255. DISPLAY_IDENTIFIER V_INJ_BURST_ACT__7_ ECU_ADDRESS 0x7fad50 BYTE_ORDER MSB_LAST FORMAT "%4.1" /end MEASUREMENT
/begin MEASUREMENT v_inj_burst_act_[8] "voltage burst signal (choosen for detection)" UWORD _CNV_A_R_LINEAR_____123_CM 1 0. 0. 255. DISPLAY_IDENTIFIER V_INJ_BURST_ACT__8_ ECU_ADDRESS 0x7fad52 BYTE_ORDER MSB_LAST FORMAT "%4.1" /end MEASUREMENT
/begin MEASUREMENT v_inj_burst_act_[9] "voltage burst signal (choosen for detection)" UWORD _CNV_A_R_LINEAR_____123_CM 1 0. 0. 255. DISPLAY_IDENTIFIER V_INJ_BURST_ACT__9_ ECU_ADDRESS 0x7fad54 BYTE_ORDER MSB_LAST FORMAT "%4.1" /end MEASUREMENT
/begin MEASUREMENT v_inj_burst_act_[10] "voltage burst signal (choosen for detection)" UWORD _CNV_A_R_LINEAR_____123_CM 1 0. 0. 255. DISPLAY_IDENTIFIER V_INJ_BURST_ACT__10_ ECU_ADDRESS 0x7fad56 BYTE_ORDER MSB_LAST FORMAT "%4.1" /end MEASUREMENT
/begin MEASUREMENT v_inj_burst_act_[11] "voltage burst signal (choosen for detection)" UWORD _CNV_A_R_LINEAR_____123_CM 1 0. 0. 255. DISPLAY_IDENTIFIER V_INJ_BURST_ACT__11_ ECU_ADDRESS 0x7fad58 BYTE_ORDER MSB_LAST FORMAT "%4.1" /end MEASUREMENT
/begin MEASUREMENT v_inj_burst_act_[12] "voltage burst signal (choosen for detection)" UWORD _CNV_A_R_LINEAR_____123_CM 1 0. 0. 255. DISPLAY_IDENTIFIER V_INJ_BURST_ACT__12_ ECU_ADDRESS 0x7fad5a BYTE_ORDER MSB_LAST FORMAT "%4.1" /end MEASUREMENT
/begin MEASUREMENT v_inj_burst_act_[13] "voltage burst signal (choosen for detection)" UWORD _CNV_A_R_LINEAR_____123_CM 1 0. 0. 255. DISPLAY_IDENTIFIER V_INJ_BURST_ACT__13_ ECU_ADDRESS 0x7fad5c BYTE_ORDER MSB_LAST FORMAT "%4.1" /end MEASUREMENT
/begin MEASUREMENT v_inj_burst_act_[14] "voltage burst signal (choosen for detection)" UWORD _CNV_A_R_LINEAR_____123_CM 1 0. 0. 255. DISPLAY_IDENTIFIER V_INJ_BURST_ACT__14_ ECU_ADDRESS 0x7fad5e BYTE_ORDER MSB_LAST FORMAT "%4.1" /end MEASUREMENT
/begin MEASUREMENT v_inj_burst_act_[15] "voltage burst signal (choosen for detection)" UWORD _CNV_A_R_LINEAR_____123_CM 1 0. 0. 255. DISPLAY_IDENTIFIER V_INJ_BURST_ACT__15_ ECU_ADDRESS 0x7fad60 BYTE_ORDER MSB_LAST FORMAT "%4.1" /end MEASUREMENT
/begin MEASUREMENT v_inj_burst_act_[16] "voltage burst signal (choosen for detection)" UWORD _CNV_A_R_LINEAR_____123_CM 1 0. 0. 255. DISPLAY_IDENTIFIER V_INJ_BURST_ACT__16_ ECU_ADDRESS 0x7fad62 BYTE_ORDER MSB_LAST FORMAT "%4.1" /end MEASUREMENT
/begin MEASUREMENT v_inj_burst_act_[17] "voltage burst signal (choosen for detection)" UWORD _CNV_A_R_LINEAR_____123_CM 1 0. 0. 255. DISPLAY_IDENTIFIER V_INJ_BURST_ACT__17_ ECU_ADDRESS 0x7fad64 BYTE_ORDER MSB_LAST FORMAT "%4.1" /end MEASUREMENT
/begin MEASUREMENT v_inj_burst_act_[18] "voltage burst signal (choosen for detection)" UWORD _CNV_A_R_LINEAR_____123_CM 1 0. 0. 255. DISPLAY_IDENTIFIER V_INJ_BURST_ACT__18_ ECU_ADDRESS 0x7fad66 BYTE_ORDER MSB_LAST FORMAT "%4.1" /end MEASUREMENT
/begin MEASUREMENT v_inj_burst_act_[19] "voltage burst signal (choosen for detection)" UWORD _CNV_A_R_LINEAR_____123_CM 1 0. 0. 255. DISPLAY_IDENTIFIER V_INJ_BURST_ACT__19_ ECU_ADDRESS 0x7fad68 BYTE_ORDER MSB_LAST FORMAT "%4.1" /end MEASUREMENT
/begin MEASUREMENT v_inj_burst_act_[20] "voltage burst signal (choosen for detection)" UWORD _CNV_A_R_LINEAR_____123_CM 1 0. 0. 255. DISPLAY_IDENTIFIER V_INJ_BURST_ACT__20_ ECU_ADDRESS 0x7fad6a BYTE_ORDER MSB_LAST FORMAT "%4.1" /end MEASUREMENT
/begin MEASUREMENT v_inj_burst_act_[21] "voltage burst signal (choosen for detection)" UWORD _CNV_A_R_LINEAR_____123_CM 1 0. 0. 255. DISPLAY_IDENTIFIER V_INJ_BURST_ACT__21_ ECU_ADDRESS 0x7fad6c BYTE_ORDER MSB_LAST FORMAT "%4.1" /end MEASUREMENT
/begin MEASUREMENT v_inj_burst_act_[22] "voltage burst signal (choosen for detection)" UWORD _CNV_A_R_LINEAR_____123_CM 1 0. 0. 255. DISPLAY_IDENTIFIER V_INJ_BURST_ACT__22_ ECU_ADDRESS 0x7fad6e BYTE_ORDER MSB_LAST FORMAT "%4.1" /end MEASUREMENT
/begin MEASUREMENT v_inj_burst_act_[23] "voltage burst signal (choosen for detection)" UWORD _CNV_A_R_LINEAR_____123_CM 1 0. 0. 255. DISPLAY_IDENTIFIER V_INJ_BURST_ACT__23_ ECU_ADDRESS 0x7fad70 BYTE_ORDER MSB_LAST FORMAT "%4.1" /end MEASUREMENT
/begin MEASUREMENT v_inj_burst_act_[24] "voltage burst signal (choosen for detection)" UWORD _CNV_A_R_LINEAR_____123_CM 1 0. 0. 255. DISPLAY_IDENTIFIER V_INJ_BURST_ACT__24_ ECU_ADDRESS 0x7fad72 BYTE_ORDER MSB_LAST FORMAT "%4.1" /end MEASUREMENT
/begin MEASUREMENT v_inj_burst_act_[25] "voltage burst signal (choosen for detection)" UWORD _CNV_A_R_LINEAR_____123_CM 1 0. 0. 255. DISPLAY_IDENTIFIER V_INJ_BURST_ACT__25_ ECU_ADDRESS 0x7fad74 BYTE_ORDER MSB_LAST FORMAT "%4.1" /end MEASUREMENT
/begin MEASUREMENT v_inj_burst_act_[26] "voltage burst signal (choosen for detection)" UWORD _CNV_A_R_LINEAR_____123_CM 1 0. 0. 255. DISPLAY_IDENTIFIER V_INJ_BURST_ACT__26_ ECU_ADDRESS 0x7fad76 BYTE_ORDER MSB_LAST FORMAT "%4.1" /end MEASUREMENT
/begin MEASUREMENT v_inj_burst_act_[27] "voltage burst signal (choosen for detection)" UWORD _CNV_A_R_LINEAR_____123_CM 1 0. 0. 255. DISPLAY_IDENTIFIER V_INJ_BURST_ACT__27_ ECU_ADDRESS 0x7fad78 BYTE_ORDER MSB_LAST FORMAT "%4.1" /end MEASUREMENT
/begin MEASUREMENT v_inj_burst_act_[28] "voltage burst signal (choosen for detection)" UWORD _CNV_A_R_LINEAR_____123_CM 1 0. 0. 255. DISPLAY_IDENTIFIER V_INJ_BURST_ACT__28_ ECU_ADDRESS 0x7fad7a BYTE_ORDER MSB_LAST FORMAT "%4.1" /end MEASUREMENT
/begin MEASUREMENT v_inj_burst_act_[29] "voltage burst signal (choosen for detection)" UWORD _CNV_A_R_LINEAR_____123_CM 1 0. 0. 255. DISPLAY_IDENTIFIER V_INJ_BURST_ACT__29_ ECU_ADDRESS 0x7fad7c BYTE_ORDER MSB_LAST FORMAT "%4.1" /end MEASUREMENT
/begin MEASUREMENT v_inj_burst_act_[30] "voltage burst signal (choosen for detection)" UWORD _CNV_A_R_LINEAR_____123_CM 1 0. 0. 255. DISPLAY_IDENTIFIER V_INJ_BURST_ACT__30_ ECU_ADDRESS 0x7fad7e BYTE_ORDER MSB_LAST FORMAT "%4.1" /end MEASUREMENT
/begin MEASUREMENT v_inj_burst_act_[31] "voltage burst signal (choosen for detection)" UWORD _CNV_A_R_LINEAR_____123_CM 1 0. 0. 255. DISPLAY_IDENTIFIER V_INJ_BURST_ACT__31_ ECU_ADDRESS 0x7fad80 BYTE_ORDER MSB_LAST FORMAT "%4.1" /end MEASUREMENT
/begin MEASUREMENT v_inj_burst_act_[32] "voltage burst signal (choosen for detection)" UWORD _CNV_A_R_LINEAR_____123_CM 1 0. 0. 255. DISPLAY_IDENTIFIER V_INJ_BURST_ACT__32_ ECU_ADDRESS 0x7fad82 BYTE_ORDER MSB_LAST FORMAT "%4.1" /end MEASUREMENT
/begin MEASUREMENT v_inj_burst_act_[33] "voltage burst signal (choosen for detection)" UWORD _CNV_A_R_LINEAR_____123_CM 1 0. 0. 255. DISPLAY_IDENTIFIER V_INJ_BURST_ACT__33_ ECU_ADDRESS 0x7fad84 BYTE_ORDER MSB_LAST FORMAT "%4.1" /end MEASUREMENT
/begin MEASUREMENT v_inj_burst_act_[34] "voltage burst signal (choosen for detection)" UWORD _CNV_A_R_LINEAR_____123_CM 1 0. 0. 255. DISPLAY_IDENTIFIER V_INJ_BURST_ACT__34_ ECU_ADDRESS 0x7fad86 BYTE_ORDER MSB_LAST FORMAT "%4.1" /end MEASUREMENT
/begin MEASUREMENT v_inj_burst_act_[35] "voltage burst signal (choosen for detection)" UWORD _CNV_A_R_LINEAR_____123_CM 1 0. 0. 255. DISPLAY_IDENTIFIER V_INJ_BURST_ACT__35_ ECU_ADDRESS 0x7fad88 BYTE_ORDER MSB_LAST FORMAT "%4.1" /end MEASUREMENT
/begin MEASUREMENT v_inj_burst_act_[36] "voltage burst signal (choosen for detection)" UWORD _CNV_A_R_LINEAR_____123_CM 1 0. 0. 255. DISPLAY_IDENTIFIER V_INJ_BURST_ACT__36_ ECU_ADDRESS 0x7fad8a BYTE_ORDER MSB_LAST FORMAT "%4.1" /end MEASUREMENT
/begin MEASUREMENT v_inj_burst_act_[37] "voltage burst signal (choosen for detection)" UWORD _CNV_A_R_LINEAR_____123_CM 1 0. 0. 255. DISPLAY_IDENTIFIER V_INJ_BURST_ACT__37_ ECU_ADDRESS 0x7fad8c BYTE_ORDER MSB_LAST FORMAT "%4.1" /end MEASUREMENT
/begin MEASUREMENT v_inj_burst_act_[38] "voltage burst signal (choosen for detection)" UWORD _CNV_A_R_LINEAR_____123_CM 1 0. 0. 255. DISPLAY_IDENTIFIER V_INJ_BURST_ACT__38_ ECU_ADDRESS 0x7fad8e BYTE_ORDER MSB_LAST FORMAT "%4.1" /end MEASUREMENT
/begin MEASUREMENT v_inj_burst_act_[39] "voltage burst signal (choosen for detection)" UWORD _CNV_A_R_LINEAR_____123_CM 1 0. 0. 255. DISPLAY_IDENTIFIER V_INJ_BURST_ACT__39_ ECU_ADDRESS 0x7fad90 BYTE_ORDER MSB_LAST FORMAT "%4.1" /end MEASUREMENT
/begin MEASUREMENT v_inj_burst_act_[40] "voltage burst signal (choosen for detection)" UWORD _CNV_A_R_LINEAR_____123_CM 1 0. 0. 255. DISPLAY_IDENTIFIER V_INJ_BURST_ACT__40_ ECU_ADDRESS 0x7fad92 BYTE_ORDER MSB_LAST FORMAT "%4.1" /end MEASUREMENT
/begin MEASUREMENT v_inj_burst_act_[41] "voltage burst signal (choosen for detection)" UWORD _CNV_A_R_LINEAR_____123_CM 1 0. 0. 255. DISPLAY_IDENTIFIER V_INJ_BURST_ACT__41_ ECU_ADDRESS 0x7fad94 BYTE_ORDER MSB_LAST FORMAT "%4.1" /end MEASUREMENT
/begin MEASUREMENT v_inj_burst_act_[42] "voltage burst signal (choosen for detection)" UWORD _CNV_A_R_LINEAR_____123_CM 1 0. 0. 255. DISPLAY_IDENTIFIER V_INJ_BURST_ACT__42_ ECU_ADDRESS 0x7fad96 BYTE_ORDER MSB_LAST FORMAT "%4.1" /end MEASUREMENT
/begin MEASUREMENT v_inj_burst_act_[43] "voltage burst signal (choosen for detection)" UWORD _CNV_A_R_LINEAR_____123_CM 1 0. 0. 255. DISPLAY_IDENTIFIER V_INJ_BURST_ACT__43_ ECU_ADDRESS 0x7fad98 BYTE_ORDER MSB_LAST FORMAT "%4.1" /end MEASUREMENT
/begin MEASUREMENT v_inj_burst_act_[44] "voltage burst signal (choosen for detection)" UWORD _CNV_A_R_LINEAR_____123_CM 1 0. 0. 255. DISPLAY_IDENTIFIER V_INJ_BURST_ACT__44_ ECU_ADDRESS 0x7fad9a BYTE_ORDER MSB_LAST FORMAT "%4.1" /end MEASUREMENT
/begin MEASUREMENT v_inj_burst_act_[45] "voltage burst signal (choosen for detection)" UWORD _CNV_A_R_LINEAR_____123_CM 1 0. 0. 255. DISPLAY_IDENTIFIER V_INJ_BURST_ACT__45_ ECU_ADDRESS 0x7fad9c BYTE_ORDER MSB_LAST FORMAT "%4.1" /end MEASUREMENT
/begin MEASUREMENT v_inj_burst_act_[46] "voltage burst signal (choosen for detection)" UWORD _CNV_A_R_LINEAR_____123_CM 1 0. 0. 255. DISPLAY_IDENTIFIER V_INJ_BURST_ACT__46_ ECU_ADDRESS 0x7fad9e BYTE_ORDER MSB_LAST FORMAT "%4.1" /end MEASUREMENT
/begin MEASUREMENT v_inj_burst_act_[47] "voltage burst signal (choosen for detection)" UWORD _CNV_A_R_LINEAR_____123_CM 1 0. 0. 255. DISPLAY_IDENTIFIER V_INJ_BURST_ACT__47_ ECU_ADDRESS 0x7fada0 BYTE_ORDER MSB_LAST FORMAT "%4.1" /end MEASUREMENT
/begin MEASUREMENT v_inj_burst_act_[48] "voltage burst signal (choosen for detection)" UWORD _CNV_A_R_LINEAR_____123_CM 1 0. 0. 255. DISPLAY_IDENTIFIER V_INJ_BURST_ACT__48_ ECU_ADDRESS 0x7fada2 BYTE_ORDER MSB_LAST FORMAT "%4.1" /end MEASUREMENT
/begin MEASUREMENT v_inj_burst_act_[49] "voltage burst signal (choosen for detection)" UWORD _CNV_A_R_LINEAR_____123_CM 1 0. 0. 255. DISPLAY_IDENTIFIER V_INJ_BURST_ACT__49_ ECU_ADDRESS 0x7fada4 BYTE_ORDER MSB_LAST FORMAT "%4.1" /end MEASUREMENT
/begin MEASUREMENT v_inj_burst_act_[50] "voltage burst signal (choosen for detection)" UWORD _CNV_A_R_LINEAR_____123_CM 1 0. 0. 255. DISPLAY_IDENTIFIER V_INJ_BURST_ACT__50_ ECU_ADDRESS 0x7fada6 BYTE_ORDER MSB_LAST FORMAT "%4.1" /end MEASUREMENT
/begin MEASUREMENT v_inj_burst_act_[51] "voltage burst signal (choosen for detection)" UWORD _CNV_A_R_LINEAR_____123_CM 1 0. 0. 255. DISPLAY_IDENTIFIER V_INJ_BURST_ACT__51_ ECU_ADDRESS 0x7fada8 BYTE_ORDER MSB_LAST FORMAT "%4.1" /end MEASUREMENT
/begin MEASUREMENT v_inj_burst_act_[52] "voltage burst signal (choosen for detection)" UWORD _CNV_A_R_LINEAR_____123_CM 1 0. 0. 255. DISPLAY_IDENTIFIER V_INJ_BURST_ACT__52_ ECU_ADDRESS 0x7fadaa BYTE_ORDER MSB_LAST FORMAT "%4.1" /end MEASUREMENT
/begin MEASUREMENT v_inj_burst_act_[53] "voltage burst signal (choosen for detection)" UWORD _CNV_A_R_LINEAR_____123_CM 1 0. 0. 255. DISPLAY_IDENTIFIER V_INJ_BURST_ACT__53_ ECU_ADDRESS 0x7fadac BYTE_ORDER MSB_LAST FORMAT "%4.1" /end MEASUREMENT
/begin MEASUREMENT v_inj_burst_act_[54] "voltage burst signal (choosen for detection)" UWORD _CNV_A_R_LINEAR_____123_CM 1 0. 0. 255. DISPLAY_IDENTIFIER V_INJ_BURST_ACT__54_ ECU_ADDRESS 0x7fadae BYTE_ORDER MSB_LAST FORMAT "%4.1" /end MEASUREMENT
/begin MEASUREMENT v_inj_burst_act_[55] "voltage burst signal (choosen for detection)" UWORD _CNV_A_R_LINEAR_____123_CM 1 0. 0. 255. DISPLAY_IDENTIFIER V_INJ_BURST_ACT__55_ ECU_ADDRESS 0x7fadb0 BYTE_ORDER MSB_LAST FORMAT "%4.1" /end MEASUREMENT
/begin MEASUREMENT v_inj_burst_act_[56] "voltage burst signal (choosen for detection)" UWORD _CNV_A_R_LINEAR_____123_CM 1 0. 0. 255. DISPLAY_IDENTIFIER V_INJ_BURST_ACT__56_ ECU_ADDRESS 0x7fadb2 BYTE_ORDER MSB_LAST FORMAT "%4.1" /end MEASUREMENT
/begin MEASUREMENT v_inj_burst_act_[57] "voltage burst signal (choosen for detection)" UWORD _CNV_A_R_LINEAR_____123_CM 1 0. 0. 255. DISPLAY_IDENTIFIER V_INJ_BURST_ACT__57_ ECU_ADDRESS 0x7fadb4 BYTE_ORDER MSB_LAST FORMAT "%4.1" /end MEASUREMENT
/begin MEASUREMENT v_inj_burst_act_[58] "voltage burst signal (choosen for detection)" UWORD _CNV_A_R_LINEAR_____123_CM 1 0. 0. 255. DISPLAY_IDENTIFIER V_INJ_BURST_ACT__58_ ECU_ADDRESS 0x7fadb6 BYTE_ORDER MSB_LAST FORMAT "%4.1" /end MEASUREMENT
/begin MEASUREMENT v_inj_burst_act_[59] "voltage burst signal (choosen for detection)" UWORD _CNV_A_R_LINEAR_____123_CM 1 0. 0. 255. DISPLAY_IDENTIFIER V_INJ_BURST_ACT__59_ ECU_ADDRESS 0x7fadb8 BYTE_ORDER MSB_LAST FORMAT "%4.1" /end MEASUREMENT
/begin MEASUREMENT v_inj_burst_act_[60] "voltage burst signal (choosen for detection)" UWORD _CNV_A_R_LINEAR_____123_CM 1 0. 0. 255. DISPLAY_IDENTIFIER V_INJ_BURST_ACT__60_ ECU_ADDRESS 0x7fadba BYTE_ORDER MSB_LAST FORMAT "%4.1" /end MEASUREMENT
/begin MEASUREMENT v_inj_burst_act_[61] "voltage burst signal (choosen for detection)" UWORD _CNV_A_R_LINEAR_____123_CM 1 0. 0. 255. DISPLAY_IDENTIFIER V_INJ_BURST_ACT__61_ ECU_ADDRESS 0x7fadbc BYTE_ORDER MSB_LAST FORMAT "%4.1" /end MEASUREMENT
/begin MEASUREMENT v_inj_burst_act_[62] "voltage burst signal (choosen for detection)" UWORD _CNV_A_R_LINEAR_____123_CM 1 0. 0. 255. DISPLAY_IDENTIFIER V_INJ_BURST_ACT__62_ ECU_ADDRESS 0x7fadbe BYTE_ORDER MSB_LAST FORMAT "%4.1" /end MEASUREMENT
/begin MEASUREMENT v_inj_burst_act_[63] "voltage burst signal (choosen for detection)" UWORD _CNV_A_R_LINEAR_____123_CM 1 0. 0. 255. DISPLAY_IDENTIFIER V_INJ_BURST_ACT__63_ ECU_ADDRESS 0x7fadc0 BYTE_ORDER MSB_LAST FORMAT "%4.1" /end MEASUREMENT
/begin MEASUREMENT v_inj_burst_act_[64] "voltage burst signal (choosen for detection)" UWORD _CNV_A_R_LINEAR_____123_CM 1 0. 0. 255. DISPLAY_IDENTIFIER V_INJ_BURST_ACT__64_ ECU_ADDRESS 0x7fadc2 BYTE_ORDER MSB_LAST FORMAT "%4.1" /end MEASUREMENT
/begin MEASUREMENT v_inj_burst_act_[65] "voltage burst signal (choosen for detection)" UWORD _CNV_A_R_LINEAR_____123_CM 1 0. 0. 255. DISPLAY_IDENTIFIER V_INJ_BURST_ACT__65_ ECU_ADDRESS 0x7fadc4 BYTE_ORDER MSB_LAST FORMAT "%4.1" /end MEASUREMENT
/begin MEASUREMENT v_inj_burst_act_[66] "voltage burst signal (choosen for detection)" UWORD _CNV_A_R_LINEAR_____123_CM 1 0. 0. 255. DISPLAY_IDENTIFIER V_INJ_BURST_ACT__66_ ECU_ADDRESS 0x7fadc6 BYTE_ORDER MSB_LAST FORMAT "%4.1" /end MEASUREMENT
/begin MEASUREMENT v_inj_burst_act_[67] "voltage burst signal (choosen for detection)" UWORD _CNV_A_R_LINEAR_____123_CM 1 0. 0. 255. DISPLAY_IDENTIFIER V_INJ_BURST_ACT__67_ ECU_ADDRESS 0x7fadc8 BYTE_ORDER MSB_LAST FORMAT "%4.1" /end MEASUREMENT
/begin MEASUREMENT v_inj_burst_act_[68] "voltage burst signal (choosen for detection)" UWORD _CNV_A_R_LINEAR_____123_CM 1 0. 0. 255. DISPLAY_IDENTIFIER V_INJ_BURST_ACT__68_ ECU_ADDRESS 0x7fadca BYTE_ORDER MSB_LAST FORMAT "%4.1" /end MEASUREMENT
/begin MEASUREMENT v_inj_burst_act_[69] "voltage burst signal (choosen for detection)" UWORD _CNV_A_R_LINEAR_____123_CM 1 0. 0. 255. DISPLAY_IDENTIFIER V_INJ_BURST_ACT__69_ ECU_ADDRESS 0x7fadcc BYTE_ORDER MSB_LAST FORMAT "%4.1" /end MEASUREMENT
/begin MEASUREMENT v_inj_burst_act_[70] "voltage burst signal (choosen for detection)" UWORD _CNV_A_R_LINEAR_____123_CM 1 0. 0. 255. DISPLAY_IDENTIFIER V_INJ_BURST_ACT__70_ ECU_ADDRESS 0x7fadce BYTE_ORDER MSB_LAST FORMAT "%4.1" /end MEASUREMENT
/begin MEASUREMENT v_inj_burst_act_[71] "voltage burst signal (choosen for detection)" UWORD _CNV_A_R_LINEAR_____123_CM 1 0. 0. 255. DISPLAY_IDENTIFIER V_INJ_BURST_ACT__71_ ECU_ADDRESS 0x7fadd0 BYTE_ORDER MSB_LAST FORMAT "%4.1" /end MEASUREMENT
/begin MEASUREMENT v_inj_burst_act_[72] "voltage burst signal (choosen for detection)" UWORD _CNV_A_R_LINEAR_____123_CM 1 0. 0. 255. DISPLAY_IDENTIFIER V_INJ_BURST_ACT__72_ ECU_ADDRESS 0x7fadd2 BYTE_ORDER MSB_LAST FORMAT "%4.1" /end MEASUREMENT
/begin COMPU_METHOD _CNV_A_R_LINEAR_____0_CM "" RAT_FUNC "%6.3" "[-]" COEFFS 0 1. 0. 0 0 1 /end COMPU_METHOD
/begin COMPU_METHOD _CNV_A_R_LINEAR_____1_CM "" RAT_FUNC "%6.3" "-" COEFFS 0 1. 0. 0 0 1 /end COMPU_METHOD
/begin COMPU_METHOD _CNV_A_R_LINEAR_____8_CM "" RAT_FUNC "%6.3" "[%]" COEFFS 0 655.3599999999997 0. 0 0 1 /end COMPU_METHOD
/begin COMPU_METHOD _CNV_S_2_RANGE______11_CM "" TAB_VERB "%6.3" "[-]" COMPU_TAB_REF _CNV_S_2_RANGE______11 /end COMPU_METHOD
/begin COMPU_VTAB _CNV_S_2_RANGE______11 "" TAB_VERB 2 0 "0" 1 "1" /end COMPU_VTAB
/begin COMPU_METHOD _CNV_A_R_LINEAR_____21_CM "" RAT_FUNC "%6.3" "[hPa]" COEFFS 0 12.06017666543982 0. 0 0 1 /end COMPU_METHOD
/begin COMPU_METHOD _CNV_A_R_LINEAR_____23_CM "" RAT_FUNC "%6.3" "[mg/stk]" COEFFS 0 47.18142548596112 0. 0 0 1 /end COMPU_METHOD
/begin COMPU_METHOD _CNV_S_173_CONV_DIAG__26_CM "" TAB_VERB "%6.3" "[-]" COMPU_TAB_REF _CNV_S_173_CONV_DIAG__26 /end COMPU_METHOD
/begin COMPU_VTAB _CNV_S_173_CONV_DIAG__26 "" TAB_VERB 173 0 "NO_ERROR" 1 "IMOB" 2 "ECU_4" 3 "ECU_2" 4 "V_DCDC_RNG" 5 "PVS_L_1" 6 "PVS_L_2" 7 "PVS_H_1" 8 "PVS_H_2" 9 "PVS_RATIO" 10 "PVS_MOVE" 11 "PVS_BLS_BTS" 12 "VCC_1" 13 "VCC_2" 14 "V_DIP_PF_RNG" 15 "DIP_PF_MES_ES" 16 "DIP_PF_MES_ERU" 17 "V_TCO_1_RNG" 18 "V_TCO_2_RNG" 19 "TCO_1_MES_GRD" 20 "TCO_2_MES_GRD" 21 "TCO_MES_PLAUS" 22 "EGR_CTL_MIN" 23 "EGR_CTL_MAX" 24 "V_AMP_RNG" 25 "AMP_MES_GRD" 26 "V_TFU_RNG" 27 "TFU_MES_GRD" 28 "V_MAP_RNG" 29 "MAP_AMP_OFS" 30 "MAP_IS_OFS" 31 "MAP_MES_GRD" 32 "MAF_KGH_PLAUS" 33 "MAF_0_RNG" 34 "V_TPC_RNG" 35 "TPC_MES_PLAUS" 36 "V_TAC_RNG" 37 "TAC_MES_PLAUS" 38 "MF_IS_OBD" 39 "CYL_BAL_0" 40 "CYL_BAL_1" 41 "CYL_BAL_2" 42 "CYL_BAL_3" 43 "EGRV_0_CTL" 44 "V_EGRV_0_BOL_AD" 45 "THR_0_CTL" 46 "V_THR_0_BOL_AD" 47 "BPA_0_CTL" 48 "V_BPA_0_BOL_AD" 49 "BYP_0_CTL" 50 "V_BYP_0_BOL_AD" 51 "MAP_CTL_MIN" 52 "MAP_CTL_MAX" 53 "EGR_IS_SLOW_OBD" 54 "MAF_EGR_THR_OBD" 55 "MAF_DIF_EGR_THR_OBD" 56 "MAP_DIF_EGR_THR_OBD" 57 "VS" 58 "CS" 59 "BLS" 60 "BLS_BTS_DECE" 61 "BLS_BTS_PLAUS" 62 "CAN_TCS" 63 "CAN_TCU" 64 "CAN_ACU" 65 "CAN_CCU" 66 "CAN_ICL" 67 "CAN_VECU" 68 "CAN_SMLS" 69 "CAN_BOFF" 70 "CAN_BEM" 71 "CAN_IF_CFT" 72 "CAN_TOT" 73 "VARCOD" 74 "ACP_MES_RNG" 75 "ACP_MES_GRD" 76 "V_TBA_RNG" 77 "TBA_MES_GRD" 78 "DUCY_ALTER_PWM_RNG" 79 "DUCY_ALTER_PWM_GRD" 80 "V_EGRV_0_RNG" 81 "V_EGRV_1_RNG" 82 "V_EGRV_0_GRD" 83 "V_EGRV_1_GRD" 84 "GES_MAF_0_MAX" 85 "TCO_1_2_PLAUS" 86 "EFP_RLY_DPS" 87 "EFP_RLY_PLAUS_1" 88 "EFP_RLY_PLAUS_2" 89 "SPI_MPS" 90 "SPI_OCT" 91 "SPI_QPS" 92 "EGR_BYP_DPS" 93 "EGRV_0" 94 "PPS_INI_0" 95 "PPS_INI_TOUT_0" 96 "PPS_PLAUS_0" 97 "PPS_CAL_0" 98 "PPS_V_INJ_0" 99 "PPS_WDT_0" 100 "PPS_FSM_0" 101 "PPS_OC_0" 102 "PPS_OC_1" 103 "PPS_OC_2" 104 "PPS_OC_3" 105 "PPS_SC_H_L_0" 106 "PPS_SC_H_L_1" 107 "PPS_SC_H_L_2" 108 "PPS_SC_H_L_3" 109 "PPS_SC_H_0" 110 "PPS_SC_L_0" 111 "BPA" 112 "EGRV" 113 "FSD_1" 114 "GL_RLY_DPS" 115 "MIS_A" 116 "MIS_B1" 117 "MIS_B4" 118 "PCV_1" 119 "PCV_2" 120 "PCV_3" 121 "RLY_MAIN" 122 "RLY_POWER" 123 "THR" 124 "VAR_COD" 125 "VB" 126 "VCV_1" 127 "VCV_2" 128 "VCV_3" 129 "CONV_MON_1" 130 "N_32_MON_1" 131 "PVS_MON_1" 132 "FCUT_MON_1" 133 "TQI_N_MAX_MON_1" 134 "SERV_MON_1" 135 "POST_INH_MON" 136 "CRU_INH_MON" 137 "CAN_INH_MON" 138 "MON_3" 139 "PER_CAM_IN_1" 140 "SYN_CAM_IN_1" 141 "REF_CRK_CAM_IN_1" 142 "CRK_TOOTH" 143 "CRK_TOOTH_PER" 144 "CRK_SYN" 145 "CRK_PLAUS" 146 "PLAUS_CAM_IN_1" 147 "SYN_CRK_CAM_IN_1" 148 "LSH_UP_1" 149 "LSH_DOWN_1" 150 "SCG_LS_DOWN_1" 151 "SCP_LS_DOWN_1" 152 "OC_LS_DOWN_1" 153 "OBD_LSH_DOWN_1" 154 "LAM_ADJ_1" 155 "CHK_LS_DOWN_1" 156 "PUC_LS_DOWN_1" 157 "FL_LS_DOWN_1" 158 "EL_LSL_UP_1" 159 "OC_LSL_UP_1" 160 "LSL_UP_IF_1" 161 "AIR_LSL_UP_1" 162 "TTIP_OBD_LS_UP_1" 163 "DYN_VLD_LS_UP_1" 164 "PUC_VLD_LS_UP_1" 165 "OBD_VLD_LSH_UP_1" 166 "SHIFT_AFL_LSL_UP_1" 167 "SHIFT_AFR_LSL_UP_1" 168 "LSH_LSL_UP_1" 169 "SWT_LS_DOWN_1" 170 "PUE_LS_DOWN_1" 171 "CHG_LS_UP" 172 "CHG_LS_DOWN" /end COMPU_VTAB
/begin COMPU_METHOD _CNV_A_R_LINEAR_____33_CM "" RAT_FUNC "%6.3" "[V]" COEFFS 0 204.8 0. 0 0 1 /end COMPU_METHOD
/begin COMPU_METHOD _CNV_A_R_LINEAR_____53_CM "" RAT_FUNC "%6.3" "[-]" COEFFS 0 32767.99807357072 0. 0 0 1 /end COMPU_METHOD
/begin COMPU_METHOD _CNV_A_R_LINEAR_____62_CM "" RAT_FUNC "%6.3" "[Nm]" COEFFS 0 32. 0. 0 0 1 /end COMPU_METHOD
/begin COMPU_METHOD _CNV_A_R_LINEAR_____63_CM "" RAT_FUNC "%6.3" "[-]" COEFFS 0 16383.81262712377 0. 0 0 1 /end COMPU_METHOD
/begin COMPU_METHOD _CNV_A_R_LINEAR_____74_CM "" RAT_FUNC "%6.3" "[km/h]" COEFFS 0 100. 0. 0 0 1 /end COMPU_METHOD
/begin COMPU_METHOD _CNV_S_2_RANGE__0___88_CM "" TAB_VERB "%6.3" "-" COMPU_TAB_REF _CNV_S_2_RANGE__0___88 /end COMPU_METHOD
/begin COMPU_VTAB _CNV_S_2_RANGE__0___88 "" TAB_VERB 2 0 "0" 1 "1" /end COMPU_VTAB
/begin COMPU_METHOD _CNV_A_R_LINEAR_____123_CM "" RAT_FUNC "%6.3" "[V]" COEFFS 0 4.011764705882353 0. 0 0 1 /end COMPU_METHOD
/begin COMPU_METHOD _CNV_A_R_LINEAR_____124_CM "" RAT_FUNC "%6.3" "[uAs]" COEFFS 0 16. 0. 0 0 1 /end COMPU_METHOD
/begin COMPU_METHOD _CNV_A_R_LINEAR_____128_CM "" RAT_FUNC "%6.3" "V" COEFFS 0 4.011764705882353 0. 0 0 1 /end COMPU_METHOD
/begin COMPU_METHOD _CNV_A_R_LINEAR_____138_CM "" RAT_FUNC "%6.3" "[%]" COEFFS 0 655.3600000071681 3.584063961170614e-007 0 0 1 /end COMPU_METHOD
/begin COMPU_METHOD _CNV_A_R_LINEAR_____208_CM "" RAT_FUNC "%6.3" "[ms]" COEFFS 0 999.9999999999999 0. 0 0 1 /end COMPU_METHOD
/begin COMPU_METHOD _CNV_A_R_LINEAR_____220_CM "" RAT_FUNC "%6.3" "[ms]" COEFFS 0 100. 0. 0 0 1 /end COMPU_METHOD
/begin COMPU_METHOD _CNV_A_R_LINEAR_____231_CM "" RAT_FUNC "%6.3" "[°TPS]" COEFFS 0 137.0962343096234 0. 0 0 1 /end COMPU_METHOD
/begin COMPU_METHOD _CNV_A_R_LINEAR_____232_CM "" RAT_FUNC "%6.3" "-" COEFFS 0 4.015748031496063e-002 0. 0 0 1 /end COMPU_METHOD
/begin COMPU_METHOD _CNV_A_R_LINEAR_____234_CM "" RAT_FUNC "%6.3" "s" COEFFS 0 10. 0. 0 0 1 /end COMPU_METHOD
/begin COMPU_METHOD _CNV_A_R_LINEAR_____235_CM "" RAT_FUNC "%6.3" "[\260C]" COEFFS 0 1.333333333333333 64. 0 0 1 /end COMPU_METHOD
/begin COMPU_METHOD _CNV_A_R_LINEAR_____295_CM "" RAT_FUNC "%6.3" "°C" COEFFS 0 1. 60. 0 0 1 /end COMPU_METHOD
/begin COMPU_METHOD _CNV_A_R_LINEAR_____314_CM "" RAT_FUNC "%6.3" "-" COEFFS 0 32768.00790412251 0. 0 0 1 /end COMPU_METHOD
/begin COMPU_METHOD _CNV_S_4_Engine_Sta_339_CM "" TAB_VERB "%6.3" "[-]" COMPU_TAB_REF _CNV_S_4_Engine_Sta_339 /end COMPU_METHOD
/begin COMPU_VTAB _CNV_S_4_Engine_Sta_339 "" TAB_VERB 4 1 "ES" 2 "ST" 4 "IS" 8 "PL" /end COMPU_VTAB
/begin COMPU_METHOD _CNV_A_R_LINEAR_____361_CM "" RAT_FUNC "%6.3" "[-]" COEFFS 0 257. 0. 0 0 1 /end COMPU_METHOD
/begin COMPU_METHOD _CNV_A_R_LINEAR_____372_CM "" RAT_FUNC "%6.3" "[-]" COEFFS 0 65535. 0. 0 0 1 /end COMPU_METHOD
/begin COMPU_METHOD _CNV_S_2_RANGE______392_CM "" TAB_VERB "%6.3" "[-]" COMPU_TAB_REF _CNV_S_2_RANGE______392 /end COMPU_METHOD
/begin COMPU_VTAB _CNV_S_2_RANGE______392 "" TAB_VERB 256 0 "0" 1 "1" 2 "1" 3 "1" 4 "1" 5 "1" 6 "1" 7 "1" 8 "1" 9 "1" 10 "1" 11 "1" 12 "1" 13 "1" 14 "1" 15 "1" 16 "1" 17 "1" 18 "1" 19 "1" 20 "1" 21 "1" 22 "1" 23 "1" 24 "1" 25 "1" 26 "1" 27 "1" 28 "1" 29 "1" 30 "1" 31 "1" 32 "1" 33 "1" 34 "1" 35 "1" 36 "1" 37 "1" 38 "1" 39 "1" 40 "1" 41 "1" 42 "1" 43 "1" 44 "1" 45 "1" 46 "1" 47 "1" 48 "1" 49 "1" 50 "1" 51 "1" 52 "1" 53 "1" 54 "1" 55 "1" 56 "1" 57 "1" 58 "1" 59 "1" 60 "1" 61 "1" 62 "1" 63 "1" 64 "1" 65 "1" 66 "1" 67 "1" 68 "1" 69 "1" 70 "1" 71 "1" 72 "1" 73 "1" 74 "1" 75 "1" 76 "1" 77 "1" 78 "1" 79 "1" 80 "1" 81 "1" 82 "1" 83 "1" 84 "1" 85 "1" 86 "1" 87 "1" 88 "1" 89 "1" 90 "1" 91 "1" 92 "1" 93 "1" 94 "1" 95 "1" 96 "1" 97 "1" 98 "1" 99 "1" 100 "1" 101 "1" 102 "1" 103 "1" 104 "1" 105 "1" 106 "1" 107 "1" 108 "1" 109 "1" 110 "1" 111 "1" 112 "1" 113 "1" 114 "1" 115 "1" 116 "1" 117 "1" 118 "1" 119 "1" 120 "1" 121 "1" 122 "1" 123 "1" 124 "1" 125 "1" 126 "1" 127 "1" 128 "1" 129 "1" 130 "1" 131 "1" 132 "1" 133 "1" 134 "1" 135 "1" 136 "1" 137 "1" 138 "1" 139 "1" 140 "1" 141 "1" 142 "1" 143 "1" 144 "1" 145 "1" 146 "1" 147 "1" 148 "1" 149 "1" 150 "1" 151 "1" 152 "1" 153 "1" 154 "1" 155 "1" 156 "1" 157 "1" 158 "1" 159 "1" 160 "1" 161 "1" 162 "1" 163 "1" 164 "1" 165 "1" 166 "1" 167 "1" 168 "1" 169 "1" 170 "1" 171 "1" 172 "1" 173 "1" 174 "1" 175 "1" 176 "1" 177 "1" 178 "1" 179 "1" 180 "1" 181 "1" 182 "1" 183 "1" 184 "1" 185 "1" 186 "1" 187 "1" 188 "1" 189 "1" 190 "1" 191 "1" 192 "1" 193 "1" 194 "1" 195 "1" 196 "1" 197 "1" 198 "1" 199 "1" 200 "1" 201 "1" 202 "1" 203 "1" 204 "1" 205 "1" 206 "1" 207 "1" 208 "1" 209 "1" 210 "1" 211 "1" 212 "1" 213 "1" 214 "1" 215 "1" 216 "1" 217 "1" 218 "1" 219 "1" 220 "1" 221 "1" 222 "1" 223 "1" 224 "1" 225 "1" 226 "1" 227 "1" 228 "1" 229 "1" 230 "1" 231 "1" 232 "1" 233 "1" 234 "1" 235 "1" 236 "1" 237 "1" 238 "1" 239 "1" 240 "1" 241 "1" 242 "1" 243 "1" 244 "1" 245 "1" 246 "1" 247 "1" 248 "1" 249 "1" 250 "1" 251 "1" 252 "1" 253 "1" 254 "1" 255 "1" /end COMPU_VTAB
/begin COMPU_METHOD _CNV_A_R_LINEAR_____532_CM "" RAT_FUNC "%6.3" "[V]" COEFFS 0 257. 0. 0 0 1 /end COMPU_METHOD
/begin COMPU_METHOD _CNV_A_R_LINEAR_____533_CM "" RAT_FUNC "%6.3" "[ms]" COEFFS 0 1000. 0. 0 0 1 /end COMPU_METHOD
/begin COMPU_METHOD _CNV_A_R_LINEAR_____534_CM "" RAT_FUNC "%6.3" "[mJ]" COEFFS 0 125.3598432925406 0. 0 0 1 /end COMPU_METHOD
/begin COMPU_METHOD _CNV_A_R_LINEAR_____535_CM "" RAT_FUNC "%6.3" "[mJ]" COEFFS 0 125.3598433405 -0.5 0 0 1 /end COMPU_METHOD
/begin COMPU_METHOD _CNV_A_R_LINEAR_____542_CM "" RAT_FUNC "%6.3" "[V]" COEFFS 0 255.9999999499993 -6.400096026482061e-006 0 0 1 /end COMPU_METHOD
/begin FUNCTION __DDS_EXPA2_DEFAULT_FUNC__ "__DDS_EXPA2_DEFAULT_FUNC__"
 /begin OUT_MEASUREMENT err_intm_diag_inst[0] err_intm_diag_inst[1] err_intm_diag_inst[2] err_intm_diag_inst[3] err_intm_diag_inst[4] err_intm_diag_inst[5] err_intm_diag_inst[6] err_intm_diag_inst[7] err_intm_diag_inst[8] err_intm_diag_inst[9] err_intm_ctr_frc[0] err_intm_ctr_frc[1] err_intm_ctr_frc[2] err_intm_ctr_frc[3] err_intm_ctr_frc[4] err_intm_ctr_frc[5] err_intm_ctr_frc[6] err_intm_ctr_frc[7] err_intm_ctr_frc[8] err_intm_ctr_frc[9] ctr_err_intm_nr lv_vs_n_con_diag tq_req_clu_cor lv_tcs_hold lv_err_can_tcs_all lv_err_can_acu_all lv_err_can_ccu_all lv_err_can_icl_all lv_err_can_smls_all lv_err_can_tcu_all lv_err_can_if_cft_all tqi_av tqi_ems tqi_ref_max eff_iga_bas_cor tqi_ref_iga_min_lamb vs_high_res tps_av tqi_bas amp_ad lv_ct lv_ac_cru_sp_ena lv_acc_red_cmd lv_temp_pwal gen_load_resp_ems1 alter_inh lv_alter_act lv_heat_inh lv_vs_lim_act lv_tqi_stnd lv_err_amp lv_n_max_req_tcu n_max_req_tcu tco_stop tco_warn t_ast_stop v_hvr tqi_req_slow tqi_req_tra lv_accin_on toil_mdl mff_sp_mv eff_scc_av vs_used fac_cyl_bal_fdout_mf lv_vb_jump lv_vs_whl_lim_can lv_whl_can_vld lv_tcu_conf_can lv_clima_conf_can lv_nom_sys_can_vld lv_conf_info_vld lv_sys_info_can_vld lv_err_imob lv_imob_inj_off lv_imob_igc_off burst_mes_mode burst_mes_mode_[0] burst_mes_mode_[1] burst_mes_mode_[2] burst_mes_mode_[3] sf_t_iv_close_ctl_sel sf_iv_foc_ctl_sel sf_pui_acq_sel sf_egy_ctl_sel sf_egy_mes_sel sf_stk_ctl_sel seg_nr_peco_cord sf_eng_state_[0] sf_eng_state_[1] sf_eng_state_[2] sf_eng_state_[3] v_inj_burst_mon v_inj_mon_ctr v_inj_burst_mon_[0] v_inj_burst_mon_[1] v_inj_burst_mon_[2] v_inj_burst_mon_[3] v_inj_burst_mon_[4] v_inj_burst_mon_[5] v_inj_burst_mon_[6] v_inj_burst_mon_[7] v_inj_burst_mon_[8] v_inj_burst_mon_[9] v_inj_burst_mon_[10] v_inj_burst_mon_[11] v_inj_burst_mon_[12] v_inj_burst_mon_[13] v_inj_burst_mon_[14] v_inj_burst_mon_[15] v_inj_burst_mon_[16] v_inj_burst_mon_[17] v_inj_burst_mon_[18] v_inj_burst_mon_[19] v_inj_burst_mon_[20] v_inj_burst_mon_[21] v_inj_burst_mon_[22] v_inj_burst_mon_[23] v_inj_burst_mon_[24] v_inj_burst_mon_[25] v_inj_burst_mon_[26] v_inj_burst_mon_[27] v_inj_burst_mon_[28] v_inj_burst_mon_[29] v_inj_burst_mon_[30] v_inj_burst_mon_[31] v_inj_burst_mon_[32] v_inj_burst_mon_[33] v_inj_burst_mon_[34] v_inj_burst_mon_[35] v_inj_burst_mon_[36] v_inj_burst_mon_[37] v_inj_burst_mon_[38] v_inj_burst_mon_[39] v_inj_burst_mon_[40] v_inj_burst_mon_[41] v_inj_burst_mon_[42] v_inj_burst_mon_[43] v_inj_burst_mon_[44] v_inj_burst_mon_[45] v_inj_burst_mon_[46] v_inj_burst_mon_[47] v_inj_burst_mon_[48] v_inj_burst_mon_[49] v_inj_burst_mon_[50] v_inj_burst_mon_[51] v_inj_burst_mon_[52] v_inj_burst_mon_[53] v_inj_burst_mon_[54] v_inj_burst_mon_[55] v_inj_burst_mon_[56] v_inj_burst_mon_[57] v_inj_burst_mon_[58] v_inj_burst_mon_[59] v_inj_burst_mon_[60] v_inj_burst_mon_[61] v_inj_burst_mon_[62] v_inj_burst_mon_[63] v_inj_burst_mon_[64] v_inj_burst_mon_[65] v_inj_burst_mon_[66] v_inj_burst_mon_[67] v_inj_burst_mon_[68] v_inj_burst_mon_[69] v_inj_burst_mon_[70] v_inj_burst_mon_[71] v_inj_burst_mon_[72] v_inj_burst_mon_[73] v_inj_burst_mon_[74] v_inj_burst_mon_[75] v_inj_burst_mon_[76] v_inj_burst_mon_[77] v_inj_burst_mon_[78] v_inj_burst_mon_[79] v_inj_burst_mon_[80] v_inj_burst_mon_[81] v_inj_burst_mon_[82] v_inj_burst_mon_[83] v_inj_burst_mon_[84] v_inj_burst_mon_[85] v_inj_burst_mon_[86] v_inj_burst_mon_[87] v_inj_burst_mon_[88] v_inj_burst_mon_[89] v_inj_burst_mon_[90] v_inj_burst_mon_[91] v_inj_burst_mon_[92] v_inj_burst_mon_[93] v_inj_burst_mon_[94] v_inj_burst_mon_[95] v_inj_burst_mon_[96] v_inj_burst_mon_[97] v_inj_burst_mon_[98] v_inj_burst_mon_[99] lv_num_stk_ast_act t_dcha_test_pls t_cha_test_pls sf_test_pls_act lv_test_pls_act t_soi_burst_mes_dly t_eoi_burst_mes_dly seg_nr_test_pls test_pls_act_ctr test_pls_wait_ctr lv_test_pls_vld fac_pwm_dcha_[0] fac_pwm_dcha_[1] fac_pwm_dcha_[2] fac_pwm_dcha_[3] step_nr_cha_frze_prev1_ctl_[0] step_nr_cha_frze_prev1_ctl_[1] step_nr_cha_frze_prev1_ctl_[2] step_nr_cha_frze_prev1_ctl_[3] step_nr_cha_frze_main1_ctl_[0] step_nr_cha_frze_main1_ctl_[1] step_nr_cha_frze_main1_ctl_[2] step_nr_cha_frze_main1_ctl_[3] step_nr_cha_frze_post1_ctl_[0] step_nr_cha_frze_post1_ctl_[1] step_nr_cha_frze_post1_ctl_[2] step_nr_cha_frze_post1_ctl_[3] t_hld_frze_prev1_ctl_[0] t_hld_frze_prev1_ctl_[1] t_hld_frze_prev1_ctl_[2] t_hld_frze_prev1_ctl_[3] t_hld_frze_main1_ctl_[0] t_hld_frze_main1_ctl_[1] t_hld_frze_main1_ctl_[2] t_hld_frze_main1_ctl_[3] t_hld_frze_post1_ctl_[0] t_hld_frze_post1_ctl_[1] t_hld_frze_post1_ctl_[2] t_hld_frze_post1_ctl_[3] step_nr_dcha_prev1_ctl_[0] step_nr_dcha_prev1_ctl_[1] step_nr_dcha_prev1_ctl_[2] step_nr_dcha_prev1_ctl_[3] step_nr_dcha_main1_ctl_[0] step_nr_dcha_main1_ctl_[1] step_nr_dcha_main1_ctl_[2] step_nr_dcha_main1_ctl_[3] step_nr_dcha_post1_ctl_[0] step_nr_dcha_post1_ctl_[1] step_nr_dcha_post1_ctl_[2] step_nr_dcha_post1_ctl_[3] t_hld_toze_prev1_ctl_[0] t_hld_toze_prev1_ctl_[1] t_hld_toze_prev1_ctl_[2] t_hld_toze_prev1_ctl_[3] t_hld_toze_main1_ctl_[0] t_hld_toze_main1_ctl_[1] t_hld_toze_main1_ctl_[2] t_hld_toze_main1_ctl_[3] t_hld_toze_post1_ctl_[0] t_hld_toze_post1_ctl_[1] t_hld_toze_post1_ctl_[2] t_hld_toze_post1_ctl_[3] seg_nr_stk_mes t_hld_frze_mv t_hld_toze_mv seg_nr_stk_ctl t_per_stk_dcha v_ampl_stk_dcha step_nr_cha_frze_ctl_bas step_nr_dcha_ctl_bas t_iv_opg_min t_iv_close_mv_mv pwm_cha_[0] pwm_cha_[1] pwm_cha_[2] pwm_cha_[3] pwm_dcha_[0] pwm_dcha_[1] pwm_dcha_[2] pwm_dcha_[3] t_eoi_ofs_ctl_[0] t_eoi_ofs_ctl_[1] t_eoi_ofs_ctl_[2] t_eoi_ofs_ctl_[3] sf_pi_ctl_egy_max egy_inj_sp_[0] egy_inj_sp_[1] egy_inj_sp_[2] egy_inj_sp_[3] lv_egy_ctl_act lv_egy_ctl_ini lv_dcha_ctl_on egy_step_sp_[0] egy_step_sp_[1] egy_step_sp_[2] egy_step_sp_[3] egy_inj_sp_pctl_[0] egy_inj_sp_pctl_[1] egy_inj_sp_pctl_[2] egy_inj_sp_pctl_[3] seg_nr_egy_ctl pwm_cha_ctl_[0] pwm_cha_ctl_[1] pwm_cha_ctl_[2] pwm_cha_ctl_[3] pwm_cha_err_ctl_[0] pwm_cha_err_ctl_[1] pwm_cha_err_ctl_[2] pwm_cha_err_ctl_[3] p_ctl_egy_[0] p_ctl_egy_[1] p_ctl_egy_[2] p_ctl_egy_[3] i_ctl_egy_[0] i_ctl_egy_[1] i_ctl_egy_[2] i_ctl_egy_[3] sf_pi_ctl_egy_min egy_inj_dif_[0] egy_inj_dif_[1] egy_inj_dif_[2] egy_inj_dif_[3] dummy_peco egy_sp_bas_iv_foc_ctl_[0] egy_sp_bas_iv_foc_ctl_[1] egy_sp_bas_iv_foc_ctl_[2] egy_sp_bas_iv_foc_ctl_[3] sf_egy_sp_man_iv_foc_ctl egy_sp_err_iv_foc_ctl_[0] egy_sp_err_iv_foc_ctl_[1] egy_sp_err_iv_foc_ctl_[2] egy_sp_err_iv_foc_ctl_[3] i_ctl_iv_foc_[0] i_ctl_iv_foc_[1] i_ctl_iv_foc_[2] i_ctl_iv_foc_[3] p_ctl_iv_foc_[0] p_ctl_iv_foc_[1] p_ctl_iv_foc_[2] p_ctl_iv_foc_[3] seg_nr_iv_foc_ctl sf_iv_foc_ctl_act sf_mes_iv_foc_vld sf_pi_ctl_iv_foc_max sf_pi_ctl_iv_foc_min v_delta_dif_[0] v_delta_dif_[1] v_delta_dif_[2] v_delta_dif_[3] v_delta_mv_[0] v_delta_mv_[1] v_delta_mv_[2] v_delta_mv_[3] v_delta_sp_mv_[0] v_delta_sp_mv_[1] v_delta_sp_mv_[2] v_delta_sp_mv_[3] t_soi_ofs_ctl_[0] t_soi_ofs_ctl_[1] t_soi_ofs_ctl_[2] t_soi_ofs_ctl_[3] lv_iv_foc_iv_close_ctl_sel egy_sp_bas_iv_close_ctl_[0] egy_sp_bas_iv_close_ctl_[1] egy_sp_bas_iv_close_ctl_[2] egy_sp_bas_iv_close_ctl_[3] sf_egy_sp_man_iv_close_ctl t_iv_close_mv_[0] t_iv_close_mv_[1] t_iv_close_mv_[2] t_iv_close_mv_[3] sf_mes_iv_close_vld egy_sp_err_t_iv_close_ctl_[0] egy_sp_err_t_iv_close_ctl_[1] egy_sp_err_t_iv_close_ctl_[2] egy_sp_err_t_iv_close_ctl_[3] i_ctl_iv_close_[0] i_ctl_iv_close_[1] i_ctl_iv_close_[2] i_ctl_iv_close_[3] i_ctl_soi_[0] i_ctl_soi_[1] i_ctl_soi_[2] i_ctl_soi_[3] p_ctl_iv_close_[0] p_ctl_iv_close_[1] p_ctl_iv_close_[2] p_ctl_iv_close_[3] p_ctl_soi_[0] p_ctl_soi_[1] p_ctl_soi_[2] p_ctl_soi_[3] seg_nr_t_iv_close_ctl sf_iv_close_ctl_act sf_pi_ctl_iv_close_max sf_pi_ctl_iv_close_min sf_pi_ctl_soi_max sf_pi_ctl_soi_min sf_soi_ctl_act t_iv_close_dif_[0] t_iv_close_dif_[1] t_iv_close_dif_[2] t_iv_close_dif_[3] t_iv_close_soi_ctl_dif_[0] t_iv_close_soi_ctl_dif_[1] t_iv_close_soi_ctl_dif_[2] t_iv_close_soi_ctl_dif_[3] t_iv_close_sp_mv_[0] t_iv_close_sp_mv_[1] t_iv_close_sp_mv_[2] t_iv_close_sp_mv_[3] t_iv_close_[0] t_iv_close_[1] t_iv_close_[2] t_iv_close_[3] v_delta_iv_foc_[0] v_delta_iv_foc_[1] v_delta_iv_foc_[2] v_delta_iv_foc_[3] v_delta_iv_foc_rel_[0] v_delta_iv_foc_rel_[1] v_delta_iv_foc_rel_[2] v_delta_iv_foc_rel_[3] egy_inj_det_dif_fil_[0] egy_inj_det_dif_fil_[1] egy_inj_det_dif_fil_[2] egy_inj_det_dif_fil_[3] egy_inj_det_dif_[0] egy_inj_det_dif_[1] egy_inj_det_dif_[2] egy_inj_det_dif_[3] egy_inj_det_fil_[0] egy_inj_det_fil_[1] egy_inj_det_fil_[2] egy_inj_det_fil_[3] egy_inj_det_[0] egy_inj_det_[1] egy_inj_det_[2] egy_inj_det_[3] egy_inj_lst_[0] egy_inj_lst_[1] egy_inj_lst_[2] egy_inj_lst_[3] nr_v_inj_dif_det_values_[0] nr_v_inj_dif_det_values_[1] nr_v_inj_dif_det_values_[2] nr_v_inj_dif_det_values_[3] nr_v_inj_dif_det_values_[4] nr_v_inj_dif_det_values_[5] nr_v_inj_dif_det_value_[0] nr_v_inj_dif_det_value_[1] nr_v_inj_dif_det_value_[2] nr_v_inj_dif_det_value_[3] q_inj_burst_act_[0] q_inj_burst_act_[1] q_inj_burst_act_[2] q_inj_burst_act_[3] q_inj_burst_act_[4] q_inj_burst_act_[5] q_inj_burst_act_[6] q_inj_burst_act_[7] q_inj_burst_act_[8] q_inj_burst_act_[9] q_inj_burst_act_[10] q_inj_burst_act_[11] q_inj_burst_act_[12] q_inj_burst_act_[13] q_inj_burst_act_[14] q_inj_burst_act_[15] q_inj_burst_act_[16] q_inj_burst_act_[17] q_inj_burst_act_[18] q_inj_burst_act_[19] q_inj_burst_act_[20] q_inj_burst_act_[21] q_inj_burst_act_[22] q_inj_burst_act_[23] q_inj_burst_act_[24] q_inj_burst_act_[25] q_inj_burst_act_[26] q_inj_burst_act_[27] q_inj_burst_act_[28] q_inj_burst_act_[29] q_inj_burst_act_[30] q_inj_burst_act_[31] q_inj_burst_act_[32] q_inj_burst_act_[33] q_inj_burst_act_[34] q_inj_burst_act_[35] q_inj_burst_act_[36] q_inj_burst_act_[37] q_inj_burst_act_[38] q_inj_burst_act_[39] q_inj_burst_act_[40] q_inj_burst_act_[41] q_inj_burst_act_[42] q_inj_burst_act_[43] q_inj_burst_act_[44] q_inj_burst_act_[45] q_inj_burst_act_[46] q_inj_burst_act_[47] q_inj_burst_exp_[0] q_inj_burst_exp_[1] q_inj_burst_exp_[2] q_inj_burst_exp_[3] q_inj_burst_exp_[4] q_inj_burst_exp_[5] q_inj_burst_exp_[6] q_inj_burst_exp_[7] q_inj_burst_exp_[8] q_inj_burst_exp_[9] q_inj_burst_exp_[10] q_inj_burst_exp_[11] q_inj_burst_exp_[12] q_inj_burst_exp_[13] q_inj_burst_exp_[14] q_inj_burst_exp_[15] q_inj_burst_exp_[16] q_inj_burst_exp_[17] q_inj_burst_exp_[18] q_inj_burst_exp_[19] q_inj_burst_exp_[20] q_inj_burst_exp_[21] q_inj_burst_exp_[22] q_inj_burst_exp_[23] q_inj_burst_exp_[24] q_inj_burst_exp_[25] q_inj_burst_exp_[26] q_inj_burst_exp_[27] q_inj_burst_exp_[28] q_inj_burst_exp_[29] q_inj_burst_exp_[30] q_inj_burst_exp_[31] q_inj_burst_exp_[32] q_inj_burst_exp_[33] q_inj_burst_exp_[34] q_inj_burst_exp_[35] q_inj_burst_exp_[36] q_inj_burst_exp_[37] q_inj_burst_exp_[38] q_inj_burst_exp_[39] q_inj_burst_exp_[40] q_inj_burst_exp_[41] q_inj_burst_exp_[42] q_inj_burst_exp_[43] q_inj_burst_exp_[44] q_inj_burst_exp_[45] q_inj_burst_exp_[46] q_inj_burst_exp_[47] q_inj_burst_intp_[0] q_inj_burst_intp_[1] q_inj_burst_intp_[2] q_inj_burst_intp_[3] q_inj_burst_intp_[4] q_inj_burst_intp_[5] q_inj_burst_intp_[6] q_inj_burst_intp_[7] q_inj_burst_intp_[8] q_inj_burst_intp_[9] q_inj_burst_intp_[10] q_inj_burst_intp_[11] q_inj_burst_intp_[12] q_inj_burst_intp_[13] q_inj_burst_intp_[14] q_inj_burst_intp_[15] q_inj_burst_intp_[16] q_inj_burst_intp_[17] q_inj_burst_intp_[18] q_inj_burst_intp_[19] q_inj_burst_intp_[20] q_inj_burst_intp_[21] q_inj_burst_intp_[22] q_inj_burst_intp_[23] q_inj_burst_intp_[24] q_inj_burst_intp_[25] q_inj_burst_intp_[26] q_inj_burst_intp_[27] q_inj_burst_intp_[28] q_inj_burst_intp_[29] q_inj_burst_intp_[30] q_inj_burst_intp_[31] q_inj_burst_intp_[32] q_inj_burst_intp_[33] q_inj_burst_intp_[34] q_inj_burst_intp_[35] q_inj_burst_intp_[36] q_inj_burst_intp_[37] q_inj_burst_intp_[38] q_inj_burst_intp_[39] q_inj_burst_intp_[40] q_inj_burst_intp_[41] q_inj_burst_intp_[42] q_inj_burst_intp_[43] q_inj_burst_intp_[44] q_inj_burst_intp_[45] q_inj_burst_intp_[46] q_inj_burst_intp_[47] q_inj_det_[0] q_inj_det_[1] q_inj_det_[2] q_inj_det_[3] seg_nr_pui_acq v_inj_burst_act_max_[0] v_inj_burst_act_max_[1] v_inj_burst_act_max_[2] v_inj_burst_act_max_[3] v_inj_burst_act_[0] v_inj_burst_act_[1] v_inj_burst_act_[2] v_inj_burst_act_[3] v_inj_burst_act_[4] v_inj_burst_act_[5] v_inj_burst_act_[6] v_inj_burst_act_[7] v_inj_burst_act_[8] v_inj_burst_act_[9] v_inj_burst_act_[10] v_inj_burst_act_[11] v_inj_burst_act_[12] v_inj_burst_act_[13] v_inj_burst_act_[14] v_inj_burst_act_[15] v_inj_burst_act_[16] v_inj_burst_act_[17] v_inj_burst_act_[18] v_inj_burst_act_[19] v_inj_burst_act_[20] v_inj_burst_act_[21] v_inj_burst_act_[22] v_inj_burst_act_[23] v_inj_burst_act_[24] v_inj_burst_act_[25] v_inj_burst_act_[26] v_inj_burst_act_[27] v_inj_burst_act_[28] v_inj_burst_act_[29] v_inj_burst_act_[30] v_inj_burst_act_[31] v_inj_burst_act_[32] v_inj_burst_act_[33] v_inj_burst_act_[34] v_inj_burst_act_[35] v_inj_burst_act_[36] v_inj_burst_act_[37] v_inj_burst_act_[38] v_inj_burst_act_[39] v_inj_burst_act_[40] v_inj_burst_act_[41] v_inj_burst_act_[42] v_inj_burst_act_[43] v_inj_burst_act_[44] v_inj_burst_act_[45] v_inj_burst_act_[46] v_inj_burst_act_[47] v_inj_burst_act_[48] v_inj_burst_act_[49] v_inj_burst_act_[50] v_inj_burst_act_[51] v_inj_burst_act_[52] v_inj_burst_act_[53] v_inj_burst_act_[54] v_inj_burst_act_[55] v_inj_burst_act_[56] v_inj_burst_act_[57] v_inj_burst_act_[58] v_inj_burst_act_[59] v_inj_burst_act_[60] v_inj_burst_act_[61] v_inj_burst_act_[62] v_inj_burst_act_[63] v_inj_burst_act_[64] v_inj_burst_act_[65] v_inj_burst_act_[66] v_inj_burst_act_[67] v_inj_burst_act_[68] v_inj_burst_act_[69] v_inj_burst_act_[70] v_inj_burst_act_[71] v_inj_burst_act_[72] /end OUT_MEASUREMENT
/end FUNCTION
/end MODULE
/end PROJECT
