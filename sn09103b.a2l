ASAP2_VERSION 1 41
/begin PROJECT SN0 "SIMOS PPD"
/begin HEADER "_default_HeaderComment" PROJECT_NO PRJ_NUM /end HEADER
/begin MODULE _default_ModuleName "_default_ModuleLongIdentifier"
/begin MOD_COMMON "_default_ModCommonComment" DEPOSIT ABSOLUTE BYTE_ORDER MSB_FIRST ALIGNMENT_BYTE 1 ALIGNMENT_WORD 2 ALIGNMENT_LONG 4 ALIGNMENT_FLOAT32_IEEE 4 ALIGNMENT_FLOAT64_IEEE 8 /end MOD_COMMON
/begin MEASUREMENT tqi_tql_tfu_prot "torque for fuel overheating protection" SWORD _CNV_A_R_LINEAR_____62_CM 1 0. -1024. 1023.96875 DISPLAY_IDENTIFIER TQI_TQL_TFU_PROT ECU_ADDRESS 0x7f9c36 BYTE_ORDER MSB_LAST FORMAT "%6.2" /end MEASUREMENT
/begin CHARACTERISTIC c_tfu_thd_tqi_tql_tfu_prot "fuel temperature threshold for fuel overheating protection" VALUE 0x85c193 _REC_VAL_20_u1 255. _CNV_A_R_LINEAR_____18_CM -50. 205. DISPLAY_IDENTIFIER C_TFU_THD_TQI_TQL_TFU_PROT FORMAT "%3.0" /end CHARACTERISTIC
/begin AXIS_PTS ldp_vs_ip_fac_tqi_tql_tfu_prot "vehicle speed correction of fuel overheating protection" 0x8433c5 vs _REC_AXS_20_u1 255. _CNV_A_R_LINEAR_____39_CM 12 0. 255. FORMAT "%3.0" /end AXIS_PTS
/begin AXIS_PTS ldp_n_ip_tqi_tql_tfu_prot "fuel overheating protection" 0x8423a6 n _REC_AXS_20_u2 6375. _CNV_A_R_LINEAR_____5_CM 16 0. 6375. FORMAT "%4.0" /end AXIS_PTS
/begin AXIS_PTS ldp_tfu_ip_tqi_tql_tfu_prot "fuel overheating protection" 0x8428e2 tfu _REC_AXS_20_u1 255. _CNV_A_R_LINEAR_____18_CM 16 -50. 205. FORMAT "%3.0" /end AXIS_PTS
/begin CHARACTERISTIC ip_fac_tqi_tql_tfu_prot "MFBPRT: vehicle speed correction of fuel overheating protection" CURVE 0x84c882 _REC_CUR_20_u1_u1 3.984375 _CNV_A_R_LINEAR_____98_CM 0. 3.984375 DISPLAY_IDENTIFIER IP_FAC_TQI_TQL_TFU_PROT FORMAT "%3.2"
 /begin AXIS_DESCR COM_AXIS vs _CNV_A_R_LINEAR_____39_CM 12 0. 255. FORMAT "%3.0" AXIS_PTS_REF ldp_vs_ip_fac_tqi_tql_tfu_prot /end AXIS_DESCR
/end CHARACTERISTIC
/begin CHARACTERISTIC ip_tqi_tql_tfu_prot "MFBPRT: fuel overheating protection" MAP 0x85b896 _REC_MAP_20_u2_u2_u1 2047.96875 _CNV_A_R_LINEAR_____89_CM -1024. 1023.96875 DISPLAY_IDENTIFIER IP_TQI_TQL_TFU_PROT FORMAT "%6.2"
 /begin AXIS_DESCR COM_AXIS n _CNV_A_R_LINEAR_____5_CM 16 0. 6375. FORMAT "%4.0" AXIS_PTS_REF ldp_n_ip_tqi_tql_tfu_prot /end AXIS_DESCR
 /begin AXIS_DESCR COM_AXIS tfu _CNV_A_R_LINEAR_____18_CM 16 -50. 205. FORMAT "%3.0" AXIS_PTS_REF ldp_tfu_ip_tqi_tql_tfu_prot /end AXIS_DESCR
/end CHARACTERISTIC
/begin MEASUREMENT soi_frze_prev1_req1 "start of pulse FROM ZERO PREV1 (requested value)" SWORD _CNV_A_R_LINEAR_____121_CM 1 0. -120. 240. DISPLAY_IDENTIFIER SOI_FRZE_PREV1_REQ1 ECU_ADDRESS 0x7fa14c BYTE_ORDER MSB_LAST FORMAT "%5.2" /end MEASUREMENT
/begin MEASUREMENT t_cha_frze_prev1_req1 "charging time of pulse FROM ZERO PREV1 (requested value)" UWORD _CNV_A_R_LINEAR_____208_CM 1 0. 0. 32.767 DISPLAY_IDENTIFIER T_CHA_FRZE_PREV1_REQ1 ECU_ADDRESS 0x7fa14e BYTE_ORDER MSB_LAST FORMAT "%5.3" /end MEASUREMENT
/begin MEASUREMENT soi_prev1_req1 "start of injection PREV1 (requested value)" SWORD _CNV_A_R_LINEAR_____121_CM 1 0. -120. 240. DISPLAY_IDENTIFIER SOI_PREV1_REQ1 ECU_ADDRESS 0x7fa150 BYTE_ORDER MSB_LAST FORMAT "%5.2" /end MEASUREMENT
/begin MEASUREMENT t_cha_prev1_req1 "charging time of injection PREV1 (requested value)" UWORD _CNV_A_R_LINEAR_____208_CM 1 0. 0. 32.767 DISPLAY_IDENTIFIER T_CHA_PREV1_REQ1 ECU_ADDRESS 0x7fa152 BYTE_ORDER MSB_LAST FORMAT "%5.3" /end MEASUREMENT
/begin MEASUREMENT eoi_prev1_req1 "end of injection PREV1 (requested value)" SWORD _CNV_A_R_LINEAR_____121_CM 1 0. -120. 240. DISPLAY_IDENTIFIER EOI_PREV1_REQ1 ECU_ADDRESS 0x7fa154 BYTE_ORDER MSB_LAST FORMAT "%5.2" /end MEASUREMENT
/begin MEASUREMENT t_dcha_prev1_req1 "discharging time of injection PREV1 (requested value)" UWORD _CNV_A_R_LINEAR_____208_CM 1 0. 0. 32.767 DISPLAY_IDENTIFIER T_DCHA_PREV1_REQ1 ECU_ADDRESS 0x7fa156 BYTE_ORDER MSB_LAST FORMAT "%5.3" /end MEASUREMENT
/begin MEASUREMENT t_hld_toze_prev1_req1 "hold time of pulse TO ZERO PREV1 (requested value)" UWORD _CNV_A_R_LINEAR_____208_CM 1 0. 0. 32.767 DISPLAY_IDENTIFIER T_HLD_TOZE_PREV1_REQ1 ECU_ADDRESS 0x7fa158 BYTE_ORDER MSB_LAST FORMAT "%5.3" /end MEASUREMENT
/begin MEASUREMENT t_dcha_toze_prev1_req1 "discharging time of pulse TO ZERO PREV1 (requested value)" UWORD _CNV_A_R_LINEAR_____208_CM 1 0. 0. 32.767 DISPLAY_IDENTIFIER T_DCHA_TOZE_PREV1_REQ1 ECU_ADDRESS 0x7fa15a BYTE_ORDER MSB_LAST FORMAT "%5.3" /end MEASUREMENT
/begin MEASUREMENT lv_frze_prev1_req2 "activation status of pulse FROM ZERO PREV1 (requested value)" UBYTE _CNV_S_2_RANGE______11_CM 1 0. 0. 1. DISPLAY_IDENTIFIER LV_FRZE_PREV1_REQ2 ECU_ADDRESS 0x7fb7ac /end MEASUREMENT
/begin MEASUREMENT lv_prev1_req2 "activation status of injection PREV1 (requested value)" UBYTE _CNV_S_2_RANGE______11_CM 1 0. 0. 1. DISPLAY_IDENTIFIER LV_PREV1_REQ2 ECU_ADDRESS 0x7fb7ad /end MEASUREMENT
/begin MEASUREMENT lv_toze_prev1_req2 "activation status of pulse TO ZERO PREV1 (requested value)" UBYTE _CNV_S_2_RANGE______11_CM 1 0. 0. 1. DISPLAY_IDENTIFIER LV_TOZE_PREV1_REQ2 ECU_ADDRESS 0x7fb7ae /end MEASUREMENT
/begin MEASUREMENT doi_prev1_bas_tu "duration of injection PREV1 (after tuning)" UWORD _CNV_A_R_LINEAR_____121_CM 1 0. 0. 360. DISPLAY_IDENTIFIER DOI_PREV1_BAS_TU ECU_ADDRESS 0x7fb06c BYTE_ORDER MSB_LAST FORMAT "%5.2" /end MEASUREMENT
/begin MEASUREMENT step_nr_cha_frze_prev1 "number of charge steps for pulse FROM ZERO PREV1" UBYTE _CNV_A_R_LINEAR_____0_CM 1 0. 0. 30. DISPLAY_IDENTIFIER STEP_NR_CHA_FRZE_PREV1 ECU_ADDRESS 0x7fbb70 FORMAT "%2.0" /end MEASUREMENT
/begin MEASUREMENT level_cha_frze_prev1 "charge level of pulse FROM ZERO PREV1" UBYTE _CNV_A_R_LINEAR_____209_CM 1 0. 0. 99.609375 DISPLAY_IDENTIFIER LEVEL_CHA_FRZE_PREV1 ECU_ADDRESS 0x7fbb71 FORMAT "%3.1" /end MEASUREMENT
/begin MEASUREMENT t_hld_frze_prev1 "hold time of pulse FROM ZERO PREV1" UWORD _CNV_A_R_LINEAR_____208_CM 1 0. 0. 32.767 DISPLAY_IDENTIFIER T_HLD_FRZE_PREV1 ECU_ADDRESS 0x7fb070 BYTE_ORDER MSB_LAST FORMAT "%5.3" /end MEASUREMENT
/begin MEASUREMENT step_nr_cha_prev1 "number of charge steps for pulse PREV1" UBYTE _CNV_A_R_LINEAR_____0_CM 1 0. 0. 30. DISPLAY_IDENTIFIER STEP_NR_CHA_PREV1 ECU_ADDRESS 0x7fbb72 FORMAT "%2.0" /end MEASUREMENT
/begin MEASUREMENT step_nr_dcha_prev1 "number of discharge steps for pulse PREV1" UBYTE _CNV_A_R_LINEAR_____0_CM 1 0. 0. 30. DISPLAY_IDENTIFIER STEP_NR_DCHA_PREV1 ECU_ADDRESS 0x7fbb73 FORMAT "%2.0" /end MEASUREMENT
/begin MEASUREMENT level_dcha_toze_prev1 "charge level of pulse TO ZERO PREV1" UBYTE _CNV_A_R_LINEAR_____209_CM 1 0. 0. 99.609375 DISPLAY_IDENTIFIER LEVEL_DCHA_TOZE_PREV1 ECU_ADDRESS 0x7fbb74 FORMAT "%3.1" /end MEASUREMENT
/begin MEASUREMENT step_nr_dcha_toze_prev1 "number of discharge steps for pulse TO ZERO PREV1" UBYTE _CNV_A_R_LINEAR_____0_CM 1 0. 0. 30. DISPLAY_IDENTIFIER STEP_NR_DCHA_TOZE_PREV1 ECU_ADDRESS 0x7fbb75 FORMAT "%2.0" /end MEASUREMENT
/begin MEASUREMENT doi_prev1_bas "duration of injection PREV1 (after Temperature / last Injection Correction)" UWORD _CNV_A_R_LINEAR_____121_CM 1 0. 0. 360. DISPLAY_IDENTIFIER DOI_PREV1_BAS ECU_ADDRESS 0x7fb06e BYTE_ORDER MSB_LAST FORMAT "%5.2" /end MEASUREMENT
/begin MEASUREMENT mf_prev1_tu_cor "increased/decreased fuel mass depending on FAC_MF_PREV1_DOI" UWORD _CNV_A_R_LINEAR_____43_CM 1 0. 0. 262.14 DISPLAY_IDENTIFIER MF_PREV1_TU_COR ECU_ADDRESS 0x7fb06a BYTE_ORDER MSB_LAST /end MEASUREMENT
/begin MEASUREMENT doi_prev1_pwr_on "power on value of duration of injection PREV1" UWORD _CNV_A_R_LINEAR_____121_CM 1 0. 0. 360. DISPLAY_IDENTIFIER DOI_PREV1_PWR_ON ECU_ADDRESS 0x7fa15c BYTE_ORDER MSB_LAST FORMAT "%5.2" /end MEASUREMENT
/begin MEASUREMENT lv_micro_step_prev1_act "microstepping PREV1 is active" UBYTE _CNV_S_2_RANGE______11_CM 1 0. 0. 1. DISPLAY_IDENTIFIER LV_MICRO_STEP_PREV1_ACT ECU_ADDRESS 0x7fb7af /end MEASUREMENT
/begin MEASUREMENT soi_frze_cor_prev1 "start of injection PREV1 correction" SWORD _CNV_A_R_LINEAR_____121_CM 1 0. -120. 240. DISPLAY_IDENTIFIER SOI_FRZE_COR_PREV1 ECU_ADDRESS 0x7fb084 BYTE_ORDER MSB_LAST FORMAT "%5.2" /end MEASUREMENT
/begin CHARACTERISTIC ip_level_cha_frze_prev1__n "DPX00O01: charge level of pulse FROM ZERO PREV1" CURVE 0x846d4c _REC_CUR_20_u1_u2 99.609375 _CNV_A_R_LINEAR_____209_CM 0. 99.609375 DISPLAY_IDENTIFIER IP_LEVEL_CHA_FRZE_PREV1__N FORMAT "%3.1"
 /begin AXIS_DESCR COM_AXIS n _CNV_A_R_LINEAR_____5_CM 8 0. 6375. FORMAT "%4.0" AXIS_PTS_REF ldp_n_ip_level_cha_frze_prev1 /end AXIS_DESCR
/end CHARACTERISTIC
/begin AXIS_PTS ldp_n_ip_level_cha_frze_prev1 "" 0x841aa8 n _REC_AXS_20_u2 6375. _CNV_A_R_LINEAR_____5_CM 8 0. 6375. FORMAT "%4.0" /end AXIS_PTS
/begin CHARACTERISTIC ip_t_hld_frze_prev1__n "DPX00O01: hold time of pulse FROM ZERO PREV1" CURVE 0x84768a _REC_CUR_20_u2_u2 32.767 _CNV_A_R_LINEAR_____208_CM 0. 32.767 DISPLAY_IDENTIFIER IP_T_HLD_FRZE_PREV1__N FORMAT "%5.3"
 /begin AXIS_DESCR COM_AXIS n _CNV_A_R_LINEAR_____5_CM 8 0. 6375. FORMAT "%4.0" AXIS_PTS_REF ldp_n_ip_t_hld_frze_prev1 /end AXIS_DESCR
/end CHARACTERISTIC
/begin AXIS_PTS ldp_n_ip_t_hld_frze_prev1 "" 0x8422a6 n _REC_AXS_20_u2 6375. _CNV_A_R_LINEAR_____5_CM 8 0. 6375. FORMAT "%4.0" /end AXIS_PTS
/begin CHARACTERISTIC c_fac_doi_prev1_tu_[0] "cylinder individual PREV1-injection tuning factor" VALUE 0x848446 _REC_VAL_20_u2 1.9999696 _CNV_A_R_LINEAR_____53_CM 0. 1.9999696 DISPLAY_IDENTIFIER C_FAC_DOI_PREV1_TU__0_ FORMAT "%5.4" /end CHARACTERISTIC
/begin CHARACTERISTIC c_fac_doi_prev1_tu_[1] "cylinder individual PREV1-injection tuning factor" VALUE 0x848448 _REC_VAL_20_u2 1.9999696 _CNV_A_R_LINEAR_____53_CM 0. 1.9999696 DISPLAY_IDENTIFIER C_FAC_DOI_PREV1_TU__1_ FORMAT "%5.4" /end CHARACTERISTIC
/begin CHARACTERISTIC c_fac_doi_prev1_tu_[2] "cylinder individual PREV1-injection tuning factor" VALUE 0x84844a _REC_VAL_20_u2 1.9999696 _CNV_A_R_LINEAR_____53_CM 0. 1.9999696 DISPLAY_IDENTIFIER C_FAC_DOI_PREV1_TU__2_ FORMAT "%5.4" /end CHARACTERISTIC
/begin CHARACTERISTIC c_fac_doi_prev1_tu_[3] "cylinder individual PREV1-injection tuning factor" VALUE 0x84844c _REC_VAL_20_u2 1.9999696 _CNV_A_R_LINEAR_____53_CM 0. 1.9999696 DISPLAY_IDENTIFIER C_FAC_DOI_PREV1_TU__3_ FORMAT "%5.4" /end CHARACTERISTIC
/begin CHARACTERISTIC c_doi_prev1_man_[0] "manual value for duration of injection PREV1" VALUE 0x8483d8 _REC_VAL_20_u2 360. _CNV_A_R_LINEAR_____121_CM 0. 360. DISPLAY_IDENTIFIER C_DOI_PREV1_MAN__0_ FORMAT "%5.2" /end CHARACTERISTIC
/begin CHARACTERISTIC c_doi_prev1_man_[1] "manual value for duration of injection PREV1" VALUE 0x8483da _REC_VAL_20_u2 360. _CNV_A_R_LINEAR_____121_CM 0. 360. DISPLAY_IDENTIFIER C_DOI_PREV1_MAN__1_ FORMAT "%5.2" /end CHARACTERISTIC
/begin CHARACTERISTIC c_doi_prev1_man_[2] "manual value for duration of injection PREV1" VALUE 0x8483dc _REC_VAL_20_u2 360. _CNV_A_R_LINEAR_____121_CM 0. 360. DISPLAY_IDENTIFIER C_DOI_PREV1_MAN__2_ FORMAT "%5.2" /end CHARACTERISTIC
/begin CHARACTERISTIC c_doi_prev1_man_[3] "manual value for duration of injection PREV1" VALUE 0x8483de _REC_VAL_20_u2 360. _CNV_A_R_LINEAR_____121_CM 0. 360. DISPLAY_IDENTIFIER C_DOI_PREV1_MAN__3_ FORMAT "%5.2" /end CHARACTERISTIC
/begin CHARACTERISTIC lc_doi_prev1_man "button for setting a manual value for duration of injection PREV1" VALUE 0x84879b _REC_VAL_20_u1 1. _CNV_A_R_LINEAR_____0_CM 0. 1. DISPLAY_IDENTIFIER LC_DOI_PREV1_MAN FORMAT "%1.0" /end CHARACTERISTIC
/begin CHARACTERISTIC ip_doi_prev1_0 "DPX00O01: array of injection duration maps (MAP 0) of injection PREV1" MAP 0x8464fe _REC_MAP_20_u2_u2_u2 360. _CNV_A_R_LINEAR_____121_CM 0. 360. DISPLAY_IDENTIFIER IP_DOI_PREV1_0 FORMAT "%5.4"
 /begin AXIS_DESCR COM_AXIS n _CNV_A_R_LINEAR_____5_CM 10 0. 6375. FORMAT "%4.0" AXIS_PTS_REF ldpm_n_ip_doi_prev1 /end AXIS_DESCR
 /begin AXIS_DESCR COM_AXIS mf_prev1_tu_cor _CNV_A_R_LINEAR_____43_CM 5 0. 262.14 AXIS_PTS_REF ldpm_mf_ip_doi_prev1 /end AXIS_DESCR
/end CHARACTERISTIC
/begin CHARACTERISTIC ip_doi_prev1_1 "DPX00O01: array of injection duration maps (MAP 1) of injection PREV1" MAP 0x846562 _REC_MAP_20_u2_u2_u2 360. _CNV_A_R_LINEAR_____121_CM 0. 360. DISPLAY_IDENTIFIER IP_DOI_PREV1_1 FORMAT "%5.4"
 /begin AXIS_DESCR COM_AXIS n _CNV_A_R_LINEAR_____5_CM 10 0. 6375. FORMAT "%4.0" AXIS_PTS_REF ldpm_n_ip_doi_prev1 /end AXIS_DESCR
 /begin AXIS_DESCR COM_AXIS mf_prev1_tu_cor _CNV_A_R_LINEAR_____43_CM 5 0. 262.14 AXIS_PTS_REF ldpm_mf_ip_doi_prev1 /end AXIS_DESCR
/end CHARACTERISTIC
/begin CHARACTERISTIC ip_doi_prev1_2 "DPX00O01: array of injection duration maps (MAP 2) of injection PREV1" MAP 0x8465c6 _REC_MAP_20_u2_u2_u2 360. _CNV_A_R_LINEAR_____121_CM 0. 360. DISPLAY_IDENTIFIER IP_DOI_PREV1_2 FORMAT "%5.4"
 /begin AXIS_DESCR COM_AXIS n _CNV_A_R_LINEAR_____5_CM 10 0. 6375. FORMAT "%4.0" AXIS_PTS_REF ldpm_n_ip_doi_prev1 /end AXIS_DESCR
 /begin AXIS_DESCR COM_AXIS mf_prev1_tu_cor _CNV_A_R_LINEAR_____43_CM 5 0. 262.14 AXIS_PTS_REF ldpm_mf_ip_doi_prev1 /end AXIS_DESCR
/end CHARACTERISTIC
/begin CHARACTERISTIC ip_doi_prev1_3 "DPX00O01: array of injection duration maps (MAP 3) of injection PREV1" MAP 0x84662a _REC_MAP_20_u2_u2_u2 360. _CNV_A_R_LINEAR_____121_CM 0. 360. DISPLAY_IDENTIFIER IP_DOI_PREV1_3 FORMAT "%5.4"
 /begin AXIS_DESCR COM_AXIS n _CNV_A_R_LINEAR_____5_CM 10 0. 6375. FORMAT "%4.0" AXIS_PTS_REF ldpm_n_ip_doi_prev1 /end AXIS_DESCR
 /begin AXIS_DESCR COM_AXIS mf_prev1_tu_cor _CNV_A_R_LINEAR_____43_CM 5 0. 262.14 AXIS_PTS_REF ldpm_mf_ip_doi_prev1 /end AXIS_DESCR
/end CHARACTERISTIC
/begin CHARACTERISTIC ip_doi_prev1_4 "DPX00O01: array of injection duration maps (MAP 4) of injection PREV1" MAP 0x84668e _REC_MAP_20_u2_u2_u2 360. _CNV_A_R_LINEAR_____121_CM 0. 360. DISPLAY_IDENTIFIER IP_DOI_PREV1_4 FORMAT "%5.4"
 /begin AXIS_DESCR COM_AXIS n _CNV_A_R_LINEAR_____5_CM 10 0. 6375. FORMAT "%4.0" AXIS_PTS_REF ldpm_n_ip_doi_prev1 /end AXIS_DESCR
 /begin AXIS_DESCR COM_AXIS mf_prev1_tu_cor _CNV_A_R_LINEAR_____43_CM 5 0. 262.14 AXIS_PTS_REF ldpm_mf_ip_doi_prev1 /end AXIS_DESCR
/end CHARACTERISTIC
/begin CHARACTERISTIC ip_doi_prev1_5 "DPX00O01: array of injection duration maps (MAP 5) of injection PREV1" MAP 0x8466f2 _REC_MAP_20_u2_u2_u2 360. _CNV_A_R_LINEAR_____121_CM 0. 360. DISPLAY_IDENTIFIER IP_DOI_PREV1_5 FORMAT "%5.4"
 /begin AXIS_DESCR COM_AXIS n _CNV_A_R_LINEAR_____5_CM 10 0. 6375. FORMAT "%4.0" AXIS_PTS_REF ldpm_n_ip_doi_prev1 /end AXIS_DESCR
 /begin AXIS_DESCR COM_AXIS mf_prev1_tu_cor _CNV_A_R_LINEAR_____43_CM 5 0. 262.14 AXIS_PTS_REF ldpm_mf_ip_doi_prev1 /end AXIS_DESCR
/end CHARACTERISTIC
/begin AXIS_PTS ldpm_n_ip_doi_prev1 "" 0x8439ca n _REC_AXS_20_u2 6375. _CNV_A_R_LINEAR_____5_CM 10 0. 6375. FORMAT "%4.0" /end AXIS_PTS
/begin AXIS_PTS ldpm_mf_ip_doi_prev1 "" 0x843544 mf_prev1_tu_cor _REC_AXS_20_u2 262.14 _CNV_A_R_LINEAR_____43_CM 5 0. 262.14 /end AXIS_PTS
/begin CHARACTERISTIC ip_sel_ip_doi_prev1__soi "DPX00O01: selector for injection duration maps of injection PREV1" CURVE 0x847500 _REC_CUR_20_u4_u2 65535. _CNV_A_R_LINEAR_____210_CM 0. 65535. DISPLAY_IDENTIFIER IP_SEL_IP_DOI_PREV1__SOI FORMAT "%10.5"
 /begin AXIS_DESCR COM_AXIS soi_prev1_tu _CNV_A_R_LINEAR_____120_CM 6 -120. 240. FORMAT "%5.2" AXIS_PTS_REF ldp_soi_ip_doi_prev1 /end AXIS_DESCR
/end CHARACTERISTIC
/begin AXIS_PTS ldp_soi_ip_doi_prev1 "" 0x842570 soi_prev1_tu _REC_AXS_20_u2 360. _CNV_A_R_LINEAR_____120_CM 6 -120. 240. FORMAT "%5.2" /end AXIS_PTS
/begin CHARACTERISTIC ip_level_dcha_toze_prev1__n "DPX00O01: discharge level of pulse TO ZERO PREV1" CURVE 0x846d64 _REC_CUR_20_u1_u2 99.609375 _CNV_A_R_LINEAR_____209_CM 0. 99.609375 DISPLAY_IDENTIFIER IP_LEVEL_DCHA_TOZE_PREV1__N FORMAT "%3.1"
 /begin AXIS_DESCR COM_AXIS n _CNV_A_R_LINEAR_____5_CM 8 0. 6375. FORMAT "%4.0" AXIS_PTS_REF ldp_n_ip_level_dcha_toze_prev1 /end AXIS_DESCR
/end CHARACTERISTIC
/begin AXIS_PTS ldp_n_ip_level_dcha_toze_prev1 "" 0x841ade n _REC_AXS_20_u2 6375. _CNV_A_R_LINEAR_____5_CM 8 0. 6375. FORMAT "%4.0" /end AXIS_PTS
/begin CHARACTERISTIC ip_t_hld_toze_prev1__n "DPX00O01: hold time of pulse TO ZERO PREV1" CURVE 0x8476ba _REC_CUR_20_u2_u2 32.767 _CNV_A_R_LINEAR_____208_CM 0. 32.767 DISPLAY_IDENTIFIER IP_T_HLD_TOZE_PREV1__N FORMAT "%5.3"
 /begin AXIS_DESCR COM_AXIS n _CNV_A_R_LINEAR_____5_CM 8 0. 6375. FORMAT "%4.0" AXIS_PTS_REF ldp_n_ip_t_hld_toze_prev1 /end AXIS_DESCR
/end CHARACTERISTIC
/begin AXIS_PTS ldp_n_ip_t_hld_toze_prev1 "" 0x8422dc n _REC_AXS_20_u2 6375. _CNV_A_R_LINEAR_____5_CM 8 0. 6375. FORMAT "%4.0" /end AXIS_PTS
/begin MEASUREMENT lf_rcha_prev1_act "Activation flag word for recharge pulses PREV1 (cylinder individual)" UWORD _CNV_A_R_LINEAR_____0_CM 1 0. 0. 65535. DISPLAY_IDENTIFIER LF_RCHA_PREV1_ACT ECU_ADDRESS 0x7fa0e0 BYTE_ORDER MSB_LAST FORMAT "%5.0" /end MEASUREMENT
/begin MEASUREMENT lf_rcha_main1_act "Activation flag word for recharge pulses MAIN1 (cylinder individual)" UWORD _CNV_A_R_LINEAR_____0_CM 1 0. 0. 65535. DISPLAY_IDENTIFIER LF_RCHA_MAIN1_ACT ECU_ADDRESS 0x7fa0e2 BYTE_ORDER MSB_LAST FORMAT "%5.0" /end MEASUREMENT
/begin MEASUREMENT lf_rcha_post1_act "Activation flag word for recharge pulses POST1 (cylinder individual)" UWORD _CNV_A_R_LINEAR_____0_CM 1 0. 0. 65535. DISPLAY_IDENTIFIER LF_RCHA_POST1_ACT ECU_ADDRESS 0x7fa0e4 BYTE_ORDER MSB_LAST FORMAT "%5.0" /end MEASUREMENT
/begin MEASUREMENT t_rcha_pulse_[0] "Recharge pulse rate" UWORD _CNV_A_R_LINEAR_____208_CM 1 0. 0. 32.767 DISPLAY_IDENTIFIER T_RCHA_PULSE__0_ ECU_ADDRESS 0x7fa0d8 BYTE_ORDER MSB_LAST FORMAT "%5.3" /end MEASUREMENT
/begin MEASUREMENT t_rcha_pulse_[1] "Recharge pulse rate" UWORD _CNV_A_R_LINEAR_____208_CM 1 0. 0. 32.767 DISPLAY_IDENTIFIER T_RCHA_PULSE__1_ ECU_ADDRESS 0x7fa0da BYTE_ORDER MSB_LAST FORMAT "%5.3" /end MEASUREMENT
/begin MEASUREMENT t_rcha_pulse_[2] "Recharge pulse rate" UWORD _CNV_A_R_LINEAR_____208_CM 1 0. 0. 32.767 DISPLAY_IDENTIFIER T_RCHA_PULSE__2_ ECU_ADDRESS 0x7fa0dc BYTE_ORDER MSB_LAST FORMAT "%5.3" /end MEASUREMENT
/begin MEASUREMENT t_rcha_pulse_[3] "Recharge pulse rate" UWORD _CNV_A_R_LINEAR_____208_CM 1 0. 0. 32.767 DISPLAY_IDENTIFIER T_RCHA_PULSE__3_ ECU_ADDRESS 0x7fa0de BYTE_ORDER MSB_LAST FORMAT "%5.3" /end MEASUREMENT
/begin CHARACTERISTIC c_tco_rcha_lim "Coolant temperature limit for recharge activation" VALUE 0x85c153 _REC_VAL_20_u1 255. _CNV_A_R_LINEAR_____18_CM -50. 205. DISPLAY_IDENTIFIER C_TCO_RCHA_LIM FORMAT "%5.3" /end CHARACTERISTIC
/begin CHARACTERISTIC c_ti_rcha_lim "Injection time limit for recharge activation" VALUE 0x85c1b2 _REC_VAL_20_u2 32.767 _CNV_A_R_LINEAR_____208_CM 0. 32.767 DISPLAY_IDENTIFIER C_TI_RCHA_LIM FORMAT "%5.3" /end CHARACTERISTIC
/begin CHARACTERISTIC c_t_rcha_pulse_dur_[0] "Recharge pulse time (cylinder individual)" VALUE 0x85c10a _REC_VAL_20_u2 32.767 _CNV_A_R_LINEAR_____208_CM 0. 32.767 DISPLAY_IDENTIFIER C_T_RCHA_PULSE_DUR__0_ FORMAT "%5.3" /end CHARACTERISTIC
/begin CHARACTERISTIC c_t_rcha_pulse_dur_[1] "Recharge pulse time (cylinder individual)" VALUE 0x85c10c _REC_VAL_20_u2 32.767 _CNV_A_R_LINEAR_____208_CM 0. 32.767 DISPLAY_IDENTIFIER C_T_RCHA_PULSE_DUR__1_ FORMAT "%5.3" /end CHARACTERISTIC
/begin CHARACTERISTIC c_t_rcha_pulse_dur_[2] "Recharge pulse time (cylinder individual)" VALUE 0x85c10e _REC_VAL_20_u2 32.767 _CNV_A_R_LINEAR_____208_CM 0. 32.767 DISPLAY_IDENTIFIER C_T_RCHA_PULSE_DUR__2_ FORMAT "%5.3" /end CHARACTERISTIC
/begin CHARACTERISTIC c_t_rcha_pulse_dur_[3] "Recharge pulse time (cylinder individual)" VALUE 0x85c110 _REC_VAL_20_u2 32.767 _CNV_A_R_LINEAR_____208_CM 0. 32.767 DISPLAY_IDENTIFIER C_T_RCHA_PULSE_DUR__3_ FORMAT "%5.3" /end CHARACTERISTIC
/begin MEASUREMENT soi_frze_prev1_pwr_on "power-on value of start of pulse FROM ZERO PREV1" SWORD _CNV_A_R_LINEAR_____121_CM 1 0. -120. 240. DISPLAY_IDENTIFIER SOI_FRZE_PREV1_PWR_ON ECU_ADDRESS 0x7fa15e BYTE_ORDER MSB_LAST FORMAT "%5.2" /end MEASUREMENT
/begin MEASUREMENT t_cha_frze_prev1 "charging time of pulse FROM ZERO PREV1" UWORD _CNV_A_R_LINEAR_____208_CM 1 0. 0. 32.767 DISPLAY_IDENTIFIER T_CHA_FRZE_PREV1 ECU_ADDRESS 0x7fa160 BYTE_ORDER MSB_LAST FORMAT "%5.3" /end MEASUREMENT
/begin MEASUREMENT soi_prev1_pwr_on "power-on value of start of injection PREV1" SWORD _CNV_A_R_LINEAR_____121_CM 1 0. -120. 240. DISPLAY_IDENTIFIER SOI_PREV1_PWR_ON ECU_ADDRESS 0x7fa162 BYTE_ORDER MSB_LAST FORMAT "%5.2" /end MEASUREMENT
/begin MEASUREMENT t_cha_prev1 "charging time of injection PREV1" UWORD _CNV_A_R_LINEAR_____208_CM 1 0. 0. 32.767 DISPLAY_IDENTIFIER T_CHA_PREV1 ECU_ADDRESS 0x7fa164 BYTE_ORDER MSB_LAST FORMAT "%5.3" /end MEASUREMENT
/begin MEASUREMENT eoi_prev1_pwr_on "power-on value of end of injection PREV1" SWORD _CNV_A_R_LINEAR_____121_CM 1 0. -120. 240. DISPLAY_IDENTIFIER EOI_PREV1_PWR_ON ECU_ADDRESS 0x7fa166 BYTE_ORDER MSB_LAST FORMAT "%5.2" /end MEASUREMENT
/begin MEASUREMENT t_dcha_prev1 "discharging time of injection PREV1" UWORD _CNV_A_R_LINEAR_____208_CM 1 0. 0. 32.767 DISPLAY_IDENTIFIER T_DCHA_PREV1 ECU_ADDRESS 0x7fa168 BYTE_ORDER MSB_LAST FORMAT "%5.3" /end MEASUREMENT
/begin MEASUREMENT t_hld_toze_prev1 "hold time of pulse TO ZERO PREV1" UWORD _CNV_A_R_LINEAR_____208_CM 1 0. 0. 32.767 DISPLAY_IDENTIFIER T_HLD_TOZE_PREV1 ECU_ADDRESS 0x7fa16a BYTE_ORDER MSB_LAST FORMAT "%5.3" /end MEASUREMENT
/begin MEASUREMENT t_dcha_toze_prev1 "discharging time of pulse TO ZERO PREV1" UWORD _CNV_A_R_LINEAR_____208_CM 1 0. 0. 32.767 DISPLAY_IDENTIFIER T_DCHA_TOZE_PREV1 ECU_ADDRESS 0x7fa16c BYTE_ORDER MSB_LAST FORMAT "%5.3" /end MEASUREMENT
/begin MEASUREMENT lv_frze_prev1_act "activation status of pulse FROM ZERO PREV1" UBYTE _CNV_S_2_RANGE______11_CM 1 0. 0. 1. DISPLAY_IDENTIFIER LV_FRZE_PREV1_ACT ECU_ADDRESS 0x7fb7b1 /end MEASUREMENT
/begin MEASUREMENT lv_prev1_act "activation status of injection PREV1" UBYTE _CNV_S_2_RANGE______11_CM 1 0. 0. 1. DISPLAY_IDENTIFIER LV_PREV1_ACT ECU_ADDRESS 0x7fb7b2 /end MEASUREMENT
/begin MEASUREMENT lv_toze_prev1_act "activation status of pulse TO ZERO PREV1" UBYTE _CNV_S_2_RANGE______11_CM 1 0. 0. 1. DISPLAY_IDENTIFIER LV_TOZE_PREV1_ACT ECU_ADDRESS 0x7fb7b3 /end MEASUREMENT
/begin MEASUREMENT soi_frze_main1_pwr_on "power-on value of start of pulse FROM ZERO MAIN1" SWORD _CNV_A_R_LINEAR_____121_CM 1 0. -120. 240. DISPLAY_IDENTIFIER SOI_FRZE_MAIN1_PWR_ON ECU_ADDRESS 0x7fa16e BYTE_ORDER MSB_LAST FORMAT "%5.2" /end MEASUREMENT
/begin MEASUREMENT t_cha_frze_main1 "charging time of pulse FROM ZERO MAIN1" UWORD _CNV_A_R_LINEAR_____208_CM 1 0. 0. 32.767 DISPLAY_IDENTIFIER T_CHA_FRZE_MAIN1 ECU_ADDRESS 0x7fa170 BYTE_ORDER MSB_LAST FORMAT "%5.3" /end MEASUREMENT
/begin MEASUREMENT soi_main1_pwr_on "power-on value of start of injection MAIN1" SWORD _CNV_A_R_LINEAR_____121_CM 1 0. -120. 240. DISPLAY_IDENTIFIER SOI_MAIN1_PWR_ON ECU_ADDRESS 0x7fa172 BYTE_ORDER MSB_LAST FORMAT "%5.2" /end MEASUREMENT
/begin MEASUREMENT t_cha_main1 "charging time of injection MAIN1" UWORD _CNV_A_R_LINEAR_____208_CM 1 0. 0. 32.767 DISPLAY_IDENTIFIER T_CHA_MAIN1 ECU_ADDRESS 0x7fa174 BYTE_ORDER MSB_LAST FORMAT "%5.3" /end MEASUREMENT
/begin MEASUREMENT lv_frze_main1_act "activation status of pulse FROM ZERO MAIN1" UBYTE _CNV_S_2_RANGE______11_CM 1 0. 0. 1. DISPLAY_IDENTIFIER LV_FRZE_MAIN1_ACT ECU_ADDRESS 0x7fb7b4 /end MEASUREMENT
/begin MEASUREMENT lv_main1_act "activation status of injection MAIN1" UBYTE _CNV_S_2_RANGE______11_CM 1 0. 0. 1. DISPLAY_IDENTIFIER LV_MAIN1_ACT ECU_ADDRESS 0x7fb7b5 /end MEASUREMENT
/begin MEASUREMENT lv_toze_main1_act "activation status of pulse TO ZERO MAIN1" UBYTE _CNV_S_2_RANGE______11_CM 1 0. 0. 1. DISPLAY_IDENTIFIER LV_TOZE_MAIN1_ACT ECU_ADDRESS 0x7fb7b6 /end MEASUREMENT
/begin MEASUREMENT lv_toze_prev1_req4 "activation status of pulse TO ZERO PREV1 (request of function PREV1)" UBYTE _CNV_S_2_RANGE______11_CM 1 0. 0. 1. DISPLAY_IDENTIFIER LV_TOZE_PREV1_REQ4 ECU_ADDRESS 0x7fbb7a /end MEASUREMENT
/begin MEASUREMENT dur_move_prev1 "duration shift of PREV1" UWORD _CNV_A_R_LINEAR_____121_CM 1 0. 0. 360. DISPLAY_IDENTIFIER DUR_MOVE_PREV1 ECU_ADDRESS 0x7fa176 BYTE_ORDER MSB_LAST FORMAT "%5.2" /end MEASUREMENT
/begin MEASUREMENT case_nr "case number of collision between PREV1 and MAIN1" UBYTE _CNV_A_R_LINEAR_____0_CM 1 0. 1. 3. DISPLAY_IDENTIFIER CASE_NR ECU_ADDRESS 0x7fb7b0 FORMAT "%1.0" /end MEASUREMENT
/begin MEASUREMENT doi_main1_pwr_on "power-on value of start of injection MAIN1" UWORD _CNV_A_R_LINEAR_____121_CM 1 0. 0. 360. DISPLAY_IDENTIFIER DOI_MAIN1_PWR_ON ECU_ADDRESS 0x7fa178 BYTE_ORDER MSB_LAST FORMAT "%5.2" /end MEASUREMENT
/begin CHARACTERISTIC c_t_dist_prev1_main1_min "minimal time between PREV1 and MAIN1" VALUE 0x848626 _REC_VAL_20_u2 32.767 _CNV_A_R_LINEAR_____208_CM 0. 32.767 DISPLAY_IDENTIFIER C_T_DIST_PREV1_MAIN1_MIN FORMAT "%5.3" /end CHARACTERISTIC
/begin CHARACTERISTIC c_dur_dist_prev1_main1_min "minimal duration between PREV1 and MAIN1" VALUE 0x8483ee _REC_VAL_20_s2 360. _CNV_A_R_LINEAR_____121_CM -120. 240. DISPLAY_IDENTIFIER C_DUR_DIST_PREV1_MAIN1_MIN FORMAT "%5.2" /end CHARACTERISTIC
/begin CHARACTERISTIC c_swi_dist "switch for minimal distance calculation method" VALUE 0x8485dd _REC_VAL_20_u1 6. _CNV_A_R_LINEAR_____0_CM 1. 7. DISPLAY_IDENTIFIER C_SWI_DIST FORMAT "%1.0" /end CHARACTERISTIC
/begin CHARACTERISTIC c_n_level_swi "rotational speed threshold for level change" VALUE 0x8484e0 _REC_VAL_20_u2 6375. _CNV_A_R_LINEAR_____5_CM 0. 6375. DISPLAY_IDENTIFIER C_N_LEVEL_SWI FORMAT "%4.0" /end CHARACTERISTIC
/begin CHARACTERISTIC lc_dir_chg_n_level "manual switch for direction of effect of C_N_LEVEL_SWI" VALUE 0x848795 _REC_VAL_20_u1 1. _CNV_A_R_LINEAR_____0_CM 0. 1. DISPLAY_IDENTIFIER LC_DIR_CHG_N_LEVEL FORMAT "%1.0" /end CHARACTERISTIC
/begin CHARACTERISTIC lc_case_clc_on "manual switch for calculation on/off" VALUE 0x84878e _REC_VAL_20_u1 1. _CNV_A_R_LINEAR_____0_CM 0. 1. DISPLAY_IDENTIFIER LC_CASE_CLC_ON FORMAT "%1.0" /end CHARACTERISTIC
/begin CHARACTERISTIC c_t_swi_1_2_ofs "this time offset causes a previously collision case change from 1 to 2" VALUE 0x8486b0 _REC_VAL_20_u2 32.767 _CNV_A_R_LINEAR_____208_CM 0. 32.767 DISPLAY_IDENTIFIER C_T_SWI_1_2_OFS FORMAT "%5.3" /end CHARACTERISTIC
/begin CHARACTERISTIC c_t_swi_2_3_ofs "this time offset causes a previously collision case change from 2 to 3" VALUE 0x8486b2 _REC_VAL_20_u2 32.767 _CNV_A_R_LINEAR_____208_CM 0. 32.767 DISPLAY_IDENTIFIER C_T_SWI_2_3_OFS FORMAT "%5.3" /end CHARACTERISTIC
/begin MEASUREMENT soi_frze_main1_req1 "start of pulse FROM ZERO MAIN1 (requested value)" SWORD _CNV_A_R_LINEAR_____121_CM 1 0. -120. 240. DISPLAY_IDENTIFIER SOI_FRZE_MAIN1_REQ1 ECU_ADDRESS 0x7fa17a BYTE_ORDER MSB_LAST FORMAT "%5.2" /end MEASUREMENT
/begin MEASUREMENT t_cha_frze_main1_req1 "charging time of pulse FROM ZERO MAIN1 (requested value)" UWORD _CNV_A_R_LINEAR_____208_CM 1 0. 0. 32.767 DISPLAY_IDENTIFIER T_CHA_FRZE_MAIN1_REQ1 ECU_ADDRESS 0x7fa17c BYTE_ORDER MSB_LAST FORMAT "%5.3" /end MEASUREMENT
/begin MEASUREMENT soi_main1_req1 "start of injection MAIN1 (requested value)" SWORD _CNV_A_R_LINEAR_____121_CM 1 0. -120. 240. DISPLAY_IDENTIFIER SOI_MAIN1_REQ1 ECU_ADDRESS 0x7fa17e BYTE_ORDER MSB_LAST FORMAT "%5.2" /end MEASUREMENT
/begin MEASUREMENT t_cha_main1_req1 "charging time of injection MAIN1 (requested value)" UWORD _CNV_A_R_LINEAR_____208_CM 1 0. 0. 32.767 DISPLAY_IDENTIFIER T_CHA_MAIN1_REQ1 ECU_ADDRESS 0x7fa180 BYTE_ORDER MSB_LAST FORMAT "%5.3" /end MEASUREMENT
/begin MEASUREMENT eoi_main1_pwr_on "power-on value of end of injection MAIN1" SWORD _CNV_A_R_LINEAR_____121_CM 1 0. -120. 240. DISPLAY_IDENTIFIER EOI_MAIN1_PWR_ON ECU_ADDRESS 0x7fa182 BYTE_ORDER MSB_LAST FORMAT "%5.2" /end MEASUREMENT
/begin MEASUREMENT t_dcha_main1 "discharging time of injection MAIN1" UWORD _CNV_A_R_LINEAR_____208_CM 1 0. 0. 32.767 DISPLAY_IDENTIFIER T_DCHA_MAIN1 ECU_ADDRESS 0x7fa188 BYTE_ORDER MSB_LAST FORMAT "%5.3" /end MEASUREMENT
/begin MEASUREMENT t_hld_toze_main1 "hold time of pulse TO ZERO MAIN1" UWORD _CNV_A_R_LINEAR_____208_CM 1 0. 0. 32.767 DISPLAY_IDENTIFIER T_HLD_TOZE_MAIN1 ECU_ADDRESS 0x7fa184 BYTE_ORDER MSB_LAST FORMAT "%5.3" /end MEASUREMENT
/begin MEASUREMENT t_dcha_toze_main1 "discharging time of pulse TO ZERO MAIN1" UWORD _CNV_A_R_LINEAR_____208_CM 1 0. 0. 32.767 DISPLAY_IDENTIFIER T_DCHA_TOZE_MAIN1 ECU_ADDRESS 0x7fa186 BYTE_ORDER MSB_LAST FORMAT "%5.3" /end MEASUREMENT
/begin MEASUREMENT lv_frze_main1_req2 "activation status of pulse FROM ZERO MAIN1 (requested value)" UBYTE _CNV_S_2_RANGE______11_CM 1 0. 0. 1. DISPLAY_IDENTIFIER LV_FRZE_MAIN1_REQ2 ECU_ADDRESS 0x7fb7b8 /end MEASUREMENT
/begin MEASUREMENT lv_main1_req2 "activation status of injection MAIN1 (requested value)" UBYTE _CNV_S_2_RANGE______11_CM 1 0. 0. 1. DISPLAY_IDENTIFIER LV_MAIN1_REQ2 ECU_ADDRESS 0x7fb7b9 /end MEASUREMENT
/begin MEASUREMENT lv_toze_main1_req2 "activation status of pulse TO ZERO MAIN1 (requested value)" UBYTE _CNV_S_2_RANGE______11_CM 1 0. 0. 1. DISPLAY_IDENTIFIER LV_TOZE_MAIN1_REQ2 ECU_ADDRESS 0x7fb7ba /end MEASUREMENT
/begin MEASUREMENT lv_frze_prev1_req3 "activation status of pulse FROM ZERO PREV1 (requested value)" UBYTE _CNV_S_2_RANGE______11_CM 1 0. 0. 1. DISPLAY_IDENTIFIER LV_FRZE_PREV1_REQ3 ECU_ADDRESS 0x7fb7bb /end MEASUREMENT
/begin MEASUREMENT lv_prev1_req3 "activation status of injection PREV1 (requested value)" UBYTE _CNV_S_2_RANGE______11_CM 1 0. 0. 1. DISPLAY_IDENTIFIER LV_PREV1_REQ3 ECU_ADDRESS 0x7fb7bc /end MEASUREMENT
/begin MEASUREMENT lv_toze_prev1_req3 "activation status of pulse TO ZERO PREV1 (requested value)" UBYTE _CNV_S_2_RANGE______11_CM 1 0. 0. 1. DISPLAY_IDENTIFIER LV_TOZE_PREV1_REQ3 ECU_ADDRESS 0x7fb7bd /end MEASUREMENT
/begin MEASUREMENT doi_main1_bas_tu "duration of injection MAIN1 (after tuning)" UWORD _CNV_A_R_LINEAR_____121_CM 1 0. 0. 360. DISPLAY_IDENTIFIER DOI_MAIN1_BAS_TU ECU_ADDRESS 0x7fb086 BYTE_ORDER MSB_LAST FORMAT "%5.2" /end MEASUREMENT
/begin MEASUREMENT step_nr_cha_frze_main1 "number of charge steps for pulse FROM ZERO MAIN1" UBYTE _CNV_A_R_LINEAR_____0_CM 1 0. 0. 30. DISPLAY_IDENTIFIER STEP_NR_CHA_FRZE_MAIN1 ECU_ADDRESS 0x7fbb7d FORMAT "%2.0" /end MEASUREMENT
/begin MEASUREMENT level_cha_frze_main1 "charge level of pulse FROM ZERO MAIN1" UBYTE _CNV_A_R_LINEAR_____209_CM 1 0. 0. 99.609375 DISPLAY_IDENTIFIER LEVEL_CHA_FRZE_MAIN1 ECU_ADDRESS 0x7fbb7e FORMAT "%3.1" /end MEASUREMENT
/begin MEASUREMENT t_hld_frze_main1 "hold time of pulse FROM ZERO MAIN1" UWORD _CNV_A_R_LINEAR_____208_CM 1 0. 0. 32.767 DISPLAY_IDENTIFIER T_HLD_FRZE_MAIN1 ECU_ADDRESS 0x7fb088 BYTE_ORDER MSB_LAST FORMAT "%5.3" /end MEASUREMENT
/begin MEASUREMENT step_nr_cha_main1 "number of charge steps for pulse MAIN1" UBYTE _CNV_A_R_LINEAR_____0_CM 1 0. 0. 30. DISPLAY_IDENTIFIER STEP_NR_CHA_MAIN1 ECU_ADDRESS 0x7fbb7f FORMAT "%2.0" /end MEASUREMENT
/begin MEASUREMENT step_nr_dcha_main1 "number of discharge steps for pulse MAIN1" UBYTE _CNV_A_R_LINEAR_____0_CM 1 0. 0. 30. DISPLAY_IDENTIFIER STEP_NR_DCHA_MAIN1 ECU_ADDRESS 0x7fbb80 FORMAT "%2.0" /end MEASUREMENT
/begin MEASUREMENT level_dcha_toze_main1 "discharge level of pulse TO ZERO MAIN1" UBYTE _CNV_A_R_LINEAR_____209_CM 1 0. 0. 99.609375 DISPLAY_IDENTIFIER LEVEL_DCHA_TOZE_MAIN1 ECU_ADDRESS 0x7fbb81 FORMAT "%3.1" /end MEASUREMENT
/begin MEASUREMENT step_nr_dcha_toze_main1 "number of discharge steps for pulse TO ZERO MAIN1" UBYTE _CNV_A_R_LINEAR_____0_CM 1 0. 0. 30. DISPLAY_IDENTIFIER STEP_NR_DCHA_TOZE_MAIN1 ECU_ADDRESS 0x7fbb82 FORMAT "%2.0" /end MEASUREMENT
/begin MEASUREMENT doi_main1_bas "duration of injection MAIN1 (after Temperature / last Injection Correction)" UWORD _CNV_A_R_LINEAR_____121_CM 1 0. 0. 360. DISPLAY_IDENTIFIER DOI_MAIN1_BAS ECU_ADDRESS 0x7fb08a BYTE_ORDER MSB_LAST FORMAT "%5.2" /end MEASUREMENT
/begin MEASUREMENT mf_main1_tu_cor "increased/decreased fuel mass depending on FAC_MF_MAIN1_DOI" UWORD _CNV_A_R_LINEAR_____43_CM 1 0. 0. 262.14 DISPLAY_IDENTIFIER MF_MAIN1_TU_COR ECU_ADDRESS 0x7fb08c BYTE_ORDER MSB_LAST /end MEASUREMENT
/begin MEASUREMENT doi_main1_req1 "duration of injection MAIN1" UWORD _CNV_A_R_LINEAR_____121_CM 1 0. 0. 360. DISPLAY_IDENTIFIER DOI_MAIN1_REQ1 ECU_ADDRESS 0x7fa18a BYTE_ORDER MSB_LAST FORMAT "%5.2" /end MEASUREMENT
/begin MEASUREMENT lv_micro_step_main1_act "microstepping MAIN1 is active" UBYTE _CNV_S_2_RANGE______11_CM 1 0. 0. 1. DISPLAY_IDENTIFIER LV_MICRO_STEP_MAIN1_ACT ECU_ADDRESS 0x7fb7be /end MEASUREMENT
/begin MEASUREMENT soi_frze_cor_main1 "start of injection MAIN1 correction" SWORD _CNV_A_R_LINEAR_____121_CM 1 0. -120. 240. DISPLAY_IDENTIFIER SOI_FRZE_COR_MAIN1 ECU_ADDRESS 0x7fb0a0 BYTE_ORDER MSB_LAST FORMAT "%5.2" /end MEASUREMENT
/begin CHARACTERISTIC ip_level_cha_frze_main1__n "DPX00Q01: charge level of pulse FROM ZERO MAIN1" CURVE 0x846d3c _REC_CUR_20_u1_u2 99.609375 _CNV_A_R_LINEAR_____209_CM 0. 99.609375 DISPLAY_IDENTIFIER IP_LEVEL_CHA_FRZE_MAIN1__N FORMAT "%3.1"
 /begin AXIS_DESCR COM_AXIS n _CNV_A_R_LINEAR_____5_CM 8 0. 6375. FORMAT "%4.0" AXIS_PTS_REF ldp_n_ip_level_cha_frze_main1 /end AXIS_DESCR
/end CHARACTERISTIC
/begin AXIS_PTS ldp_n_ip_level_cha_frze_main1 "" 0x841a84 n _REC_AXS_20_u2 6375. _CNV_A_R_LINEAR_____5_CM 8 0. 6375. FORMAT "%4.0" /end AXIS_PTS
/begin CHARACTERISTIC ip_t_hld_frze_main1__n "DPX00Q01: hold time of pulse FROM ZERO MAIN1" CURVE 0x84766a _REC_CUR_20_u2_u2 32.767 _CNV_A_R_LINEAR_____208_CM 0. 32.767 DISPLAY_IDENTIFIER IP_T_HLD_FRZE_MAIN1__N FORMAT "%5.3"
 /begin AXIS_DESCR COM_AXIS n _CNV_A_R_LINEAR_____5_CM 8 0. 6375. FORMAT "%4.0" AXIS_PTS_REF ldp_n_ip_t_hld_frze_main1 /end AXIS_DESCR
/end CHARACTERISTIC
/begin AXIS_PTS ldp_n_ip_t_hld_frze_main1 "" 0x842282 n _REC_AXS_20_u2 6375. _CNV_A_R_LINEAR_____5_CM 8 0. 6375. FORMAT "%4.0" /end AXIS_PTS
/begin CHARACTERISTIC c_fac_doi_main1_tu_[0] "" VALUE 0x848436 _REC_VAL_20_u2 1.9999696 _CNV_A_R_LINEAR_____53_CM 0. 1.9999696 DISPLAY_IDENTIFIER C_FAC_DOI_MAIN1_TU__0_ FORMAT "%6.5" /end CHARACTERISTIC
/begin CHARACTERISTIC c_fac_doi_main1_tu_[1] "" VALUE 0x848438 _REC_VAL_20_u2 1.9999696 _CNV_A_R_LINEAR_____53_CM 0. 1.9999696 DISPLAY_IDENTIFIER C_FAC_DOI_MAIN1_TU__1_ FORMAT "%6.5" /end CHARACTERISTIC
/begin CHARACTERISTIC c_fac_doi_main1_tu_[2] "" VALUE 0x84843a _REC_VAL_20_u2 1.9999696 _CNV_A_R_LINEAR_____53_CM 0. 1.9999696 DISPLAY_IDENTIFIER C_FAC_DOI_MAIN1_TU__2_ FORMAT "%6.5" /end CHARACTERISTIC
/begin CHARACTERISTIC c_fac_doi_main1_tu_[3] "" VALUE 0x84843c _REC_VAL_20_u2 1.9999696 _CNV_A_R_LINEAR_____53_CM 0. 1.9999696 DISPLAY_IDENTIFIER C_FAC_DOI_MAIN1_TU__3_ FORMAT "%6.5" /end CHARACTERISTIC
/begin CHARACTERISTIC c_doi_main1_man_[0] "manual value for duration of injection MAIN1" VALUE 0x8483c4 _REC_VAL_20_u2 360. _CNV_A_R_LINEAR_____121_CM 0. 360. DISPLAY_IDENTIFIER C_DOI_MAIN1_MAN__0_ FORMAT "%5.2" /end CHARACTERISTIC
/begin CHARACTERISTIC c_doi_main1_man_[1] "manual value for duration of injection MAIN1" VALUE 0x8483c6 _REC_VAL_20_u2 360. _CNV_A_R_LINEAR_____121_CM 0. 360. DISPLAY_IDENTIFIER C_DOI_MAIN1_MAN__1_ FORMAT "%5.2" /end CHARACTERISTIC
/begin CHARACTERISTIC c_doi_main1_man_[2] "manual value for duration of injection MAIN1" VALUE 0x8483c8 _REC_VAL_20_u2 360. _CNV_A_R_LINEAR_____121_CM 0. 360. DISPLAY_IDENTIFIER C_DOI_MAIN1_MAN__2_ FORMAT "%5.2" /end CHARACTERISTIC
/begin CHARACTERISTIC c_doi_main1_man_[3] "manual value for duration of injection MAIN1" VALUE 0x8483ca _REC_VAL_20_u2 360. _CNV_A_R_LINEAR_____121_CM 0. 360. DISPLAY_IDENTIFIER C_DOI_MAIN1_MAN__3_ FORMAT "%5.2" /end CHARACTERISTIC
/begin CHARACTERISTIC lc_doi_main1_man "button for setting a manual value for duration of injection MAIN1" VALUE 0x848797 _REC_VAL_20_u1 1. _CNV_A_R_LINEAR_____0_CM 0. 1. DISPLAY_IDENTIFIER LC_DOI_MAIN1_MAN FORMAT "%1.0" /end CHARACTERISTIC
/begin CHARACTERISTIC ip_doi_main1_0 "DPX00Q01: array of injection duration maps (MAP 0) of injection MAIN1" MAP 0x845868 _REC_MAP_20_u2_u2_u2 360. _CNV_A_R_LINEAR_____121_CM 0. 360. DISPLAY_IDENTIFIER IP_DOI_MAIN1_0 FORMAT "%5.2"
 /begin AXIS_DESCR COM_AXIS n _CNV_A_R_LINEAR_____5_CM 16 0. 6375. FORMAT "%4.0" AXIS_PTS_REF ldpm_n_ip_doi_main1 /end AXIS_DESCR
 /begin AXIS_DESCR COM_AXIS mf_main1_tu_cor _CNV_A_R_LINEAR_____43_CM 16 0. 262.14 AXIS_PTS_REF ldpm_mf_ip_doi_main1 /end AXIS_DESCR
/end CHARACTERISTIC
/begin CHARACTERISTIC ip_doi_main1_1 "DPX00Q01: array of injection duration maps (MAP 1) of injection MAIN1" MAP 0x845a68 _REC_MAP_20_u2_u2_u2 360. _CNV_A_R_LINEAR_____121_CM 0. 360. DISPLAY_IDENTIFIER IP_DOI_MAIN1_1 FORMAT "%5.2"
 /begin AXIS_DESCR COM_AXIS n _CNV_A_R_LINEAR_____5_CM 16 0. 6375. FORMAT "%4.0" AXIS_PTS_REF ldpm_n_ip_doi_main1 /end AXIS_DESCR
 /begin AXIS_DESCR COM_AXIS mf_main1_tu_cor _CNV_A_R_LINEAR_____43_CM 16 0. 262.14 AXIS_PTS_REF ldpm_mf_ip_doi_main1 /end AXIS_DESCR
/end CHARACTERISTIC
/begin CHARACTERISTIC ip_doi_main1_2 "DPX00Q01: array of injection duration maps (MAP 2) of injection MAIN1" MAP 0x845c68 _REC_MAP_20_u2_u2_u2 360. _CNV_A_R_LINEAR_____121_CM 0. 360. DISPLAY_IDENTIFIER IP_DOI_MAIN1_2 FORMAT "%5.2"
 /begin AXIS_DESCR COM_AXIS n _CNV_A_R_LINEAR_____5_CM 16 0. 6375. FORMAT "%4.0" AXIS_PTS_REF ldpm_n_ip_doi_main1 /end AXIS_DESCR
 /begin AXIS_DESCR COM_AXIS mf_main1_tu_cor _CNV_A_R_LINEAR_____43_CM 16 0. 262.14 AXIS_PTS_REF ldpm_mf_ip_doi_main1 /end AXIS_DESCR
/end CHARACTERISTIC
/begin CHARACTERISTIC ip_doi_main1_3 "DPX00Q01: array of injection duration maps (MAP 3) of injection MAIN1" MAP 0x845e68 _REC_MAP_20_u2_u2_u2 360. _CNV_A_R_LINEAR_____121_CM 0. 360. DISPLAY_IDENTIFIER IP_DOI_MAIN1_3 FORMAT "%5.2"
 /begin AXIS_DESCR COM_AXIS n _CNV_A_R_LINEAR_____5_CM 16 0. 6375. FORMAT "%4.0" AXIS_PTS_REF ldpm_n_ip_doi_main1 /end AXIS_DESCR
 /begin AXIS_DESCR COM_AXIS mf_main1_tu_cor _CNV_A_R_LINEAR_____43_CM 16 0. 262.14 AXIS_PTS_REF ldpm_mf_ip_doi_main1 /end AXIS_DESCR
/end CHARACTERISTIC
/begin CHARACTERISTIC ip_doi_main1_4 "DPX00Q01: array of injection duration maps (MAP 4) of injection MAIN1" MAP 0x846068 _REC_MAP_20_u2_u2_u2 360. _CNV_A_R_LINEAR_____121_CM 0. 360. DISPLAY_IDENTIFIER IP_DOI_MAIN1_4 FORMAT "%5.2"
 /begin AXIS_DESCR COM_AXIS n _CNV_A_R_LINEAR_____5_CM 16 0. 6375. FORMAT "%4.0" AXIS_PTS_REF ldpm_n_ip_doi_main1 /end AXIS_DESCR
 /begin AXIS_DESCR COM_AXIS mf_main1_tu_cor _CNV_A_R_LINEAR_____43_CM 16 0. 262.14 AXIS_PTS_REF ldpm_mf_ip_doi_main1 /end AXIS_DESCR
/end CHARACTERISTIC
/begin CHARACTERISTIC ip_doi_main1_5 "DPX00Q01: array of injection duration maps (MAP 5) of injection MAIN1" MAP 0x846268 _REC_MAP_20_u2_u2_u2 360. _CNV_A_R_LINEAR_____121_CM 0. 360. DISPLAY_IDENTIFIER IP_DOI_MAIN1_5 FORMAT "%5.2"
 /begin AXIS_DESCR COM_AXIS n _CNV_A_R_LINEAR_____5_CM 16 0. 6375. FORMAT "%4.0" AXIS_PTS_REF ldpm_n_ip_doi_main1 /end AXIS_DESCR
 /begin AXIS_DESCR COM_AXIS mf_main1_tu_cor _CNV_A_R_LINEAR_____43_CM 16 0. 262.14 AXIS_PTS_REF ldpm_mf_ip_doi_main1 /end AXIS_DESCR
/end CHARACTERISTIC
/begin AXIS_PTS ldpm_n_ip_doi_main1 "" 0x84399c n _REC_AXS_20_u2 6375. _CNV_A_R_LINEAR_____5_CM 16 0. 6375. FORMAT "%4.0" /end AXIS_PTS
/begin AXIS_PTS ldpm_mf_ip_doi_main1 "" 0x843516 mf_main1_tu_cor _REC_AXS_20_u2 262.14 _CNV_A_R_LINEAR_____43_CM 16 0. 262.14 /end AXIS_PTS
/begin CHARACTERISTIC ip_sel_ip_doi_main1__soi "DPX00Q01: selector for injection duration maps of injection MAIN1" CURVE 0x8474dc _REC_CUR_20_u4_u2 65535. _CNV_A_R_LINEAR_____210_CM 0. 65535. DISPLAY_IDENTIFIER IP_SEL_IP_DOI_MAIN1__SOI FORMAT "%10.5"
 /begin AXIS_DESCR COM_AXIS soi_main1_tu _CNV_A_R_LINEAR_____120_CM 6 -120. 240. FORMAT "%5.2" AXIS_PTS_REF ldp_soi_ip_doi_main1 /end AXIS_DESCR
/end CHARACTERISTIC
/begin AXIS_PTS ldp_soi_ip_doi_main1 "" 0x84255a soi_main1_tu _REC_AXS_20_u2 360. _CNV_A_R_LINEAR_____120_CM 6 -120. 240. FORMAT "%5.2" /end AXIS_PTS
/begin CHARACTERISTIC ip_level_dcha_toze_main1__n "DPX00Q01: discharge level of pulse TO ZERO MAIN1" CURVE 0x846d54 _REC_CUR_20_u1_u2 99.609375 _CNV_A_R_LINEAR_____209_CM 0. 99.609375 DISPLAY_IDENTIFIER IP_LEVEL_DCHA_TOZE_MAIN1__N FORMAT "%3.1"
 /begin AXIS_DESCR COM_AXIS n _CNV_A_R_LINEAR_____5_CM 8 0. 6375. FORMAT "%4.0" AXIS_PTS_REF ldp_n_ip_level_dcha_toze_main1 /end AXIS_DESCR
/end CHARACTERISTIC
/begin AXIS_PTS ldp_n_ip_level_dcha_toze_main1 "" 0x841aba n _REC_AXS_20_u2 6375. _CNV_A_R_LINEAR_____5_CM 8 0. 6375. FORMAT "%4.0" /end AXIS_PTS
/begin CHARACTERISTIC ip_t_hld_toze_main1__n "DPX00Q01: hold time of pulse TO ZERO MAIN1" CURVE 0x84769a _REC_CUR_20_u2_u2 32.767 _CNV_A_R_LINEAR_____208_CM 0. 32.767 DISPLAY_IDENTIFIER IP_T_HLD_TOZE_MAIN1__N FORMAT "%5.3"
 /begin AXIS_DESCR COM_AXIS n _CNV_A_R_LINEAR_____5_CM 8 0. 6375. FORMAT "%4.0" AXIS_PTS_REF ldp_n_ip_t_hld_toze_main1 /end AXIS_DESCR
/end CHARACTERISTIC
/begin AXIS_PTS ldp_n_ip_t_hld_toze_main1 "" 0x8422b8 n _REC_AXS_20_u2 6375. _CNV_A_R_LINEAR_____5_CM 8 0. 6375. FORMAT "%4.0" /end AXIS_PTS
/begin MEASUREMENT soi_frze_post1_pwr_on "power-on value for start of pulse FROM ZERO POST1" SWORD _CNV_A_R_LINEAR_____121_CM 1 0. -120. 240. DISPLAY_IDENTIFIER SOI_FRZE_POST1_PWR_ON ECU_ADDRESS 0x7fa18c BYTE_ORDER MSB_LAST FORMAT "%5.2" /end MEASUREMENT
/begin MEASUREMENT t_cha_frze_post1 "charging time of pulse FROM ZERO POST1" UWORD _CNV_A_R_LINEAR_____208_CM 1 0. 0. 32.767 DISPLAY_IDENTIFIER T_CHA_FRZE_POST1 ECU_ADDRESS 0x7fa18e BYTE_ORDER MSB_LAST FORMAT "%5.3" /end MEASUREMENT
/begin MEASUREMENT soi_post1_pwr_on "power-on value for start of injection POST1" SWORD _CNV_A_R_LINEAR_____121_CM 1 0. -120. 240. DISPLAY_IDENTIFIER SOI_POST1_PWR_ON ECU_ADDRESS 0x7fa190 BYTE_ORDER MSB_LAST FORMAT "%5.2" /end MEASUREMENT
/begin MEASUREMENT t_cha_post1 "charging time of injection POST1" UWORD _CNV_A_R_LINEAR_____208_CM 1 0. 0. 32.767 DISPLAY_IDENTIFIER T_CHA_POST1 ECU_ADDRESS 0x7fa192 BYTE_ORDER MSB_LAST FORMAT "%5.3" /end MEASUREMENT
/begin MEASUREMENT eoi_post1_pwr_on "power-on value for end of injection POST1" SWORD _CNV_A_R_LINEAR_____121_CM 1 0. -120. 240. DISPLAY_IDENTIFIER EOI_POST1_PWR_ON ECU_ADDRESS 0x7fa194 BYTE_ORDER MSB_LAST FORMAT "%5.2" /end MEASUREMENT
/begin MEASUREMENT t_dcha_post1 "discharging time of injection POST1" UWORD _CNV_A_R_LINEAR_____208_CM 1 0. 0. 32.767 DISPLAY_IDENTIFIER T_DCHA_POST1 ECU_ADDRESS 0x7fa196 BYTE_ORDER MSB_LAST FORMAT "%5.3" /end MEASUREMENT
/begin MEASUREMENT t_hld_toze_post1 "hold time of pulse TO ZERO POST1" UWORD _CNV_A_R_LINEAR_____208_CM 1 0. 0. 32.767 DISPLAY_IDENTIFIER T_HLD_TOZE_POST1 ECU_ADDRESS 0x7fa198 BYTE_ORDER MSB_LAST FORMAT "%5.3" /end MEASUREMENT
/begin MEASUREMENT t_dcha_toze_post1 "discharging time of pulse TO ZERO POST1" UWORD _CNV_A_R_LINEAR_____208_CM 1 0. 0. 32.767 DISPLAY_IDENTIFIER T_DCHA_TOZE_POST1 ECU_ADDRESS 0x7fa19a BYTE_ORDER MSB_LAST FORMAT "%5.3" /end MEASUREMENT
/begin MEASUREMENT lv_frze_post1_act "activation status of pulse FROM ZERO POST1" UBYTE _CNV_S_2_RANGE______11_CM 1 0. 0. 1. DISPLAY_IDENTIFIER LV_FRZE_POST1_ACT ECU_ADDRESS 0x7fb7bf /end MEASUREMENT
/begin MEASUREMENT lv_post1_act "activation status of injection POST1" UBYTE _CNV_S_2_RANGE______11_CM 1 0. 0. 1. DISPLAY_IDENTIFIER LV_POST1_ACT ECU_ADDRESS 0x7fb7c0 /end MEASUREMENT
/begin MEASUREMENT lv_toze_post1_act "activation status of pulse TO ZERO POST1" UBYTE _CNV_S_2_RANGE______11_CM 1 0. 0. 1. DISPLAY_IDENTIFIER LV_TOZE_POST1_ACT ECU_ADDRESS 0x7fb7c1 /end MEASUREMENT
/begin MEASUREMENT doi_post1_bas_tu "duration of injection POST1 (after tuning)" UWORD _CNV_A_R_LINEAR_____121_CM 1 0. 0. 360. DISPLAY_IDENTIFIER DOI_POST1_BAS_TU ECU_ADDRESS 0x7fb0a4 BYTE_ORDER MSB_LAST FORMAT "%5.2" /end MEASUREMENT
/begin MEASUREMENT step_nr_cha_frze_post1 "number of charge steps for pulse FROM ZERO POST1" UBYTE _CNV_A_R_LINEAR_____0_CM 1 0. 0. 30. DISPLAY_IDENTIFIER STEP_NR_CHA_FRZE_POST1 ECU_ADDRESS 0x7fbb87 FORMAT "%2.0" /end MEASUREMENT
/begin MEASUREMENT level_cha_frze_post1 "charge level of pulse FROM ZERO POST1" UBYTE _CNV_A_R_LINEAR_____209_CM 1 0. 0. 99.609375 DISPLAY_IDENTIFIER LEVEL_CHA_FRZE_POST1 ECU_ADDRESS 0x7fbb88 FORMAT "%3.1" /end MEASUREMENT
/begin MEASUREMENT t_hld_frze_post1 "hold time of pulse FROM ZERO POST1" UWORD _CNV_A_R_LINEAR_____208_CM 1 0. 0. 32.767 DISPLAY_IDENTIFIER T_HLD_FRZE_POST1 ECU_ADDRESS 0x7fb0a8 BYTE_ORDER MSB_LAST FORMAT "%5.3" /end MEASUREMENT
/begin MEASUREMENT step_nr_cha_post1 "number of charge steps for pulse POST1" UBYTE _CNV_A_R_LINEAR_____0_CM 1 0. 0. 30. DISPLAY_IDENTIFIER STEP_NR_CHA_POST1 ECU_ADDRESS 0x7fbb89 FORMAT "%2.0" /end MEASUREMENT
/begin MEASUREMENT step_nr_dcha_post1 "number of discharge steps for pulse POST1" UBYTE _CNV_A_R_LINEAR_____0_CM 1 0. 0. 30. DISPLAY_IDENTIFIER STEP_NR_DCHA_POST1 ECU_ADDRESS 0x7fbb8a FORMAT "%2.0" /end MEASUREMENT
/begin MEASUREMENT level_dcha_toze_post1 "discharge level of pulse TO ZERO POST1" UBYTE _CNV_A_R_LINEAR_____209_CM 1 0. 0. 99.609375 DISPLAY_IDENTIFIER LEVEL_DCHA_TOZE_POST1 ECU_ADDRESS 0x7fbb8b FORMAT "%3.1" /end MEASUREMENT
/begin MEASUREMENT step_nr_dcha_toze_post1 "number of discharge steps for pulse TO ZERO POST1" UBYTE _CNV_A_R_LINEAR_____0_CM 1 0. 0. 30. DISPLAY_IDENTIFIER STEP_NR_DCHA_TOZE_POST1 ECU_ADDRESS 0x7fbb8c FORMAT "%2.0" /end MEASUREMENT
/begin MEASUREMENT doi_post1_bas "duration of injection POST1 (after Temperature / last Injection Correction)" UWORD _CNV_A_R_LINEAR_____121_CM 1 0. 0. 360. DISPLAY_IDENTIFIER DOI_POST1_BAS ECU_ADDRESS 0x7fb0a6 BYTE_ORDER MSB_LAST FORMAT "%5.2" /end MEASUREMENT
/begin MEASUREMENT mf_post1_tu_cor "increased/decreased fuel mass depending on FAC_MF_POST1_DOI" UWORD _CNV_A_R_LINEAR_____43_CM 1 0. 0. 262.14 DISPLAY_IDENTIFIER MF_POST1_TU_COR ECU_ADDRESS 0x7fb0a2 BYTE_ORDER MSB_LAST /end MEASUREMENT
/begin MEASUREMENT doi_post1_pwr_on "power on value of duration of injection POST1" UWORD _CNV_A_R_LINEAR_____121_CM 1 0. 0. 360. DISPLAY_IDENTIFIER DOI_POST1_PWR_ON ECU_ADDRESS 0x7fa19c BYTE_ORDER MSB_LAST FORMAT "%5.2" /end MEASUREMENT
/begin MEASUREMENT lv_micro_step_post1_act "microstepping POST1 is activ" UBYTE _CNV_S_2_RANGE______11_CM 1 0. 0. 1. DISPLAY_IDENTIFIER LV_MICRO_STEP_POST1_ACT ECU_ADDRESS 0x7fb7c2 /end MEASUREMENT
/begin MEASUREMENT soi_frze_cor_post1 "start of injection POST1 correction" SWORD _CNV_A_R_LINEAR_____121_CM 1 0. -120. 240. DISPLAY_IDENTIFIER SOI_FRZE_COR_POST1 ECU_ADDRESS 0x7fb0bc BYTE_ORDER MSB_LAST FORMAT "%5.2" /end MEASUREMENT
/begin CHARACTERISTIC ip_level_cha_frze_post1__n "DPX00S01: charge level of pulse FROM ZERO POST1" CURVE 0x846d44 _REC_CUR_20_u1_u2 99.609375 _CNV_A_R_LINEAR_____209_CM 0. 99.609375 DISPLAY_IDENTIFIER IP_LEVEL_CHA_FRZE_POST1__N FORMAT "%3.1"
 /begin AXIS_DESCR COM_AXIS n _CNV_A_R_LINEAR_____5_CM 8 0. 6375. FORMAT "%4.0" AXIS_PTS_REF ldp_n_ip_level_cha_frze_post1 /end AXIS_DESCR
/end CHARACTERISTIC
/begin AXIS_PTS ldp_n_ip_level_cha_frze_post1 "" 0x841a96 n _REC_AXS_20_u2 6375. _CNV_A_R_LINEAR_____5_CM 8 0. 6375. FORMAT "%4.0" /end AXIS_PTS
/begin CHARACTERISTIC ip_t_hld_frze_post1__n "DPX00S01: hold time of pulse FROM ZERO POST1" CURVE 0x84767a _REC_CUR_20_u2_u2 32.767 _CNV_A_R_LINEAR_____208_CM 0. 32.767 DISPLAY_IDENTIFIER IP_T_HLD_FRZE_POST1__N FORMAT "%5.3"
 /begin AXIS_DESCR COM_AXIS n _CNV_A_R_LINEAR_____5_CM 8 0. 6375. FORMAT "%4.0" AXIS_PTS_REF ldp_n_ip_t_hld_frze_post1 /end AXIS_DESCR
/end CHARACTERISTIC
/begin AXIS_PTS ldp_n_ip_t_hld_frze_post1 "" 0x842294 n _REC_AXS_20_u2 6375. _CNV_A_R_LINEAR_____5_CM 8 0. 6375. FORMAT "%4.0" /end AXIS_PTS
/begin CHARACTERISTIC c_fac_doi_post1_tu_[0] "cylinder individual POST1-injection tuning factor" VALUE 0x84843e _REC_VAL_20_u2 1.9999696 _CNV_A_R_LINEAR_____53_CM 0. 1.9999696 DISPLAY_IDENTIFIER C_FAC_DOI_POST1_TU__0_ FORMAT "%5.4" /end CHARACTERISTIC
/begin CHARACTERISTIC c_fac_doi_post1_tu_[1] "cylinder individual POST1-injection tuning factor" VALUE 0x848440 _REC_VAL_20_u2 1.9999696 _CNV_A_R_LINEAR_____53_CM 0. 1.9999696 DISPLAY_IDENTIFIER C_FAC_DOI_POST1_TU__1_ FORMAT "%5.4" /end CHARACTERISTIC
/begin CHARACTERISTIC c_fac_doi_post1_tu_[2] "cylinder individual POST1-injection tuning factor" VALUE 0x848442 _REC_VAL_20_u2 1.9999696 _CNV_A_R_LINEAR_____53_CM 0. 1.9999696 DISPLAY_IDENTIFIER C_FAC_DOI_POST1_TU__2_ FORMAT "%5.4" /end CHARACTERISTIC
/begin CHARACTERISTIC c_fac_doi_post1_tu_[3] "cylinder individual POST1-injection tuning factor" VALUE 0x848444 _REC_VAL_20_u2 1.9999696 _CNV_A_R_LINEAR_____53_CM 0. 1.9999696 DISPLAY_IDENTIFIER C_FAC_DOI_POST1_TU__3_ FORMAT "%5.4" /end CHARACTERISTIC
/begin CHARACTERISTIC c_doi_post1_man_[0] "manual value for duration of injection POST1" VALUE 0x8483ce _REC_VAL_20_u2 360. _CNV_A_R_LINEAR_____121_CM 0. 360. DISPLAY_IDENTIFIER C_DOI_POST1_MAN__0_ FORMAT "%5.2" /end CHARACTERISTIC
/begin CHARACTERISTIC c_doi_post1_man_[1] "manual value for duration of injection POST1" VALUE 0x8483d0 _REC_VAL_20_u2 360. _CNV_A_R_LINEAR_____121_CM 0. 360. DISPLAY_IDENTIFIER C_DOI_POST1_MAN__1_ FORMAT "%5.2" /end CHARACTERISTIC
/begin CHARACTERISTIC c_doi_post1_man_[2] "manual value for duration of injection POST1" VALUE 0x8483d2 _REC_VAL_20_u2 360. _CNV_A_R_LINEAR_____121_CM 0. 360. DISPLAY_IDENTIFIER C_DOI_POST1_MAN__2_ FORMAT "%5.2" /end CHARACTERISTIC
/begin CHARACTERISTIC c_doi_post1_man_[3] "manual value for duration of injection POST1" VALUE 0x8483d4 _REC_VAL_20_u2 360. _CNV_A_R_LINEAR_____121_CM 0. 360. DISPLAY_IDENTIFIER C_DOI_POST1_MAN__3_ FORMAT "%5.2" /end CHARACTERISTIC
/begin CHARACTERISTIC lc_doi_post1_man "button for setting a manual value for duration of injection POST1" VALUE 0x84879a _REC_VAL_20_u1 1. _CNV_A_R_LINEAR_____0_CM 0. 1. DISPLAY_IDENTIFIER LC_DOI_POST1_MAN FORMAT "%1.0" /end CHARACTERISTIC
/begin CHARACTERISTIC ip_doi_post1_0 "DPX00S01: array of injection duration maps (MAP 0) of injection POST1" MAP 0x846468 _REC_MAP_20_u2_u2_u2 360. _CNV_A_R_LINEAR_____121_CM 0. 360. DISPLAY_IDENTIFIER IP_DOI_POST1_0 FORMAT "%5.2"
 /begin AXIS_DESCR COM_AXIS n _CNV_A_R_LINEAR_____5_CM 5 0. 6375. FORMAT "%4.0" AXIS_PTS_REF ldpm_n_ip_doi_post1 /end AXIS_DESCR
 /begin AXIS_DESCR COM_AXIS mf_post1_tu_cor _CNV_A_R_LINEAR_____43_CM 5 0. 262.14 AXIS_PTS_REF ldpm_mf_ip_doi_post1 /end AXIS_DESCR
/end CHARACTERISTIC
/begin CHARACTERISTIC ip_doi_post1_1 "DPX00S01: array of injection duration maps (MAP 1) of injection POST1" MAP 0x84649a _REC_MAP_20_u2_u2_u2 360. _CNV_A_R_LINEAR_____121_CM 0. 360. DISPLAY_IDENTIFIER IP_DOI_POST1_1 FORMAT "%5.2"
 /begin AXIS_DESCR COM_AXIS n _CNV_A_R_LINEAR_____5_CM 5 0. 6375. FORMAT "%4.0" AXIS_PTS_REF ldpm_n_ip_doi_post1 /end AXIS_DESCR
 /begin AXIS_DESCR COM_AXIS mf_post1_tu_cor _CNV_A_R_LINEAR_____43_CM 5 0. 262.14 AXIS_PTS_REF ldpm_mf_ip_doi_post1 /end AXIS_DESCR
/end CHARACTERISTIC
/begin CHARACTERISTIC ip_doi_post1_2 "DPX00S01: array of injection duration maps (MAP 2) of injection POST1" MAP 0x8464cc _REC_MAP_20_u2_u2_u2 360. _CNV_A_R_LINEAR_____121_CM 0. 360. DISPLAY_IDENTIFIER IP_DOI_POST1_2 FORMAT "%5.2"
 /begin AXIS_DESCR COM_AXIS n _CNV_A_R_LINEAR_____5_CM 5 0. 6375. FORMAT "%4.0" AXIS_PTS_REF ldpm_n_ip_doi_post1 /end AXIS_DESCR
 /begin AXIS_DESCR COM_AXIS mf_post1_tu_cor _CNV_A_R_LINEAR_____43_CM 5 0. 262.14 AXIS_PTS_REF ldpm_mf_ip_doi_post1 /end AXIS_DESCR
/end CHARACTERISTIC
/begin AXIS_PTS ldpm_n_ip_doi_post1 "" 0x8439be n _REC_AXS_20_u2 6375. _CNV_A_R_LINEAR_____5_CM 5 0. 6375. FORMAT "%4.0" /end AXIS_PTS
/begin AXIS_PTS ldpm_mf_ip_doi_post1 "" 0x843538 mf_post1_tu_cor _REC_AXS_20_u2 262.14 _CNV_A_R_LINEAR_____43_CM 5 0. 262.14 /end AXIS_PTS
/begin CHARACTERISTIC ip_sel_ip_doi_post1__soi "DPX00S01: selector for injection duration maps of injection POST1" CURVE 0x8474f4 _REC_CUR_20_u4_u2 65535. _CNV_A_R_LINEAR_____210_CM 0. 65535. DISPLAY_IDENTIFIER IP_SEL_IP_DOI_POST1__SOI FORMAT "%10.5"
 /begin AXIS_DESCR COM_AXIS soi_post1_tu _CNV_A_R_LINEAR_____120_CM 3 -120. 240. FORMAT "%5.2" AXIS_PTS_REF ldp_soi_ip_doi_post1 /end AXIS_DESCR
/end CHARACTERISTIC
/begin AXIS_PTS ldp_soi_ip_doi_post1 "" 0x842568 soi_post1_tu _REC_AXS_20_u2 360. _CNV_A_R_LINEAR_____120_CM 3 -120. 240. FORMAT "%5.2" /end AXIS_PTS
/begin CHARACTERISTIC ip_level_dcha_toze_post1__n "DPX00S01: discharge level of pulse TO ZERO POST1" CURVE 0x846d5c _REC_CUR_20_u1_u2 99.609375 _CNV_A_R_LINEAR_____209_CM 0. 99.609375 DISPLAY_IDENTIFIER IP_LEVEL_DCHA_TOZE_POST1__N FORMAT "%3.1"
 /begin AXIS_DESCR COM_AXIS n _CNV_A_R_LINEAR_____5_CM 8 0. 6375. FORMAT "%4.0" AXIS_PTS_REF ldp_n_ip_level_dcha_toze_post1 /end AXIS_DESCR
/end CHARACTERISTIC
/begin AXIS_PTS ldp_n_ip_level_dcha_toze_post1 "" 0x841acc n _REC_AXS_20_u2 6375. _CNV_A_R_LINEAR_____5_CM 8 0. 6375. FORMAT "%4.0" /end AXIS_PTS
/begin CHARACTERISTIC ip_t_hld_toze_post1__n "DPX00S01: hold time of pulse TO ZERO POST1" CURVE 0x8476aa _REC_CUR_20_u2_u2 32.767 _CNV_A_R_LINEAR_____208_CM 0. 32.767 DISPLAY_IDENTIFIER IP_T_HLD_TOZE_POST1__N FORMAT "%5.3"
 /begin AXIS_DESCR COM_AXIS n _CNV_A_R_LINEAR_____5_CM 8 0. 6375. FORMAT "%4.0" AXIS_PTS_REF ldp_n_ip_t_hld_toze_post1 /end AXIS_DESCR
/end CHARACTERISTIC
/begin AXIS_PTS ldp_n_ip_t_hld_toze_post1 "" 0x8422ca n _REC_AXS_20_u2 6375. _CNV_A_R_LINEAR_____5_CM 8 0. 6375. FORMAT "%4.0" /end AXIS_PTS
/begin CHARACTERISTIC c_fac_t_dif_min_main1_post1 "factor to increase the time gap minimally needed between EOI_MAIN1 and SOI_FRZE_POST1" VALUE 0x848460 _REC_VAL_20_u2 3.99998471 _CNV_A_R_LINEAR_____63_CM 0. 3.99998471 DISPLAY_IDENTIFIER C_FAC_T_DIF_MIN_MAIN1_POST1 FORMAT "%6.5" /end CHARACTERISTIC
/begin MEASUREMENT dummy_soi "SOI" SWORD _CNV_A_R_LINEAR_____121_CM 1 0. -120. 240. DISPLAY_IDENTIFIER DUMMY_SOI ECU_ADDRESS 0x7fb0be BYTE_ORDER MSB_LAST FORMAT "%5.2" /end MEASUREMENT
/begin MEASUREMENT dummy_mf "MF" UWORD _CNV_A_R_LINEAR_____43_CM 1 0. 0. 262.14 DISPLAY_IDENTIFIER DUMMY_MF ECU_ADDRESS 0x7fb0c0 BYTE_ORDER MSB_LAST FORMAT "%4.1" /end MEASUREMENT
/begin MEASUREMENT dummy_level "LEVEL" UBYTE _CNV_A_R_LINEAR_____211_CM 1 0. 0. 63.75 DISPLAY_IDENTIFIER DUMMY_LEVEL ECU_ADDRESS 0x7fbb91 FORMAT "%3.1" /end MEASUREMENT
/begin MEASUREMENT dummy_doi "DURATION" UWORD _CNV_A_R_LINEAR_____121_CM 1 0. 0. 360. DISPLAY_IDENTIFIER DUMMY_DOI ECU_ADDRESS 0x7fb0c2 BYTE_ORDER MSB_LAST FORMAT "%5.2" /end MEASUREMENT
/begin MEASUREMENT t_dcha2newcyl_min "minimal time from discharge to charge (with switching to another cylinder)" UWORD _CNV_A_R_LINEAR_____208_CM 1 0. 0. 32.767 DISPLAY_IDENTIFIER T_DCHA2NEWCYL_MIN ECU_ADDRESS 0x7fa0e6 BYTE_ORDER MSB_LAST FORMAT "%5.3" /end MEASUREMENT
/begin MEASUREMENT t_cha_min "minimal time for charging" UWORD _CNV_A_R_LINEAR_____208_CM 1 0. 0. 32.767 DISPLAY_IDENTIFIER T_CHA_MIN ECU_ADDRESS 0x7fa0e8 BYTE_ORDER MSB_LAST FORMAT "%5.3" /end MEASUREMENT
/begin MEASUREMENT t_cha_max "maximal time for charging" UWORD _CNV_A_R_LINEAR_____208_CM 1 0. 0. 32.767 DISPLAY_IDENTIFIER T_CHA_MAX ECU_ADDRESS 0x7fa0ea BYTE_ORDER MSB_LAST FORMAT "%5.3" /end MEASUREMENT
/begin MEASUREMENT t_dcha_min "minimal time for discharging" UWORD _CNV_A_R_LINEAR_____208_CM 1 0. 0. 32.767 DISPLAY_IDENTIFIER T_DCHA_MIN ECU_ADDRESS 0x7fa0ec BYTE_ORDER MSB_LAST FORMAT "%5.3" /end MEASUREMENT
/begin MEASUREMENT t_dcha_max "maximal time for discharging" UWORD _CNV_A_R_LINEAR_____208_CM 1 0. 0. 32.767 DISPLAY_IDENTIFIER T_DCHA_MAX ECU_ADDRESS 0x7fa0ee BYTE_ORDER MSB_LAST FORMAT "%5.3" /end MEASUREMENT
/begin MEASUREMENT stk_max_piezo "maximal piezo stroke" UBYTE _CNV_A_R_LINEAR_____212_CM 1 0. 0. 51. DISPLAY_IDENTIFIER STK_MAX_PIEZO ECU_ADDRESS 0x7fb792 FORMAT "%3.1" /end MEASUREMENT
/begin MEASUREMENT t_step_pps "duration of one charge/discharge step of the CC powerstage" UWORD _CNV_A_R_LINEAR_____208_CM 1 0. 0. 32.767 DISPLAY_IDENTIFIER T_STEP_PPS ECU_ADDRESS 0x7fa0f0 BYTE_ORDER MSB_LAST FORMAT "%5.3" /end MEASUREMENT
/begin MEASUREMENT t_soi_dly "runtime delay for start of injection (time)" UWORD _CNV_A_R_LINEAR_____208_CM 1 0. 0. 32.767 DISPLAY_IDENTIFIER T_SOI_DLY ECU_ADDRESS 0x7fa0f2 BYTE_ORDER MSB_LAST FORMAT "%5.3" /end MEASUREMENT
/begin MEASUREMENT lv_doi_mod "chosen duration calculation method (0: \"classic\", 1: \"new\")" UBYTE _CNV_S_2_RANGE______11_CM 1 0. 0. 1. DISPLAY_IDENTIFIER LV_DOI_MOD ECU_ADDRESS 0x7fb798 /end MEASUREMENT
/begin MEASUREMENT step_sp_pps "set point for total number of charge steps (including steps for building up force of tightness only)" UBYTE _CNV_A_R_LINEAR_____0_CM 1 0. 1. 30. DISPLAY_IDENTIFIER STEP_SP_PPS ECU_ADDRESS 0x7fb793 FORMAT "%2.0" /end MEASUREMENT
/begin MEASUREMENT step_sp_iv_foc "set point for number of charge steps for building up force of tightness only" UBYTE _CNV_A_R_LINEAR_____0_CM 1 0. 0. 30. DISPLAY_IDENTIFIER STEP_SP_IV_FOC ECU_ADDRESS 0x7fb794 FORMAT "%2.0" /end MEASUREMENT
/begin MEASUREMENT ti_req_ti_min "injection time of the minimal injection time mode" UWORD _CNV_A_R_LINEAR_____208_CM 1 0. 0. 32.767 DISPLAY_IDENTIFIER TI_REQ_TI_MIN ECU_ADDRESS 0x7fa0f4 BYTE_ORDER MSB_LAST FORMAT "%5.3" /end MEASUREMENT
/begin MEASUREMENT t_hld_min_bas "base value for minimal hold time of any pulse" UWORD _CNV_A_R_LINEAR_____208_CM 1 0. 0. 32.767 DISPLAY_IDENTIFIER T_HLD_MIN_BAS ECU_ADDRESS 0x7fa0f6 BYTE_ORDER MSB_LAST FORMAT "%5.3" /end MEASUREMENT
/begin MEASUREMENT step_cha_min "minimal step number for charging" UBYTE _CNV_A_R_LINEAR_____0_CM 1 0. 0. 30. DISPLAY_IDENTIFIER STEP_CHA_MIN ECU_ADDRESS 0x7fb795 FORMAT "%2.0" /end MEASUREMENT
/begin MEASUREMENT step_dcha_min "minimal step number for discharging" UBYTE _CNV_A_R_LINEAR_____0_CM 1 0. 0. 30. DISPLAY_IDENTIFIER STEP_DCHA_MIN ECU_ADDRESS 0x7fb796 FORMAT "%2.0" /end MEASUREMENT
/begin MEASUREMENT ang_cam_st "start angle of active camshaft" SWORD _CNV_A_R_LINEAR_____121_CM 1 0. -120. 240. DISPLAY_IDENTIFIER ANG_CAM_ST ECU_ADDRESS 0x7fa0f8 BYTE_ORDER MSB_LAST FORMAT "%5.2" /end MEASUREMENT
/begin MEASUREMENT ang_cam_end "end angle of active camshaft" SWORD _CNV_A_R_LINEAR_____121_CM 1 0. -120. 240. DISPLAY_IDENTIFIER ANG_CAM_END ECU_ADDRESS 0x7fa0fa BYTE_ORDER MSB_LAST FORMAT "%5.2" /end MEASUREMENT
/begin MEASUREMENT ti_min "minimal time for durations of injections" UWORD _CNV_A_R_LINEAR_____208_CM 1 0. 0. 32.767 DISPLAY_IDENTIFIER TI_MIN ECU_ADDRESS 0x7fa0fc BYTE_ORDER MSB_LAST FORMAT "%5.3" /end MEASUREMENT
/begin MEASUREMENT lv_ip_on "button for choice of Level and T_HLD calculation method (0: \" by control\", 1: \"by map\")" UBYTE _CNV_S_2_RANGE______11_CM 1 0. 0. 1. DISPLAY_IDENTIFIER LV_IP_ON ECU_ADDRESS 0x7fb799 /end MEASUREMENT
/begin MEASUREMENT t_grp2sel_min "minimal time from end of group signal to selection signal" UWORD _CNV_A_R_LINEAR_____208_CM 1 0. 0. 32.767 DISPLAY_IDENTIFIER T_GRP2SEL_MIN ECU_ADDRESS 0x7fa0fe BYTE_ORDER MSB_LAST FORMAT "%5.3" /end MEASUREMENT
/begin MEASUREMENT t_cha_frze_min "minimal time for charging from zero" UWORD _CNV_A_R_LINEAR_____208_CM 1 0. 0. 32.767 DISPLAY_IDENTIFIER T_CHA_FRZE_MIN ECU_ADDRESS 0x7fa100 BYTE_ORDER MSB_LAST FORMAT "%5.3" /end MEASUREMENT
/begin MEASUREMENT t_cha_micro_step_min "minimal time for charging" UWORD _CNV_A_R_LINEAR_____208_CM 1 0. 0. 32.767 DISPLAY_IDENTIFIER T_CHA_MICRO_STEP_MIN ECU_ADDRESS 0x7fa102 BYTE_ORDER MSB_LAST FORMAT "%5.3" /end MEASUREMENT
/begin MEASUREMENT t_hld_pls_min "minimal time from end of charge to EOI" UWORD _CNV_A_R_LINEAR_____208_CM 1 0. 0. 32.767 DISPLAY_IDENTIFIER T_HLD_PLS_MIN ECU_ADDRESS 0x7fa104 BYTE_ORDER MSB_LAST FORMAT "%5.3" /end MEASUREMENT
/begin MEASUREMENT t_dist_pls2pls_min "minimal time from end of discharge PREV1 to charge MAIN1" UWORD _CNV_A_R_LINEAR_____208_CM 1 0. 0. 32.767 DISPLAY_IDENTIFIER T_DIST_PLS2PLS_MIN ECU_ADDRESS 0x7fa106 BYTE_ORDER MSB_LAST FORMAT "%5.3" /end MEASUREMENT
/begin MEASUREMENT t_eoi_trig_ofs "time from EOI Trigger to EOI" UWORD _CNV_A_R_LINEAR_____208_CM 1 0. 0. 32.767 DISPLAY_IDENTIFIER T_EOI_TRIG_OFS ECU_ADDRESS 0x7fa108 BYTE_ORDER MSB_LAST FORMAT "%5.3" /end MEASUREMENT
/begin MEASUREMENT lv_doi_min_mod "button for choice DOI_MIN calculation mode" UBYTE _CNV_S_2_RANGE______11_CM 1 0. 0. 1. DISPLAY_IDENTIFIER LV_DOI_MIN_MOD ECU_ADDRESS 0x7fb79a /end MEASUREMENT
/begin MEASUREMENT lv_micro_step_frze_mod "button for choice Pulse FRZE Limitation mode" UBYTE _CNV_S_2_RANGE______11_CM 1 0. 0. 1. DISPLAY_IDENTIFIER LV_MICRO_STEP_FRZE_MOD ECU_ADDRESS 0x7fb79b /end MEASUREMENT
/begin MEASUREMENT t_dist_main12post1_min "minimal time from end of discharge Main1 to charge Post1" UWORD _CNV_A_R_LINEAR_____208_CM 1 0. 0. 32.767 DISPLAY_IDENTIFIER T_DIST_MAIN12POST1_MIN ECU_ADDRESS 0x7fa10a BYTE_ORDER MSB_LAST FORMAT "%5.3" /end MEASUREMENT
/begin MEASUREMENT lv_micro_step_on "button for activation micro stepping (0: \"off\", 1: \"on\")" UBYTE _CNV_S_2_RANGE______11_CM 1 0. 0. 1. DISPLAY_IDENTIFIER LV_MICRO_STEP_ON ECU_ADDRESS 0x7fb79c /end MEASUREMENT
/begin CHARACTERISTIC c_t_cha2cha_min "minimal time from charge to charge" VALUE 0x8485f4 _REC_VAL_20_u2 32.767 _CNV_A_R_LINEAR_____208_CM 0. 32.767 DISPLAY_IDENTIFIER C_T_CHA2CHA_MIN FORMAT "%5.3" /end CHARACTERISTIC
/begin CHARACTERISTIC c_t_dcha2dcha_min "minimal time from discharge to discharge" VALUE 0x848610 _REC_VAL_20_u2 32.767 _CNV_A_R_LINEAR_____208_CM 0. 32.767 DISPLAY_IDENTIFIER C_T_DCHA2DCHA_MIN FORMAT "%5.3" /end CHARACTERISTIC
/begin CHARACTERISTIC c_t_cha2dcha_min "minimal time from charge to discharge" VALUE 0x8485f6 _REC_VAL_20_u2 32.767 _CNV_A_R_LINEAR_____208_CM 0. 32.767 DISPLAY_IDENTIFIER C_T_CHA2DCHA_MIN FORMAT "%5.3" /end CHARACTERISTIC
/begin CHARACTERISTIC c_t_dcha2cha_min "minimal time from discharge to charge" VALUE 0x84860e _REC_VAL_20_u2 32.767 _CNV_A_R_LINEAR_____208_CM 0. 32.767 DISPLAY_IDENTIFIER C_T_DCHA2CHA_MIN FORMAT "%5.3" /end CHARACTERISTIC
/begin CHARACTERISTIC c_t_dcha2newcha_min "minimal time from discharge to charge (with full discharge in between)" VALUE 0x848612 _REC_VAL_20_u2 32.767 _CNV_A_R_LINEAR_____208_CM 0. 32.767 DISPLAY_IDENTIFIER C_T_DCHA2NEWCHA_MIN FORMAT "%5.3" /end CHARACTERISTIC
/begin CHARACTERISTIC c_stk_max_piezo "maximal piezo stroke" VALUE 0x8485dc _REC_VAL_20_u1 50.8 _CNV_A_R_LINEAR_____212_CM 0.2 51. DISPLAY_IDENTIFIER C_STK_MAX_PIEZO FORMAT "%3.1" /end CHARACTERISTIC
/begin CHARACTERISTIC c_t_soi_dly "runtime delay for start of injection" VALUE 0x8486a8 _REC_VAL_20_u2 32.767 _CNV_A_R_LINEAR_____208_CM 0. 32.767 DISPLAY_IDENTIFIER C_T_SOI_DLY FORMAT "%5.3" /end CHARACTERISTIC
/begin CHARACTERISTIC lc_doi_mod "button for choice of duration calculation method (0: \"classic\", 1: \"new\")" VALUE 0x848799 _REC_VAL_20_u1 1. _CNV_A_R_LINEAR_____0_CM 0. 1. DISPLAY_IDENTIFIER LC_DOI_MOD FORMAT "%1.0" /end CHARACTERISTIC
/begin CHARACTERISTIC c_step_sp_pps "set point for total number of charge steps (including steps for building up force of tightness only)" VALUE 0x8485d8 _REC_VAL_20_u1 29. _CNV_A_R_LINEAR_____0_CM 1. 30. DISPLAY_IDENTIFIER C_STEP_SP_PPS FORMAT "%2.0" /end CHARACTERISTIC
/begin CHARACTERISTIC c_step_sp_iv_foc "set point for number of charge steps for building up force of tightness only" VALUE 0x8485d7 _REC_VAL_20_u1 30. _CNV_A_R_LINEAR_____0_CM 0. 30. DISPLAY_IDENTIFIER C_STEP_SP_IV_FOC FORMAT "%2.0" /end CHARACTERISTIC
/begin CHARACTERISTIC c_ti_req_ti_min "injection time of the minimal injection time mode" VALUE 0x8486ee _REC_VAL_20_u2 32.767 _CNV_A_R_LINEAR_____208_CM 0. 32.767 DISPLAY_IDENTIFIER C_TI_REQ_TI_MIN FORMAT "%5.3" /end CHARACTERISTIC
/begin CHARACTERISTIC c_t_hld_min_bas "base value for minimal hold time of any pulse" VALUE 0x848650 _REC_VAL_20_u2 32.767 _CNV_A_R_LINEAR_____208_CM 0. 32.767 DISPLAY_IDENTIFIER C_T_HLD_MIN_BAS FORMAT "%5.3" /end CHARACTERISTIC
/begin CHARACTERISTIC c_ang_cam_st "start angle of active camshaft" VALUE 0x8482fe _REC_VAL_20_s2 360. _CNV_A_R_LINEAR_____121_CM -120. 240. DISPLAY_IDENTIFIER C_ANG_CAM_ST FORMAT "%5.2" /end CHARACTERISTIC
/begin CHARACTERISTIC c_ang_cam_end "end angle of active camshaft" VALUE 0x8482fc _REC_VAL_20_s2 360. _CNV_A_R_LINEAR_____121_CM -120. 240. DISPLAY_IDENTIFIER C_ANG_CAM_END FORMAT "%5.2" /end CHARACTERISTIC
/begin CHARACTERISTIC c_ti_min "minimal time for durations of injections" VALUE 0x8486ec _REC_VAL_20_u2 32.767 _CNV_A_R_LINEAR_____208_CM 0. 32.767 DISPLAY_IDENTIFIER C_TI_MIN FORMAT "%5.3" /end CHARACTERISTIC
/begin CHARACTERISTIC lc_ip_on "button for choice of Level and T_HLD calculation method (0: \" by control\", 1: \"by map\")" VALUE 0x8487ae _REC_VAL_20_u1 1. _CNV_A_R_LINEAR_____0_CM 0. 1. DISPLAY_IDENTIFIER LC_IP_ON FORMAT "%1.0" /end CHARACTERISTIC
/begin CHARACTERISTIC c_t_grp2sel_min "minimal time from end of group signal to selection signal minimal time for charging from zero minimal time for charging minimal time from end of charge to EOI minimal time from end of discharge PREV1 to charge MAIN1 time from EOI Trigger to EOI button for" VALUE 0x848646 _REC_VAL_20_u2 32.767 _CNV_A_R_LINEAR_____208_CM 0. 32.767 DISPLAY_IDENTIFIER C_T_GRP2SEL_MIN FORMAT "%5.3" /end CHARACTERISTIC
/begin MEASUREMENT ti_max "maximal time for durations of injections" UWORD _CNV_A_R_LINEAR_____208_CM 1 0. 0. 32.767 DISPLAY_IDENTIFIER TI_MAX ECU_ADDRESS 0x7fa10c BYTE_ORDER MSB_LAST FORMAT "%5.3" /end MEASUREMENT
/begin MEASUREMENT doi_max "maximal duration of injections" UWORD _CNV_A_R_LINEAR_____121_CM 1 0. 0. 360. DISPLAY_IDENTIFIER DOI_MAX ECU_ADDRESS 0x7fa10e BYTE_ORDER MSB_LAST FORMAT "%5.2" /end MEASUREMENT
/begin MEASUREMENT doi_min "minimal duration of injections" UWORD _CNV_A_R_LINEAR_____121_CM 1 0. 0. 360. DISPLAY_IDENTIFIER DOI_MIN ECU_ADDRESS 0x7fa110 BYTE_ORDER MSB_LAST FORMAT "%5.2" /end MEASUREMENT
/begin MEASUREMENT soi_dly "runtime delay for start of injection (angle)" UWORD _CNV_A_R_LINEAR_____121_CM 1 0. 0. 360. DISPLAY_IDENTIFIER SOI_DLY ECU_ADDRESS 0x7fa112 BYTE_ORDER MSB_LAST FORMAT "%5.2" /end MEASUREMENT
/begin MEASUREMENT dur_dcha2newcyl_min "minimal duration from discharge to charge (with switching to another cylinder)" UWORD _CNV_A_R_LINEAR_____121_CM 1 0. 0. 360. DISPLAY_IDENTIFIER DUR_DCHA2NEWCYL_MIN ECU_ADDRESS 0x7fa114 BYTE_ORDER MSB_LAST FORMAT "%5.2" /end MEASUREMENT
/begin MEASUREMENT dur_pls_min "duration of a minimal pulse" UWORD _CNV_A_R_LINEAR_____121_CM 1 0. 0. 360. DISPLAY_IDENTIFIER DUR_PLS_MIN ECU_ADDRESS 0x7fa116 BYTE_ORDER MSB_LAST FORMAT "%5.2" /end MEASUREMENT
/begin MEASUREMENT dur_grp2sel_min "minimal duration from end of group signal to selection signal" UWORD _CNV_A_R_LINEAR_____121_CM 1 0. 0. 360. DISPLAY_IDENTIFIER DUR_GRP2SEL_MIN ECU_ADDRESS 0x7fa118 BYTE_ORDER MSB_LAST FORMAT "%5.2" /end MEASUREMENT
/begin MEASUREMENT t_hld_min "minimal hold time of any pulse" UWORD _CNV_A_R_LINEAR_____208_CM 1 0. 0. 32.767 DISPLAY_IDENTIFIER T_HLD_MIN ECU_ADDRESS 0x7fa11a BYTE_ORDER MSB_LAST FORMAT "%5.3" /end MEASUREMENT
/begin MEASUREMENT ofs_level_cor "correction offset for all levels" SBYTE _CNV_A_R_LINEAR_____213_CM 1 0. -50. 49.6094 DISPLAY_IDENTIFIER OFS_LEVEL_COR ECU_ADDRESS 0x7fb797 FORMAT "%3.1" /end MEASUREMENT
/begin MEASUREMENT dur_wout_frze_min "minimal duration without FROM ZERO Pulse" UWORD _CNV_A_R_LINEAR_____121_CM 1 0. 0. 360. DISPLAY_IDENTIFIER DUR_WOUT_FRZE_MIN ECU_ADDRESS 0x7fa11c BYTE_ORDER MSB_LAST FORMAT "%5.2" /end MEASUREMENT
/begin MEASUREMENT dur_with_frze_min "minimal duration with FROM ZERO Pulse" UWORD _CNV_A_R_LINEAR_____121_CM 1 0. 0. 360. DISPLAY_IDENTIFIER DUR_WITH_FRZE_MIN ECU_ADDRESS 0x7fa11e BYTE_ORDER MSB_LAST FORMAT "%5.2" /end MEASUREMENT
/begin CHARACTERISTIC c_ti_cold_max "upper time limit for durations of injections at cold start" VALUE 0x8486e8 _REC_VAL_20_u2 32.767 _CNV_A_R_LINEAR_____208_CM 0. 32.767 DISPLAY_IDENTIFIER C_TI_COLD_MAX FORMAT "%5.3" /end CHARACTERISTIC
/begin CHARACTERISTIC c_ti_max "maximal time for durations of injections" VALUE 0x8486ea _REC_VAL_20_u2 32.767 _CNV_A_R_LINEAR_____208_CM 0. 32.767 DISPLAY_IDENTIFIER C_TI_MAX FORMAT "%5.3" /end CHARACTERISTIC
/begin CHARACTERISTIC ip_fac_t_hld_min_inc__n "DPX00M01: correction factor for minimal hold time of any pulse" CURVE 0x846ca0 _REC_CUR_20_u2_u2 32.767 _CNV_A_R_LINEAR_____214_CM 0. 32.767 DISPLAY_IDENTIFIER IP_FAC_T_HLD_MIN_INC__N FORMAT "%5.3"
 /begin AXIS_DESCR COM_AXIS n _CNV_A_R_LINEAR_____5_CM 8 0. 6375. FORMAT "%4.0" AXIS_PTS_REF ldp_n_ip_fac_t_hld_min_inc /end AXIS_DESCR
/end CHARACTERISTIC
/begin AXIS_PTS ldp_n_ip_fac_t_hld_min_inc "" 0x844606 n _REC_AXS_20_u2 6375. _CNV_A_R_LINEAR_____5_CM 8 0. 6375. FORMAT "%4.0" /end AXIS_PTS
/begin CHARACTERISTIC ip_ofs_level_cor__tfu "DPX00M01: correction offset for all level values" CURVE 0x847368 _REC_CUR_20_u1_u1 99.60939999999999 _CNV_A_R_LINEAR_____215_CM -50. 49.6094 DISPLAY_IDENTIFIER IP_OFS_LEVEL_COR__TFU FORMAT "%3.1"
 /begin AXIS_DESCR COM_AXIS tfu _CNV_A_R_LINEAR_____18_CM 6 -50. 205. FORMAT "%3.0" AXIS_PTS_REF ldp_tfu_ip_ofs_level_cor /end AXIS_DESCR
/end CHARACTERISTIC
/begin AXIS_PTS ldp_tfu_ip_ofs_level_cor "" 0x8428db tfu _REC_AXS_20_u1 255. _CNV_A_R_LINEAR_____18_CM 6 -50. 205. FORMAT "%3.0" /end AXIS_PTS
/begin CHARACTERISTIC c_t_cha_frze_min "mminimal time for charging from zero" VALUE 0x8485fa _REC_VAL_20_u2 32.767 _CNV_A_R_LINEAR_____208_CM 0. 32.767 DISPLAY_IDENTIFIER C_T_CHA_FRZE_MIN FORMAT "%5.3" /end CHARACTERISTIC
/begin CHARACTERISTIC c_t_cha_micro_step_min "minimal time for charging" VALUE 0x848602 _REC_VAL_20_u2 32.767 _CNV_A_R_LINEAR_____208_CM 0. 32.767 DISPLAY_IDENTIFIER C_T_CHA_MICRO_STEP_MIN FORMAT "%5.3" /end CHARACTERISTIC
/begin CHARACTERISTIC c_t_hld_pls_min "minimal time from end of charge EOI" VALUE 0x848652 _REC_VAL_20_u2 32.767 _CNV_A_R_LINEAR_____208_CM 0. 32.767 DISPLAY_IDENTIFIER C_T_HLD_PLS_MIN FORMAT "%5.3" /end CHARACTERISTIC
/begin CHARACTERISTIC c_t_dist_pls2pls_min "minimal time from end of discharge PREV1 to charge MAIN1" VALUE 0x848624 _REC_VAL_20_u2 32.767 _CNV_A_R_LINEAR_____208_CM 0. 32.767 DISPLAY_IDENTIFIER C_T_DIST_PLS2PLS_MIN FORMAT "%5.3" /end CHARACTERISTIC
/begin CHARACTERISTIC c_t_eoi_trig_ofs "time from EOI Trigger to EOI" VALUE 0x84863e _REC_VAL_20_u2 32.767 _CNV_A_R_LINEAR_____208_CM 0. 32.767 DISPLAY_IDENTIFIER C_T_EOI_TRIG_OFS FORMAT "%5.3" /end CHARACTERISTIC
/begin CHARACTERISTIC c_t_dist_main12post1_min "minimal time from end of discharge MAIN1 to charge POST1" VALUE 0x848622 _REC_VAL_20_u2 32.767 _CNV_A_R_LINEAR_____208_CM 0. 32.767 DISPLAY_IDENTIFIER C_T_DIST_MAIN12POST1_MIN FORMAT "%5.3" /end CHARACTERISTIC
/begin CHARACTERISTIC lc_doi_min_mod "button for choice DOI_MIN calculation mode" VALUE 0x848798 _REC_VAL_20_u1 1. _CNV_A_R_LINEAR_____0_CM 0. 1. DISPLAY_IDENTIFIER LC_DOI_MIN_MOD FORMAT "%1.0" /end CHARACTERISTIC
/begin CHARACTERISTIC lc_micro_step_frze_mod "button for choice Pulse FRZE Limitation mode" VALUE 0x8487cb _REC_VAL_20_u1 1. _CNV_A_R_LINEAR_____0_CM 0. 1. DISPLAY_IDENTIFIER LC_MICRO_STEP_FRZE_MOD FORMAT "%1.0" /end CHARACTERISTIC
/begin CHARACTERISTIC lc_micro_step_on "button for activation micro stepping (0: off, 1: on)" VALUE 0x8487cc _REC_VAL_20_u1 1. _CNV_A_R_LINEAR_____0_CM 0. 1. DISPLAY_IDENTIFIER LC_MICRO_STEP_ON FORMAT "%1.0" /end CHARACTERISTIC
/begin CHARACTERISTIC c_fac1_egy_pps_stk "linear coefficient of the polynomial energy stroke dependency" VALUE 0x84842c _REC_VAL_20_u2 3.99993896484375 _CNV_A_R_LINEAR_____216_CM 0. 3.99993896484375 DISPLAY_IDENTIFIER C_FAC1_EGY_PPS_STK FORMAT "%6.5" /end CHARACTERISTIC
/begin CHARACTERISTIC c_fac2_egy_pps_stk "quadratic coefficient of the polynomial energy stroke dependency" VALUE 0x84842e _REC_VAL_20_u2 1.99996948242188 _CNV_A_R_LINEAR_____217_CM 0. 1.99996948242188 DISPLAY_IDENTIFIER C_FAC2_EGY_PPS_STK FORMAT "%6.5" /end CHARACTERISTIC
/begin CHARACTERISTIC ip_fac_prs_soi__mf__dur "DPX00T01: factor for a SOI value describing the effect of the preceding injection on the system pressure" MAP 0x846be6 _REC_MAP_20_u2_u2_u2 3.99993896484375 _CNV_A_R_LINEAR_____15_CM 0. 3.99993896484375 DISPLAY_IDENTIFIER IP_FAC_PRS_SOI__MF__DUR FORMAT "%6.5"
 /begin AXIS_DESCR COM_AXIS dummy_mf _CNV_A_R_LINEAR_____218_CM 6 0. 262.14 AXIS_PTS_REF ldp_mf_ip_fac_prs_soi /end AXIS_DESCR
 /begin AXIS_DESCR COM_AXIS dummy_doi _CNV_A_R_LINEAR_____121_CM 8 0. 360. FORMAT "%5.2" AXIS_PTS_REF ldp_dur_ip_fac_prs_soi /end AXIS_DESCR
/end CHARACTERISTIC
/begin AXIS_PTS ldp_mf_ip_fac_prs_soi "" 0x841870 dummy_mf _REC_AXS_20_u2 262.14 _CNV_A_R_LINEAR_____218_CM 6 0. 262.14 /end AXIS_PTS
/begin AXIS_PTS ldp_dur_ip_fac_prs_soi "" 0x841626 dummy_doi _REC_AXS_20_u2 360. _CNV_A_R_LINEAR_____121_CM 8 0. 360. FORMAT "%5.2" /end AXIS_PTS
/begin CHARACTERISTIC ip_fac_prs_doi__mf__dur "DPX00T01: factor for a DOI value describing the effect of the preceding injection on the system pressure" MAP 0x846b86 _REC_MAP_20_u2_u2_u2 3.99993896484375 _CNV_A_R_LINEAR_____15_CM 0. 3.99993896484375 DISPLAY_IDENTIFIER IP_FAC_PRS_DOI__MF__DUR FORMAT "%6.5"
 /begin AXIS_DESCR COM_AXIS dummy_mf _CNV_A_R_LINEAR_____218_CM 6 0. 262.14 AXIS_PTS_REF ldp_mf_ip_fac_prs_doi /end AXIS_DESCR
 /begin AXIS_DESCR COM_AXIS dummy_doi _CNV_A_R_LINEAR_____121_CM 8 0. 360. FORMAT "%5.2" AXIS_PTS_REF ldp_dur_ip_fac_prs_doi /end AXIS_DESCR
/end CHARACTERISTIC
/begin AXIS_PTS ldp_mf_ip_fac_prs_doi "" 0x841862 dummy_mf _REC_AXS_20_u2 262.14 _CNV_A_R_LINEAR_____218_CM 6 0. 262.14 /end AXIS_PTS
/begin AXIS_PTS ldp_dur_ip_fac_prs_doi "" 0x841614 dummy_doi _REC_AXS_20_u2 360. _CNV_A_R_LINEAR_____121_CM 8 0. 360. FORMAT "%5.2" /end AXIS_PTS
/begin CHARACTERISTIC ip_soi_dly__n__level "DPX00T01: delay angle for start of injection" MAP 0x847524 _REC_MAP_20_u2_u2_u1 360. _CNV_A_R_LINEAR_____120_CM -120. 240. DISPLAY_IDENTIFIER IP_SOI_DLY__N__LEVEL FORMAT "%5.2"
 /begin AXIS_DESCR COM_AXIS n _CNV_A_R_LINEAR_____5_CM 8 0. 6375. FORMAT "%4.0" AXIS_PTS_REF ldp_n_ip_soi_dly /end AXIS_DESCR
 /begin AXIS_DESCR COM_AXIS dummy_level _CNV_A_R_LINEAR_____209_CM 6 0. 99.609375 FORMAT "%3.1" AXIS_PTS_REF ldp_level_ip_soi_dly /end AXIS_DESCR
/end CHARACTERISTIC
/begin AXIS_PTS ldp_n_ip_soi_dly "" 0x841f48 n _REC_AXS_20_u2 6375. _CNV_A_R_LINEAR_____5_CM 8 0. 6375. FORMAT "%4.0" /end AXIS_PTS
/begin AXIS_PTS ldp_level_ip_soi_dly "" 0x841712 dummy_level _REC_AXS_20_u1 99.609375 _CNV_A_R_LINEAR_____209_CM 6 0. 99.609375 FORMAT "%3.1" /end AXIS_PTS
/begin AXIS_PTS ldpm_soi_ip_fac_doi "" 0x843e6c dummy_soi _REC_AXS_20_u2 360. _CNV_A_R_LINEAR_____120_CM 8 -120. 240. FORMAT "%5.2" /end AXIS_PTS
/begin CHARACTERISTIC ip_fac_doi__soi__tfu_delta "DPX00T01: factor for de-/increase the DOI depending on TFU" MAP 0x846a24 _REC_MAP_20_u2_u2_u2 3.99993896484375 _CNV_A_R_LINEAR_____15_CM 0. 3.99993896484375 DISPLAY_IDENTIFIER IP_FAC_DOI__SOI__TFU_DELTA FORMAT "%6.5"
 /begin AXIS_DESCR COM_AXIS dummy_soi _CNV_A_R_LINEAR_____120_CM 8 -120. 240. FORMAT "%5.2" AXIS_PTS_REF ldpm_soi_ip_fac_doi /end AXIS_DESCR
 /begin AXIS_DESCR COM_AXIS dummy_soi _CNV_A_R_LINEAR_____219_CM 8 -205. 205. FORMAT "%3.0" AXIS_PTS_REF ldp_tfu_delta_ip_fac_doi /end AXIS_DESCR
/end CHARACTERISTIC
/begin AXIS_PTS ldp_tfu_delta_ip_fac_doi "" 0x8428b8 dummy_soi _REC_AXS_20_u2 410. _CNV_A_R_LINEAR_____219_CM 8 -205. 205. FORMAT "%3.0" /end AXIS_PTS
/begin CHARACTERISTIC ip_fac_doi__soi__tco_delta "DPX00T01: factor for de-/increase the DOI depending on TCO" MAP 0x8469a4 _REC_MAP_20_u2_u2_u2 3.99993896484375 _CNV_A_R_LINEAR_____15_CM 0. 3.99993896484375 DISPLAY_IDENTIFIER IP_FAC_DOI__SOI__TCO_DELTA FORMAT "%6.5"
 /begin AXIS_DESCR COM_AXIS dummy_soi _CNV_A_R_LINEAR_____120_CM 8 -120. 240. FORMAT "%5.2" AXIS_PTS_REF ldpm_soi_ip_fac_doi /end AXIS_DESCR
 /begin AXIS_DESCR COM_AXIS dummy_doi _CNV_A_R_LINEAR_____219_CM 8 -205. 205. FORMAT "%3.0" AXIS_PTS_REF ldp_tco_delta_ip_fac_doi /end AXIS_DESCR
/end CHARACTERISTIC
/begin AXIS_PTS ldp_tco_delta_ip_fac_doi "" 0x84269a dummy_doi _REC_AXS_20_u2 410. _CNV_A_R_LINEAR_____219_CM 8 -205. 205. FORMAT "%3.0" /end AXIS_PTS
/begin MEASUREMENT soi_frze_prev1_pwr_on_tu "tuned power-on value of start of pulse FROM ZERO PREV1" SWORD _CNV_A_R_LINEAR_____121_CM 1 0. -120. 240. DISPLAY_IDENTIFIER SOI_FRZE_PREV1_PWR_ON_TU ECU_ADDRESS 0x7fa1a0 BYTE_ORDER MSB_LAST FORMAT "%5.2" /end MEASUREMENT
/begin MEASUREMENT t_cha_frze_prev1_tu "tuned value of charging time of pulse FROM ZERO PREV1" UBYTE _CNV_A_R_LINEAR_____220_CM 1 0. 0. 0.31 DISPLAY_IDENTIFIER T_CHA_FRZE_PREV1_TU ECU_ADDRESS 0x7fb7c3 FORMAT "%3.2" /end MEASUREMENT
/begin MEASUREMENT soi_prev1_pwr_on_tu "tuned power-on value of start of injection PREV1" SWORD _CNV_A_R_LINEAR_____121_CM 1 0. -120. 240. DISPLAY_IDENTIFIER SOI_PREV1_PWR_ON_TU ECU_ADDRESS 0x7fa1a2 BYTE_ORDER MSB_LAST FORMAT "%5.2" /end MEASUREMENT
/begin MEASUREMENT t_cha_prev1_tu "tuned value of charging time of injection PREV1" UBYTE _CNV_A_R_LINEAR_____220_CM 1 0. 0. 0.31 DISPLAY_IDENTIFIER T_CHA_PREV1_TU ECU_ADDRESS 0x7fb7c4 FORMAT "%3.2" /end MEASUREMENT
/begin MEASUREMENT eoi_prev1_pwr_on_tu "tuned power-on value of end of injection PREV1" SWORD _CNV_A_R_LINEAR_____121_CM 1 0. -120. 240. DISPLAY_IDENTIFIER EOI_PREV1_PWR_ON_TU ECU_ADDRESS 0x7fa1a4 BYTE_ORDER MSB_LAST FORMAT "%5.2" /end MEASUREMENT
/begin MEASUREMENT t_dcha_prev1_tu "tuned value of discharging time of injection PREV1" UBYTE _CNV_A_R_LINEAR_____220_CM 1 0. 0. 0.31 DISPLAY_IDENTIFIER T_DCHA_PREV1_TU ECU_ADDRESS 0x7fb7c5 FORMAT "%3.2" /end MEASUREMENT
/begin MEASUREMENT t_hld_toze_prev1_tu "tuned value of hold time of pulse TO ZERO PREV1" UWORD _CNV_A_R_LINEAR_____208_CM 1 0. 0. 32.767 DISPLAY_IDENTIFIER T_HLD_TOZE_PREV1_TU ECU_ADDRESS 0x7fa1a6 BYTE_ORDER MSB_LAST FORMAT "%5.3" /end MEASUREMENT
/begin MEASUREMENT t_dcha_toze_prev1_tu "tuned value of discharging time of pulse TO ZERO PREV1" UBYTE _CNV_A_R_LINEAR_____220_CM 1 0. 0. 0.31 DISPLAY_IDENTIFIER T_DCHA_TOZE_PREV1_TU ECU_ADDRESS 0x7fb7c6 FORMAT "%3.2" /end MEASUREMENT
/begin MEASUREMENT soi_frze_main1_pwr_on_tu "tuned power-on value of start of pulse FROM ZERO MAIN1" SWORD _CNV_A_R_LINEAR_____121_CM 1 0. -120. 240. DISPLAY_IDENTIFIER SOI_FRZE_MAIN1_PWR_ON_TU ECU_ADDRESS 0x7fa1a8 BYTE_ORDER MSB_LAST FORMAT "%5.2" /end MEASUREMENT
/begin MEASUREMENT t_cha_frze_main1_tu "tuned value of charging time of pulse FROM ZERO MAIN1" UBYTE _CNV_A_R_LINEAR_____220_CM 1 0. 0. 0.31 DISPLAY_IDENTIFIER T_CHA_FRZE_MAIN1_TU ECU_ADDRESS 0x7fb7c7 FORMAT "%3.2" /end MEASUREMENT
/begin MEASUREMENT soi_main1_pwr_on_tu "tuned power-on value of start of injection MAIN1" SWORD _CNV_A_R_LINEAR_____121_CM 1 0. -120. 240. DISPLAY_IDENTIFIER SOI_MAIN1_PWR_ON_TU ECU_ADDRESS 0x7fa1aa BYTE_ORDER MSB_LAST FORMAT "%5.2" /end MEASUREMENT
/begin MEASUREMENT t_cha_main1_tu "tuned value of charging time of injection MAIN1" UBYTE _CNV_A_R_LINEAR_____220_CM 1 0. 0. 0.31 DISPLAY_IDENTIFIER T_CHA_MAIN1_TU ECU_ADDRESS 0x7fb7c8 FORMAT "%3.2" /end MEASUREMENT
/begin MEASUREMENT eoi_main1_pwr_on_tu "tuned power-on value of end of injection MAIN1" SWORD _CNV_A_R_LINEAR_____121_CM 1 0. -120. 240. DISPLAY_IDENTIFIER EOI_MAIN1_PWR_ON_TU ECU_ADDRESS 0x7fa1ac BYTE_ORDER MSB_LAST FORMAT "%5.2" /end MEASUREMENT
/begin MEASUREMENT t_dcha_main1_tu "tuned value of discharging time of injection MAIN1" UBYTE _CNV_A_R_LINEAR_____220_CM 1 0. 0. 0.31 DISPLAY_IDENTIFIER T_DCHA_MAIN1_TU ECU_ADDRESS 0x7fb7c9 FORMAT "%3.2" /end MEASUREMENT
/begin MEASUREMENT t_hld_toze_main1_tu "tuned value of hold time of pulse TO ZERO MAIN1" UWORD _CNV_A_R_LINEAR_____208_CM 1 0. 0. 32.767 DISPLAY_IDENTIFIER T_HLD_TOZE_MAIN1_TU ECU_ADDRESS 0x7fa1ae BYTE_ORDER MSB_LAST FORMAT "%5.3" /end MEASUREMENT
/begin MEASUREMENT t_dcha_toze_main1_tu "tuned value of discharging time of pulse TO ZERO MAIN1" UBYTE _CNV_A_R_LINEAR_____220_CM 1 0. 0. 0.31 DISPLAY_IDENTIFIER T_DCHA_TOZE_MAIN1_TU ECU_ADDRESS 0x7fb7ca FORMAT "%3.2" /end MEASUREMENT
/begin MEASUREMENT soi_frze_post1_pwr_on_tu "tuned power-on value of start of pulse FROM ZERO POST1" SWORD _CNV_A_R_LINEAR_____121_CM 1 0. -120. 240. DISPLAY_IDENTIFIER SOI_FRZE_POST1_PWR_ON_TU ECU_ADDRESS 0x7fa1b0 BYTE_ORDER MSB_LAST FORMAT "%5.2" /end MEASUREMENT
/begin MEASUREMENT t_cha_frze_post1_tu "tuned value of charging time of pulse FROM ZERO POST1" UBYTE _CNV_A_R_LINEAR_____220_CM 1 0. 0. 0.31 DISPLAY_IDENTIFIER T_CHA_FRZE_POST1_TU ECU_ADDRESS 0x7fb7cb FORMAT "%3.2" /end MEASUREMENT
/begin MEASUREMENT soi_post1_pwr_on_tu "tuned power-on value of start of injection POST1" SWORD _CNV_A_R_LINEAR_____121_CM 1 0. -120. 240. DISPLAY_IDENTIFIER SOI_POST1_PWR_ON_TU ECU_ADDRESS 0x7fa1b2 BYTE_ORDER MSB_LAST FORMAT "%5.2" /end MEASUREMENT
/begin MEASUREMENT t_cha_post1_tu "tuned value of charging time of injection POST1" UBYTE _CNV_A_R_LINEAR_____220_CM 1 0. 0. 0.31 DISPLAY_IDENTIFIER T_CHA_POST1_TU ECU_ADDRESS 0x7fb7cc FORMAT "%3.2" /end MEASUREMENT
/begin MEASUREMENT eoi_post1_pwr_on_tu "tuned power-on value of end of injection POST1" SWORD _CNV_A_R_LINEAR_____121_CM 1 0. -120. 240. DISPLAY_IDENTIFIER EOI_POST1_PWR_ON_TU ECU_ADDRESS 0x7fa1b4 BYTE_ORDER MSB_LAST FORMAT "%5.2" /end MEASUREMENT
/begin MEASUREMENT t_dcha_post1_tu "tuned value of discharging time of injection POST1" UBYTE _CNV_A_R_LINEAR_____220_CM 1 0. 0. 0.31 DISPLAY_IDENTIFIER T_DCHA_POST1_TU ECU_ADDRESS 0x7fb7cd FORMAT "%3.2" /end MEASUREMENT
/begin MEASUREMENT t_hld_toze_post1_tu "tuned value of hold time of pulse TO ZERO POST1" UWORD _CNV_A_R_LINEAR_____208_CM 1 0. 0. 32.767 DISPLAY_IDENTIFIER T_HLD_TOZE_POST1_TU ECU_ADDRESS 0x7fa1b6 BYTE_ORDER MSB_LAST FORMAT "%5.3" /end MEASUREMENT
/begin MEASUREMENT t_dcha_toze_post1_tu "tuned value of discharging time of pulse TO ZERO POST1" UBYTE _CNV_A_R_LINEAR_____220_CM 1 0. 0. 0.31 DISPLAY_IDENTIFIER T_DCHA_TOZE_POST1_TU ECU_ADDRESS 0x7fb7ce FORMAT "%3.2" /end MEASUREMENT
/begin MEASUREMENT sf_inj_state_tu.word "" UWORD _CNV_S_9_CONV_INJ_S_221_CM 1 0. 0. 8. DISPLAY_IDENTIFIER SF_INJ_STATE_TU ECU_ADDRESS 0x7fa1b8 BYTE_ORDER MSB_LAST /end MEASUREMENT
/begin MEASUREMENT sf_inj_state_tu.bf.unused "" UWORD _CNV_A_R_LINEAR_____0_CM 1 0. 0. 65535. DISPLAY_IDENTIFIER SF_INJ_STATE_TU_BF_UNUSED ECU_ADDRESS 0x7fa1b8 BYTE_ORDER MSB_LAST BIT_MASK 0xFFC00000 /end MEASUREMENT
/begin MEASUREMENT sf_inj_state_tu.bf.lv_inj_di "" UWORD _CNV_A_R_LINEAR_____0_CM 1 0. 0. 65535. DISPLAY_IDENTIFIER SF_INJ_STATE_TU_BF_LV_INJ_DI ECU_ADDRESS 0x7fa1b8 BYTE_ORDER MSB_LAST BIT_MASK 0x200000 /end MEASUREMENT
/begin MEASUREMENT sf_inj_state_tu.bf.lv_post1_inj_act "" UWORD _CNV_A_R_LINEAR_____0_CM 1 0. 0. 65535. DISPLAY_IDENTIFIER SF_INJ_STATE_TU_BF_LV_POST1_INJ_ ECU_ADDRESS 0x7fa1b8 BYTE_ORDER MSB_LAST BIT_MASK 0x100000 /end MEASUREMENT
/begin MEASUREMENT sf_inj_state_tu.bf.lv_main2_inj_act "" UWORD _CNV_A_R_LINEAR_____0_CM 1 0. 0. 65535. DISPLAY_IDENTIFIER SF_INJ_STATE_TU_BF_LV_MAIN2_INJ_ ECU_ADDRESS 0x7fa1b8 BYTE_ORDER MSB_LAST BIT_MASK 0x80000 /end MEASUREMENT
/begin MEASUREMENT sf_inj_state_tu.bf.lv_main1_inj_act "" UWORD _CNV_A_R_LINEAR_____0_CM 1 0. 0. 65535. DISPLAY_IDENTIFIER SF_INJ_STATE_TU_BF_LV_MAIN1_INJ_ ECU_ADDRESS 0x7fa1b8 BYTE_ORDER MSB_LAST BIT_MASK 0x40000 /end MEASUREMENT
/begin MEASUREMENT sf_inj_state_tu.bf.lv_prev2_inj_act "" UWORD _CNV_A_R_LINEAR_____0_CM 1 0. 0. 65535. DISPLAY_IDENTIFIER SF_INJ_STATE_TU_BF_LV_PREV2_INJ_ ECU_ADDRESS 0x7fa1b8 BYTE_ORDER MSB_LAST BIT_MASK 0x20000 /end MEASUREMENT
/begin MEASUREMENT sf_inj_state_tu.bf.lv_prev1_inj_act "" UWORD _CNV_A_R_LINEAR_____0_CM 1 0. 0. 65535. DISPLAY_IDENTIFIER SF_INJ_STATE_TU_BF_LV_PREV1_INJ_ ECU_ADDRESS 0x7fa1b8 BYTE_ORDER MSB_LAST BIT_MASK 0x10000 /end MEASUREMENT
/begin MEASUREMENT sf_pls_state_tu "tuned value of pulse activation status word" UWORD _CNV_A_R_LINEAR_____0_CM 1 0. 0. 65535. DISPLAY_IDENTIFIER SF_PLS_STATE_TU ECU_ADDRESS 0x7fa1bc BYTE_ORDER MSB_LAST FORMAT "%5.0" /end MEASUREMENT
/begin MEASUREMENT sf_pls_state_tu_[0] "pulse state (tuned)" UWORD _CNV_A_R_LINEAR_____0_CM 1 0. 0. 65535. DISPLAY_IDENTIFIER SF_PLS_STATE_TU__0_ ECU_ADDRESS 0x7fa1be BYTE_ORDER MSB_LAST FORMAT "%5.0" /end MEASUREMENT
/begin MEASUREMENT sf_pls_state_tu_[1] "pulse state (tuned)" UWORD _CNV_A_R_LINEAR_____0_CM 1 0. 0. 65535. DISPLAY_IDENTIFIER SF_PLS_STATE_TU__1_ ECU_ADDRESS 0x7fa1c0 BYTE_ORDER MSB_LAST FORMAT "%5.0" /end MEASUREMENT
/begin MEASUREMENT sf_pls_state_tu_[2] "pulse state (tuned)" UWORD _CNV_A_R_LINEAR_____0_CM 1 0. 0. 65535. DISPLAY_IDENTIFIER SF_PLS_STATE_TU__2_ ECU_ADDRESS 0x7fa1c2 BYTE_ORDER MSB_LAST FORMAT "%5.0" /end MEASUREMENT
/begin MEASUREMENT sf_pls_state_tu_[3] "pulse state (tuned)" UWORD _CNV_A_R_LINEAR_____0_CM 1 0. 0. 65535. DISPLAY_IDENTIFIER SF_PLS_STATE_TU__3_ ECU_ADDRESS 0x7fa1c4 BYTE_ORDER MSB_LAST FORMAT "%5.0" /end MEASUREMENT
/begin MEASUREMENT nr_inj_seg_tu "tuned value of number of enabled injections" UBYTE _CNV_A_R_LINEAR_____0_CM 1 0. 0. 255. DISPLAY_IDENTIFIER NR_INJ_SEG_TU ECU_ADDRESS 0x7fb7cf FORMAT "%3.0" /end MEASUREMENT
/begin MEASUREMENT sf_inj_off_tu "tuned value of disabled injectors status word" UBYTE _CNV_A_R_LINEAR_____0_CM 1 0. 0. 255. DISPLAY_IDENTIFIER SF_INJ_OFF_TU ECU_ADDRESS 0x7fb7d0 FORMAT "%3.0" /end MEASUREMENT
/begin MEASUREMENT ti_prev1 "injection time of injection PREV1" UWORD _CNV_A_R_LINEAR_____208_CM 1 0. 0. 32.767 DISPLAY_IDENTIFIER TI_PREV1 ECU_ADDRESS 0x7fa1c6 BYTE_ORDER MSB_LAST FORMAT "%5.3" /end MEASUREMENT
/begin MEASUREMENT ti_main1 "injection time of injection MAIN1" UWORD _CNV_A_R_LINEAR_____208_CM 1 0. 0. 32.767 DISPLAY_IDENTIFIER TI_MAIN1 ECU_ADDRESS 0x7fa1c8 BYTE_ORDER MSB_LAST FORMAT "%5.3" /end MEASUREMENT
/begin MEASUREMENT ti_post1 "injection time of injection POST1" UWORD _CNV_A_R_LINEAR_____208_CM 1 0. 0. 32.767 DISPLAY_IDENTIFIER TI_POST1 ECU_ADDRESS 0x7fa1ca BYTE_ORDER MSB_LAST FORMAT "%5.3" /end MEASUREMENT
/begin MEASUREMENT ti_prev1_tu "tuned injection time of injection PREV1" UWORD _CNV_A_R_LINEAR_____208_CM 1 0. 0. 32.767 DISPLAY_IDENTIFIER TI_PREV1_TU ECU_ADDRESS 0x7fa1cc BYTE_ORDER MSB_LAST FORMAT "%5.3" /end MEASUREMENT
/begin MEASUREMENT ti_main1_tu "tuned injection time of injection MAIN1" UWORD _CNV_A_R_LINEAR_____208_CM 1 0. 0. 32.767 DISPLAY_IDENTIFIER TI_MAIN1_TU ECU_ADDRESS 0x7fa1ce BYTE_ORDER MSB_LAST FORMAT "%5.3" /end MEASUREMENT
/begin MEASUREMENT ti_post1_tu "tuned injection time of injection POST1" UWORD _CNV_A_R_LINEAR_____208_CM 1 0. 0. 32.767 DISPLAY_IDENTIFIER TI_POST1_TU ECU_ADDRESS 0x7fa1d0 BYTE_ORDER MSB_LAST FORMAT "%5.3" /end MEASUREMENT
/begin MEASUREMENT lv_t_cha_prev1_vld "charging time of injection PREV1 is long enough for a real injection" UBYTE _CNV_S_2_RANGE______11_CM 1 0. 0. 1. DISPLAY_IDENTIFIER LV_T_CHA_PREV1_VLD ECU_ADDRESS 0x7fb7d2 /end MEASUREMENT
/begin MEASUREMENT lv_t_cha_main1_vld "charging time of injection MAIN1 is long enough for a real injection" UBYTE _CNV_S_2_RANGE______11_CM 1 0. 0. 1. DISPLAY_IDENTIFIER LV_T_CHA_MAIN1_VLD ECU_ADDRESS 0x7fb7d3 /end MEASUREMENT
/begin MEASUREMENT lv_t_cha_post1_vld "charging time of injection POST1 is long enough for a real injection" UBYTE _CNV_S_2_RANGE______11_CM 1 0. 0. 1. DISPLAY_IDENTIFIER LV_T_CHA_POST1_VLD ECU_ADDRESS 0x7fb7d4 /end MEASUREMENT
/begin MEASUREMENT lv_t_cha_tot_vld "charging time of the first injection (PREV1 or MAIN1if available) is long enough for a real injection" UBYTE _CNV_S_2_RANGE______11_CM 1 0. 0. 1. DISPLAY_IDENTIFIER LV_T_CHA_TOT_VLD ECU_ADDRESS 0x7fb7d5 /end MEASUREMENT
/begin MEASUREMENT sf_t_cha_tot_vld_hys "LV_T_CHA_TOT_VLD smoothed using some kind of hysteresis (cylinder individual)" UWORD _CNV_A_R_LINEAR_____0_CM 1 0. 0. 65535. DISPLAY_IDENTIFIER SF_T_CHA_TOT_VLD_HYS ECU_ADDRESS 0x7fa1d2 BYTE_ORDER MSB_LAST FORMAT "%5.0" /end MEASUREMENT
/begin MEASUREMENT t_cha_seq1 "charging time of the first injection of sequence 1 (i.e. PREV1 or MAIN1)" UBYTE _CNV_A_R_LINEAR_____220_CM 1 0. 0. 0.31 DISPLAY_IDENTIFIER T_CHA_SEQ1 ECU_ADDRESS 0x7fb7d1 FORMAT "%3.2" /end MEASUREMENT
/begin MEASUREMENT doi_prev1_pwr_on_tu "tuned power-on value of duration of injection PREV1" UWORD _CNV_A_R_LINEAR_____121_CM 1 0. 0. 360. DISPLAY_IDENTIFIER DOI_PREV1_PWR_ON_TU ECU_ADDRESS 0x7fa1d4 BYTE_ORDER MSB_LAST FORMAT "%5.2" /end MEASUREMENT
/begin MEASUREMENT doi_main1_pwr_on_tu "tuned power-on value of duration of injection MAIN1" UWORD _CNV_A_R_LINEAR_____121_CM 1 0. 0. 360. DISPLAY_IDENTIFIER DOI_MAIN1_PWR_ON_TU ECU_ADDRESS 0x7fa1d6 BYTE_ORDER MSB_LAST FORMAT "%5.2" /end MEASUREMENT
/begin MEASUREMENT doi_post1_pwr_on_tu "tuned power-on value of duration of injection POST1" UWORD _CNV_A_R_LINEAR_____121_CM 1 0. 0. 360. DISPLAY_IDENTIFIER DOI_POST1_PWR_ON_TU ECU_ADDRESS 0x7fa1d8 BYTE_ORDER MSB_LAST FORMAT "%5.2" /end MEASUREMENT
/begin CHARACTERISTIC lc_tun_pui_man "button for setting manual values for all output variables of the injection timing" VALUE 0x8487e0 _REC_VAL_20_u1 1. _CNV_A_R_LINEAR_____0_CM 0. 1. DISPLAY_IDENTIFIER LC_TUN_PUI_MAN FORMAT "%1.0" /end CHARACTERISTIC
/begin CHARACTERISTIC c_soi_frze_prev1_man "manual value for start of pulse FROM ZERO PREV1" VALUE 0x8485c6 _REC_VAL_20_s2 360. _CNV_A_R_LINEAR_____121_CM -120. 240. DISPLAY_IDENTIFIER C_SOI_FRZE_PREV1_MAN FORMAT "%5.2" /end CHARACTERISTIC
/begin CHARACTERISTIC c_t_cha_frze_prev1_man "manual value for charge time of pulse FROM ZERO PREV1" VALUE 0x8485fe _REC_VAL_20_u2 32.767 _CNV_A_R_LINEAR_____208_CM 0. 32.767 DISPLAY_IDENTIFIER C_T_CHA_FRZE_PREV1_MAN FORMAT "%5.3" /end CHARACTERISTIC
/begin CHARACTERISTIC c_soi_prev1_man "manual value for start of injection PREV1" VALUE 0x8485cc _REC_VAL_20_s2 360. _CNV_A_R_LINEAR_____121_CM -120. 240. DISPLAY_IDENTIFIER C_SOI_PREV1_MAN FORMAT "%5.2" /end CHARACTERISTIC
/begin CHARACTERISTIC c_t_cha_prev1_man "manual value for charge time of injection PREV1" VALUE 0x848606 _REC_VAL_20_u2 32.767 _CNV_A_R_LINEAR_____208_CM 0. 32.767 DISPLAY_IDENTIFIER C_T_CHA_PREV1_MAN FORMAT "%5.3" /end CHARACTERISTIC
/begin CHARACTERISTIC c_eoi_prev1_man "manual value for end of injection PREV1" VALUE 0x848428 _REC_VAL_20_s2 360. _CNV_A_R_LINEAR_____121_CM -120. 240. DISPLAY_IDENTIFIER C_EOI_PREV1_MAN FORMAT "%5.2" /end CHARACTERISTIC
/begin CHARACTERISTIC c_t_dcha_prev1_man "manual value for discharge time of injection PREV1" VALUE 0x848618 _REC_VAL_20_u2 32.767 _CNV_A_R_LINEAR_____208_CM 0. 32.767 DISPLAY_IDENTIFIER C_T_DCHA_PREV1_MAN FORMAT "%5.3" /end CHARACTERISTIC
/begin CHARACTERISTIC c_t_hld_toze_prev1_man "manual value for hold time of pulse TO ZERO PREV1" VALUE 0x84865c _REC_VAL_20_u2 32.767 _CNV_A_R_LINEAR_____208_CM 0. 32.767 DISPLAY_IDENTIFIER C_T_HLD_TOZE_PREV1_MAN FORMAT "%5.3" /end CHARACTERISTIC
/begin CHARACTERISTIC c_t_dcha_toze_prev1_man "manual value for discharge time of pulse TO ZERO PREV1" VALUE 0x848620 _REC_VAL_20_u2 32.767 _CNV_A_R_LINEAR_____208_CM 0. 32.767 DISPLAY_IDENTIFIER C_T_DCHA_TOZE_PREV1_MAN FORMAT "%5.3" /end CHARACTERISTIC
/begin CHARACTERISTIC c_doi_prev1_man "manual value for duration o finjection of pulse PREV1" VALUE 0x8483d6 _REC_VAL_20_u2 360. _CNV_A_R_LINEAR_____121_CM 0. 360. DISPLAY_IDENTIFIER C_DOI_PREV1_MAN FORMAT "%5.2" /end CHARACTERISTIC
/begin CHARACTERISTIC c_soi_frze_main1_man "manual value for start of pulse FROM ZERO MAIN1" VALUE 0x8485c2 _REC_VAL_20_s2 360. _CNV_A_R_LINEAR_____121_CM -120. 240. DISPLAY_IDENTIFIER C_SOI_FRZE_MAIN1_MAN FORMAT "%5.2" /end CHARACTERISTIC
/begin CHARACTERISTIC c_t_cha_frze_main1_man "manual value for charge time of pulse FROM ZERO MAIN1" VALUE 0x8485f8 _REC_VAL_20_u2 32.767 _CNV_A_R_LINEAR_____208_CM 0. 32.767 DISPLAY_IDENTIFIER C_T_CHA_FRZE_MAIN1_MAN FORMAT "%5.3" /end CHARACTERISTIC
/begin CHARACTERISTIC c_soi_main1_man "manual value for start of injection MAIN1" VALUE 0x8485c8 _REC_VAL_20_s2 360. _CNV_A_R_LINEAR_____121_CM -120. 240. DISPLAY_IDENTIFIER C_SOI_MAIN1_MAN FORMAT "%5.2" /end CHARACTERISTIC
/begin CHARACTERISTIC c_t_cha_main1_man "manual value for charge time of injection MAIN1" VALUE 0x848600 _REC_VAL_20_u2 32.767 _CNV_A_R_LINEAR_____208_CM 0. 32.767 DISPLAY_IDENTIFIER C_T_CHA_MAIN1_MAN FORMAT "%5.3" /end CHARACTERISTIC
/begin CHARACTERISTIC c_eoi_main1_man "manual value for end of injection MAIN1" VALUE 0x848424 _REC_VAL_20_s2 360. _CNV_A_R_LINEAR_____121_CM -120. 240. DISPLAY_IDENTIFIER C_EOI_MAIN1_MAN FORMAT "%5.2" /end CHARACTERISTIC
/begin CHARACTERISTIC c_t_dcha_main1_man "manual value for discharge time of injection MAIN1" VALUE 0x848614 _REC_VAL_20_u2 32.767 _CNV_A_R_LINEAR_____208_CM 0. 32.767 DISPLAY_IDENTIFIER C_T_DCHA_MAIN1_MAN FORMAT "%5.3" /end CHARACTERISTIC
/begin CHARACTERISTIC c_t_hld_toze_main1_man "manual value for hold time of pulse TO ZERO MAIN1" VALUE 0x848654 _REC_VAL_20_u2 32.767 _CNV_A_R_LINEAR_____208_CM 0. 32.767 DISPLAY_IDENTIFIER C_T_HLD_TOZE_MAIN1_MAN FORMAT "%5.3" /end CHARACTERISTIC
/begin CHARACTERISTIC c_t_dcha_toze_main1_man "manual value for discharge time of pulse TO ZERO MAIN1" VALUE 0x84861c _REC_VAL_20_u2 32.767 _CNV_A_R_LINEAR_____208_CM 0. 32.767 DISPLAY_IDENTIFIER C_T_DCHA_TOZE_MAIN1_MAN FORMAT "%5.3" /end CHARACTERISTIC
/begin CHARACTERISTIC c_doi_main1_man "manual value for duration o finjection of pulse MAIN1" VALUE 0x8483c2 _REC_VAL_20_u2 360. _CNV_A_R_LINEAR_____121_CM 0. 360. DISPLAY_IDENTIFIER C_DOI_MAIN1_MAN FORMAT "%5.2" /end CHARACTERISTIC
/begin CHARACTERISTIC c_soi_frze_post1_man "manual value for start of pulse FROM ZERO POST1" VALUE 0x8485c4 _REC_VAL_20_s2 360. _CNV_A_R_LINEAR_____121_CM -120. 240. DISPLAY_IDENTIFIER C_SOI_FRZE_POST1_MAN FORMAT "%5.2" /end CHARACTERISTIC
/begin CHARACTERISTIC c_t_cha_frze_post1_man "manual value for charge time of pulse FROM ZERO POST1" VALUE 0x8485fc _REC_VAL_20_u2 32.767 _CNV_A_R_LINEAR_____208_CM 0. 32.767 DISPLAY_IDENTIFIER C_T_CHA_FRZE_POST1_MAN FORMAT "%5.3" /end CHARACTERISTIC
/begin CHARACTERISTIC c_soi_post1_man "manual value for start of injection POST1" VALUE 0x8485ca _REC_VAL_20_s2 360. _CNV_A_R_LINEAR_____121_CM -120. 240. DISPLAY_IDENTIFIER C_SOI_POST1_MAN FORMAT "%5.2" /end CHARACTERISTIC
/begin CHARACTERISTIC c_t_cha_post1_man "manual value for charge time of injection POST1" VALUE 0x848604 _REC_VAL_20_u2 32.767 _CNV_A_R_LINEAR_____208_CM 0. 32.767 DISPLAY_IDENTIFIER C_T_CHA_POST1_MAN FORMAT "%5.3" /end CHARACTERISTIC
/begin CHARACTERISTIC c_eoi_post1_man "manual value for end of injection POST1" VALUE 0x848426 _REC_VAL_20_s2 360. _CNV_A_R_LINEAR_____121_CM -120. 240. DISPLAY_IDENTIFIER C_EOI_POST1_MAN FORMAT "%5.2" /end CHARACTERISTIC
/begin CHARACTERISTIC c_t_dcha_post1_man "manual value for discharge time of injection POST1" VALUE 0x848616 _REC_VAL_20_u2 32.767 _CNV_A_R_LINEAR_____208_CM 0. 32.767 DISPLAY_IDENTIFIER C_T_DCHA_POST1_MAN FORMAT "%5.3" /end CHARACTERISTIC
/begin CHARACTERISTIC c_t_hld_toze_post1_man "manual value for hold time of pulse TO ZERO POST1" VALUE 0x848658 _REC_VAL_20_u2 32.767 _CNV_A_R_LINEAR_____208_CM 0. 32.767 DISPLAY_IDENTIFIER C_T_HLD_TOZE_POST1_MAN FORMAT "%5.3" /end CHARACTERISTIC
/begin CHARACTERISTIC c_t_dcha_toze_post1_man "manual value for discharge time of pulse TO ZERO POST1" VALUE 0x84861e _REC_VAL_20_u2 32.767 _CNV_A_R_LINEAR_____208_CM 0. 32.767 DISPLAY_IDENTIFIER C_T_DCHA_TOZE_POST1_MAN FORMAT "%5.3" /end CHARACTERISTIC
/begin CHARACTERISTIC c_doi_post1_man "manual value for duration o finjection of pulse POST1" VALUE 0x8483cc _REC_VAL_20_u2 360. _CNV_A_R_LINEAR_____121_CM 0. 360. DISPLAY_IDENTIFIER C_DOI_POST1_MAN FORMAT "%5.2" /end CHARACTERISTIC
/begin CHARACTERISTIC c_sf_pls_state_man "manual value for pulse activation status word" VALUE 0x8485c0 _REC_VAL_20_u2 65535. _CNV_A_R_LINEAR_____0_CM 0. 65535. DISPLAY_IDENTIFIER C_SF_PLS_STATE_MAN FORMAT "%5.0" /end CHARACTERISTIC
/begin CHARACTERISTIC c_t_cha_tot_min "minimal total charge time for an injection" VALUE 0x84860a _REC_VAL_20_u2 32.767 _CNV_A_R_LINEAR_____208_CM 0. 32.767 DISPLAY_IDENTIFIER C_T_CHA_TOT_MIN FORMAT "%5.3" /end CHARACTERISTIC
/begin CHARACTERISTIC c_ctr_t_cha_tot_vld_hys_on "switch on value of the hysteresis counter for LV_T_CHA_TOT_VLD" VALUE 0x848362 _REC_VAL_20_u1 255. _CNV_A_R_LINEAR_____0_CM 0. 255. DISPLAY_IDENTIFIER C_CTR_T_CHA_TOT_VLD_HYS_ON FORMAT "%3.0" /end CHARACTERISTIC
/begin MEASUREMENT lv_inj_ena_st "Release of injection during engine state start" UBYTE _CNV_S_2_RANGE______11_CM 1 0. 0. 1. DISPLAY_IDENTIFIER LV_INJ_ENA_ST ECU_ADDRESS 0x7fb7d9 /end MEASUREMENT
/begin MEASUREMENT mf_is_tar "Target fuel mass for transition from start to idle speed" UWORD _CNV_A_R_LINEAR_____43_CM 1 0. 0. 262.14 DISPLAY_IDENTIFIER MF_IS_TAR ECU_ADDRESS 0x7fa1dc BYTE_ORDER MSB_LAST /end MEASUREMENT
/begin MEASUREMENT ctr_tran_st_is "Segment counter for transition engine start to idle speed" UBYTE _CNV_A_R_LINEAR_____0_CM 1 0. 0. 255. DISPLAY_IDENTIFIER CTR_TRAN_ST_IS ECU_ADDRESS 0x7fb7d6 FORMAT "%3.0" /end MEASUREMENT
/begin MEASUREMENT sf_inj_off "" UBYTE _CNV_A_R_LINEAR_____0_CM 1 0. 0. 255. DISPLAY_IDENTIFIER SF_INJ_OFF ECU_ADDRESS 0x7fb7d8 FORMAT "%3.0" /end MEASUREMENT
/begin CHARACTERISTIC ip_mf_is_tar__tco "DPX00901: target fuel mass for transition from engine start to idle speed" CURVE 0x846d7c _REC_CUR_20_u2_u1 262.14 _CNV_A_R_LINEAR_____43_CM 0. 262.14 DISPLAY_IDENTIFIER IP_MF_IS_TAR__TCO
 /begin AXIS_DESCR COM_AXIS tco _CNV_A_R_LINEAR_____18_CM 8 -50. 205. FORMAT "%3.0" AXIS_PTS_REF ldp_tco_ip_mf_is_tar /end AXIS_DESCR
/end CHARACTERISTIC
/begin AXIS_PTS ldp_tco_ip_mf_is_tar "" 0x8427fd tco _REC_AXS_20_u1 255. _CNV_A_R_LINEAR_____18_CM 8 -50. 205. FORMAT "%3.0" /end AXIS_PTS
/begin CHARACTERISTIC ip_ctr_tran_st_is__tco "DPX00901: segment counter for transition from engine start to idle speed" CURVE 0x845854 _REC_CUR_20_u1_u1 255. _CNV_A_R_LINEAR_____0_CM 0. 255. DISPLAY_IDENTIFIER IP_CTR_TRAN_ST_IS__TCO FORMAT "%3.0"
 /begin AXIS_DESCR COM_AXIS tco _CNV_A_R_LINEAR_____18_CM 8 -50. 205. FORMAT "%3.0" AXIS_PTS_REF ldp_tco_ip_ctr_tran_st_is /end AXIS_DESCR
/end CHARACTERISTIC
/begin AXIS_PTS ldp_tco_ip_ctr_tran_st_is "" 0x8426ac tco _REC_AXS_20_u1 255. _CNV_A_R_LINEAR_____18_CM 8 -50. 205. FORMAT "%3.0" /end AXIS_PTS
/begin MEASUREMENT sf_inj_state.word "" UWORD _CNV_S_9_CONV_INJ_S_221_CM 1 0. 0. 8. DISPLAY_IDENTIFIER SF_INJ_STATE ECU_ADDRESS 0x7fa1e0 BYTE_ORDER MSB_LAST /end MEASUREMENT
/begin MEASUREMENT sf_inj_state.bf.unused "" UWORD _CNV_A_R_LINEAR_____0_CM 1 0. 0. 65535. DISPLAY_IDENTIFIER SF_INJ_STATE_BF_UNUSED ECU_ADDRESS 0x7fa1e0 BYTE_ORDER MSB_LAST BIT_MASK 0xFFC00000 /end MEASUREMENT
/begin MEASUREMENT sf_inj_state.bf.lv_inj_di "" UWORD _CNV_A_R_LINEAR_____0_CM 1 0. 0. 65535. DISPLAY_IDENTIFIER SF_INJ_STATE_BF_LV_INJ_DI ECU_ADDRESS 0x7fa1e0 BYTE_ORDER MSB_LAST BIT_MASK 0x200000 /end MEASUREMENT
/begin MEASUREMENT sf_inj_state.bf.lv_post1_inj_act "" UWORD _CNV_A_R_LINEAR_____0_CM 1 0. 0. 65535. DISPLAY_IDENTIFIER SF_INJ_STATE_BF_LV_POST1_INJ_ACT ECU_ADDRESS 0x7fa1e0 BYTE_ORDER MSB_LAST BIT_MASK 0x100000 /end MEASUREMENT
/begin MEASUREMENT sf_inj_state.bf.lv_main2_inj_act "" UWORD _CNV_A_R_LINEAR_____0_CM 1 0. 0. 65535. DISPLAY_IDENTIFIER SF_INJ_STATE_BF_LV_MAIN2_INJ_ACT ECU_ADDRESS 0x7fa1e0 BYTE_ORDER MSB_LAST BIT_MASK 0x80000 /end MEASUREMENT
/begin MEASUREMENT sf_inj_state.bf.lv_main1_inj_act "" UWORD _CNV_A_R_LINEAR_____0_CM 1 0. 0. 65535. DISPLAY_IDENTIFIER SF_INJ_STATE_BF_LV_MAIN1_INJ_ACT ECU_ADDRESS 0x7fa1e0 BYTE_ORDER MSB_LAST BIT_MASK 0x40000 /end MEASUREMENT
/begin MEASUREMENT sf_inj_state.bf.lv_prev2_inj_act "" UWORD _CNV_A_R_LINEAR_____0_CM 1 0. 0. 65535. DISPLAY_IDENTIFIER SF_INJ_STATE_BF_LV_PREV2_INJ_ACT ECU_ADDRESS 0x7fa1e0 BYTE_ORDER MSB_LAST BIT_MASK 0x20000 /end MEASUREMENT
/begin MEASUREMENT sf_inj_state.bf.lv_prev1_inj_act "" UWORD _CNV_A_R_LINEAR_____0_CM 1 0. 0. 65535. DISPLAY_IDENTIFIER SF_INJ_STATE_BF_LV_PREV1_INJ_ACT ECU_ADDRESS 0x7fa1e0 BYTE_ORDER MSB_LAST BIT_MASK 0x10000 /end MEASUREMENT
/begin MEASUREMENT sf_pls_state "pulse activation status word" UWORD _CNV_A_R_LINEAR_____0_CM 1 0. 0. 65535. DISPLAY_IDENTIFIER SF_PLS_STATE ECU_ADDRESS 0x7fa1e4 BYTE_ORDER MSB_LAST FORMAT "%5.0" /end MEASUREMENT
/begin MEASUREMENT iv_on "injections enabled status word" UWORD _CNV_A_R_LINEAR_____0_CM 1 0. 0. 65535. DISPLAY_IDENTIFIER IV_ON ECU_ADDRESS 0x7fa1e6 BYTE_ORDER MSB_LAST FORMAT "%5.0" /end MEASUREMENT
/begin MEASUREMENT nr_inj_seg "number of enabled injections" UBYTE _CNV_A_R_LINEAR_____0_CM 1 0. 0. 255. DISPLAY_IDENTIFIER NR_INJ_SEG ECU_ADDRESS 0x7fb7d7 FORMAT "%3.0" /end MEASUREMENT
/begin MEASUREMENT lv_inj_ena "flag indicating if the injection is globally enabled or not" UBYTE _CNV_S_2_RANGE______11_CM 1 0. 0. 1. DISPLAY_IDENTIFIER LV_INJ_ENA ECU_ADDRESS 0x7fb7da /end MEASUREMENT
/begin MEASUREMENT lv_inj_di "flag indicating if all injections are disabled or not" UBYTE _CNV_S_2_RANGE______11_CM 1 0. 0. 1. DISPLAY_IDENTIFIER LV_INJ_DI ECU_ADDRESS 0x7fb7db /end MEASUREMENT
/begin MEASUREMENT fac_doi_inc "factor to increase/decrease fuel mass at cold start" UWORD _CNV_A_R_LINEAR_____15_CM 1 0. 0. 3.99993896484375 DISPLAY_IDENTIFIER FAC_DOI_INC ECU_ADDRESS 0x7fa144 BYTE_ORDER MSB_LAST FORMAT "%6.5" /end MEASUREMENT
/begin MEASUREMENT lv_doi_inc_ena "fuel mass compensation for cold start active" UBYTE _CNV_S_2_RANGE______11_CM 1 0. 0. 1. DISPLAY_IDENTIFIER LV_DOI_INC_ENA ECU_ADDRESS 0x7fb7ab /end MEASUREMENT
/begin MEASUREMENT fac_doi_prev1_tfu "factor to increase/decrease DOI depending on TFU" UWORD _CNV_A_R_LINEAR_____15_CM 1 0. 0. 3.99993896484375 DISPLAY_IDENTIFIER FAC_DOI_PREV1_TFU ECU_ADDRESS 0x7fb056 BYTE_ORDER MSB_LAST FORMAT "%6.5" /end MEASUREMENT
/begin MEASUREMENT fac_doi_main1_tfu "factor to increase/decrease DOI depending on TFU" UWORD _CNV_A_R_LINEAR_____15_CM 1 0. 0. 3.99993896484375 DISPLAY_IDENTIFIER FAC_DOI_MAIN1_TFU ECU_ADDRESS 0x7fb058 BYTE_ORDER MSB_LAST FORMAT "%6.5" /end MEASUREMENT
/begin MEASUREMENT fac_doi_post1_tfu "factor to increase/decrease DOI depending on TFU" UWORD _CNV_A_R_LINEAR_____15_CM 1 0. 0. 3.99993896484375 DISPLAY_IDENTIFIER FAC_DOI_POST1_TFU ECU_ADDRESS 0x7fb05a BYTE_ORDER MSB_LAST FORMAT "%6.5" /end MEASUREMENT
/begin MEASUREMENT fac_doi_prev1 "factor to increase/decrease DOI depending on TFU and TCO" UWORD _CNV_A_R_LINEAR_____15_CM 1 0. 0. 3.99993896484375 DISPLAY_IDENTIFIER FAC_DOI_PREV1 ECU_ADDRESS 0x7fa146 BYTE_ORDER MSB_LAST FORMAT "%6.5" /end MEASUREMENT
/begin MEASUREMENT fac_doi_main1 "factor to increase/decrease DOI depending on TFU and TCO" UWORD _CNV_A_R_LINEAR_____15_CM 1 0. 0. 3.99993896484375 DISPLAY_IDENTIFIER FAC_DOI_MAIN1 ECU_ADDRESS 0x7fa148 BYTE_ORDER MSB_LAST FORMAT "%6.5" /end MEASUREMENT
/begin MEASUREMENT fac_doi_post1 "factor to increase/decrease DOI depending on TFU and TCO" UWORD _CNV_A_R_LINEAR_____15_CM 1 0. 0. 3.99993896484375 DISPLAY_IDENTIFIER FAC_DOI_POST1 ECU_ADDRESS 0x7fa14a BYTE_ORDER MSB_LAST FORMAT "%6.5" /end MEASUREMENT
/begin MEASUREMENT fac_doi_prev1_tco "factor to increase/decrease DOI depending on TCO" UWORD _CNV_A_R_LINEAR_____15_CM 1 0. 0. 3.99993896484375 DISPLAY_IDENTIFIER FAC_DOI_PREV1_TCO ECU_ADDRESS 0x7fb05c BYTE_ORDER MSB_LAST FORMAT "%6.5" /end MEASUREMENT
/begin MEASUREMENT fac_doi_main1_tco "factor to increase/decrease DOI depending on TCO" UWORD _CNV_A_R_LINEAR_____15_CM 1 0. 0. 3.99993896484375 DISPLAY_IDENTIFIER FAC_DOI_MAIN1_TCO ECU_ADDRESS 0x7fb05e BYTE_ORDER MSB_LAST FORMAT "%6.5" /end MEASUREMENT
/begin MEASUREMENT fac_doi_post1_tco "factor to increase/decrease DOI depending on TCO" UWORD _CNV_A_R_LINEAR_____15_CM 1 0. 0. 3.99993896484375 DISPLAY_IDENTIFIER FAC_DOI_POST1_TCO ECU_ADDRESS 0x7fb060 BYTE_ORDER MSB_LAST FORMAT "%6.5" /end MEASUREMENT
/begin CHARACTERISTIC c_tfu_max_doi_inc "maximal TFU for fuel mass compensation for cold start" VALUE 0x8486e4 _REC_VAL_20_u1 255. _CNV_A_R_LINEAR_____18_CM -50. 205. DISPLAY_IDENTIFIER C_TFU_MAX_DOI_INC FORMAT "%3.0" /end CHARACTERISTIC
/begin CHARACTERISTIC c_tfu_tco_dif_max_doi_inc "maximal difference between TFU and TCO for fuel mass compensation" VALUE 0x8486e5 _REC_VAL_20_u1 205. _CNV_A_R_LINEAR_____20_CM 0. 205. DISPLAY_IDENTIFIER C_TFU_TCO_DIF_MAX_DOI_INC FORMAT "%3.0" /end CHARACTERISTIC
/begin CHARACTERISTIC ip_dly_ctr_doi_inc__tfu "DPX00N01: number of strokes with fixed fuel mass compensation" CURVE 0x84585c _REC_CUR_20_u2_u1 65535. _CNV_A_R_LINEAR_____222_CM 0. 65535. DISPLAY_IDENTIFIER IP_DLY_CTR_DOI_INC__TFU FORMAT "%5.0"
 /begin AXIS_DESCR COM_AXIS tfu _CNV_A_R_LINEAR_____18_CM 6 -50. 205. FORMAT "%3.0" AXIS_PTS_REF ldpm_tfu_ip_doi_inc /end AXIS_DESCR
/end CHARACTERISTIC
/begin AXIS_PTS ldpm_tfu_ip_doi_inc "" 0x843ef1 tfu _REC_AXS_20_u1 255. _CNV_A_R_LINEAR_____18_CM 6 -50. 205. FORMAT "%3.0" /end AXIS_PTS
/begin CHARACTERISTIC ip_fac_doi_inc_ini__tfu "DPX00N01: fuel mass compensation factor for cold start" CURVE 0x846aa4 _REC_CUR_20_u1_u1 3.984375 _CNV_A_R_LINEAR_____98_CM 0. 3.984375 DISPLAY_IDENTIFIER IP_FAC_DOI_INC_INI__TFU FORMAT "%3.2"
 /begin AXIS_DESCR COM_AXIS tfu _CNV_A_R_LINEAR_____18_CM 6 -50. 205. FORMAT "%3.0" AXIS_PTS_REF ldpm_tfu_ip_doi_inc /end AXIS_DESCR
/end CHARACTERISTIC
/begin CHARACTERISTIC ip_slop_ctr_doi_inc__tfu "DPX00N01: increment/decrement value for fuel mass compensation at cold start" CURVE 0x847518 _REC_CUR_20_u2_u1 3.99993896484375 _CNV_A_R_LINEAR_____15_CM 0. 3.99993896484375 DISPLAY_IDENTIFIER IP_SLOP_CTR_DOI_INC__TFU FORMAT "%6.5"
 /begin AXIS_DESCR COM_AXIS tfu _CNV_A_R_LINEAR_____18_CM 6 -50. 205. FORMAT "%3.0" AXIS_PTS_REF ldpm_tfu_ip_doi_inc /end AXIS_DESCR
/end CHARACTERISTIC
/begin CHARACTERISTIC lc_doi_inc_rest_on "button for fuel mass compensation also at restart" VALUE 0x848796 _REC_VAL_20_u1 1. _CNV_A_R_LINEAR_____0_CM 0. 1. DISPLAY_IDENTIFIER LC_DOI_INC_REST_ON FORMAT "%1.0" /end CHARACTERISTIC
/begin CHARACTERISTIC lc_cold_start_cor_on "button for fuel mass compensation at start" VALUE 0x848792 _REC_VAL_20_u1 1. _CNV_A_R_LINEAR_____0_CM 0. 1. DISPLAY_IDENTIFIER LC_COLD_START_COR_ON FORMAT "%1.0" /end CHARACTERISTIC
/begin CHARACTERISTIC lc_temp_cor_on "button for DOI compensation depending on TCO and TFU" VALUE 0x8487dd _REC_VAL_20_u1 1. _CNV_A_R_LINEAR_____0_CM 0. 1. DISPLAY_IDENTIFIER LC_TEMP_COR_ON FORMAT "%1.0" /end CHARACTERISTIC
/begin CHARACTERISTIC c_tfu_tco_dif_max_doi_inj "maximal difference between TFU and TCO for start of TFU Correction Counter" VALUE 0x8486e6 _REC_VAL_20_u1 255. _CNV_A_R_LINEAR_____18_CM -50. 205. DISPLAY_IDENTIFIER C_TFU_TCO_DIF_MAX_DOI_INJ FORMAT "%3.0" /end CHARACTERISTIC
/begin CHARACTERISTIC c_tco_min_doi_inj "maximal TCO for start of TFU Correction Counter" VALUE 0x8486d4 _REC_VAL_20_u1 255. _CNV_A_R_LINEAR_____18_CM -50. 205. DISPLAY_IDENTIFIER C_TCO_MIN_DOI_INJ FORMAT "%3.0" /end CHARACTERISTIC
/begin CHARACTERISTIC c_nr_seg_tfu_cor "Number of Segments to approach TFU" VALUE 0x848526 _REC_VAL_20_u2 65535. _CNV_A_R_LINEAR_____0_CM 0. 65535. DISPLAY_IDENTIFIER C_NR_SEG_TFU_COR FORMAT "%5.0" /end CHARACTERISTIC
/begin CHARACTERISTIC ip_fac_temp_delta__ctr "DPX00N01: factor to transfer the corrected TFU value from TCO to TFU" CURVE 0x846cce _REC_CUR_20_u2_u2 0.9999847412109381 _CNV_A_R_LINEAR_____14_CM 0. 0.9999847412109381 DISPLAY_IDENTIFIER IP_FAC_TEMP_DELTA__CTR FORMAT "%6.5"
 /begin AXIS_DESCR COM_AXIS dummy_level _CNV_A_R_LINEAR_____14_CM 10 0. 0.9999847412109381 FORMAT "%6.5" AXIS_PTS_REF ldp_fac_ip_fac_temp_delta /end AXIS_DESCR
/end CHARACTERISTIC
/begin AXIS_PTS ldp_fac_ip_fac_temp_delta "" 0x84167c dummy_level _REC_AXS_20_u2 0.9999847412109381 _CNV_A_R_LINEAR_____14_CM 10 0. 0.9999847412109381 FORMAT "%6.5" /end AXIS_PTS
/begin CHARACTERISTIC ip_tfu_sp__n__mf "DPX00N01: Set point for Fuel Temperature" MAP 0x847d2e _REC_MAP_20_u1_u2_u2 255. _CNV_A_R_LINEAR_____18_CM -50. 205. DISPLAY_IDENTIFIER IP_TFU_SP__N__MF FORMAT "%3.0"
 /begin AXIS_DESCR COM_AXIS n _CNV_A_R_LINEAR_____5_CM 16 0. 6375. FORMAT "%4.0" AXIS_PTS_REF ldpm_n_ip_temp_sp /end AXIS_DESCR
 /begin AXIS_DESCR COM_AXIS mf_tot _CNV_A_R_LINEAR_____218_CM 16 0. 262.14 AXIS_PTS_REF ldpm_mf_ip_temp_sp /end AXIS_DESCR
/end CHARACTERISTIC
/begin AXIS_PTS ldpm_n_ip_temp_sp "" 0x843c78 n _REC_AXS_20_u2 6375. _CNV_A_R_LINEAR_____5_CM 16 0. 6375. FORMAT "%4.0" /end AXIS_PTS
/begin AXIS_PTS ldpm_mf_ip_temp_sp "" 0x843562 mf_tot _REC_AXS_20_u2 262.14 _CNV_A_R_LINEAR_____218_CM 16 0. 262.14 /end AXIS_PTS
/begin CHARACTERISTIC ip_tco_sp__n__mf "DPX00N01: Set point for cooling water Temperature" MAP 0x847af8 _REC_MAP_20_u2_u2_u2 360. _CNV_A_R_LINEAR_____121_CM 0. 360. DISPLAY_IDENTIFIER IP_TCO_SP__N__MF FORMAT "%5.2"
 /begin AXIS_DESCR COM_AXIS n _CNV_A_R_LINEAR_____5_CM 16 0. 6375. FORMAT "%4.0" AXIS_PTS_REF ldpm_n_ip_temp_sp /end AXIS_DESCR
 /begin AXIS_DESCR COM_AXIS mf_tot _CNV_A_R_LINEAR_____218_CM 16 0. 262.14 AXIS_PTS_REF ldpm_mf_ip_temp_sp /end AXIS_DESCR
/end CHARACTERISTIC
/begin MEASUREMENT mf_prev1_tu "" UWORD _CNV_A_R_LINEAR_____43_CM 1 0. 0. 262.14 DISPLAY_IDENTIFIER MF_PREV1_TU ECU_ADDRESS 0x7f9cbc BYTE_ORDER MSB_LAST FORMAT "%4.1" /end MEASUREMENT
/begin MEASUREMENT mf_prev2_tu "" UWORD _CNV_A_R_LINEAR_____43_CM 1 0. 0. 262.14 DISPLAY_IDENTIFIER MF_PREV2_TU ECU_ADDRESS 0x7f9cbe BYTE_ORDER MSB_LAST FORMAT "%4.1" /end MEASUREMENT
/begin MEASUREMENT mf_main1_tu "" UWORD _CNV_A_R_LINEAR_____43_CM 1 0. 0. 262.14 DISPLAY_IDENTIFIER MF_MAIN1_TU ECU_ADDRESS 0x7f9cc0 BYTE_ORDER MSB_LAST FORMAT "%4.1" /end MEASUREMENT
/begin MEASUREMENT mf_main2_tu "" UWORD _CNV_A_R_LINEAR_____43_CM 1 0. 0. 262.14 DISPLAY_IDENTIFIER MF_MAIN2_TU ECU_ADDRESS 0x7f9cc2 BYTE_ORDER MSB_LAST FORMAT "%4.1" /end MEASUREMENT
/begin MEASUREMENT mf_post1_tu "" UWORD _CNV_A_R_LINEAR_____43_CM 1 0. 0. 262.14 DISPLAY_IDENTIFIER MF_POST1_TU ECU_ADDRESS 0x7f9cc4 BYTE_ORDER MSB_LAST FORMAT "%4.1" /end MEASUREMENT
/begin MEASUREMENT mf_post2_tu "" UWORD _CNV_A_R_LINEAR_____43_CM 1 0. 0. 262.14 DISPLAY_IDENTIFIER MF_POST2_TU ECU_ADDRESS 0x7f9cc6 BYTE_ORDER MSB_LAST FORMAT "%4.1" /end MEASUREMENT
/begin MEASUREMENT mf_inj_sum "" UWORD _CNV_A_R_LINEAR_____43_CM 1 0. 0. 262.14 DISPLAY_IDENTIFIER MF_INJ_SUM ECU_ADDRESS 0x7f9cc8 BYTE_ORDER MSB_LAST FORMAT "%4.1" /end MEASUREMENT
/begin CHARACTERISTIC lc_mf_prev1_tu_on "" VALUE 0x85c349 _REC_VAL_20_u1 1. _CNV_A_R_LINEAR_____0_CM 0. 1. DISPLAY_IDENTIFIER LC_MF_PREV1_TU_ON FORMAT "%1.0" /end CHARACTERISTIC
/begin CHARACTERISTIC lc_mf_prev2_tu_on "" VALUE 0x85c34a _REC_VAL_20_u1 1. _CNV_A_R_LINEAR_____0_CM 0. 1. DISPLAY_IDENTIFIER LC_MF_PREV2_TU_ON FORMAT "%1.0" /end CHARACTERISTIC
/begin CHARACTERISTIC lc_mf_main1_tu_on "" VALUE 0x85c345 _REC_VAL_20_u1 1. _CNV_A_R_LINEAR_____0_CM 0. 1. DISPLAY_IDENTIFIER LC_MF_MAIN1_TU_ON FORMAT "%1.0" /end CHARACTERISTIC
/begin CHARACTERISTIC lc_mf_main2_tu_on "" VALUE 0x85c346 _REC_VAL_20_u1 1. _CNV_A_R_LINEAR_____0_CM 0. 1. DISPLAY_IDENTIFIER LC_MF_MAIN2_TU_ON FORMAT "%1.0" /end CHARACTERISTIC
/begin CHARACTERISTIC lc_mf_post2_tu_on "" VALUE 0x85c348 _REC_VAL_20_u1 1. _CNV_A_R_LINEAR_____0_CM 0. 1. DISPLAY_IDENTIFIER LC_MF_POST2_TU_ON FORMAT "%1.0" /end CHARACTERISTIC
/begin CHARACTERISTIC lc_mf_post1_tu_on "" VALUE 0x85c347 _REC_VAL_20_u1 1. _CNV_A_R_LINEAR_____0_CM 0. 1. DISPLAY_IDENTIFIER LC_MF_POST1_TU_ON FORMAT "%1.0" /end CHARACTERISTIC
/begin CHARACTERISTIC c_mf_main1_add_tu "" VALUE 0x848810 _REC_VAL_20_s2 262.14 _CNV_A_R_LINEAR_____43_CM -131.072 131.068 DISPLAY_IDENTIFIER C_MF_MAIN1_ADD_TU FORMAT "%6.2" /end CHARACTERISTIC
/begin CHARACTERISTIC c_mf_main2_add_tu "" VALUE 0x848812 _REC_VAL_20_s2 262.14 _CNV_A_R_LINEAR_____43_CM -131.072 131.068 DISPLAY_IDENTIFIER C_MF_MAIN2_ADD_TU FORMAT "%6.2" /end CHARACTERISTIC
/begin CHARACTERISTIC c_fac_mf_prev1_tu "Tuning PREV1" VALUE 0x848838 _REC_VAL_20_u2 1.9999696 _CNV_A_R_LINEAR_____53_CM 0. 1.9999696 DISPLAY_IDENTIFIER C_FAC_MF_PREV1_TU FORMAT "%5.4" /end CHARACTERISTIC
/begin CHARACTERISTIC c_fac_mf_prev2_tu "" VALUE 0x84885c _REC_VAL_20_u2 1.9999696 _CNV_A_R_LINEAR_____53_CM 0. 1.9999696 DISPLAY_IDENTIFIER C_FAC_MF_PREV2_TU FORMAT "%5.4" /end CHARACTERISTIC
/begin CHARACTERISTIC c_mf_post1_add_tu "" VALUE 0x848876 _REC_VAL_20_s2 262.14 _CNV_A_R_LINEAR_____43_CM -131.072 131.068 DISPLAY_IDENTIFIER C_MF_POST1_ADD_TU FORMAT "%6.2" /end CHARACTERISTIC
/begin CHARACTERISTIC c_mf_post2_add_tu "" VALUE 0x848862 _REC_VAL_20_s2 262.14 _CNV_A_R_LINEAR_____43_CM -131.072 131.068 DISPLAY_IDENTIFIER C_MF_POST2_ADD_TU FORMAT "%6.2" /end CHARACTERISTIC
/begin CHARACTERISTIC c_mf_main1_test_add_tu[0] "" VALUE 0x848814 _REC_VAL_20_s2 262.14 _CNV_A_R_LINEAR_____43_CM -131.072 131.068 DISPLAY_IDENTIFIER C_MF_MAIN1_TEST_ADD_TU_0_ FORMAT "%6.2" /end CHARACTERISTIC
/begin CHARACTERISTIC c_mf_main1_test_add_tu[1] "" VALUE 0x848816 _REC_VAL_20_s2 262.14 _CNV_A_R_LINEAR_____43_CM -131.072 131.068 DISPLAY_IDENTIFIER C_MF_MAIN1_TEST_ADD_TU_1_ FORMAT "%6.2" /end CHARACTERISTIC
/begin CHARACTERISTIC c_mf_main1_test_add_tu[2] "" VALUE 0x848818 _REC_VAL_20_s2 262.14 _CNV_A_R_LINEAR_____43_CM -131.072 131.068 DISPLAY_IDENTIFIER C_MF_MAIN1_TEST_ADD_TU_2_ FORMAT "%6.2" /end CHARACTERISTIC
/begin CHARACTERISTIC c_mf_main1_test_add_tu[3] "" VALUE 0x84881a _REC_VAL_20_s2 262.14 _CNV_A_R_LINEAR_____43_CM -131.072 131.068 DISPLAY_IDENTIFIER C_MF_MAIN1_TEST_ADD_TU_3_ FORMAT "%6.2" /end CHARACTERISTIC
/begin CHARACTERISTIC c_mf_main2_test_add_tu[0] "" VALUE 0x84881c _REC_VAL_20_s2 262.14 _CNV_A_R_LINEAR_____43_CM -131.072 131.068 DISPLAY_IDENTIFIER C_MF_MAIN2_TEST_ADD_TU_0_ FORMAT "%6.2" /end CHARACTERISTIC
/begin CHARACTERISTIC c_mf_main2_test_add_tu[1] "" VALUE 0x84881e _REC_VAL_20_s2 262.14 _CNV_A_R_LINEAR_____43_CM -131.072 131.068 DISPLAY_IDENTIFIER C_MF_MAIN2_TEST_ADD_TU_1_ FORMAT "%6.2" /end CHARACTERISTIC
/begin CHARACTERISTIC c_mf_main2_test_add_tu[2] "" VALUE 0x848820 _REC_VAL_20_s2 262.14 _CNV_A_R_LINEAR_____43_CM -131.072 131.068 DISPLAY_IDENTIFIER C_MF_MAIN2_TEST_ADD_TU_2_ FORMAT "%6.2" /end CHARACTERISTIC
/begin CHARACTERISTIC c_mf_main2_test_add_tu[3] "" VALUE 0x848822 _REC_VAL_20_s2 262.14 _CNV_A_R_LINEAR_____43_CM -131.072 131.068 DISPLAY_IDENTIFIER C_MF_MAIN2_TEST_ADD_TU_3_ FORMAT "%6.2" /end CHARACTERISTIC
/begin CHARACTERISTIC c_mf_prev1_test_add_tu[0] "" VALUE 0x848826 _REC_VAL_20_s2 262.14 _CNV_A_R_LINEAR_____43_CM -131.072 131.068 DISPLAY_IDENTIFIER C_MF_PREV1_TEST_ADD_TU_0_ FORMAT "%6.2" /end CHARACTERISTIC
/begin CHARACTERISTIC c_mf_prev1_test_add_tu[1] "" VALUE 0x848828 _REC_VAL_20_s2 262.14 _CNV_A_R_LINEAR_____43_CM -131.072 131.068 DISPLAY_IDENTIFIER C_MF_PREV1_TEST_ADD_TU_1_ FORMAT "%6.2" /end CHARACTERISTIC
/begin CHARACTERISTIC c_mf_prev1_test_add_tu[2] "" VALUE 0x84882a _REC_VAL_20_s2 262.14 _CNV_A_R_LINEAR_____43_CM -131.072 131.068 DISPLAY_IDENTIFIER C_MF_PREV1_TEST_ADD_TU_2_ FORMAT "%6.2" /end CHARACTERISTIC
/begin CHARACTERISTIC c_mf_prev1_test_add_tu[3] "" VALUE 0x84882c _REC_VAL_20_s2 262.14 _CNV_A_R_LINEAR_____43_CM -131.072 131.068 DISPLAY_IDENTIFIER C_MF_PREV1_TEST_ADD_TU_3_ FORMAT "%6.2" /end CHARACTERISTIC
/begin CHARACTERISTIC c_mf_prev2_test_add_tu[0] "" VALUE 0x848830 _REC_VAL_20_s2 262.14 _CNV_A_R_LINEAR_____43_CM -131.072 131.068 DISPLAY_IDENTIFIER C_MF_PREV2_TEST_ADD_TU_0_ FORMAT "%6.2" /end CHARACTERISTIC
/begin CHARACTERISTIC c_mf_prev2_test_add_tu[1] "" VALUE 0x848832 _REC_VAL_20_s2 262.14 _CNV_A_R_LINEAR_____43_CM -131.072 131.068 DISPLAY_IDENTIFIER C_MF_PREV2_TEST_ADD_TU_1_ FORMAT "%6.2" /end CHARACTERISTIC
/begin CHARACTERISTIC c_mf_prev2_test_add_tu[2] "" VALUE 0x848834 _REC_VAL_20_s2 262.14 _CNV_A_R_LINEAR_____43_CM -131.072 131.068 DISPLAY_IDENTIFIER C_MF_PREV2_TEST_ADD_TU_2_ FORMAT "%6.2" /end CHARACTERISTIC
/begin CHARACTERISTIC c_mf_prev2_test_add_tu[3] "" VALUE 0x848836 _REC_VAL_20_s2 262.14 _CNV_A_R_LINEAR_____43_CM -131.072 131.068 DISPLAY_IDENTIFIER C_MF_PREV2_TEST_ADD_TU_3_ FORMAT "%6.2" /end CHARACTERISTIC
/begin CHARACTERISTIC c_mf_post2_test_add_tu[0] "" VALUE 0x84886c _REC_VAL_20_s2 262.14 _CNV_A_R_LINEAR_____43_CM -131.072 131.068 DISPLAY_IDENTIFIER C_MF_POST2_TEST_ADD_TU_0_ FORMAT "%6.2" /end CHARACTERISTIC
/begin CHARACTERISTIC c_mf_post2_test_add_tu[1] "" VALUE 0x84886e _REC_VAL_20_s2 262.14 _CNV_A_R_LINEAR_____43_CM -131.072 131.068 DISPLAY_IDENTIFIER C_MF_POST2_TEST_ADD_TU_1_ FORMAT "%6.2" /end CHARACTERISTIC
/begin CHARACTERISTIC c_mf_post2_test_add_tu[2] "" VALUE 0x848870 _REC_VAL_20_s2 262.14 _CNV_A_R_LINEAR_____43_CM -131.072 131.068 DISPLAY_IDENTIFIER C_MF_POST2_TEST_ADD_TU_2_ FORMAT "%6.2" /end CHARACTERISTIC
/begin CHARACTERISTIC c_mf_post2_test_add_tu[3] "" VALUE 0x848872 _REC_VAL_20_s2 262.14 _CNV_A_R_LINEAR_____43_CM -131.072 131.068 DISPLAY_IDENTIFIER C_MF_POST2_TEST_ADD_TU_3_ FORMAT "%6.2" /end CHARACTERISTIC
/begin CHARACTERISTIC c_mf_post1_test_add_tu[0] "" VALUE 0x848878 _REC_VAL_20_s2 262.14 _CNV_A_R_LINEAR_____43_CM -131.072 131.068 DISPLAY_IDENTIFIER C_MF_POST1_TEST_ADD_TU_0_ FORMAT "%6.2" /end CHARACTERISTIC
/begin CHARACTERISTIC c_mf_post1_test_add_tu[1] "" VALUE 0x84887a _REC_VAL_20_s2 262.14 _CNV_A_R_LINEAR_____43_CM -131.072 131.068 DISPLAY_IDENTIFIER C_MF_POST1_TEST_ADD_TU_1_ FORMAT "%6.2" /end CHARACTERISTIC
/begin CHARACTERISTIC c_mf_post1_test_add_tu[2] "" VALUE 0x84887c _REC_VAL_20_s2 262.14 _CNV_A_R_LINEAR_____43_CM -131.072 131.068 DISPLAY_IDENTIFIER C_MF_POST1_TEST_ADD_TU_2_ FORMAT "%6.2" /end CHARACTERISTIC
/begin CHARACTERISTIC c_mf_post1_test_add_tu[3] "" VALUE 0x84887e _REC_VAL_20_s2 262.14 _CNV_A_R_LINEAR_____43_CM -131.072 131.068 DISPLAY_IDENTIFIER C_MF_POST1_TEST_ADD_TU_3_ FORMAT "%6.2" /end CHARACTERISTIC
/begin CHARACTERISTIC c_mf_main1_add_tu_cyl[0] "" VALUE 0x84883c _REC_VAL_20_s2 262.14 _CNV_A_R_LINEAR_____43_CM -131.072 131.068 DISPLAY_IDENTIFIER C_MF_MAIN1_ADD_TU_CYL_0_ FORMAT "%6.2" /end CHARACTERISTIC
/begin CHARACTERISTIC c_mf_main1_add_tu_cyl[1] "" VALUE 0x84883e _REC_VAL_20_s2 262.14 _CNV_A_R_LINEAR_____43_CM -131.072 131.068 DISPLAY_IDENTIFIER C_MF_MAIN1_ADD_TU_CYL_1_ FORMAT "%6.2" /end CHARACTERISTIC
/begin CHARACTERISTIC c_mf_main1_add_tu_cyl[2] "" VALUE 0x848840 _REC_VAL_20_s2 262.14 _CNV_A_R_LINEAR_____43_CM -131.072 131.068 DISPLAY_IDENTIFIER C_MF_MAIN1_ADD_TU_CYL_2_ FORMAT "%6.2" /end CHARACTERISTIC
/begin CHARACTERISTIC c_mf_main1_add_tu_cyl[3] "" VALUE 0x848842 _REC_VAL_20_s2 262.14 _CNV_A_R_LINEAR_____43_CM -131.072 131.068 DISPLAY_IDENTIFIER C_MF_MAIN1_ADD_TU_CYL_3_ FORMAT "%6.2" /end CHARACTERISTIC
/begin CHARACTERISTIC c_mf_main2_add_tu_cyl[0] "" VALUE 0x848844 _REC_VAL_20_s2 262.14 _CNV_A_R_LINEAR_____43_CM -131.072 131.068 DISPLAY_IDENTIFIER C_MF_MAIN2_ADD_TU_CYL_0_ FORMAT "%6.2" /end CHARACTERISTIC
/begin CHARACTERISTIC c_mf_main2_add_tu_cyl[1] "" VALUE 0x848846 _REC_VAL_20_s2 262.14 _CNV_A_R_LINEAR_____43_CM -131.072 131.068 DISPLAY_IDENTIFIER C_MF_MAIN2_ADD_TU_CYL_1_ FORMAT "%6.2" /end CHARACTERISTIC
/begin CHARACTERISTIC c_mf_main2_add_tu_cyl[2] "" VALUE 0x848848 _REC_VAL_20_s2 262.14 _CNV_A_R_LINEAR_____43_CM -131.072 131.068 DISPLAY_IDENTIFIER C_MF_MAIN2_ADD_TU_CYL_2_ FORMAT "%6.2" /end CHARACTERISTIC
/begin CHARACTERISTIC c_mf_main2_add_tu_cyl[3] "" VALUE 0x84884a _REC_VAL_20_s2 262.14 _CNV_A_R_LINEAR_____43_CM -131.072 131.068 DISPLAY_IDENTIFIER C_MF_MAIN2_ADD_TU_CYL_3_ FORMAT "%6.2" /end CHARACTERISTIC
/begin CHARACTERISTIC c_mf_prev1_add_tu_cyl[0] "" VALUE 0x84884c _REC_VAL_20_s2 262.14 _CNV_A_R_LINEAR_____43_CM -131.072 131.068 DISPLAY_IDENTIFIER C_MF_PREV1_ADD_TU_CYL_0_ FORMAT "%6.2" /end CHARACTERISTIC
/begin CHARACTERISTIC c_mf_prev1_add_tu_cyl[1] "" VALUE 0x84884e _REC_VAL_20_s2 262.14 _CNV_A_R_LINEAR_____43_CM -131.072 131.068 DISPLAY_IDENTIFIER C_MF_PREV1_ADD_TU_CYL_1_ FORMAT "%6.2" /end CHARACTERISTIC
/begin CHARACTERISTIC c_mf_prev1_add_tu_cyl[2] "" VALUE 0x848850 _REC_VAL_20_s2 262.14 _CNV_A_R_LINEAR_____43_CM -131.072 131.068 DISPLAY_IDENTIFIER C_MF_PREV1_ADD_TU_CYL_2_ FORMAT "%6.2" /end CHARACTERISTIC
/begin CHARACTERISTIC c_mf_prev1_add_tu_cyl[3] "" VALUE 0x848852 _REC_VAL_20_s2 262.14 _CNV_A_R_LINEAR_____43_CM -131.072 131.068 DISPLAY_IDENTIFIER C_MF_PREV1_ADD_TU_CYL_3_ FORMAT "%6.2" /end CHARACTERISTIC
/begin CHARACTERISTIC c_mf_prev2_add_tu_cyl[0] "" VALUE 0x848854 _REC_VAL_20_s2 262.14 _CNV_A_R_LINEAR_____43_CM -131.072 131.068 DISPLAY_IDENTIFIER C_MF_PREV2_ADD_TU_CYL_0_ FORMAT "%6.2" /end CHARACTERISTIC
/begin CHARACTERISTIC c_mf_prev2_add_tu_cyl[1] "" VALUE 0x848856 _REC_VAL_20_s2 262.14 _CNV_A_R_LINEAR_____43_CM -131.072 131.068 DISPLAY_IDENTIFIER C_MF_PREV2_ADD_TU_CYL_1_ FORMAT "%6.2" /end CHARACTERISTIC
/begin CHARACTERISTIC c_mf_prev2_add_tu_cyl[2] "" VALUE 0x848858 _REC_VAL_20_s2 262.14 _CNV_A_R_LINEAR_____43_CM -131.072 131.068 DISPLAY_IDENTIFIER C_MF_PREV2_ADD_TU_CYL_2_ FORMAT "%6.2" /end CHARACTERISTIC
/begin CHARACTERISTIC c_mf_prev2_add_tu_cyl[3] "" VALUE 0x84885a _REC_VAL_20_s2 262.14 _CNV_A_R_LINEAR_____43_CM -131.072 131.068 DISPLAY_IDENTIFIER C_MF_PREV2_ADD_TU_CYL_3_ FORMAT "%6.2" /end CHARACTERISTIC
/begin CHARACTERISTIC c_mf_post1_add_tu_cyl[0] "" VALUE 0x848888 _REC_VAL_20_s2 262.14 _CNV_A_R_LINEAR_____43_CM -131.072 131.068 DISPLAY_IDENTIFIER C_MF_POST1_ADD_TU_CYL_0_ FORMAT "%6.2" /end CHARACTERISTIC
/begin CHARACTERISTIC c_mf_post1_add_tu_cyl[1] "" VALUE 0x84888a _REC_VAL_20_s2 262.14 _CNV_A_R_LINEAR_____43_CM -131.072 131.068 DISPLAY_IDENTIFIER C_MF_POST1_ADD_TU_CYL_1_ FORMAT "%6.2" /end CHARACTERISTIC
/begin CHARACTERISTIC c_mf_post1_add_tu_cyl[2] "" VALUE 0x84888c _REC_VAL_20_s2 262.14 _CNV_A_R_LINEAR_____43_CM -131.072 131.068 DISPLAY_IDENTIFIER C_MF_POST1_ADD_TU_CYL_2_ FORMAT "%6.2" /end CHARACTERISTIC
/begin CHARACTERISTIC c_mf_post1_add_tu_cyl[3] "" VALUE 0x84888e _REC_VAL_20_s2 262.14 _CNV_A_R_LINEAR_____43_CM -131.072 131.068 DISPLAY_IDENTIFIER C_MF_POST1_ADD_TU_CYL_3_ FORMAT "%6.2" /end CHARACTERISTIC
/begin CHARACTERISTIC c_mf_post2_add_tu_cyl[0] "" VALUE 0x848864 _REC_VAL_20_s2 262.14 _CNV_A_R_LINEAR_____43_CM -131.072 131.068 DISPLAY_IDENTIFIER C_MF_POST2_ADD_TU_CYL_0_ FORMAT "%6.2" /end CHARACTERISTIC
/begin CHARACTERISTIC c_mf_post2_add_tu_cyl[1] "" VALUE 0x848866 _REC_VAL_20_s2 262.14 _CNV_A_R_LINEAR_____43_CM -131.072 131.068 DISPLAY_IDENTIFIER C_MF_POST2_ADD_TU_CYL_1_ FORMAT "%6.2" /end CHARACTERISTIC
/begin CHARACTERISTIC c_mf_post2_add_tu_cyl[2] "" VALUE 0x848868 _REC_VAL_20_s2 262.14 _CNV_A_R_LINEAR_____43_CM -131.072 131.068 DISPLAY_IDENTIFIER C_MF_POST2_ADD_TU_CYL_2_ FORMAT "%6.2" /end CHARACTERISTIC
/begin CHARACTERISTIC c_mf_post2_add_tu_cyl[3] "" VALUE 0x84886a _REC_VAL_20_s2 262.14 _CNV_A_R_LINEAR_____43_CM -131.072 131.068 DISPLAY_IDENTIFIER C_MF_POST2_ADD_TU_CYL_3_ FORMAT "%6.2" /end CHARACTERISTIC
/begin CHARACTERISTIC c_fac_mf_main1_tu "" VALUE 0x84883a _REC_VAL_20_u2 1.9999696 _CNV_A_R_LINEAR_____53_CM 0. 1.9999696 DISPLAY_IDENTIFIER C_FAC_MF_MAIN1_TU FORMAT "%5.4" /end CHARACTERISTIC
/begin CHARACTERISTIC c_fac_mf_main2_tu "" VALUE 0x84885e _REC_VAL_20_u2 1.9999696 _CNV_A_R_LINEAR_____53_CM 0. 1.9999696 DISPLAY_IDENTIFIER C_FAC_MF_MAIN2_TU FORMAT "%5.4" /end CHARACTERISTIC
/begin CHARACTERISTIC c_fac_mf_post1_tu "" VALUE 0x848874 _REC_VAL_20_u2 1.9999696 _CNV_A_R_LINEAR_____53_CM 0. 1.9999696 DISPLAY_IDENTIFIER C_FAC_MF_POST1_TU FORMAT "%5.4" /end CHARACTERISTIC
/begin CHARACTERISTIC c_fac_mf_post2_tu "" VALUE 0x848860 _REC_VAL_20_u2 1.9999696 _CNV_A_R_LINEAR_____53_CM 0. 1.9999696 DISPLAY_IDENTIFIER C_FAC_MF_POST2_TU FORMAT "%5.4" /end CHARACTERISTIC
/begin CHARACTERISTIC ip_mf_main1_inj_test_ad "MF: Fuel Mass Tuning" MAP 0x85307e _REC_MAP_20_u2_u2_u2 262.14 _CNV_A_R_LINEAR_____133_CM -131.072 131.068 DISPLAY_IDENTIFIER IP_MF_MAIN1_INJ_TEST_AD FORMAT "%5.3"
 /begin AXIS_DESCR COM_AXIS n _CNV_A_R_LINEAR_____5_CM 16 0. 6375. FORMAT "%4.0" AXIS_PTS_REF ldp_n_ip_mf_main1_inj_test_ad /end AXIS_DESCR
 /begin AXIS_DESCR COM_AXIS tqi_sp _CNV_A_R_LINEAR_____340_CM 16 -1024. 1023.97 FORMAT "%7.2" AXIS_PTS_REF ldp_tqi_sp_ip_mf_main1_inj_test_ad /end AXIS_DESCR
/end CHARACTERISTIC
/begin AXIS_PTS ldp_n_ip_mf_main1_inj_test_ad "" 0x841d80 n _REC_AXS_20_u2 6375. _CNV_A_R_LINEAR_____5_CM 16 0. 6375. FORMAT "%4.0" /end AXIS_PTS
/begin AXIS_PTS ldp_tqi_sp_ip_mf_main1_inj_test_ad "" 0x842f34 tqi_sp _REC_AXS_20_u2 2047.97 _CNV_A_R_LINEAR_____340_CM 16 -1024. 1023.97 FORMAT "%7.2" /end AXIS_PTS
/begin MEASUREMENT lv_fast_inj_upd "the fast update is tried" UBYTE _CNV_S_2_RANGE______11_CM 1 0. 0. 1. DISPLAY_IDENTIFIER LV_FAST_INJ_UPD ECU_ADDRESS 0x7fb7b7 /end MEASUREMENT
/begin MEASUREMENT lv_fast_upd_miss "the fast update failed" UBYTE _CNV_S_2_RANGE______11_CM 1 0. 0. 1. DISPLAY_IDENTIFIER LV_FAST_UPD_MISS ECU_ADDRESS 0x7fbb7c /end MEASUREMENT
/begin CHARACTERISTIC c_n_max_fast_inj_upd "maximal engine speed where an fast update is attempted" VALUE 0x85bfa2 _REC_VAL_20_u2 3500. _CNV_A_R_LINEAR_____5_CM 0. 3500. DISPLAY_IDENTIFIER C_N_MAX_FAST_INJ_UPD FORMAT "%4.0" /end CHARACTERISTIC
/begin CHARACTERISTIC lc_fast_inj_upd_cdn_ovs "Fast update is deactivated in part load (default is one)" VALUE 0x85c325 _REC_VAL_20_u1 1. _CNV_A_R_LINEAR_____0_CM 0. 1. DISPLAY_IDENTIFIER LC_FAST_INJ_UPD_CDN_OVS FORMAT "%1.0" /end CHARACTERISTIC
/begin MEASUREMENT lv_tqi_slm_bol_plaus "Blue smoke limitation enable" UBYTE _CNV_S_2_RANGE______11_CM 1 0. 0. 1. DISPLAY_IDENTIFIER LV_TQI_SLM_BOL_PLAUS ECU_ADDRESS 0x7fb643 /end MEASUREMENT
/begin MEASUREMENT tqi_slm_bol "Indicated torque for blue smoke limitation" SWORD _CNV_A_R_LINEAR_____62_CM 1 0. -1024. 1023.96875 DISPLAY_IDENTIFIER TQI_SLM_BOL ECU_ADDRESS 0x7f9c38 BYTE_ORDER MSB_LAST FORMAT "%6.2" /end MEASUREMENT
/begin CHARACTERISTIC c_dri_tqi_bol "Lower gear threshold" VALUE 0x85bdd3 _REC_VAL_20_u1 15. _CNV_A_R_LINEAR_____0_CM 0. 15. DISPLAY_IDENTIFIER C_DRI_TQI_BOL FORMAT "%2.0" /end CHARACTERISTIC
/begin CHARACTERISTIC c_lgrd_tqi_dec_tq_bol "Decrement limitation for the TQI_SLM_BOL transition" VALUE 0x85beb0 _REC_VAL_20_u2 1023.96875 _CNV_A_R_LINEAR_____62_CM 0. 1023.96875 DISPLAY_IDENTIFIER C_LGRD_TQI_DEC_TQ_BOL FORMAT "%6.2" /end CHARACTERISTIC
/begin CHARACTERISTIC c_lgrd_tqi_inc_tq_bol "Increment limitation for the TQI_SLM_BOL transition" VALUE 0x85beb2 _REC_VAL_20_u2 1023.96875 _CNV_A_R_LINEAR_____62_CM 0. 1023.96875 DISPLAY_IDENTIFIER C_LGRD_TQI_INC_TQ_BOL FORMAT "%6.2" /end CHARACTERISTIC
/begin CHARACTERISTIC ip_tqi_bol_amp_tco "MFBOL: minimum indicated torque to avoid blue smoke" MAP 0x85b536 _REC_MAP_20_u2_u1_u2 2047.96875 _CNV_A_R_LINEAR_____89_CM -1024. 1023.96875 DISPLAY_IDENTIFIER IP_TQI_BOL_AMP_TCO FORMAT "%6.2"
 /begin AXIS_DESCR COM_AXIS tco _CNV_A_R_LINEAR_____18_CM 6 -50. 205. FORMAT "%3.0" AXIS_PTS_REF ldpm_tco_ip_mf /end AXIS_DESCR
 /begin AXIS_DESCR COM_AXIS amp _CNV_A_R_LINEAR_____21_CM 6 0. 5434. FORMAT "%6.2" AXIS_PTS_REF ldp_amp_ip_mf /end AXIS_DESCR
/end CHARACTERISTIC
/begin AXIS_PTS ldpm_tco_ip_mf "minimum indicated torque to avoid blue smoke" 0x843ea5 tco _REC_AXS_20_u1 255. _CNV_A_R_LINEAR_____18_CM 6 -50. 205. FORMAT "%3.0" /end AXIS_PTS
/begin AXIS_PTS ldp_amp_ip_mf "minimum indicated torque to avoid blue smoke" 0x8412ec amp _REC_AXS_20_u2 5434. _CNV_A_R_LINEAR_____21_CM 6 0. 5434. FORMAT "%6.2" /end AXIS_PTS
/begin CHARACTERISTIC c_cyl_bal_ad_cdn "lower reversing point for hysteresis" VALUE 0x85bdc0 _REC_VAL_20_u2 7.999755856000001 _CNV_A_R_LINEAR_____369_CM 0. 7.999755856 DISPLAY_IDENTIFIER C_CYL_BAL_AD_CDN FORMAT "%5.4" /end CHARACTERISTIC
/begin CHARACTERISTIC c_cyl_bal_ad_hys "upper reversing point for hysteresis" VALUE 0x85bdc2 _REC_VAL_20_u2 7.999755856000001 _CNV_A_R_LINEAR_____370_CM 0. 7.999755856 DISPLAY_IDENTIFIER C_CYL_BAL_AD_HYS FORMAT "%5.4" /end CHARACTERISTIC
/begin CHARACTERISTIC c_t_dly_cyl_bal_ad "time delay for application conditions" VALUE 0x85c0a4 _REC_VAL_20_u2 6553.5 _CNV_A_R_LINEAR_____19_CM 0. 6553.5 DISPLAY_IDENTIFIER C_T_DLY_CYL_BAL_AD FORMAT "%5.1" /end CHARACTERISTIC
/begin CHARACTERISTIC c_thd_drv1_er_bal_fdout "threshold for disabling balancing in case of dynamics" VALUE 0x85c196 _REC_VAL_20_s2 65535. _CNV_A_R_LINEAR_____359_CM -32768. 32767. DISPLAY_IDENTIFIER C_THD_DRV1_ER_BAL_FDOUT FORMAT "%1.0" /end CHARACTERISTIC
/begin CHARACTERISTIC lc_cyl_bal_pl_ena "button to enable balancing also in partload" VALUE 0x85c30d _REC_VAL_20_u1 1. _CNV_A_R_LINEAR_____0_CM 0. 1. DISPLAY_IDENTIFIER LC_CYL_BAL_PL_ENA FORMAT "%1.0" /end CHARACTERISTIC
/begin MEASUREMENT cyl_bal_dif_mmv "mean value over the control inputs over one camshaft revolution" SWORD _CNV_A_R_LINEAR_____371_CM 1 0. -8. 7.999755856 DISPLAY_IDENTIFIER CYL_BAL_DIF_MMV ECU_ADDRESS 0x7fa55c BYTE_ORDER MSB_LAST FORMAT "%6.5" /end MEASUREMENT
/begin MEASUREMENT lv_cyl_bal_ena "boolean for balancing conditions active" UBYTE _CNV_A_R_LINEAR_____0_CM 1 0. 0. 1. DISPLAY_IDENTIFIER LV_CYL_BAL_ENA ECU_ADDRESS 0x7fb430 FORMAT "%1.0" /end MEASUREMENT
/begin MEASUREMENT lv_hys_cyl_bal_dif_mmv "flag for hysteresis condition" UBYTE _CNV_A_R_LINEAR_____0_CM 1 0. 0. 1. DISPLAY_IDENTIFIER LV_HYS_CYL_BAL_DIF_MMV ECU_ADDRESS 0x7fb431 FORMAT "%1.0" /end MEASUREMENT
/begin MEASUREMENT lv_t_dly_cyl_bal_act_st "" UBYTE _CNV_A_R_LINEAR_____0_CM 1 0. 0. 1. DISPLAY_IDENTIFIER LV_T_DLY_CYL_BAL_ACT_ST ECU_ADDRESS 0x7fb42f FORMAT "%1.0" /end MEASUREMENT
/begin CHARACTERISTIC c_cyl_bal_ofs "offset for correction factor segment" VALUE 0x85bdc4 _REC_VAL_20_u1 255. _CNV_A_R_LINEAR_____0_CM 0. 255. DISPLAY_IDENTIFIER C_CYL_BAL_OFS FORMAT "%3.0" /end CHARACTERISTIC
/begin CHARACTERISTIC c_n_max_bol_cyl_bal "lower enginespeed limit of variable weight" VALUE 0x85bf9a _REC_VAL_20_u2 6375. _CNV_A_R_LINEAR_____5_CM 0. 6375. DISPLAY_IDENTIFIER C_N_MAX_BOL_CYL_BAL FORMAT "%5.0" /end CHARACTERISTIC
/begin CHARACTERISTIC c_n_max_bol_cyl_bal_pl "lower enginespeed limit of variable weight for partload" VALUE 0x85bf9c _REC_VAL_20_u2 6375. _CNV_A_R_LINEAR_____5_CM 0. 6375. DISPLAY_IDENTIFIER C_N_MAX_BOL_CYL_BAL_PL FORMAT "%5.0" /end CHARACTERISTIC
/begin CHARACTERISTIC c_n_max_tol_cyl_bal "upper enginespeed limit of variable weight" VALUE 0x85bfb2 _REC_VAL_20_u2 6375. _CNV_A_R_LINEAR_____5_CM 0. 6375. DISPLAY_IDENTIFIER C_N_MAX_TOL_CYL_BAL FORMAT "%5.0" /end CHARACTERISTIC
/begin CHARACTERISTIC c_n_max_tol_cyl_bal_pl "upper enginespeed limit of variable weight for partload" VALUE 0x85bfb4 _REC_VAL_20_u2 6375. _CNV_A_R_LINEAR_____5_CM 0. 6375. DISPLAY_IDENTIFIER C_N_MAX_TOL_CYL_BAL_PL FORMAT "%5.0" /end CHARACTERISTIC
/begin CHARACTERISTIC c_t_dly_cyl_bal_lock "time after cold start with factors = 1" VALUE 0x85c0a6 _REC_VAL_20_u2 6553.5 _CNV_A_R_LINEAR_____19_CM 0. 6553.5 DISPLAY_IDENTIFIER C_T_DLY_CYL_BAL_LOCK FORMAT "%5.1" /end CHARACTERISTIC
/begin CHARACTERISTIC c_thd_tco_cyl_bal_di "tco threshold below which balancing is disabled" VALUE 0x85c198 _REC_VAL_20_u1 255. _CNV_A_R_LINEAR_____18_CM -50. 205. DISPLAY_IDENTIFIER C_THD_TCO_CYL_BAL_DI FORMAT "%3.0" /end CHARACTERISTIC
/begin CHARACTERISTIC c_thd_tco_cyl_bal_ena "threshold for enabling balancing depending on coolant temperature" VALUE 0x85c199 _REC_VAL_20_u1 255. _CNV_A_R_LINEAR_____18_CM -50. 205. DISPLAY_IDENTIFIER C_THD_TCO_CYL_BAL_ENA FORMAT "%4.1" /end CHARACTERISTIC
/begin MEASUREMENT fac_cyl_bal_ramp_tco[0] "correction factor calculated by the ramp for TCO x=0...NC_CYL_NR-1" UWORD _CNV_A_R_LINEAR_____53_CM 1 0. 0. 1.9999696 DISPLAY_IDENTIFIER FAC_CYL_BAL_RAMP_TCO_0_ ECU_ADDRESS 0x7f978c BYTE_ORDER MSB_LAST FORMAT "%5.3" /end MEASUREMENT
/begin MEASUREMENT fac_cyl_bal_ramp_tco[1] "correction factor calculated by the ramp for TCO x=0...NC_CYL_NR-1" UWORD _CNV_A_R_LINEAR_____53_CM 1 0. 0. 1.9999696 DISPLAY_IDENTIFIER FAC_CYL_BAL_RAMP_TCO_1_ ECU_ADDRESS 0x7f978e BYTE_ORDER MSB_LAST FORMAT "%5.3" /end MEASUREMENT
/begin MEASUREMENT fac_cyl_bal_ramp_tco[2] "correction factor calculated by the ramp for TCO x=0...NC_CYL_NR-1" UWORD _CNV_A_R_LINEAR_____53_CM 1 0. 0. 1.9999696 DISPLAY_IDENTIFIER FAC_CYL_BAL_RAMP_TCO_2_ ECU_ADDRESS 0x7f9790 BYTE_ORDER MSB_LAST FORMAT "%5.3" /end MEASUREMENT
/begin MEASUREMENT lv_cyl_bal_lock_tco "bit showing that TCO conditions set cylinder balancing to state  OFF" UBYTE _CNV_A_R_LINEAR_____0_CM 1 0. 0. 1. DISPLAY_IDENTIFIER LV_CYL_BAL_LOCK_TCO ECU_ADDRESS 0x7fb9db FORMAT "%1.0" /end MEASUREMENT
/begin MEASUREMENT lv_cyl_bal_tco_ramp_off "bit showing that the first ramp (for TCO condition) is no more active" UBYTE _CNV_A_R_LINEAR_____0_CM 1 0. 0. 1. DISPLAY_IDENTIFIER LV_CYL_BAL_TCO_RAMP_OFF ECU_ADDRESS 0x7fb9de FORMAT "%1.0" /end MEASUREMENT
/begin MEASUREMENT lv_fac_cyl_bal_grd_lim_act "bit showing that gradient limitation is active" UBYTE _CNV_A_R_LINEAR_____0_CM 1 0. 0. 1. DISPLAY_IDENTIFIER LV_FAC_CYL_BAL_GRD_LIM_ACT ECU_ADDRESS 0x7fb435 FORMAT "%1.0" /end MEASUREMENT
/begin MEASUREMENT lv_t_dly_cyl_bal_lock_st "" UBYTE _CNV_A_R_LINEAR_____0_CM 1 0. 0. 1. DISPLAY_IDENTIFIER LV_T_DLY_CYL_BAL_LOCK_ST ECU_ADDRESS 0x7fb433 FORMAT "%1.0" /end MEASUREMENT
/begin MEASUREMENT n_max_bol_cyl_bal "lower enginespeed limit of variable weight" UWORD _CNV_A_R_LINEAR_____5_CM 1 0. 0. 6375. DISPLAY_IDENTIFIER N_MAX_BOL_CYL_BAL ECU_ADDRESS 0x7fa55e BYTE_ORDER MSB_LAST FORMAT "%4.0" /end MEASUREMENT
/begin MEASUREMENT n_max_tol_cyl_bal "upper enginespeed limit of variable weight" UWORD _CNV_A_R_LINEAR_____5_CM 1 0. 0. 6375. DISPLAY_IDENTIFIER N_MAX_TOL_CYL_BAL ECU_ADDRESS 0x7fa560 BYTE_ORDER MSB_LAST FORMAT "%4.0" /end MEASUREMENT
/begin MEASUREMENT lv_cyl_bal_lock "balancing is locked, balancing factors are set to 1" UBYTE _CNV_A_R_LINEAR_____0_CM 1 0. 0. 1. DISPLAY_IDENTIFIER LV_CYL_BAL_LOCK ECU_ADDRESS 0x7fb432 FORMAT "%1.0" /end MEASUREMENT
/begin MEASUREMENT lv_cyl_bal_init_tco "initialisation request for cylinder balancing controller for low TCO" UBYTE _CNV_A_R_LINEAR_____0_CM 1 0. 0. 1. DISPLAY_IDENTIFIER LV_CYL_BAL_INIT_TCO ECU_ADDRESS 0x7fb437 FORMAT "%1.0" /end MEASUREMENT
/begin MEASUREMENT fac_cyl_bal[0] "cylinder balancing factor x=0...NC_CYL_NR-1" UWORD _CNV_A_R_LINEAR_____53_CM 1 0. 0. 1.9999696 DISPLAY_IDENTIFIER FAC_CYL_BAL_0_ ECU_ADDRESS 0x7f977c BYTE_ORDER MSB_LAST FORMAT "%5.3" /end MEASUREMENT
/begin MEASUREMENT fac_cyl_bal[1] "cylinder balancing factor x=0...NC_CYL_NR-1" UWORD _CNV_A_R_LINEAR_____53_CM 1 0. 0. 1.9999696 DISPLAY_IDENTIFIER FAC_CYL_BAL_1_ ECU_ADDRESS 0x7f977e BYTE_ORDER MSB_LAST FORMAT "%5.3" /end MEASUREMENT
/begin MEASUREMENT fac_cyl_bal[2] "cylinder balancing factor x=0...NC_CYL_NR-1" UWORD _CNV_A_R_LINEAR_____53_CM 1 0. 0. 1.9999696 DISPLAY_IDENTIFIER FAC_CYL_BAL_2_ ECU_ADDRESS 0x7f9780 BYTE_ORDER MSB_LAST FORMAT "%5.3" /end MEASUREMENT
/begin MEASUREMENT fac_cyl_bal_n_fdout[0] "" UWORD _CNV_A_R_LINEAR_____53_CM 1 0. 0. 1.9999696 DISPLAY_IDENTIFIER FAC_CYL_BAL_N_FDOUT_0_ ECU_ADDRESS 0x7fa562 BYTE_ORDER MSB_LAST FORMAT "%6.4" /end MEASUREMENT
/begin MEASUREMENT fac_cyl_bal_n_fdout[1] "" UWORD _CNV_A_R_LINEAR_____53_CM 1 0. 0. 1.9999696 DISPLAY_IDENTIFIER FAC_CYL_BAL_N_FDOUT_1_ ECU_ADDRESS 0x7fa564 BYTE_ORDER MSB_LAST FORMAT "%6.4" /end MEASUREMENT
/begin MEASUREMENT fac_cyl_bal_n_fdout[2] "" UWORD _CNV_A_R_LINEAR_____53_CM 1 0. 0. 1.9999696 DISPLAY_IDENTIFIER FAC_CYL_BAL_N_FDOUT_2_ ECU_ADDRESS 0x7fa566 BYTE_ORDER MSB_LAST FORMAT "%6.4" /end MEASUREMENT
/begin CHARACTERISTIC lc_cyl_bal_on "switch to enable balancing manually" VALUE 0x85c30c _REC_VAL_20_u1 1. _CNV_A_R_LINEAR_____0_CM 0. 1. DISPLAY_IDENTIFIER LC_CYL_BAL_ON FORMAT "%1.0" /end CHARACTERISTIC
/begin CHARACTERISTIC lc_cyl_bal_init_tco_act "switch to enable reinitialization of controller for low TCO" VALUE 0x85c30b _REC_VAL_20_u1 1. _CNV_A_R_LINEAR_____0_CM 0. 1. DISPLAY_IDENTIFIER LC_CYL_BAL_INIT_TCO_ACT FORMAT "%1.0" /end CHARACTERISTIC
/begin CHARACTERISTIC c_slop_tran_cyl_bal_off_on "slope for transition from factor 1 to stored values" VALUE 0x85c028 _REC_VAL_20_u2 0.49999237 _CNV_A_R_LINEAR_____373_CM 0. 0.49999237 DISPLAY_IDENTIFIER C_SLOP_TRAN_CYL_BAL_OFF_ON FORMAT "%7.6" /end CHARACTERISTIC
/begin CHARACTERISTIC c_mf_bol_cyl_bal_fdout "start point for fadeout of cylinder balancing factors via fuelmass" VALUE 0x85bf52 _REC_VAL_20_u2 262.14 _CNV_A_R_LINEAR_____43_CM 0. 262.14 DISPLAY_IDENTIFIER C_MF_BOL_CYL_BAL_FDOUT FORMAT "%7.3" /end CHARACTERISTIC
/begin CHARACTERISTIC c_slop_fdout_cyl_bal_mf "slope for the balancing factor correction in dependence of MF_TOT" VALUE 0x85c026 _REC_VAL_20_u2 125. _CNV_A_R_LINEAR_____374_CM 0. 125. DISPLAY_IDENTIFIER C_SLOP_FDOUT_CYL_BAL_MF FORMAT "%7.4" /end CHARACTERISTIC
/begin CHARACTERISTIC c_cyl_bal_pi_max "maximum threshold for controller output" VALUE 0x85bdc6 _REC_VAL_20_u2 1.9999696 _CNV_A_R_LINEAR_____53_CM 0. 1.9999696 DISPLAY_IDENTIFIER C_CYL_BAL_PI_MAX FORMAT "%6.5" /end CHARACTERISTIC
/begin CHARACTERISTIC c_cyl_bal_pi_min "minimum threshold for controller output" VALUE 0x85bdc8 _REC_VAL_20_u2 1.9999696 _CNV_A_R_LINEAR_____53_CM 0. 1.9999696 DISPLAY_IDENTIFIER C_CYL_BAL_PI_MIN FORMAT "%6.5" /end CHARACTERISTIC
/begin CHARACTERISTIC c_kr_pi_cyl_bal "gain for PI-controller" VALUE 0x85beac _REC_VAL_20_u2 0.9999874 _CNV_A_R_LINEAR_____90_CM 0. 0.9999874 DISPLAY_IDENTIFIER C_KR_PI_CYL_BAL FORMAT "%7.6" /end CHARACTERISTIC
/begin CHARACTERISTIC c_tn_pi_cyl_bal "integral action time for PI controller" VALUE 0x85c1be _REC_VAL_20_u2 8388.48 _CNV_A_R_LINEAR_____375_CM 0. 8388.48 DISPLAY_IDENTIFIER C_TN_PI_CYL_BAL FORMAT "%6.2" /end CHARACTERISTIC
/begin CHARACTERISTIC lc_cyl_bal_init "switch to re-initialise the controller manually" VALUE 0x85c30a _REC_VAL_20_u1 1. _CNV_A_R_LINEAR_____0_CM 0. 1. DISPLAY_IDENTIFIER LC_CYL_BAL_INIT FORMAT "%1.0" /end CHARACTERISTIC
/begin MEASUREMENT cyl_bal_pi[0] "output of the PI-controller x = 0...NC_CYL_NR-1" UWORD _CNV_A_R_LINEAR_____53_CM 1 0. 0. 1.9999696 DISPLAY_IDENTIFIER CYL_BAL_PI_0_ ECU_ADDRESS 0x7f9794 BYTE_ORDER MSB_LAST FORMAT "%5.3" /end MEASUREMENT
/begin MEASUREMENT cyl_bal_pi[1] "output of the PI-controller x = 0...NC_CYL_NR-1" UWORD _CNV_A_R_LINEAR_____53_CM 1 0. 0. 1.9999696 DISPLAY_IDENTIFIER CYL_BAL_PI_1_ ECU_ADDRESS 0x7f9796 BYTE_ORDER MSB_LAST FORMAT "%5.3" /end MEASUREMENT
/begin MEASUREMENT cyl_bal_pi[2] "output of the PI-controller x = 0...NC_CYL_NR-1" UWORD _CNV_A_R_LINEAR_____53_CM 1 0. 0. 1.9999696 DISPLAY_IDENTIFIER CYL_BAL_PI_2_ ECU_ADDRESS 0x7f9798 BYTE_ORDER MSB_LAST FORMAT "%5.3" /end MEASUREMENT
/begin MEASUREMENT cyl_bal_pi_mmv "mean value over PI-controller output" UWORD _CNV_A_R_LINEAR_____53_CM 1 0. 0. 1.9999696 DISPLAY_IDENTIFIER CYL_BAL_PI_MMV ECU_ADDRESS 0x7fa56c BYTE_ORDER MSB_LAST FORMAT "%5.3" /end MEASUREMENT
/begin MEASUREMENT lv_t_dly_cyl_bal_act "" UBYTE _CNV_S_2_RANGE______3_CM 1 0. 0. 1. DISPLAY_IDENTIFIER LV_T_DLY_CYL_BAL_ACT ECU_ADDRESS 0x7fb9e0 /end MEASUREMENT
/begin MEASUREMENT lv_t_dly_cyl_bal_lock "" UBYTE _CNV_A_R_LINEAR_____0_CM 1 0. 0. 1. DISPLAY_IDENTIFIER LV_T_DLY_CYL_BAL_LOCK ECU_ADDRESS 0x7fb9e1 FORMAT "%1.0" /end MEASUREMENT
/begin MEASUREMENT sf_cyl_bal "state of cylinder balancing" UBYTE _CNV_S_3_Cylinder_B_376_CM 1 0. 1. 3. DISPLAY_IDENTIFIER SF_CYL_BAL ECU_ADDRESS 0x7fb438 /end MEASUREMENT
/begin MEASUREMENT lv_cyl_bal_pi_lim[0] "" UBYTE _CNV_S_2_RANGE______28_CM 1 0. 0. 1. DISPLAY_IDENTIFIER LV_CYL_BAL_PI_LIM_0_ ECU_ADDRESS 0x7fb439 /end MEASUREMENT
/begin MEASUREMENT lv_cyl_bal_pi_lim[1] "" UBYTE _CNV_S_2_RANGE______28_CM 1 0. 0. 1. DISPLAY_IDENTIFIER LV_CYL_BAL_PI_LIM_1_ ECU_ADDRESS 0x7fb43a /end MEASUREMENT
/begin MEASUREMENT lv_cyl_bal_pi_lim[2] "" UBYTE _CNV_S_2_RANGE______28_CM 1 0. 0. 1. DISPLAY_IDENTIFIER LV_CYL_BAL_PI_LIM_2_ ECU_ADDRESS 0x7fb43b /end MEASUREMENT
/begin MEASUREMENT lv_cyl_bal_pi_lim[3] "" UBYTE _CNV_S_2_RANGE______28_CM 1 0. 0. 1. DISPLAY_IDENTIFIER LV_CYL_BAL_PI_LIM_3_ ECU_ADDRESS 0x7fb43c /end MEASUREMENT
/begin MEASUREMENT lv_cyl_bal_init "flag for initialisation of controller" UBYTE _CNV_A_R_LINEAR_____0_CM 1 0. 0. 1. DISPLAY_IDENTIFIER LV_CYL_BAL_INIT ECU_ADDRESS 0x7fb9e2 FORMAT "%1.0" /end MEASUREMENT
/begin CHARACTERISTIC c_fac_er_fil "filterfactor for ER lowpass" VALUE 0x85be38 _REC_VAL_20_u2 0.9999847412109381 _CNV_A_R_LINEAR_____14_CM 0. 0.9999847412109381 DISPLAY_IDENTIFIER C_FAC_ER_FIL FORMAT "%6.5" /end CHARACTERISTIC
/begin CHARACTERISTIC lc_swi_cyl_bal_inp "switches input signal for cylinder balancing controller" VALUE 0x85c361 _REC_VAL_20_u1 1. _CNV_A_R_LINEAR_____0_CM 0. 1. DISPLAY_IDENTIFIER LC_SWI_CYL_BAL_INP FORMAT "%1.0" /end CHARACTERISTIC
/begin MEASUREMENT cyl_bal_dif[0] "control deviation cylinder balancing x=0...NC_CYL_NR-1" SWORD _CNV_A_R_LINEAR_____371_CM 1 0. -8. 7.999755856 DISPLAY_IDENTIFIER CYL_BAL_DIF_0_ ECU_ADDRESS 0x7f97a8 BYTE_ORDER MSB_LAST FORMAT "%6.5" /end MEASUREMENT
/begin MEASUREMENT cyl_bal_dif[1] "control deviation cylinder balancing x=0...NC_CYL_NR-1" SWORD _CNV_A_R_LINEAR_____371_CM 1 0. -8. 7.999755856 DISPLAY_IDENTIFIER CYL_BAL_DIF_1_ ECU_ADDRESS 0x7f97aa BYTE_ORDER MSB_LAST FORMAT "%6.5" /end MEASUREMENT
/begin MEASUREMENT cyl_bal_dif[2] "control deviation cylinder balancing x=0...NC_CYL_NR-1" SWORD _CNV_A_R_LINEAR_____371_CM 1 0. -8. 7.999755856 DISPLAY_IDENTIFIER CYL_BAL_DIF_2_ ECU_ADDRESS 0x7f97ac BYTE_ORDER MSB_LAST FORMAT "%6.5" /end MEASUREMENT
/begin MEASUREMENT cyl_nr_cyl_bal "offset corrected cylinder number for balancing" UBYTE _CNV_A_R_LINEAR_____0_CM 1 0. 0. 255. DISPLAY_IDENTIFIER CYL_NR_CYL_BAL ECU_ADDRESS 0x7fb43d FORMAT "%3.0" /end MEASUREMENT
/begin MEASUREMENT lv_intv_thr[0] "open loop control active" UBYTE _CNV_S_2_RANGE______11_CM 1 0. 0. 1. DISPLAY_IDENTIFIER LV_INTV_THR_0_ ECU_ADDRESS 0x7fb474 /end MEASUREMENT
/begin MEASUREMENT intv_thr[0] "open loop control signal" SWORD _CNV_A_R_LINEAR_____155_CM 1 0. -100. 99.9969482421875 DISPLAY_IDENTIFIER INTV_THR_0_ ECU_ADDRESS 0x7f97c6 BYTE_ORDER MSB_LAST FORMAT "%5.3" /end MEASUREMENT
/begin CHARACTERISTIC ip_ctl_max_thr_grd "GE_TCLP: maximum limit of THR_j controller output depending on actuator velocity" MAP 0x8457c4 _REC_MAP_20_u2_u2_u2 199.9969482 _CNV_A_R_LINEAR_____158_CM -100. 99.99694820000001 DISPLAY_IDENTIFIER IP_CTL_MAX_THR_GRD FORMAT "%5.3"
 /begin AXIS_DESCR COM_AXIS ang_thr_fil[0] _CNV_A_R_LINEAR_____158_CM 6 -100. 99.99694820000001 FORMAT "%5.3" AXIS_PTS_REF ldp_ang_thr_ip_ctl_max /end AXIS_DESCR
 /begin AXIS_DESCR COM_AXIS ang_grd_thr_fil[0] _CNV_A_R_LINEAR_____424_CM 6 -32768. 32766. FORMAT "%10.5" AXIS_PTS_REF ldp_ang_grd_thr_ip_ctl_max /end AXIS_DESCR
/end CHARACTERISTIC
/begin AXIS_PTS ldp_ang_thr_ip_ctl_max "" 0x8413b2 ang_thr_fil[0] _REC_AXS_20_u2 199.9969482 _CNV_A_R_LINEAR_____158_CM 6 -100. 99.99694820000001 FORMAT "%5.3" /end AXIS_PTS
/begin AXIS_PTS ldp_ang_grd_thr_ip_ctl_max "" 0x84132e ang_grd_thr_fil[0] _REC_AXS_20_u2 65534. _CNV_A_R_LINEAR_____424_CM 6 -32768. 32766. FORMAT "%10.5" /end AXIS_PTS
/begin CHARACTERISTIC ip_ctl_min_thr_grd "GE_TCLP: minimum limit of THR_j controller output depending on actuator velocity" MAP 0x84580c _REC_MAP_20_u2_u2_u2 199.9969482 _CNV_A_R_LINEAR_____158_CM -100. 99.99694820000001 DISPLAY_IDENTIFIER IP_CTL_MIN_THR_GRD FORMAT "%5.3"
 /begin AXIS_DESCR COM_AXIS ang_thr_fil[0] _CNV_A_R_LINEAR_____158_CM 6 -100. 99.99694820000001 FORMAT "%5.3" AXIS_PTS_REF ldp_ang_thr_ip_ctl_min /end AXIS_DESCR
 /begin AXIS_DESCR COM_AXIS ang_grd_thr_fil[0] _CNV_A_R_LINEAR_____424_CM 6 -32768. 32766. FORMAT "%10.5" AXIS_PTS_REF ldp_ang_grd_thr_ip_ctl_min /end AXIS_DESCR
/end CHARACTERISTIC
/begin AXIS_PTS ldp_ang_thr_ip_ctl_min "" 0x8413c0 ang_thr_fil[0] _REC_AXS_20_u2 199.9969482 _CNV_A_R_LINEAR_____158_CM 6 -100. 99.99694820000001 FORMAT "%5.3" /end AXIS_PTS
/begin AXIS_PTS ldp_ang_grd_thr_ip_ctl_min "" 0x84133c ang_grd_thr_fil[0] _REC_AXS_20_u2 65534. _CNV_A_R_LINEAR_____424_CM 6 -32768. 32766. FORMAT "%10.5" /end AXIS_PTS
/begin MEASUREMENT ad_thr_mmv[0] "adaption signal" SWORD _CNV_A_R_LINEAR_____12_CM 1 0. -100. 99.996948242 DISPLAY_IDENTIFIER AD_THR_MMV_0_ ECU_ADDRESS 0x7f97c8 BYTE_ORDER MSB_LAST FORMAT "%5.3" /end MEASUREMENT
/begin MEASUREMENT lv_ad_thr[0] "enable flag for the EGR- throttle adaption" UBYTE _CNV_S_2_RANGE______11_CM 1 0. 0. 1. DISPLAY_IDENTIFIER LV_AD_THR_0_ ECU_ADDRESS 0x7fb475 /end MEASUREMENT
/begin MEASUREMENT lv_v_thr_tol_ad_orng[0] "minimum of sensor value at top limit out of range" UBYTE _CNV_S_2_RANGE______11_CM 1 0. 0. 1. DISPLAY_IDENTIFIER LV_V_THR_TOL_AD_ORNG_0_ ECU_ADDRESS 0x7fba20 /end MEASUREMENT
/begin MEASUREMENT v_thr_tol[0] "adaption value of V_THR_TOL_j" UWORD _CNV_A_R_LINEAR_____412_CM 1 0. 0. 319.995172 DISPLAY_IDENTIFIER V_THR_TOL_0_ ECU_ADDRESS 0x7f97ca BYTE_ORDER MSB_LAST /end MEASUREMENT
/begin MEASUREMENT lv_cdn_ad_v_thr_tol[0] "period of time when then new adaption value is stored" UBYTE _CNV_S_2_RANGE______11_CM 1 0. 0. 1. DISPLAY_IDENTIFIER LV_CDN_AD_V_THR_TOL_0_ ECU_ADDRESS 0x7fba21 /end MEASUREMENT
/begin MEASUREMENT v_thr_tol_det[0] "sampled value of V_THR_i" UWORD _CNV_A_R_LINEAR_____412_CM 1 0. 0. 319.995172 DISPLAY_IDENTIFIER V_THR_TOL_DET_0_ ECU_ADDRESS 0x7fa5d2 BYTE_ORDER MSB_LAST /end MEASUREMENT
/begin MEASUREMENT t_ad_thr_bol_av[0] "adaption time at the bottom limit" UWORD _CNV_A_R_LINEAR_____76_CM 1 0. 0. 65.535 DISPLAY_IDENTIFIER T_AD_THR_BOL_AV_0_ ECU_ADDRESS 0x7fa5d4 BYTE_ORDER MSB_LAST FORMAT "%5.3" /end MEASUREMENT
/begin MEASUREMENT lv_ad_thr_bol[0] "enabled adaption at the bottom limit" UBYTE _CNV_S_2_RANGE______11_CM 1 0. 0. 1. DISPLAY_IDENTIFIER LV_AD_THR_BOL_0_ ECU_ADDRESS 0x7fb476 /end MEASUREMENT
/begin MEASUREMENT lv_ad_thr_bol_req[0] "requested enabled adaption at the bottom limit" UBYTE _CNV_S_2_RANGE______11_CM 1 0. 0. 1. DISPLAY_IDENTIFIER LV_AD_THR_BOL_REQ_0_ ECU_ADDRESS 0x7fba22 /end MEASUREMENT
/begin MEASUREMENT lv_ad_thr_tol_req[0] "requested enabled adaption at the top limit" UBYTE _CNV_S_2_RANGE______11_CM 1 0. 0. 1. DISPLAY_IDENTIFIER LV_AD_THR_TOL_REQ_0_ ECU_ADDRESS 0x7fba23 /end MEASUREMENT
/begin MEASUREMENT lv_ena_ad_thr[0] "enabled ad. EGR throttle sensor" UBYTE _CNV_S_2_RANGE______11_CM 1 0. 0. 1. DISPLAY_IDENTIFIER LV_ENA_AD_THR_0_ ECU_ADDRESS 0x7fba24 /end MEASUREMENT
/begin MEASUREMENT t_ad_thr_tol_av[0] "adaption time at the top limit" UWORD _CNV_A_R_LINEAR_____76_CM 1 0. 0. 65.535 DISPLAY_IDENTIFIER T_AD_THR_TOL_AV_0_ ECU_ADDRESS 0x7fa5d6 BYTE_ORDER MSB_LAST FORMAT "%5.3" /end MEASUREMENT
/begin MEASUREMENT lv_ad_thr_tol[0] "enabled adaption at the top limit" UBYTE _CNV_S_2_RANGE______11_CM 1 0. 0. 1. DISPLAY_IDENTIFIER LV_AD_THR_TOL_0_ ECU_ADDRESS 0x7fb477 /end MEASUREMENT
/begin MEASUREMENT lv_v_thr_bol_ad_orng[0] "minimum of sensor value at bottom limit out of range" UBYTE _CNV_S_2_RANGE______11_CM 1 0. 0. 1. DISPLAY_IDENTIFIER LV_V_THR_BOL_AD_ORNG_0_ ECU_ADDRESS 0x7fb478 /end MEASUREMENT
/begin MEASUREMENT v_thr_bol[0] "adaption value of V_THR_BOL_j" UWORD _CNV_A_R_LINEAR_____412_CM 1 0. 0. 319.995172 DISPLAY_IDENTIFIER V_THR_BOL_0_ ECU_ADDRESS 0x7f97cc BYTE_ORDER MSB_LAST /end MEASUREMENT
/begin MEASUREMENT lv_cdn_ad_v_thr_bol[0] "period of time when then new adaption value is stored" UBYTE _CNV_S_2_RANGE______11_CM 1 0. 0. 1. DISPLAY_IDENTIFIER LV_CDN_AD_V_THR_BOL_0_ ECU_ADDRESS 0x7fb479 /end MEASUREMENT
/begin MEASUREMENT v_thr_bol_det[0] "sampled value of V_THR_i" UWORD _CNV_A_R_LINEAR_____412_CM 1 0. 0. 319.995172 DISPLAY_IDENTIFIER V_THR_BOL_DET_0_ ECU_ADDRESS 0x7fa5d8 BYTE_ORDER MSB_LAST /end MEASUREMENT
/begin CHARACTERISTIC c_crlc_ad_thr[0] "correlation coefficient for adaption of THR" VALUE 0x85bd44 _REC_VAL_20_u2 0.9999847412109381 _CNV_A_R_LINEAR_____14_CM 0. 0.9999847412109381 DISPLAY_IDENTIFIER C_CRLC_AD_THR_0 FORMAT "%6.5" /end CHARACTERISTIC
/begin CHARACTERISTIC c_crlc_v_thr_tol[0] "correlation of V_THR_i during adaption at top limit" VALUE 0x85bd66 _REC_VAL_20_u2 0.9999847412109381 _CNV_A_R_LINEAR_____14_CM 0. 0.9999847412109381 DISPLAY_IDENTIFIER C_CRLC_V_THR_0_TOL FORMAT "%6.5" /end CHARACTERISTIC
/begin CHARACTERISTIC c_v_thr_max_ad_tol[0] "allowed maximum adaption value of V_THR_j at top limit" VALUE 0x85c28c _REC_VAL_20_u2 319.995172 _CNV_A_R_LINEAR_____412_CM 0. 319.995172 DISPLAY_IDENTIFIER C_V_THR_0_MAX_AD_TOL /end CHARACTERISTIC
/begin CHARACTERISTIC c_v_thr_min_ad_tol[0] "allowed minimum adaption value of V_THR at top limit" VALUE 0x85c298 _REC_VAL_20_u2 319.995172 _CNV_A_R_LINEAR_____412_CM 0. 319.995172 DISPLAY_IDENTIFIER C_V_THR_0_MIN_AD_TOL /end CHARACTERISTIC
/begin CHARACTERISTIC lc_v_thr_tol_sub[0] "activation of substitute value of V_THR_j_TOL at top limit if an adaption error is detected" VALUE 0x85c384 _REC_VAL_20_u1 1. _CNV_A_R_LINEAR_____0_CM 0. 1. DISPLAY_IDENTIFIER LC_V_THR_0_TOL_SUB FORMAT "%1.0" /end CHARACTERISTIC
/begin CHARACTERISTIC c_v_thr_tol_sub[0] "substitute value of V_THR_j_TOL at top limit if an adaption error is detected" VALUE 0x85c2a0 _REC_VAL_20_u2 319.995172 _CNV_A_R_LINEAR_____412_CM 0. 319.995172 DISPLAY_IDENTIFIER C_V_THR_0_TOL_SUB /end CHARACTERISTIC
/begin CHARACTERISTIC c_ang_sp_ad_thr_bol[0] "activation threshold for adaption at the bottom limit" VALUE 0x85bcde _REC_VAL_20_u2 99.99847412109381 _CNV_A_R_LINEAR_____8_CM 0. 99.99847412109381 DISPLAY_IDENTIFIER C_ANG_SP_AD_THR_0_BOL FORMAT "%5.3" /end CHARACTERISTIC
/begin CHARACTERISTIC c_v_grd_thr_st_ad_bol[0] "maximum gradient of potentiometer voltage to start adaption" VALUE 0x85c22e _REC_VAL_20_u1 124.511719 _CNV_A_R_LINEAR_____413_CM 0. 124.511719 DISPLAY_IDENTIFIER C_V_GRD_THR_0_ST_AD_BOL FORMAT "%4.1" /end CHARACTERISTIC
/begin CHARACTERISTIC c_temp_st_ad_thr_max[0] "maximum ambient temperature to start adaption" VALUE 0x85c17b _REC_VAL_20_u1 255. _CNV_A_R_LINEAR_____18_CM -50. 205. DISPLAY_IDENTIFIER C_TEMP_ST_AD_THR_0_MAX FORMAT "%3.0" /end CHARACTERISTIC
/begin CHARACTERISTIC c_temp_st_ad_thr_min[0] "minimum ambient temperature to start adaption" VALUE 0x85c17d _REC_VAL_20_u1 255. _CNV_A_R_LINEAR_____18_CM -50. 205. DISPLAY_IDENTIFIER C_TEMP_ST_AD_THR_0_MIN FORMAT "%3.0" /end CHARACTERISTIC
/begin CHARACTERISTIC c_v_thr_max_st_ad_bol[0] "value of V_THR to start adaption" VALUE 0x85c290 _REC_VAL_20_u2 319.995172 _CNV_A_R_LINEAR_____412_CM 0. 319.995172 DISPLAY_IDENTIFIER C_V_THR_0_MAX_ST_AD_BOL /end CHARACTERISTIC
/begin CHARACTERISTIC c_t_ad_thr_bol[0] "adaption time at the bottom limit" VALUE 0x85c08c _REC_VAL_20_u2 65.535 _CNV_A_R_LINEAR_____76_CM 0. 65.535 DISPLAY_IDENTIFIER C_T_AD_THR_0_BOL FORMAT "%5.3" /end CHARACTERISTIC
/begin CHARACTERISTIC c_t_ad_thr_bol_ini[0] "initialization of learning unit" VALUE 0x85c090 _REC_VAL_20_u2 65.535 _CNV_A_R_LINEAR_____76_CM 0. 65.535 DISPLAY_IDENTIFIER C_T_AD_THR_0_BOL_INI FORMAT "%5.3" /end CHARACTERISTIC
/begin CHARACTERISTIC c_ang_sp_ad_thr_tol[0] "activation threshold for adaption at the top limit" VALUE 0x85bce2 _REC_VAL_20_u2 99.99847412109381 _CNV_A_R_LINEAR_____8_CM 0. 99.99847412109381 DISPLAY_IDENTIFIER C_ANG_SP_AD_THR_0_TOL FORMAT "%5.3" /end CHARACTERISTIC
/begin CHARACTERISTIC c_v_grd_thr_st_ad_tol[0] "maximum gradient of potentiometer voltage to start adaption" VALUE 0x85c230 _REC_VAL_20_u1 124.511719 _CNV_A_R_LINEAR_____413_CM 0. 124.511719 DISPLAY_IDENTIFIER C_V_GRD_THR_0_ST_AD_TOL FORMAT "%4.1" /end CHARACTERISTIC
/begin CHARACTERISTIC c_v_thr_min_st_ad_tol[0] "value of V_THR to start adaption" VALUE 0x85c29c _REC_VAL_20_u2 319.995172 _CNV_A_R_LINEAR_____412_CM 0. 319.995172 DISPLAY_IDENTIFIER C_V_THR_0_MIN_ST_AD_TOL /end CHARACTERISTIC
/begin CHARACTERISTIC c_t_ad_thr_tol[0] "adaption time at the top limit" VALUE 0x85c094 _REC_VAL_20_u2 65.535 _CNV_A_R_LINEAR_____76_CM 0. 65.535 DISPLAY_IDENTIFIER C_T_AD_THR_0_TOL FORMAT "%5.3" /end CHARACTERISTIC
/begin CHARACTERISTIC c_t_ad_thr_tol_ini[0] "initialization of learning unit" VALUE 0x85c098 _REC_VAL_20_u2 65.535 _CNV_A_R_LINEAR_____76_CM 0. 65.535 DISPLAY_IDENTIFIER C_T_AD_THR_0_TOL_INI FORMAT "%5.3" /end CHARACTERISTIC
/begin CHARACTERISTIC c_crlc_v_thr_bol[0] "correlation of V_THR_i during adaption at bottom limit" VALUE 0x85bd62 _REC_VAL_20_u2 0.9999847412109381 _CNV_A_R_LINEAR_____14_CM 0. 0.9999847412109381 DISPLAY_IDENTIFIER C_CRLC_V_THR_0_BOL FORMAT "%6.5" /end CHARACTERISTIC
/begin CHARACTERISTIC c_v_thr_max_ad_bol[0] "allowed maximum adaption value of V_THR at bottom limit" VALUE 0x85c288 _REC_VAL_20_u2 319.995172 _CNV_A_R_LINEAR_____412_CM 0. 319.995172 DISPLAY_IDENTIFIER C_V_THR_0_MAX_AD_BOL /end CHARACTERISTIC
/begin CHARACTERISTIC c_v_thr_min_ad_bol[0] "allowed minimum adaption value of V_THR at bottom limit" VALUE 0x85c294 _REC_VAL_20_u2 319.995172 _CNV_A_R_LINEAR_____412_CM 0. 319.995172 DISPLAY_IDENTIFIER C_V_THR_0_MIN_AD_BOL /end CHARACTERISTIC
/begin CHARACTERISTIC lc_v_thr_bol_sub[0] "activation of substitute value of V_THR_j_BOL at bottom limit if an adaption error is detected" VALUE 0x85c382 _REC_VAL_20_u1 1. _CNV_A_R_LINEAR_____0_CM 0. 1. DISPLAY_IDENTIFIER LC_V_THR_0_BOL_SUB FORMAT "%1.0" /end CHARACTERISTIC
/begin CHARACTERISTIC c_v_thr_bol_sub[0] "substitute value of V_THR_j_BOL at bottom limit if an adaption error is detected" VALUE 0x85c284 _REC_VAL_20_u2 319.995172 _CNV_A_R_LINEAR_____412_CM 0. 319.995172 DISPLAY_IDENTIFIER C_V_THR_0_BOL_SUB /end CHARACTERISTIC
/begin CHARACTERISTIC id_ad_thr_bol__t_ad_thr "GE_TAD: actuator signal during BOL adaption" CURVE 0x8488e8 _REC_CUR_20_u2_u2 199.9969482 _CNV_A_R_LINEAR_____158_CM -100. 99.99694820000001 DISPLAY_IDENTIFIER ID_AD_THR_BOL__T_AD_THR FORMAT "%5.3"
 /begin AXIS_DESCR COM_AXIS t_ad_thr_bol_av[0] _CNV_A_R_LINEAR_____76_CM 4 0. 65.535 FORMAT "%5.3" AXIS_PTS_REF ldp_t_ad_thr_bol__ip_ad_thr /end AXIS_DESCR
/end CHARACTERISTIC
/begin AXIS_PTS ldp_t_ad_thr_bol__ip_ad_thr "" 0x8425f4 t_ad_thr_bol_av[0] _REC_AXS_20_u2 65.535 _CNV_A_R_LINEAR_____76_CM 4 0. 65.535 FORMAT "%5.3" /end AXIS_PTS
/begin CHARACTERISTIC id_ad_thr_tol__t_ad_thr "GE_TAD: actuator signal during TOL adaption" CURVE 0x8488f0 _REC_CUR_20_u2_u2 199.9969482 _CNV_A_R_LINEAR_____158_CM -100. 99.99694820000001 DISPLAY_IDENTIFIER ID_AD_THR_TOL__T_AD_THR FORMAT "%5.3"
 /begin AXIS_DESCR COM_AXIS t_ad_thr_tol_av[0] _CNV_A_R_LINEAR_____76_CM 4 0. 65.535 FORMAT "%5.3" AXIS_PTS_REF ldp_t_ad_thr_tol__ip_ad_thr /end AXIS_DESCR
/end CHARACTERISTIC
/begin AXIS_PTS ldp_t_ad_thr_tol__ip_ad_thr "" 0x8425fe t_ad_thr_tol_av[0] _REC_AXS_20_u2 65.535 _CNV_A_R_LINEAR_____76_CM 4 0. 65.535 FORMAT "%5.3" /end AXIS_PTS
/begin CHARACTERISTIC c_vb_max_ad_thr "maximum battery voltage for THR adaption" VALUE 0x85c2b0 _REC_VAL_20_u1 28.8 _CNV_A_R_LINEAR_____48_CM 0. 28.8 DISPLAY_IDENTIFIER C_VB_MAX_AD_THR /end CHARACTERISTIC
/begin CHARACTERISTIC c_vb_min_ad_thr "minimum battery voltage for THR adaption" VALUE 0x85c2b4 _REC_VAL_20_u1 28.8 _CNV_A_R_LINEAR_____48_CM 0. 28.8 DISPLAY_IDENTIFIER C_VB_MIN_AD_THR /end CHARACTERISTIC
/begin MEASUREMENT lv_ena_ad_thr_ext[0] "enabled adaption of the thr pos sensor" UBYTE _CNV_S_2_RANGE______11_CM 1 0. 0. 1. DISPLAY_IDENTIFIER LV_ENA_AD_THR_EXT_0_ ECU_ADDRESS 0x7fb49b /end MEASUREMENT
/begin MEASUREMENT portpwm_hys_out "Output of hysteresis" UBYTE _CNV_A_R_LINEAR_____0_CM 1 0. 0. 1. DISPLAY_IDENTIFIER PORTPWM_HYS_OUT ECU_ADDRESS 0x7fba6b FORMAT "%1.0" /end MEASUREMENT
/begin MEASUREMENT portpwm_wout_hys "Duty cycle without hysteresis" UWORD _CNV_A_R_LINEAR_____201_CM 1 0. 0. 99.972117 DISPLAY_IDENTIFIER PORTPWM_WOUT_HYS ECU_ADDRESS 0x7fa87e BYTE_ORDER MSB_LAST FORMAT "%5.3" /end MEASUREMENT
/begin MEASUREMENT portpwm_hys "Duty cycle with hysteresis" UWORD _CNV_A_R_LINEAR_____201_CM 1 0. 0. 99.972117 DISPLAY_IDENTIFIER PORTPWM_HYS ECU_ADDRESS 0x7fa87c BYTE_ORDER MSB_LAST FORMAT "%5.3" /end MEASUREMENT
/begin MEASUREMENT portpwm "Duty cycle of swirl flap" UWORD _CNV_A_R_LINEAR_____201_CM 1 0. 0. 99.972117 DISPLAY_IDENTIFIER PORTPWM ECU_ADDRESS 0x7f990e BYTE_ORDER MSB_LAST FORMAT "%5.3" /end MEASUREMENT
/begin CHARACTERISTIC c_ducy_on "Value of duty for hysteresis on" VALUE 0x8483ec _REC_VAL_20_u2 99.972117 _CNV_A_R_LINEAR_____201_CM 0. 99.972117 DISPLAY_IDENTIFIER C_DUCY_ON FORMAT "%6.5" /end CHARACTERISTIC
/begin CHARACTERISTIC c_ducy_off "Upper value for duty cycle for hysteresis" VALUE 0x8483ea _REC_VAL_20_u2 99.972117 _CNV_A_R_LINEAR_____201_CM 0. 99.972117 DISPLAY_IDENTIFIER C_DUCY_OFF FORMAT "%6.5" /end CHARACTERISTIC
/begin CHARACTERISTIC c_ducy_hys_up "Upper value for the hysteresis" VALUE 0x8483e8 _REC_VAL_20_u2 99.972117 _CNV_A_R_LINEAR_____201_CM 0. 99.972117 DISPLAY_IDENTIFIER C_DUCY_HYS_UP FORMAT "%6.5" /end CHARACTERISTIC
/begin CHARACTERISTIC c_ducy_hys_down "lower level for the hysteresis" VALUE 0x8483e6 _REC_VAL_20_u2 99.972117 _CNV_A_R_LINEAR_____201_CM 0. 99.972117 DISPLAY_IDENTIFIER C_DUCY_HYS_DOWN FORMAT "%6.5" /end CHARACTERISTIC
/begin CHARACTERISTIC ip_portpwm__n__mf_tot "GE_SWRL: Swirl map" MAP 0x84744a _REC_MAP_20_u2_u2_u2 99.972117 _CNV_A_R_LINEAR_____201_CM 0. 99.972117 DISPLAY_IDENTIFIER IP_PORTPWM__N__MF_TOT FORMAT "%5.3"
 /begin AXIS_DESCR COM_AXIS n _CNV_A_R_LINEAR_____5_CM 5 0. 8160. FORMAT "%4.0" AXIS_PTS_REF ldp_n_ip_portpwm /end AXIS_DESCR
 /begin AXIS_DESCR COM_AXIS mf_tot _CNV_A_R_LINEAR_____55_CM 5 0. 65.535 FORMAT "%5.3" AXIS_PTS_REF ldp_mf_tot_ip_portpwm /end AXIS_DESCR
/end CHARACTERISTIC
/begin AXIS_PTS ldp_n_ip_portpwm "" 0x841eea n _REC_AXS_20_u2 8160. _CNV_A_R_LINEAR_____5_CM 5 0. 8160. FORMAT "%4.0" /end AXIS_PTS
/begin AXIS_PTS ldp_mf_tot_ip_portpwm "" 0x8418a4 mf_tot _REC_AXS_20_u2 65.535 _CNV_A_R_LINEAR_____55_CM 5 0. 65.535 FORMAT "%5.3" /end AXIS_PTS
/begin COMPU_METHOD _CNV_A_R_LINEAR_____0_CM "" RAT_FUNC "%6.3" "[-]" COEFFS 0 1. 0. 0 0 1 /end COMPU_METHOD
/begin COMPU_METHOD _CNV_S_2_RANGE______3_CM "" TAB_VERB "%6.3" "[-]" COMPU_TAB_REF _CNV_S_2_RANGE______3 /end COMPU_METHOD
/begin COMPU_VTAB _CNV_S_2_RANGE______3 "" TAB_VERB 2 0 "" 1 "1" /end COMPU_VTAB
/begin COMPU_METHOD _CNV_A_R_LINEAR_____5_CM "" RAT_FUNC "%6.3" "[rpm]" COEFFS 0 1. 0. 0 0 1 /end COMPU_METHOD
/begin COMPU_METHOD _CNV_A_R_LINEAR_____8_CM "" RAT_FUNC "%6.3" "[%]" COEFFS 0 655.3599999999997 0. 0 0 1 /end COMPU_METHOD
/begin COMPU_METHOD _CNV_S_2_RANGE______11_CM "" TAB_VERB "%6.3" "[-]" COMPU_TAB_REF _CNV_S_2_RANGE______11 /end COMPU_METHOD
/begin COMPU_VTAB _CNV_S_2_RANGE______11 "" TAB_VERB 2 0 "0" 1 "1" /end COMPU_VTAB
/begin COMPU_METHOD _CNV_A_R_LINEAR_____12_CM "" RAT_FUNC "%6.3" "[%]" COEFFS 0 327.6800000003072 3.071909304708242e-008 0 0 1 /end COMPU_METHOD
/begin COMPU_METHOD _CNV_A_R_LINEAR_____14_CM "" RAT_FUNC "%6.3" "[-]" COEFFS 0 65535.99999999996 0. 0 0 1 /end COMPU_METHOD
/begin COMPU_METHOD _CNV_A_R_LINEAR_____15_CM "" RAT_FUNC "%6.3" "[-]" COEFFS 0 16384. 0. 0 0 1 /end COMPU_METHOD
/begin COMPU_METHOD _CNV_A_R_LINEAR_____18_CM "" RAT_FUNC "%6.3" "[°C]" COEFFS 0 1. 50. 0 0 1 /end COMPU_METHOD
/begin COMPU_METHOD _CNV_A_R_LINEAR_____19_CM "" RAT_FUNC "%6.3" "[s]" COEFFS 0 10. 0. 0 0 1 /end COMPU_METHOD
/begin COMPU_METHOD _CNV_A_R_LINEAR_____20_CM "" RAT_FUNC "%6.3" "[°C]" COEFFS 0 1. 0. 0 0 1 /end COMPU_METHOD
/begin COMPU_METHOD _CNV_A_R_LINEAR_____21_CM "" RAT_FUNC "%6.3" "[hPa]" COEFFS 0 12.06017666543982 0. 0 0 1 /end COMPU_METHOD
/begin COMPU_METHOD _CNV_S_2_RANGE______28_CM "" TAB_VERB "%6.3" "[-]" COMPU_TAB_REF _CNV_S_2_RANGE______28 /end COMPU_METHOD
/begin COMPU_VTAB _CNV_S_2_RANGE______28 "" TAB_VERB 2 0 "passive" 1 "active" /end COMPU_VTAB
/begin COMPU_METHOD _CNV_A_R_LINEAR_____39_CM "" RAT_FUNC "%6.3" "[km/h]" COEFFS 0 1. 0. 0 0 1 /end COMPU_METHOD
/begin COMPU_METHOD _CNV_A_R_LINEAR_____43_CM "" RAT_FUNC "%6.3" "[mg/stk]" COEFFS 0 250. 0. 0 0 1 /end COMPU_METHOD
/begin COMPU_METHOD _CNV_A_R_LINEAR_____48_CM "" RAT_FUNC "%6.3" "[V]" COEFFS 0 8.854166666666666 0. 0 0 1 /end COMPU_METHOD
/begin COMPU_METHOD _CNV_A_R_LINEAR_____53_CM "" RAT_FUNC "%6.3" "[-]" COEFFS 0 32767.99807357072 0. 0 0 1 /end COMPU_METHOD
/begin COMPU_METHOD _CNV_A_R_LINEAR_____55_CM "" RAT_FUNC "%6.3" "[mg/stk]" COEFFS 0 1000. 0. 0 0 1 /end COMPU_METHOD
/begin COMPU_METHOD _CNV_A_R_LINEAR_____62_CM "" RAT_FUNC "%6.3" "[Nm]" COEFFS 0 32. 0. 0 0 1 /end COMPU_METHOD
/begin COMPU_METHOD _CNV_A_R_LINEAR_____63_CM "" RAT_FUNC "%6.3" "[-]" COEFFS 0 16383.81262712377 0. 0 0 1 /end COMPU_METHOD
/begin COMPU_METHOD _CNV_A_R_LINEAR_____76_CM "" RAT_FUNC "%6.3" "[s]" COEFFS 0 1000. 0. 0 0 1 /end COMPU_METHOD
/begin COMPU_METHOD _CNV_A_R_LINEAR_____89_CM "" RAT_FUNC "%6.3" "[Nm]" COEFFS 0 32. 32768. 0 0 1 /end COMPU_METHOD
/begin COMPU_METHOD _CNV_A_R_LINEAR_____90_CM "" RAT_FUNC "%6.3" "[-]" COEFFS 0 65535.82575140447 0. 0 0 1 /end COMPU_METHOD
/begin COMPU_METHOD _CNV_A_R_LINEAR_____98_CM "" RAT_FUNC "%6.3" "[-]" COEFFS 0 64. 0. 0 0 1 /end COMPU_METHOD
/begin COMPU_METHOD _CNV_A_R_LINEAR_____120_CM "" RAT_FUNC "%6.3" "[°CRK]" COEFFS 0 42.66666666666666 5120. 0 0 1 /end COMPU_METHOD
/begin COMPU_METHOD _CNV_A_R_LINEAR_____121_CM "" RAT_FUNC "%6.3" "[°CRK]" COEFFS 0 42.66666666666666 0. 0 0 1 /end COMPU_METHOD
/begin COMPU_METHOD _CNV_A_R_LINEAR_____133_CM "" RAT_FUNC "%6.3" "[mg/stk]" COEFFS 0 250. 32768. 0 0 1 /end COMPU_METHOD
/begin COMPU_METHOD _CNV_A_R_LINEAR_____155_CM "" RAT_FUNC "%6.3" "[%]" COEFFS 0 327.68 0. 0 0 1 /end COMPU_METHOD
/begin COMPU_METHOD _CNV_A_R_LINEAR_____158_CM "" RAT_FUNC "%6.3" "[%]" COEFFS 0 327.680000069121 32768.0000069121 0 0 1 /end COMPU_METHOD
/begin COMPU_METHOD _CNV_A_R_LINEAR_____201_CM "" RAT_FUNC "%6.3" "[%]" COEFFS 0 327.7613897082924 0. 0 0 1 /end COMPU_METHOD
/begin COMPU_METHOD _CNV_A_R_LINEAR_____208_CM "" RAT_FUNC "%6.3" "[ms]" COEFFS 0 999.9999999999999 0. 0 0 1 /end COMPU_METHOD
/begin COMPU_METHOD _CNV_A_R_LINEAR_____209_CM "" RAT_FUNC "%6.3" "[%/um]" COEFFS 0 2.56 0. 0 0 1 /end COMPU_METHOD
/begin COMPU_METHOD _CNV_A_R_LINEAR_____210_CM "" RAT_FUNC "%6.3" "[-]" COEFFS 0 65537. 0. 0 0 1 /end COMPU_METHOD
/begin COMPU_METHOD _CNV_A_R_LINEAR_____211_CM "" RAT_FUNC "%6.3" "[um]" COEFFS 0 4. 0. 0 0 1 /end COMPU_METHOD
/begin COMPU_METHOD _CNV_A_R_LINEAR_____212_CM "" RAT_FUNC "%6.3" "[um]" COEFFS 0 5. 0. 0 0 1 /end COMPU_METHOD
/begin COMPU_METHOD _CNV_A_R_LINEAR_____213_CM "" RAT_FUNC "%6.3" "[%/um]" COEFFS 0 2.559999357490358 -3.212548212161437e-005 0 0 1 /end COMPU_METHOD
/begin COMPU_METHOD _CNV_A_R_LINEAR_____214_CM "" RAT_FUNC "%6.3" "[-]" COEFFS 0 999.9999999999999 0. 0 0 1 /end COMPU_METHOD
/begin COMPU_METHOD _CNV_A_R_LINEAR_____215_CM "" RAT_FUNC "%6.3" "[%/um]" COEFFS 0 2.559999357490358 127.9999678745179 0 0 1 /end COMPU_METHOD
/begin COMPU_METHOD _CNV_A_R_LINEAR_____216_CM "" RAT_FUNC "%6.3" "[mVAs/um]" COEFFS 0 16384. 0. 0 0 1 /end COMPU_METHOD
/begin COMPU_METHOD _CNV_A_R_LINEAR_____217_CM "" RAT_FUNC "%6.3" "[mVAs/um2]" COEFFS 0 32767.99999999992 0. 0 0 1 /end COMPU_METHOD
/begin COMPU_METHOD _CNV_A_R_LINEAR_____218_CM "" RAT_FUNC "%6.3" "mg/stk" COEFFS 0 250. 0. 0 0 1 /end COMPU_METHOD
/begin COMPU_METHOD _CNV_A_R_LINEAR_____219_CM "" RAT_FUNC "%6.3" "[°C]" COEFFS 0 1. 205. 0 0 1 /end COMPU_METHOD
/begin COMPU_METHOD _CNV_A_R_LINEAR_____220_CM "" RAT_FUNC "%6.3" "[ms]" COEFFS 0 100. 0. 0 0 1 /end COMPU_METHOD
/begin COMPU_METHOD _CNV_S_9_CONV_INJ_S_221_CM "" TAB_VERB "%6.3" "[-]" COMPU_TAB_REF _CNV_S_9_CONV_INJ_S_221 /end COMPU_METHOD
/begin COMPU_VTAB _CNV_S_9_CONV_INJ_S_221 "" TAB_VERB 9 0 "NO INJECTION" 1 "PREV" 2 "MAIN" 3 "PREV/MAIN" 4 "POST" 5 "PREV/POST" 6 "MAIN/POST" 7 "PREV/MAIN/POST" 8 "INJECTION DISABLED" /end COMPU_VTAB
/begin COMPU_METHOD _CNV_A_R_LINEAR_____222_CM "" RAT_FUNC "%6.3" "[stk]" COEFFS 0 1. 0. 0 0 1 /end COMPU_METHOD
/begin COMPU_METHOD _CNV_A_R_LINEAR_____340_CM "" RAT_FUNC "%6.3" "[Nm]" COEFFS 0 31.99998046846389 32767.97999970703 0 0 1 /end COMPU_METHOD
/begin COMPU_METHOD _CNV_A_R_LINEAR_____359_CM "" RAT_FUNC "%6.3" "[us]" COEFFS 0 1. 0. 0 0 1 /end COMPU_METHOD
/begin COMPU_METHOD _CNV_A_R_LINEAR_____369_CM "" RAT_FUNC "%6.3" "[rpm/ms]" COEFFS 0 4096.000001728053 0. 0 0 1 /end COMPU_METHOD
/begin COMPU_METHOD _CNV_A_R_LINEAR_____370_CM "" RAT_FUNC "%6.3" "[-]" COEFFS 0 4096.000001728053 0. 0 0 1 /end COMPU_METHOD
/begin COMPU_METHOD _CNV_A_R_LINEAR_____371_CM "" RAT_FUNC "%6.3" "[-]" COEFFS 0 4096.000000864013 6.912101525813341e-006 0 0 1 /end COMPU_METHOD
/begin COMPU_METHOD _CNV_A_R_LINEAR_____373_CM "" RAT_FUNC "%6.3" "[1/seg]" COEFFS 0 131072.0001587224 0. 0 0 1 /end COMPU_METHOD
/begin COMPU_METHOD _CNV_A_R_LINEAR_____374_CM "" RAT_FUNC "%6.3" "[1/mg/stk]" COEFFS 0 524.28 0. 0 0 1 /end COMPU_METHOD
/begin COMPU_METHOD _CNV_A_R_LINEAR_____375_CM "" RAT_FUNC "%6.3" "[ms]" COEFFS 0 7.8125 0. 0 0 1 /end COMPU_METHOD
/begin COMPU_METHOD _CNV_S_3_Cylinder_B_376_CM "" TAB_VERB "%6.3" "[-]" COMPU_TAB_REF _CNV_S_3_Cylinder_B_376 /end COMPU_METHOD
/begin COMPU_VTAB _CNV_S_3_Cylinder_B_376 "" TAB_VERB 3 1 "OFF" 2 "OPEN LOOP" 3 "ACTIVE" /end COMPU_VTAB
/begin COMPU_METHOD _CNV_A_R_LINEAR_____412_CM "" RAT_FUNC "%6.3" "[V]" COEFFS 0 204.7999649194707 0. 0 0 1 /end COMPU_METHOD
/begin COMPU_METHOD _CNV_A_R_LINEAR_____413_CM "" RAT_FUNC "%6.3" "[V/s]" COEFFS 0 2.047999995887937 0. 0 0 1 /end COMPU_METHOD
/begin COMPU_METHOD _CNV_A_R_LINEAR_____424_CM "" RAT_FUNC "%6.3" "[%/s]" COEFFS 0 1.000015259254738 32768.50001525926 0 0 1 /end COMPU_METHOD
/begin RECORD_LAYOUT _REC_VAL_20_u1 FNC_VALUES 1 UBYTE COLUMN_DIR DIRECT /end RECORD_LAYOUT
/begin RECORD_LAYOUT _REC_AXS_20_u2 NO_AXIS_PTS_X 1 UWORD AXIS_PTS_X 2 UWORD INDEX_INCR DIRECT /end RECORD_LAYOUT
/begin RECORD_LAYOUT _REC_CUR_20_u1_u2 FNC_VALUES 1 UBYTE COLUMN_DIR DIRECT /end RECORD_LAYOUT
/begin RECORD_LAYOUT _REC_MAP_20_u1_u2_u2 FNC_VALUES 1 UBYTE COLUMN_DIR DIRECT /end RECORD_LAYOUT
/begin RECORD_LAYOUT _REC_MAP_20_u2_u2_u2 FNC_VALUES 1 UWORD COLUMN_DIR DIRECT /end RECORD_LAYOUT
/begin RECORD_LAYOUT _REC_VAL_20_u2 FNC_VALUES 1 UWORD COLUMN_DIR DIRECT /end RECORD_LAYOUT
/begin RECORD_LAYOUT _REC_VAL_20_s2 FNC_VALUES 1 SWORD COLUMN_DIR DIRECT /end RECORD_LAYOUT
/begin RECORD_LAYOUT _REC_AXS_20_u1 NO_AXIS_PTS_X 1 UBYTE AXIS_PTS_X 2 UBYTE INDEX_INCR DIRECT /end RECORD_LAYOUT
/begin RECORD_LAYOUT _REC_CUR_20_u2_u2 FNC_VALUES 1 UWORD COLUMN_DIR DIRECT /end RECORD_LAYOUT
/begin RECORD_LAYOUT _REC_CUR_20_u2_u1 FNC_VALUES 1 UWORD COLUMN_DIR DIRECT /end RECORD_LAYOUT
/begin RECORD_LAYOUT _REC_MAP_20_u2_u2_u1 FNC_VALUES 1 UWORD COLUMN_DIR DIRECT /end RECORD_LAYOUT
/begin RECORD_LAYOUT _REC_CUR_20_u1_u1 FNC_VALUES 1 UBYTE COLUMN_DIR DIRECT /end RECORD_LAYOUT
/begin RECORD_LAYOUT _REC_MAP_20_u2_u1_u2 FNC_VALUES 1 UWORD COLUMN_DIR DIRECT /end RECORD_LAYOUT
/begin RECORD_LAYOUT _REC_CUR_20_u4_u2 FNC_VALUES 1 ULONG COLUMN_DIR DIRECT /end RECORD_LAYOUT
/begin FUNCTION GES_AGE_TAD ""
 /begin DEF_CHARACTERISTIC c_crlc_ad_thr[0] c_crlc_v_thr_tol[0] c_v_thr_max_ad_tol[0] c_v_thr_min_ad_tol[0] lc_v_thr_tol_sub[0] c_v_thr_tol_sub[0] c_ang_sp_ad_thr_bol[0] c_v_grd_thr_st_ad_bol[0] c_temp_st_ad_thr_max[0] c_temp_st_ad_thr_min[0] c_v_thr_max_st_ad_bol[0] c_t_ad_thr_bol[0] c_t_ad_thr_bol_ini[0] c_ang_sp_ad_thr_tol[0] c_v_grd_thr_st_ad_tol[0] c_v_thr_min_st_ad_tol[0] c_t_ad_thr_tol[0] c_t_ad_thr_tol_ini[0] c_crlc_v_thr_bol[0] c_v_thr_max_ad_bol[0] c_v_thr_min_ad_bol[0] lc_v_thr_bol_sub[0] c_v_thr_bol_sub[0] id_ad_thr_bol__t_ad_thr ldp_t_ad_thr_bol__ip_ad_thr id_ad_thr_tol__t_ad_thr ldp_t_ad_thr_tol__ip_ad_thr c_vb_max_ad_thr c_vb_min_ad_thr /end DEF_CHARACTERISTIC
 /begin OUT_MEASUREMENT ad_thr_mmv[0] lv_ad_thr[0] lv_v_thr_tol_ad_orng[0] v_thr_tol[0] lv_cdn_ad_v_thr_tol[0] v_thr_tol_det[0] t_ad_thr_bol_av[0] lv_ad_thr_bol[0] lv_ad_thr_bol_req[0] lv_ad_thr_tol_req[0] lv_ena_ad_thr[0] t_ad_thr_tol_av[0] lv_ad_thr_tol[0] lv_v_thr_bol_ad_orng[0] v_thr_bol[0] lv_cdn_ad_v_thr_bol[0] v_thr_bol_det[0] lv_ena_ad_thr_ext[0] /end OUT_MEASUREMENT
/end FUNCTION
/begin FUNCTION GES_AGE_TCLP ""
 /begin DEF_CHARACTERISTIC ip_ctl_max_thr_grd ldp_ang_thr_ip_ctl_max ldp_ang_grd_thr_ip_ctl_max ip_ctl_min_thr_grd ldp_ang_thr_ip_ctl_min ldp_ang_grd_thr_ip_ctl_min /end DEF_CHARACTERISTIC
/end FUNCTION
/begin FUNCTION GES_AGE_TAI "" /begin OUT_MEASUREMENT lv_intv_thr[0] intv_thr[0] /end OUT_MEASUREMENT /end FUNCTION
/begin FUNCTION GES_AGE_SWRL ""
 /begin DEF_CHARACTERISTIC c_ducy_on c_ducy_off c_ducy_hys_up c_ducy_hys_down ip_portpwm__n__mf_tot ldp_n_ip_portpwm ldp_mf_tot_ip_portpwm /end DEF_CHARACTERISTIC
 /begin OUT_MEASUREMENT portpwm_hys_out portpwm_wout_hys portpwm_hys portpwm /end OUT_MEASUREMENT
/end FUNCTION
/begin FUNCTION C_X_DOI ""
 /begin SUB_FUNCTION DOI_ASTCCORD DOI_ACYB_ACT DOI_ACYB_COR DOI_ACYB_CTL DOI_ACYB_PRP /end SUB_FUNCTION
/end FUNCTION
/begin FUNCTION DOI_ASTCCORD "PUI Stroke Control General" /end FUNCTION
/begin FUNCTION DOI_ACYB_ACT "Cylinder Balancing - Activation Conditions"
 /begin DEF_CHARACTERISTIC c_cyl_bal_ad_cdn c_cyl_bal_ad_hys c_t_dly_cyl_bal_ad c_thd_drv1_er_bal_fdout lc_cyl_bal_pl_ena /end DEF_CHARACTERISTIC
 /begin OUT_MEASUREMENT cyl_bal_dif_mmv lv_cyl_bal_ena lv_hys_cyl_bal_dif_mmv lv_t_dly_cyl_bal_act_st /end OUT_MEASUREMENT
/end FUNCTION
/begin FUNCTION DOI_ACYB_COR "Cylinder Balancing - Calculation of Correction Values"
 /begin DEF_CHARACTERISTIC c_cyl_bal_ofs c_n_max_bol_cyl_bal c_n_max_bol_cyl_bal_pl c_n_max_tol_cyl_bal c_n_max_tol_cyl_bal_pl c_t_dly_cyl_bal_lock c_thd_tco_cyl_bal_di c_thd_tco_cyl_bal_ena lc_cyl_bal_on lc_cyl_bal_init_tco_act c_slop_tran_cyl_bal_off_on c_mf_bol_cyl_bal_fdout c_slop_fdout_cyl_bal_mf /end DEF_CHARACTERISTIC
 /begin OUT_MEASUREMENT fac_cyl_bal_ramp_tco[0] fac_cyl_bal_ramp_tco[1] fac_cyl_bal_ramp_tco[2] lv_cyl_bal_lock_tco lv_cyl_bal_tco_ramp_off lv_fac_cyl_bal_grd_lim_act lv_t_dly_cyl_bal_lock_st n_max_bol_cyl_bal n_max_tol_cyl_bal lv_cyl_bal_lock lv_cyl_bal_init_tco fac_cyl_bal[0] fac_cyl_bal[1] fac_cyl_bal[2] fac_cyl_bal_n_fdout[0] fac_cyl_bal_n_fdout[1] fac_cyl_bal_n_fdout[2] /end OUT_MEASUREMENT
/end FUNCTION
/begin FUNCTION DOI_ACYB_CTL "Cylinder Balancing - Control Algorithm"
 /begin DEF_CHARACTERISTIC c_cyl_bal_pi_max c_cyl_bal_pi_min c_kr_pi_cyl_bal c_tn_pi_cyl_bal lc_cyl_bal_init /end DEF_CHARACTERISTIC
 /begin OUT_MEASUREMENT cyl_bal_pi[0] cyl_bal_pi[1] cyl_bal_pi[2] cyl_bal_pi_mmv lv_t_dly_cyl_bal_act lv_t_dly_cyl_bal_lock sf_cyl_bal lv_cyl_bal_pi_lim[0] lv_cyl_bal_pi_lim[1] lv_cyl_bal_pi_lim[2] lv_cyl_bal_pi_lim[3] lv_cyl_bal_init /end OUT_MEASUREMENT
/end FUNCTION
/begin FUNCTION DOI_ACYB_PRP "Cylinder Balancing - Signal Preparation" /begin DEF_CHARACTERISTIC c_fac_er_fil lc_swi_cyl_bal_inp /end DEF_CHARACTERISTIC
 /begin OUT_MEASUREMENT cyl_bal_dif[0] cyl_bal_dif[1] cyl_bal_dif[2] cyl_nr_cyl_bal /end OUT_MEASUREMENT
/end FUNCTION
/begin FUNCTION C_X_TI ""
 /begin SUB_FUNCTION TI_COLDSTART TI_LIBC TI_LIM TI_MAIN1 TI_CORD TI_COLCK TI_POST1 TI_PREV1 TI_RLINJ TI_TUNE TI_FIU TI_TUN TI_COL /end SUB_FUNCTION
/end FUNCTION
/begin FUNCTION TI_COLDSTART ""
 /begin DEF_CHARACTERISTIC c_tfu_max_doi_inc c_tfu_tco_dif_max_doi_inc ip_dly_ctr_doi_inc__tfu ldpm_tfu_ip_doi_inc ip_fac_doi_inc_ini__tfu ip_slop_ctr_doi_inc__tfu lc_doi_inc_rest_on lc_cold_start_cor_on lc_temp_cor_on c_tfu_tco_dif_max_doi_inj c_tco_min_doi_inj c_nr_seg_tfu_cor ip_fac_temp_delta__ctr ldp_fac_ip_fac_temp_delta ip_tfu_sp__n__mf ldpm_n_ip_temp_sp ldpm_mf_ip_temp_sp ip_tco_sp__n__mf /end DEF_CHARACTERISTIC
 /begin OUT_MEASUREMENT fac_doi_inc lv_doi_inc_ena fac_doi_prev1_tfu fac_doi_main1_tfu fac_doi_post1_tfu fac_doi_prev1 fac_doi_main1 fac_doi_post1 fac_doi_prev1_tco fac_doi_main1_tco fac_doi_post1_tco /end OUT_MEASUREMENT
/end FUNCTION
/begin FUNCTION TI_LIBC ""
 /begin DEF_CHARACTERISTIC c_fac1_egy_pps_stk c_fac2_egy_pps_stk ip_fac_prs_soi__mf__dur ldp_mf_ip_fac_prs_soi ldp_dur_ip_fac_prs_soi ip_fac_prs_doi__mf__dur ldp_mf_ip_fac_prs_doi ldp_dur_ip_fac_prs_doi ip_soi_dly__n__level ldp_n_ip_soi_dly ldp_level_ip_soi_dly ldpm_soi_ip_fac_doi ip_fac_doi__soi__tfu_delta ldp_tfu_delta_ip_fac_doi ip_fac_doi__soi__tco_delta ldp_tco_delta_ip_fac_doi /end DEF_CHARACTERISTIC
/end FUNCTION
/begin FUNCTION TI_LIM ""
 /begin DEF_CHARACTERISTIC c_t_cha2cha_min c_t_dcha2dcha_min c_t_cha2dcha_min c_t_dcha2cha_min c_t_dcha2newcha_min c_stk_max_piezo c_t_soi_dly lc_doi_mod c_step_sp_pps c_step_sp_iv_foc c_ti_req_ti_min c_t_hld_min_bas c_ang_cam_st c_ang_cam_end c_ti_min lc_ip_on c_t_grp2sel_min c_ti_cold_max c_ti_max ip_fac_t_hld_min_inc__n ldp_n_ip_fac_t_hld_min_inc ip_ofs_level_cor__tfu ldp_tfu_ip_ofs_level_cor c_t_cha_frze_min c_t_cha_micro_step_min c_t_hld_pls_min c_t_dist_pls2pls_min c_t_eoi_trig_ofs c_t_dist_main12post1_min lc_doi_min_mod lc_micro_step_frze_mod lc_micro_step_on /end DEF_CHARACTERISTIC
 /begin OUT_MEASUREMENT t_dcha2newcyl_min t_cha_min t_cha_max t_dcha_min t_dcha_max stk_max_piezo t_step_pps t_soi_dly lv_doi_mod step_sp_pps step_sp_iv_foc ti_req_ti_min t_hld_min_bas step_cha_min step_dcha_min ang_cam_st ang_cam_end ti_min lv_ip_on t_grp2sel_min t_cha_frze_min t_cha_micro_step_min t_hld_pls_min t_dist_pls2pls_min t_eoi_trig_ofs lv_doi_min_mod lv_micro_step_frze_mod t_dist_main12post1_min lv_micro_step_on ti_max doi_max doi_min soi_dly dur_dcha2newcyl_min dur_pls_min dur_grp2sel_min t_hld_min ofs_level_cor dur_wout_frze_min dur_with_frze_min /end OUT_MEASUREMENT
/end FUNCTION
/begin FUNCTION TI_MAIN1 ""
 /begin DEF_CHARACTERISTIC ip_level_cha_frze_main1__n ldp_n_ip_level_cha_frze_main1 ip_t_hld_frze_main1__n ldp_n_ip_t_hld_frze_main1 c_fac_doi_main1_tu_[0] c_fac_doi_main1_tu_[1] c_fac_doi_main1_tu_[2] c_fac_doi_main1_tu_[3] c_doi_main1_man_[0] c_doi_main1_man_[1] c_doi_main1_man_[2] c_doi_main1_man_[3] lc_doi_main1_man ip_doi_main1_0 ip_doi_main1_1 ip_doi_main1_2 ip_doi_main1_3 ip_doi_main1_4 ip_doi_main1_5 ldpm_n_ip_doi_main1 ldpm_mf_ip_doi_main1 ip_sel_ip_doi_main1__soi ldp_soi_ip_doi_main1 ip_level_dcha_toze_main1__n ldp_n_ip_level_dcha_toze_main1 ip_t_hld_toze_main1__n ldp_n_ip_t_hld_toze_main1 /end DEF_CHARACTERISTIC
 /begin OUT_MEASUREMENT soi_frze_cor_prev1 soi_frze_main1_req1 t_cha_frze_main1_req1 soi_main1_req1 t_cha_main1_req1 eoi_main1_pwr_on t_dcha_main1 t_hld_toze_main1 t_dcha_toze_main1 lv_frze_main1_req2 lv_main1_req2 lv_toze_main1_req2 lv_frze_prev1_req3 lv_prev1_req3 lv_toze_prev1_req3 doi_main1_bas_tu step_nr_cha_frze_main1 level_cha_frze_main1 t_hld_frze_main1 step_nr_cha_main1 step_nr_dcha_main1 level_dcha_toze_main1 step_nr_dcha_toze_main1 doi_main1_bas mf_main1_tu_cor doi_main1_req1 lv_micro_step_main1_act soi_frze_cor_main1 soi_frze_cor_post1 /end OUT_MEASUREMENT
/end FUNCTION
/begin FUNCTION TI_CORD "" /begin OUT_MEASUREMENT dummy_soi dummy_mf dummy_level dummy_doi /end OUT_MEASUREMENT /end FUNCTION
/begin FUNCTION TI_COLCK "" /end FUNCTION
/begin FUNCTION TI_POST1 ""
 /begin DEF_CHARACTERISTIC ip_level_cha_frze_post1__n ldp_n_ip_level_cha_frze_post1 ip_t_hld_frze_post1__n ldp_n_ip_t_hld_frze_post1 c_fac_doi_post1_tu_[0] c_fac_doi_post1_tu_[1] c_fac_doi_post1_tu_[2] c_fac_doi_post1_tu_[3] c_doi_post1_man_[0] c_doi_post1_man_[1] c_doi_post1_man_[2] c_doi_post1_man_[3] lc_doi_post1_man ip_doi_post1_0 ip_doi_post1_1 ip_doi_post1_2 ldpm_n_ip_doi_post1 ldpm_mf_ip_doi_post1 ip_sel_ip_doi_post1__soi ldp_soi_ip_doi_post1 ip_level_dcha_toze_post1__n ldp_n_ip_level_dcha_toze_post1 ip_t_hld_toze_post1__n ldp_n_ip_t_hld_toze_post1 c_fac_t_dif_min_main1_post1 /end DEF_CHARACTERISTIC
 /begin OUT_MEASUREMENT soi_frze_post1_pwr_on t_cha_frze_post1 soi_post1_pwr_on t_cha_post1 eoi_post1_pwr_on t_dcha_post1 t_hld_toze_post1 t_dcha_toze_post1 lv_frze_post1_act lv_post1_act lv_toze_post1_act doi_post1_bas_tu step_nr_cha_frze_post1 level_cha_frze_post1 t_hld_frze_post1 step_nr_cha_post1 step_nr_dcha_post1 level_dcha_toze_post1 step_nr_dcha_toze_post1 doi_post1_bas mf_post1_tu_cor doi_post1_pwr_on lv_micro_step_post1_act /end OUT_MEASUREMENT
/end FUNCTION
/begin FUNCTION TI_PREV1 ""
 /begin DEF_CHARACTERISTIC ip_level_cha_frze_prev1__n ldp_n_ip_level_cha_frze_prev1 ip_t_hld_frze_prev1__n ldp_n_ip_t_hld_frze_prev1 c_fac_doi_prev1_tu_[0] c_fac_doi_prev1_tu_[1] c_fac_doi_prev1_tu_[2] c_fac_doi_prev1_tu_[3] c_doi_prev1_man_[0] c_doi_prev1_man_[1] c_doi_prev1_man_[2] c_doi_prev1_man_[3] lc_doi_prev1_man ip_doi_prev1_0 ip_doi_prev1_1 ip_doi_prev1_2 ip_doi_prev1_3 ip_doi_prev1_4 ip_doi_prev1_5 ldpm_n_ip_doi_prev1 ldpm_mf_ip_doi_prev1 ip_sel_ip_doi_prev1__soi ldp_soi_ip_doi_prev1 ip_level_dcha_toze_prev1__n ldp_n_ip_level_dcha_toze_prev1 ip_t_hld_toze_prev1__n ldp_n_ip_t_hld_toze_prev1 /end DEF_CHARACTERISTIC
 /begin OUT_MEASUREMENT soi_frze_prev1_req1 t_cha_frze_prev1_req1 soi_prev1_req1 t_cha_prev1_req1 eoi_prev1_req1 t_dcha_prev1_req1 t_hld_toze_prev1_req1 t_dcha_toze_prev1_req1 lv_frze_prev1_req2 lv_prev1_req2 lv_toze_prev1_req2 doi_prev1_bas_tu step_nr_cha_frze_prev1 level_cha_frze_prev1 t_hld_frze_prev1 step_nr_cha_prev1 step_nr_dcha_prev1 level_dcha_toze_prev1 step_nr_dcha_toze_prev1 doi_prev1_bas mf_prev1_tu_cor doi_prev1_pwr_on lv_micro_step_prev1_act /end OUT_MEASUREMENT
/end FUNCTION
/begin FUNCTION TI_RLINJ ""
 /begin DEF_CHARACTERISTIC ip_mf_is_tar__tco ldp_tco_ip_mf_is_tar ip_ctr_tran_st_is__tco ldp_tco_ip_ctr_tran_st_is /end DEF_CHARACTERISTIC
 /begin OUT_MEASUREMENT lv_inj_ena_st mf_is_tar ctr_tran_st_is sf_inj_off sf_inj_state.word sf_inj_state.bf.unused sf_inj_state.bf.lv_inj_di sf_inj_state.bf.lv_post1_inj_act sf_inj_state.bf.lv_main2_inj_act sf_inj_state.bf.lv_main1_inj_act sf_inj_state.bf.lv_prev2_inj_act sf_inj_state.bf.lv_prev1_inj_act sf_pls_state iv_on nr_inj_seg lv_inj_ena lv_inj_di /end OUT_MEASUREMENT
/end FUNCTION
/begin FUNCTION TI_TUNE ""
 /begin OUT_MEASUREMENT sf_pls_state_tu_[0] sf_pls_state_tu_[1] sf_pls_state_tu_[2] sf_pls_state_tu_[3] sf_inj_off_tu /end OUT_MEASUREMENT
/end FUNCTION
/begin FUNCTION TI_FIU "Taskhandling of the Fast Injection Update" /begin DEF_CHARACTERISTIC c_n_max_fast_inj_upd lc_fast_inj_upd_cdn_ovs /end DEF_CHARACTERISTIC /begin OUT_MEASUREMENT lv_fast_inj_upd lv_fast_upd_miss /end OUT_MEASUREMENT /end FUNCTION
/begin FUNCTION TI_TUN "Injection Timing Tuning"
 /begin DEF_CHARACTERISTIC lc_tun_pui_man c_soi_frze_prev1_man c_t_cha_frze_prev1_man c_soi_prev1_man c_t_cha_prev1_man c_eoi_prev1_man c_t_dcha_prev1_man c_t_hld_toze_prev1_man c_t_dcha_toze_prev1_man c_doi_prev1_man c_soi_frze_main1_man c_t_cha_frze_main1_man c_soi_main1_man c_t_cha_main1_man c_eoi_main1_man c_t_dcha_main1_man c_t_hld_toze_main1_man c_t_dcha_toze_main1_man c_doi_main1_man c_soi_frze_post1_man c_t_cha_frze_post1_man c_soi_post1_man c_t_cha_post1_man c_eoi_post1_man c_t_dcha_post1_man c_t_hld_toze_post1_man c_t_dcha_toze_post1_man c_doi_post1_man c_sf_pls_state_man c_t_cha_tot_min c_ctr_t_cha_tot_vld_hys_on /end DEF_CHARACTERISTIC
 /begin OUT_MEASUREMENT soi_frze_prev1_pwr_on_tu t_cha_frze_prev1_tu soi_prev1_pwr_on_tu t_cha_prev1_tu eoi_prev1_pwr_on_tu t_dcha_prev1_tu t_hld_toze_prev1_tu t_dcha_toze_prev1_tu soi_frze_main1_pwr_on_tu t_cha_frze_main1_tu soi_main1_pwr_on_tu t_cha_main1_tu eoi_main1_pwr_on_tu t_dcha_main1_tu t_hld_toze_main1_tu t_dcha_toze_main1_tu soi_frze_post1_pwr_on_tu t_cha_frze_post1_tu soi_post1_pwr_on_tu t_cha_post1_tu eoi_post1_pwr_on_tu t_dcha_post1_tu t_hld_toze_post1_tu t_dcha_toze_post1_tu sf_inj_state_tu.word sf_inj_state_tu.bf.unused sf_inj_state_tu.bf.lv_inj_di sf_inj_state_tu.bf.lv_post1_inj_act sf_inj_state_tu.bf.lv_main2_inj_act sf_inj_state_tu.bf.lv_main1_inj_act sf_inj_state_tu.bf.lv_prev2_inj_act sf_inj_state_tu.bf.lv_prev1_inj_act sf_pls_state_tu nr_inj_seg_tu ti_prev1 ti_main1 ti_post1 ti_prev1_tu ti_main1_tu ti_post1_tu lv_t_cha_prev1_vld lv_t_cha_main1_vld lv_t_cha_post1_vld lv_t_cha_tot_vld sf_t_cha_tot_vld_hys t_cha_seq1 doi_prev1_pwr_on_tu doi_main1_pwr_on_tu doi_post1_pwr_on_tu /end OUT_MEASUREMENT
/end FUNCTION
/begin FUNCTION TI_COL "Injection Timing Collision Check"
 /begin DEF_CHARACTERISTIC c_t_dist_prev1_main1_min c_dur_dist_prev1_main1_min c_swi_dist c_n_level_swi lc_dir_chg_n_level lc_case_clc_on c_t_swi_1_2_ofs c_t_swi_2_3_ofs /end DEF_CHARACTERISTIC
 /begin OUT_MEASUREMENT soi_frze_prev1_pwr_on t_cha_frze_prev1 soi_prev1_pwr_on t_cha_prev1 eoi_prev1_pwr_on t_dcha_prev1 t_hld_toze_prev1 t_dcha_toze_prev1 lv_frze_prev1_act lv_prev1_act lv_toze_prev1_act soi_frze_main1_pwr_on t_cha_frze_main1 soi_main1_pwr_on t_cha_main1 lv_frze_main1_act lv_main1_act lv_toze_main1_act lv_toze_prev1_req4 dur_move_prev1 case_nr doi_main1_pwr_on /end OUT_MEASUREMENT
/end FUNCTION
/begin FUNCTION C_X_ASTCTL ""
 /begin SUB_FUNCTION ASTCTL_ENME ASTCTL_AQSI ASTCTL_THCL ASTCTL_ENCL ASTCTL_PUICTL ASTCTL_PUIPFSP ASTCTL_NRMPLS ARCHA_CTL /end SUB_FUNCTION
/end FUNCTION
/begin FUNCTION ASTCTL_ENME "" /end FUNCTION
/begin FUNCTION ASTCTL_AQSI "" /end FUNCTION
/begin FUNCTION ASTCTL_THCL "" /end FUNCTION
/begin FUNCTION ASTCTL_ENCL "" /end FUNCTION
/begin FUNCTION ASTCTL_PUICTL "PECO PUI Controller" /end FUNCTION
/begin FUNCTION ASTCTL_PUIPFSP "PECO PUI Acquisition of Piezo Signals" /end FUNCTION
/begin FUNCTION ASTCTL_NRMPLS "PUI Normalisation Pulse General" /end FUNCTION
/begin FUNCTION ARCHA_CTL ""
 /begin DEF_CHARACTERISTIC c_tco_rcha_lim c_ti_rcha_lim c_t_rcha_pulse_dur_[0] c_t_rcha_pulse_dur_[1] c_t_rcha_pulse_dur_[2] c_t_rcha_pulse_dur_[3] /end DEF_CHARACTERISTIC
 /begin OUT_MEASUREMENT lf_rcha_prev1_act lf_rcha_main1_act lf_rcha_post1_act t_rcha_pulse_[0] t_rcha_pulse_[1] t_rcha_pulse_[2] t_rcha_pulse_[3] /end OUT_MEASUREMENT
/end FUNCTION
/begin FUNCTION C_Y_MF ""
 /begin SUB_FUNCTION MF_AMFBPRT MF_AMFCORD MF_ATQISLM MF_AMFBOL MF_AMFSLM MF_AMF_INJCOR MF_AMF_MINOR_TEMP MF_AMF_TEMP_LEVEL MF_AMF_MINOR_ACT MF_AMF_MINOR_ST MF_AMF_MINOR MF_AMF_INJMIN MF_AMFSTBAS MF_AMF_MINOR_RGN MF_AMF_MINOR_TRAN MF_AMF_MAIN MF_AMF_MAIN_RGN MF_AMF_MAIN_TEMP MF_AMF_MAIN_TRAN MF_AMF_TRAN MF_AMFSPLIT /end SUB_FUNCTION
/end FUNCTION
/begin FUNCTION MF_AMFBPRT ""
 /begin DEF_CHARACTERISTIC c_tfu_thd_tqi_tql_tfu_prot ldp_vs_ip_fac_tqi_tql_tfu_prot ldp_n_ip_tqi_tql_tfu_prot ldp_tfu_ip_tqi_tql_tfu_prot ip_fac_tqi_tql_tfu_prot ip_tqi_tql_tfu_prot /end DEF_CHARACTERISTIC
 /begin OUT_MEASUREMENT tqi_tql_tfu_prot /end OUT_MEASUREMENT
/end FUNCTION
/begin FUNCTION MF_AMFCORD "Fuel Mass Tuning"
 /begin DEF_CHARACTERISTIC lc_mf_prev1_tu_on lc_mf_prev2_tu_on lc_mf_main1_tu_on lc_mf_main2_tu_on lc_mf_post2_tu_on lc_mf_post1_tu_on c_mf_main1_add_tu c_mf_main2_add_tu c_fac_mf_prev1_tu c_fac_mf_prev2_tu c_mf_post1_add_tu c_mf_post2_add_tu c_mf_main1_test_add_tu[0] c_mf_main1_test_add_tu[1] c_mf_main1_test_add_tu[2] c_mf_main1_test_add_tu[3] c_mf_main2_test_add_tu[0] c_mf_main2_test_add_tu[1] c_mf_main2_test_add_tu[2] c_mf_main2_test_add_tu[3] c_mf_prev1_test_add_tu[0] c_mf_prev1_test_add_tu[1] c_mf_prev1_test_add_tu[2] c_mf_prev1_test_add_tu[3] c_mf_prev2_test_add_tu[0] c_mf_prev2_test_add_tu[1] c_mf_prev2_test_add_tu[2] c_mf_prev2_test_add_tu[3] c_mf_post2_test_add_tu[0] c_mf_post2_test_add_tu[1] c_mf_post2_test_add_tu[2] c_mf_post2_test_add_tu[3] c_mf_post1_test_add_tu[0] c_mf_post1_test_add_tu[1] c_mf_post1_test_add_tu[2] c_mf_post1_test_add_tu[3] c_mf_main1_add_tu_cyl[0] c_mf_main1_add_tu_cyl[1] c_mf_main1_add_tu_cyl[2] c_mf_main1_add_tu_cyl[3] c_mf_main2_add_tu_cyl[0] c_mf_main2_add_tu_cyl[1] c_mf_main2_add_tu_cyl[2] c_mf_main2_add_tu_cyl[3] c_mf_prev1_add_tu_cyl[0] c_mf_prev1_add_tu_cyl[1] c_mf_prev1_add_tu_cyl[2] c_mf_prev1_add_tu_cyl[3] c_mf_prev2_add_tu_cyl[0] c_mf_prev2_add_tu_cyl[1] c_mf_prev2_add_tu_cyl[2] c_mf_prev2_add_tu_cyl[3] c_mf_post1_add_tu_cyl[0] c_mf_post1_add_tu_cyl[1] c_mf_post1_add_tu_cyl[2] c_mf_post1_add_tu_cyl[3] c_mf_post2_add_tu_cyl[0] c_mf_post2_add_tu_cyl[1] c_mf_post2_add_tu_cyl[2] c_mf_post2_add_tu_cyl[3] c_fac_mf_main1_tu c_fac_mf_main2_tu c_fac_mf_post1_tu c_fac_mf_post2_tu ip_mf_main1_inj_test_ad ldp_n_ip_mf_main1_inj_test_ad ldp_tqi_sp_ip_mf_main1_inj_test_ad /end DEF_CHARACTERISTIC
 /begin OUT_MEASUREMENT mf_prev1_tu mf_prev2_tu mf_main1_tu mf_main2_tu mf_post1_tu mf_post2_tu mf_inj_sum /end OUT_MEASUREMENT
/end FUNCTION
/begin FUNCTION MF_ATQISLM "Indicated Torque for Smoke Limitation" /end FUNCTION
/begin FUNCTION MF_AMFBOL "Indicated torque for blue smoke limitation"
 /begin DEF_CHARACTERISTIC c_dri_tqi_bol c_lgrd_tqi_dec_tq_bol c_lgrd_tqi_inc_tq_bol ip_tqi_bol_amp_tco ldpm_tco_ip_mf ldp_amp_ip_mf /end DEF_CHARACTERISTIC
 /begin OUT_MEASUREMENT lv_tqi_slm_bol_plaus tqi_slm_bol /end OUT_MEASUREMENT
/end FUNCTION
/end MODULE
/end PROJECT
