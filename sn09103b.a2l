ASAP2_VERSION 1 41
/begin PROJECT SN0 "SIMOS PPD"
/begin HEADER "_default_HeaderComment" PROJECT_NO PRJ_NUM /end HEADER
/begin MODULE _default_ModuleName "_default_ModuleLongIdentifier"
/begin MOD_COMMON "_default_ModCommonComment" DEPOSIT ABSOLUTE BYTE_ORDER MSB_FIRST ALIGNMENT_BYTE 1 ALIGNMENT_WORD 2 ALIGNMENT_LONG 4 ALIGNMENT_FLOAT32_IEEE 4 ALIGNMENT_FLOAT64_IEEE 8 /end MOD_COMMON
/begin CHARACTERISTIC c_lshpwm_min_lsh_down "Minimum permitted heater effective voltage PWM for downstream LSH OBDII diagnosis " VALUE 0x840e41 _REC_VAL_20_u1 99.609375 _CNV_A_R_LINEAR_____479_CM 0. 99.609375 DISPLAY_IDENTIFIER C_LSHPWM_MIN_LSH_DOWN FORMAT "%9.6" /end CHARACTERISTIC
/begin CHARACTERISTIC c_lshpwm_max_lsh_down "Maximum permitted heater effective voltage PWM for downstream LSH OBDII diagnosis " VALUE 0x840e3d _REC_VAL_20_u1 99.609375 _CNV_A_R_LINEAR_____479_CM 0. 99.609375 DISPLAY_IDENTIFIER C_LSHPWM_MAX_LSH_DOWN FORMAT "%9.6" /end CHARACTERISTIC
/begin CHARACTERISTIC c_teg_cat_down_max_obd_lsh_down "Temperature threshold under which downstream LSH OBDII diagnosis activated" VALUE 0x840f08 _REC_VAL_20_u2 2047. _CNV_A_R_EGCP_LINEA_461_CM 0. 2047. DISPLAY_IDENTIFIER C_TEG_CAT_DOWN_MAX_OBD_LSH_DOWN FORMAT "%9.4" /end CHARACTERISTIC
/begin CHARACTERISTIC c_temp_sp_obd_lsh_down "Set temperature for downstream LSH operation used to generate power integral" VALUE 0x840f20 _REC_VAL_20_u2 2047. _CNV_A_R_EGCP_LINEA_461_CM 0. 2047. DISPLAY_IDENTIFIER C_TEMP_SP_OBD_LSH_DOWN FORMAT "%9.4" /end CHARACTERISTIC
/begin AXIS_PTS ldp_r_it_ls_down_new_lsh_down "" 0x8408c8 online_dummy _REC_AXS_20_u2 65535. _CNV_A_R_LINEAR_____480_CM 4 0. 65535. FORMAT "%5.0" /end AXIS_PTS
/begin CHARACTERISTIC c_t_dly_obd_lsh_down "Minimum delay prior to checking status of OBDI heater / signal faults" VALUE 0x840eb0 _REC_VAL_20_u1 255. _CNV_A_R_LINEAR_____32_CM 0. 255. DISPLAY_IDENTIFIER C_T_DLY_OBD_LSH_DOWN FORMAT "%3.0" /end CHARACTERISTIC
/begin CHARACTERISTIC ip_fac_maf_obd_lsh_down "Factor reflecting forced convection influence of cooling area, gas velocity and heat transfer coefficient" CURVE 0x840b18 _REC_CUR_20_u1_u2 15.9375 _CNV_A_R_EGCP_LINEA_481_CM 0. 15.9375 DISPLAY_IDENTIFIER IP_FAC_MAF_OBD_LSH_DOWN
 /begin AXIS_DESCR COM_AXIS maf_kgh _CNV_A_R_LINEAR_____472_CM 6 0. 2047.96875 FORMAT "%10.5" AXIS_PTS_REF ldpm_maf_kgh_3_egcp /end AXIS_DESCR
/end CHARACTERISTIC
/begin CHARACTERISTIC c_tcc_thd_err_obd_lsh_down "Fault detection threshold, when exceeded, heater is determined to be defective during driving cycle" VALUE 0x840efa _REC_VAL_20_u2 1023. _CNV_A_R_LINEAR_____1_CM 0. 1023. DISPLAY_IDENTIFIER C_TCC_THD_ERR_OBD_LSH_DOWN FORMAT "%4.0" /end CHARACTERISTIC
/begin CHARACTERISTIC c_tcc_thd_obd_lsh_down "Number of valid downstream LSH OBDII diagnosis cycles over which statistic evaluation to be carried out" VALUE 0x840efe _REC_VAL_20_u2 1023. _CNV_A_R_LINEAR_____1_CM 0. 1023. DISPLAY_IDENTIFIER C_TCC_THD_OBD_LSH_DOWN FORMAT "%4.0" /end CHARACTERISTIC
/begin CHARACTERISTIC c_pow_int_min_obd_lsh_down "Measure of minimum required cooling energy required at downstream sensor prior to checking Ri threshold" VALUE 0x840e7e _REC_VAL_20_u2 65535. _CNV_A_R_LINEAR_____482_CM 0. 65535. DISPLAY_IDENTIFIER C_POW_INT_MIN_OBD_LSH_DOWN FORMAT "%5.0" /end CHARACTERISTIC
/begin CHARACTERISTIC ip_r_it_thd_obd_lsh_down "Internal resistance threshold, when exceeded, heater is determined to be defective for current diagnosis cycle" CURVE 0x840c6e _REC_CUR_20_u2_u2 65535. _CNV_A_R_LINEAR_____480_CM 0. 65535. DISPLAY_IDENTIFIER IP_R_IT_THD_OBD_LSH_DOWN FORMAT "%5.0"
 /begin AXIS_DESCR COM_AXIS online_dummy _CNV_A_R_LINEAR_____480_CM 4 0. 65535. FORMAT "%5.0" AXIS_PTS_REF ldp_r_it_ls_down_new_lsh_down /end AXIS_DESCR
/end CHARACTERISTIC
/begin MEASUREMENT lv_err_obd_lsh_down_1 "Boolean flag indicating that diagnosis has been completed" UBYTE _CNV_S_2_RANGE__0___88_CM 1 0. 0. 1. DISPLAY_IDENTIFIER LV_ERR_OBD_LSH_DOWN_1_ ECU_ADDRESS 0x7fb56f BIT_MASK 0x1 /end MEASUREMENT
/begin CHARACTERISTIC c_lshpwm_min_lsh_up "Minimum permitted heater effective voltage PWM for upstream LSH OBD2 diagnosis" VALUE 0x840e42 _REC_VAL_20_u1 99.609375 _CNV_A_R_LINEAR_____479_CM 0. 99.609375 DISPLAY_IDENTIFIER C_LSHPWM_MIN_LSH_UP FORMAT "%9.6" /end CHARACTERISTIC
/begin CHARACTERISTIC c_ttip_min_obd_lsh_up "Lower diagnosis threshold for oxygen sensor ceramic temperature" VALUE 0x840f2c _REC_VAL_20_s2 4095.9375 _CNV_A_R_EGCP_LINEA_461_CM -2048. 2047.9375 DISPLAY_IDENTIFIER C_TTIP_MIN_OBD_LSH_UP FORMAT "%10.4" /end CHARACTERISTIC
/begin CHARACTERISTIC c_ttip_max_obd_lsh_up "Upper diagnosis threshold for oxygen sensor ceramic temperature" VALUE 0x840f26 _REC_VAL_20_s2 4095.9375 _CNV_A_R_EGCP_LINEA_461_CM -2048. 2047.9375 DISPLAY_IDENTIFIER C_TTIP_MAX_OBD_LSH_UP FORMAT "%10.4" /end CHARACTERISTIC
/begin CHARACTERISTIC c_tcc_thd_obd_lsh_up "Number of valid LSH OBD2 diagnosis cycles over which statistic evaluation to be carried out" VALUE 0x840f00 _REC_VAL_20_u2 65535. _CNV_A_R_LINEAR_____1_CM 0. 65535. DISPLAY_IDENTIFIER C_TCC_THD_OBD_LSH_UP FORMAT "%5.0" /end CHARACTERISTIC
/begin CHARACTERISTIC c_tcc_thd_err_obd_lsh_up "Fault detection threshold, when exceeded, heater is determined to be defective during driving cycle" VALUE 0x840efc _REC_VAL_20_u2 65535. _CNV_A_R_LINEAR_____1_CM 0. 65535. DISPLAY_IDENTIFIER C_TCC_THD_ERR_OBD_LSH_UP FORMAT "%5.0" /end CHARACTERISTIC
/begin CHARACTERISTIC lc_obd_rep_lsh_up "Logical constant permitting dignosis to be repeated within onde driving cycle" VALUE 0x840fb4 _REC_VAL_20_u1 1. _CNV_A_R_LINEAR_____1_CM 0. 1. DISPLAY_IDENTIFIER LC_OBD_REP_LSH_UP FORMAT "%1.0" /end CHARACTERISTIC
/begin CHARACTERISTIC ip_t_dly_ls_up_ready_raw_lsh_up "Time after heater management start to exaggerated forced stimulation, if no raw readiness observed" CURVE 0x840cc2 _REC_CUR_20_u2_u2 6553.5 _CNV_A_R_LINEAR_____234_CM 0. 6553.5 DISPLAY_IDENTIFIER IP_T_DLY_LS_UP_READY_RAW_LSH_UP FORMAT "%6.1"
 /begin AXIS_DESCR COM_AXIS online_dummy _CNV_A_R_EGCP_LINEA_462_CM 6 -2048. 2047.9375 FORMAT "%10.4" AXIS_PTS_REF ldpm_temp_ini_ls_up_1_egcp /end AXIS_DESCR
/end CHARACTERISTIC
/begin CHARACTERISTIC ip_t_dly_ls_up_ready_obd_lsh_up "Time threshold after heater management start where fault detected, if no full operative readiness observed" CURVE 0x840cb6 _REC_CUR_20_u2_u2 6553.5 _CNV_A_R_LINEAR_____234_CM 0. 6553.5 DISPLAY_IDENTIFIER IP_T_DLY_LS_UP_READY_OBD_LSH_UP FORMAT "%6.1"
 /begin AXIS_DESCR COM_AXIS online_dummy _CNV_A_R_EGCP_LINEA_462_CM 6 -2048. 2047.9375 FORMAT "%10.4" AXIS_PTS_REF ldpm_temp_ini_ls_up_1_egcp /end AXIS_DESCR
/end CHARACTERISTIC
/begin CHARACTERISTIC lc_obd_lsh_up "Logical constant permitting dignosis to be carried out" VALUE 0x840fb3 _REC_VAL_20_u1 1. _CNV_A_R_LINEAR_____1_CM 0. 1. DISPLAY_IDENTIFIER LC_OBD_LSH_UP FORMAT "%1.0" /end CHARACTERISTIC
/begin CHARACTERISTIC c_t_dly_pow_ctl_obd_lsh_up "Minimum delay prior to checking status of OBD1 heater /signal faults" VALUE 0x840eb3 _REC_VAL_20_u1 255. _CNV_A_R_LINEAR_____32_CM 0. 255. DISPLAY_IDENTIFIER C_T_DLY_POW_CTL_OBD_LSH_UP FORMAT "%3.0" /end CHARACTERISTIC
/begin CHARACTERISTIC c_t_dly_ttip_mes_obd_lsh_up "Time delay after TTIP_ERR_MES symptom valid to set error flag" VALUE 0x840eb6 _REC_VAL_20_u1 255. _CNV_A_R_LINEAR_____32_CM 0. 255. DISPLAY_IDENTIFIER C_T_DLY_TTIP_MES_OBD_LSH_UP FORMAT "%3.0" /end CHARACTERISTIC
/begin CHARACTERISTIC c_t_dly_ttip_res_obd_lsh_up "Time delay to reset TTIP_ERR_MES timer" VALUE 0x840eb7 _REC_VAL_20_u1 255. _CNV_A_R_LINEAR_____32_CM 0. 255. DISPLAY_IDENTIFIER C_T_DLY_TTIP_RES_OBD_LSH_UP FORMAT "%3.0" /end CHARACTERISTIC
/begin MEASUREMENT egcp[0].egcp_struct_outdglsh0.err_diag_lsh_up "diagnosis condition for each symptom of upstream heater diagnosis OBD I" UBYTE _CNV_A_R_LINEAR_____0_CM 1 0. 0. 7. DISPLAY_IDENTIFIER ERR_DIAG_LSH_UP_1_ ECU_ADDRESS 0x7f953a FORMAT "%1.0" /end MEASUREMENT
/begin MEASUREMENT egcp[0].egcp_struct_outdglsh0.cdn_diag_lsh_up "Diagnosis condition for each symptom of upstream heater diagnosis OBD I" UBYTE _CNV_A_R_LINEAR_____0_CM 1 0. 0. 7. DISPLAY_IDENTIFIER CDN_DIAG_LSH_UP_1_ ECU_ADDRESS 0x7f953b FORMAT "%1.0" /end MEASUREMENT
/begin MEASUREMENT egcp[0].egcp_struct_outdglsh0.lv_lsh_scg_act_lsh_up "Boolean flag indicating that debounce for upstream heater OBD I SCG diagnosis active" UBYTE _CNV_S_2_RANGE__0___88_CM 1 0. 0. 1. DISPLAY_IDENTIFIER LV_LSH_SCG_ACT_LSH_UP_1_ ECU_ADDRESS 0x7f953c /end MEASUREMENT
/begin MEASUREMENT egcp[0].egcp_struct_outdglshi0.lv_inh_diag_lsh_up "Inhibit flag for upstream oxygen sensor heater OBDI diagnosis" UBYTE _CNV_S_2_RANGE__0___88_CM 1 0. 0. 1. DISPLAY_IDENTIFIER LV_INH_DIAG_LSH_UP_1_ ECU_ADDRESS 0x7f953d BIT_MASK 0x1 /end MEASUREMENT
/begin MEASUREMENT egcp[0].egcp_struct_outdglshd0.err_diag_lsh_down "raw value of error symptom for downstream heater diagnosis OBD I" UBYTE _CNV_A_R_LINEAR_____0_CM 1 0. 0. 7. DISPLAY_IDENTIFIER ERR_DIAG_LSH_DOWN_1_ ECU_ADDRESS 0x7f953e FORMAT "%1.0" /end MEASUREMENT
/begin MEASUREMENT egcp[0].egcp_struct_outdglshd0.cdn_diag_lsh_down "Diagnosis condition for each symptom of downstream heater diagnosis OBD I" UBYTE _CNV_A_R_LINEAR_____0_CM 1 0. 0. 7. DISPLAY_IDENTIFIER CDN_DIAG_LSH_DOWN_1_ ECU_ADDRESS 0x7f953f FORMAT "%1.0" /end MEASUREMENT
/begin MEASUREMENT egcp[0].egcp_struct_outdglshdi0.lv_inh_diag_lsh_down "Inhibit flag for downstream oxygen sensor heater OBDI diagnosis" UBYTE _CNV_S_2_RANGE__0___88_CM 1 0. 0. 1. DISPLAY_IDENTIFIER LV_INH_DIAG_LSH_DOWN_1_ ECU_ADDRESS 0x7f9540 BIT_MASK 0x1 /end MEASUREMENT
/begin MEASUREMENT egcp[0].egcp_struct_pladglsd2.lv_diag_cdn_plaus_ls_down "Boolean flag, plausibility check on downstream oxygen sensor signal possible" UBYTE _CNV_S_2_RANGE__0___88_CM 1 0. 0. 1. DISPLAY_IDENTIFIER LV_DIAG_CDN_PLAUS_LS_DOWN_1_ ECU_ADDRESS 0x7f9541 BIT_MASK 0x1 /end MEASUREMENT
/begin MEASUREMENT egcp[0].egcp_struct_pladglsd2.lv_err_plaus_ls_down "Boolean flag, error plausibility check on downstream oxygen sensor signal" UBYTE _CNV_S_2_RANGE__0___88_CM 1 0. 0. 1. DISPLAY_IDENTIFIER LV_ERR_PLAUS_LS_DOWN_1_ ECU_ADDRESS 0x7f9542 BIT_MASK 0x1 /end MEASUREMENT
/begin MEASUREMENT egcp[0].egcp_struct_pladgspi0.ctr_err_save_diag_lsl_up_if "Number of communication errors during the WRAF sensor controller initialization " UBYTE _CNV_A_R_LINEAR_____1_CM 1 0. 0. 255. DISPLAY_IDENTIFIER CTR_ERR_SAVE_DIAG_LSL_UP_IF_1_ ECU_ADDRESS 0x7f9543 FORMAT "%3.0" /end MEASUREMENT
/begin MEASUREMENT egcp[0].egcp_struct_pladgspii0.lv_inh_diag_lsl_up_if "Inhibit diagnosis" UBYTE _CNV_S_2_RANGE__0___88_CM 1 0. 0. 1. DISPLAY_IDENTIFIER LV_INH_DIAG_LSL_UP_IF_1_ ECU_ADDRESS 0x7f9544 BIT_MASK 0x1 /end MEASUREMENT
/begin MEASUREMENT egcp[0].egcp_struct_sigcvif2.state_lsl_if_spi_wr "Bit-field mapping of contents to be written to ATIC42 INIT_REG_1" UBYTE _CNV_A_R_LINEAR_____1_CM 1 0. 0. 255. DISPLAY_IDENTIFIER STATE_LSL_IF_SPI_WR_1_ ECU_ADDRESS 0x7f9553 FORMAT "%3.0" /end MEASUREMENT
/begin MEASUREMENT egcp[0].egcp_struct_sigcvif2.state_lsl_if_conf_spi_wr "Mapping of contents to be written to ATIC42 INIT_REG_1" UBYTE _CNV_A_R_LINEAR_____1_CM 1 0. 0. 255. DISPLAY_IDENTIFIER STATE_LSL_IF_CONF_SPI_WR_1_ ECU_ADDRESS 0x7f9554 FORMAT "%3.0" /end MEASUREMENT
/begin MEASUREMENT egcp[0].egcp_struct_sigcvif2.lv_lsl_if_spi_rst_end "Boolean flag indicating general status of  ATIC42 initialisation after RESET" UBYTE _CNV_S_2_RANGE__0___88_CM 1 0. 0. 1. DISPLAY_IDENTIFIER LV_LSL_IF_SPI_RST_END_1_ ECU_ADDRESS 0x7f9555 BIT_MASK 0x1 /end MEASUREMENT
/begin MEASUREMENT egcp[0].egcp_struct_sigcvifi2.t_dly_di_lsl_if "Configuration of the Sensor Protection Time" UBYTE _CNV_A_R_LINEAR_____0_CM 1 0. 0. 7. DISPLAY_IDENTIFIER T_DLY_DI_LSL_IF_1_ ECU_ADDRESS 0x7f9556 FORMAT "%1.0" /end MEASUREMENT
/begin MEASUREMENT egcp[0].egcp_struct_sigcvifi2.lv_lsl_ena_lsl_if "Boolean flag to enable/disable WRAF sensor connection" UBYTE _CNV_S_2_RANGE__0___88_CM 1 0. 0. 1. DISPLAY_IDENTIFIER LV_LSL_ENA_LSL_IF_1_ ECU_ADDRESS 0x7f9557 BIT_MASK 0x1 /end MEASUREMENT
/begin MEASUREMENT egcp[0].egcp_struct_sigcvifi2.lv_lsl_if_rst "Boolean flag to reset the ATIC42" UBYTE _CNV_S_2_RANGE__0___88_CM 1 0. 0. 1. DISPLAY_IDENTIFIER LV_LSL_IF_RST_1_ ECU_ADDRESS 0x7f9558 BIT_MASK 0x1 /end MEASUREMENT
/begin MEASUREMENT egcp[0].egcp_struct_sigcvifi2.lv_swi_gain_lsl_if "Boolean flag configuring the WRAF sensor interface gain-selection" UBYTE _CNV_S_2_RANGE__0___88_CM 1 0. 0. 1. DISPLAY_IDENTIFIER LV_SWI_GAIN_LSL_IF_1_ ECU_ADDRESS 0x7f9559 BIT_MASK 0x1 /end MEASUREMENT
/begin MEASUREMENT egcp[0].egcp_struct_sigcvifi2.lv_lsl_ena_tmp_lsl_if "Temporary storage variable for content of WRAF sensor enable bit" UBYTE _CNV_S_2_RANGE__0___88_CM 1 0. 0. 1. DISPLAY_IDENTIFIER LV_LSL_ENA_TMP_LSL_IF_1_ ECU_ADDRESS 0x7f955a BIT_MASK 0x1 /end MEASUREMENT
/begin MEASUREMENT egcp[0].egcp_struct_sigcvridi0.lv_inh_r_it_ls_down "Boolean flag indicating that downstream sensor internal resistance determination shall be inhibited when set" UBYTE _CNV_S_2_RANGE__0___88_CM 1 0. 0. 1. DISPLAY_IDENTIFIER LV_INH_R_IT_LS_DOWN_1_ ECU_ADDRESS 0x7f959e BIT_MASK 0x1 /end MEASUREMENT
/begin MEASUREMENT egcp[0].egcp_struct_sigcvtipa0.ttip_mes_ls_up "Oxygen sensor ceramic temperature" SWORD _CNV_A_R_EGCP_LINEA_461_CM 1 0. -2048. 2047.9375 DISPLAY_IDENTIFIER TTIP_MES_LS_UP_1_ ECU_ADDRESS 0x7f95a0 BYTE_ORDER MSB_LAST FORMAT "%10.4" /end MEASUREMENT
/begin MEASUREMENT egcp[0].egcp_struct_sigcvtipa0.r_it_ls_up "Oxygen sensor element internal resistance" UWORD _CNV_A_R_EGCP_LINEA_459_CM 1 0. 0. 16383.75 DISPLAY_IDENTIFIER R_IT_LS_UP_1_ ECU_ADDRESS 0x7f95a2 BYTE_ORDER MSB_LAST FORMAT "%9.2" /end MEASUREMENT
/begin MEASUREMENT egcp[0].egcp_struct_sigcvtipa0.tcc_v_ofs_mes_r_it_ls_up "Counter incremented for every measured offset voltage in resistance measurement mode" UWORD _CNV_A_R_LINEAR_____1_CM 1 0. 0. 65535. DISPLAY_IDENTIFIER TCC_V_OFS_MES_R_IT_LS_UP_1_ ECU_ADDRESS 0x7f95a4 BYTE_ORDER MSB_LAST FORMAT "%5.0" /end MEASUREMENT
/begin MEASUREMENT egcp[0].egcp_struct_sigcvtipa0.tcc_v_ofs_adj_r_it_ls_up "Counter incremented for every offset voltage in resistance adjust mode" UWORD _CNV_A_R_LINEAR_____1_CM 1 0. 0. 65535. DISPLAY_IDENTIFIER TCC_V_OFS_ADJ_R_IT_LS_UP_1_ ECU_ADDRESS 0x7f95a6 BYTE_ORDER MSB_LAST FORMAT "%5.0" /end MEASUREMENT
/begin MEASUREMENT egcp[0].egcp_struct_sigcvtipa0.tcc_fac_gain_h_r_it_ls_up "Counter incremented for every high gain adjust measurement" UWORD _CNV_A_R_LINEAR_____1_CM 1 0. 0. 65535. DISPLAY_IDENTIFIER TCC_FAC_GAIN_H_R_IT_LS_UP_1_ ECU_ADDRESS 0x7f95a8 BYTE_ORDER MSB_LAST FORMAT "%5.0" /end MEASUREMENT
/begin MEASUREMENT egcp[0].egcp_struct_sigcvtipa0.tcc_fac_gain_l_r_it_ls_up "Counter incremented for every low gain adjust measurement" UWORD _CNV_A_R_LINEAR_____1_CM 1 0. 0. 65535. DISPLAY_IDENTIFIER TCC_FAC_GAIN_L_R_IT_LS_UP_1_ ECU_ADDRESS 0x7f95aa BYTE_ORDER MSB_LAST FORMAT "%5.0" /end MEASUREMENT
/begin MEASUREMENT egcp[0].egcp_struct_sigcvtipa0.tcc_err_v_ofs_mes_r_it_ls_up "Counter incremented for every invalid offset voltage in resistance measurement mode" UWORD _CNV_A_R_LINEAR_____1_CM 1 0. 0. 65535. DISPLAY_IDENTIFIER TCC_ERR_V_OFS_MES_R_IT_LS_UP_1_ ECU_ADDRESS 0x7f95ac BYTE_ORDER MSB_LAST FORMAT "%5.0" /end MEASUREMENT
/begin MEASUREMENT egcp[0].egcp_struct_sigcvtipa0.tcc_err_v_ofs_adj_r_it_ls_up "Counter incremented for every invalid offset voltage in resistance adjust mode" UWORD _CNV_A_R_LINEAR_____1_CM 1 0. 0. 65535. DISPLAY_IDENTIFIER TCC_ERR_V_OFS_ADJ_R_IT_LS_UP_1_ ECU_ADDRESS 0x7f95ae BYTE_ORDER MSB_LAST FORMAT "%5.0" /end MEASUREMENT
/begin MEASUREMENT egcp[0].egcp_struct_sigcvtipa0.tcc_err_fac_gain_h_r_ls_up "Counter incremented for every invalid high gain adjust measurement" UWORD _CNV_A_R_LINEAR_____1_CM 1 0. 0. 65535. DISPLAY_IDENTIFIER TCC_ERR_FAC_GAIN_H_R_LS_UP_1_ ECU_ADDRESS 0x7f95b0 BYTE_ORDER MSB_LAST FORMAT "%5.0" /end MEASUREMENT
/begin MEASUREMENT egcp[0].egcp_struct_sigcvtipa0.tcc_err_fac_gain_l_r_ls_up "Counter incremented for every invalid low gain adjust measurement" UWORD _CNV_A_R_LINEAR_____1_CM 1 0. 0. 65535. DISPLAY_IDENTIFIER TCC_ERR_FAC_GAIN_L_R_LS_UP_1_ ECU_ADDRESS 0x7f95b2 BYTE_ORDER MSB_LAST FORMAT "%5.0" /end MEASUREMENT
/begin MEASUREMENT egcp[0].egcp_struct_sigcvtipa0.v_ofs_adj_r_it_ls_up "Internal resistance determination circuit offset in resistance adjust mode" UWORD _CNV_A_R_EGCP_LINEA_502_CM 1 0. 0. 4.995 DISPLAY_IDENTIFIER V_OFS_ADJ_R_IT_LS_UP_1_ ECU_ADDRESS 0x7f95b4 BYTE_ORDER MSB_LAST FORMAT "%5.3" /end MEASUREMENT
/begin MEASUREMENT egcp[0].egcp_struct_sigcvtipa0.v_ofs_mes_r_it_ls_up "Internal resistance determination circuit offset in resistance measurement mode" UWORD _CNV_A_R_EGCP_LINEA_502_CM 1 0. 0. 4.995 DISPLAY_IDENTIFIER V_OFS_MES_R_IT_LS_UP_1_ ECU_ADDRESS 0x7f95b6 BYTE_ORDER MSB_LAST FORMAT "%5.3" /end MEASUREMENT
/begin MEASUREMENT egcp[0].egcp_struct_sigcvtipa0.fac_gain_h_r_it_ls_up "High gain of oxygen sensor internal resistance determination circuit" UWORD _CNV_A_R_EGCP_LINEA_503_CM 1 0. 0. 23.999634 DISPLAY_IDENTIFIER FAC_GAIN_H_R_IT_LS_UP_1_ ECU_ADDRESS 0x7f95b8 BYTE_ORDER MSB_LAST FORMAT "%7.4" /end MEASUREMENT
/begin MEASUREMENT egcp[0].egcp_struct_sigcvtipa0.fac_gain_l_r_it_ls_up "Low gain of oxygen sensor internal resistance determination circuit" UWORD _CNV_A_R_EGCP_LINEA_503_CM 1 0. 0. 23.999634 DISPLAY_IDENTIFIER FAC_GAIN_L_R_IT_LS_UP_1_ ECU_ADDRESS 0x7f95ba BYTE_ORDER MSB_LAST FORMAT "%7.4" /end MEASUREMENT
/begin MEASUREMENT egcp[0].egcp_struct_sigcvtipa0.frq_r_it_osc_lsl_if_spi_wr "Variable indicating coded information for requested Ri determination oscillator frequency" UBYTE _CNV_A_R_LINEAR_____1_CM 1 0. 0. 127. DISPLAY_IDENTIFIER FRQ_R_IT_OSC_LSL_IF_SPI_WR_1_ ECU_ADDRESS 0x7f95bc FORMAT "%3.0" /end MEASUREMENT
/begin MEASUREMENT egcp[0].egcp_struct_sigcvtipa0.state_ttip_mes_ls_up "State variable indicating current state of function" UBYTE _CNV_S_5_EGCP_RANGE_504_CM 1 0. 0. 4. DISPLAY_IDENTIFIER STATE_TTIP_MES_LS_UP_1_ ECU_ADDRESS 0x7f95bd /end MEASUREMENT
/begin MEASUREMENT egcp[0].egcp_struct_sigcvtipa0.lv_fac_gain_h_vld_r_it_ls_up "Boolean flag indicating measured high gain valid" UBYTE _CNV_S_2_RANGE__0___88_CM 1 0. 0. 1. DISPLAY_IDENTIFIER LV_FAC_GAIN_H_VLD_R_IT_LS_UP_1_ ECU_ADDRESS 0x7f95be BIT_MASK 0x1 /end MEASUREMENT
/begin MEASUREMENT egcp[0].egcp_struct_sigcvtipa0.lv_fac_gain_l_vld_r_it_ls_up "Boolean flag indicating measured low gain valid" UBYTE _CNV_S_2_RANGE__0___88_CM 1 0. 0. 1. DISPLAY_IDENTIFIER LV_FAC_GAIN_L_VLD_R_IT_LS_UP_1_ ECU_ADDRESS 0x7f95bf BIT_MASK 0x1 /end MEASUREMENT
/begin MEASUREMENT egcp[0].egcp_struct_sigcvtipa0.lv_r_it_cal_ena_lsl_if "Boolean flag requesting WRAF interface internal resistance adjust mode to be enabled" UBYTE _CNV_S_2_RANGE__0___88_CM 1 0. 0. 1. DISPLAY_IDENTIFIER LV_R_IT_CAL_ENA_LSL_IF_1_ ECU_ADDRESS 0x7f95c0 BIT_MASK 0x1 /end MEASUREMENT
/begin MEASUREMENT egcp[0].egcp_struct_sigcvtipa0.lv_r_it_osc_ena_lsl_if "Boolean flag requesting WRAF interface internal oscillator to be enabled" UBYTE _CNV_S_2_RANGE__0___88_CM 1 0. 0. 1. DISPLAY_IDENTIFIER LV_R_IT_OSC_ENA_LSL_IF_1_ ECU_ADDRESS 0x7f95c1 BIT_MASK 0x1 /end MEASUREMENT
/begin MEASUREMENT egcp[0].egcp_struct_sigcvtipa0.lv_r_it_swi_rng_lsl_if "Boolean flag requesting WRAF interface to select internal resistance gain (range)" UBYTE _CNV_S_2_RANGE__0___88_CM 1 0. 0. 1. DISPLAY_IDENTIFIER LV_R_IT_SWI_RNG_LSL_IF_1_ ECU_ADDRESS 0x7f95c2 BIT_MASK 0x1 /end MEASUREMENT
/begin MEASUREMENT egcp[0].egcp_struct_sigcvtipa0.lv_ttip_mes_vld_ls_up "Boolean flag indicating validity of oxygen sensor ceramic temperature TTIP_MES_LS_UP[NC_CBK_EX_NR]" UBYTE _CNV_S_2_RANGE__0___88_CM 1 0. 0. 1. DISPLAY_IDENTIFIER LV_TTIP_MES_VLD_LS_UP_1_ ECU_ADDRESS 0x7f95c3 BIT_MASK 0x1 /end MEASUREMENT
/begin MEASUREMENT egcp[0].egcp_struct_sigcvtipa0.lv_v_ofs_adj_vld_r_it_ls_up "Boolean flag indicating offset in resistance adjust mode valid" UBYTE _CNV_S_2_RANGE__0___88_CM 1 0. 0. 1. DISPLAY_IDENTIFIER LV_V_OFS_ADJ_VLD_R_IT_LS_UP_1_ ECU_ADDRESS 0x7f95c4 BIT_MASK 0x1 /end MEASUREMENT
/begin MEASUREMENT egcp[0].egcp_struct_sigcvtipa0.lv_v_ofs_mes_vld_r_it_ls_up "Boolean flag indicating offset in resistance measurement mode valid" UBYTE _CNV_S_2_RANGE__0___88_CM 1 0. 0. 1. DISPLAY_IDENTIFIER LV_V_OFS_MES_VLD_R_IT_LS_UP_1_ ECU_ADDRESS 0x7f95c5 BIT_MASK 0x1 /end MEASUREMENT
/begin MEASUREMENT egcp[0].egcp_struct_sigcvtipa0.lv_v_ref_vld_r_it_ls_up "Boolean flag indicating internal resistance determination circuit references valid" UBYTE _CNV_S_2_RANGE__0___88_CM 1 0. 0. 1. DISPLAY_IDENTIFIER LV_V_REF_VLD_R_IT_LS_UP_1_ ECU_ADDRESS 0x7f95c6 BIT_MASK 0x1 /end MEASUREMENT
/begin MEASUREMENT egcp[0].egcp_struct_sigcvtipa0.lv_r_it_req_ls_up "Boolean flag indicating that conditions have been met and resistance determination requested" UBYTE _CNV_S_2_RANGE__0___88_CM 1 0. 0. 1. DISPLAY_IDENTIFIER LV_R_IT_REQ_LS_UP_1_ ECU_ADDRESS 0x7f95c7 BIT_MASK 0x1 /end MEASUREMENT
/begin MEASUREMENT egcp[0].egcp_struct_sigcvtipai0.lv_inh_ttip_ls_up "Boolean flag indicating that upstream oxygen sensor ceramic temperature determination shall be inhibited " UBYTE _CNV_S_2_RANGE__0___88_CM 1 0. 0. 1. DISPLAY_IDENTIFIER LV_INH_TTIP_LS_UP_1_ ECU_ADDRESS 0x7f95c8 BIT_MASK 0x1 /end MEASUREMENT
/begin MEASUREMENT egcp[0].egcp_struct_sigdglsd1.t_act_pls_diag_scg_ls_down "Delay time for final diagnosis activation " UWORD _CNV_A_R_LINEAR_____234_CM 1 0. 0. 6553.5 DISPLAY_IDENTIFIER T_ACT_PLS_DIAG_SCG_LS_DOWN_1_ ECU_ADDRESS 0x7f95ca BYTE_ORDER MSB_LAST FORMAT "%6.1" /end MEASUREMENT
/begin MEASUREMENT egcp[0].egcp_struct_sigdglsd1.t_act_pls_diag_oc_ls_down "Delay time for final diagnosis activation " UWORD _CNV_A_R_LINEAR_____234_CM 1 0. 0. 6553.5 DISPLAY_IDENTIFIER T_ACT_PLS_DIAG_OC_LS_DOWN_1_ ECU_ADDRESS 0x7f95cc BYTE_ORDER MSB_LAST FORMAT "%6.1" /end MEASUREMENT
/begin MEASUREMENT egcp[0].egcp_struct_sigdglsd1.t_cdn_diag_oc_ls_down "Detection time for status OC before diagnosis" UWORD _CNV_A_R_LINEAR_____234_CM 1 0. 0. 6553.5 DISPLAY_IDENTIFIER T_CDN_DIAG_OC_LS_DOWN_1_ ECU_ADDRESS 0x7f95ce BYTE_ORDER MSB_LAST FORMAT "%6.1" /end MEASUREMENT
/begin MEASUREMENT egcp[0].egcp_struct_sigdglsd1.ctr_r_upd_diag_scg_ls_down "Value of handshake counter for last valid resistance value used for short circuit to ground diagnosis" UWORD _CNV_A_R_LINEAR_____1_CM 1 0. 0. 65535. DISPLAY_IDENTIFIER CTR_R_UPD_DIAG_SCG_LS_DOWN_1_ ECU_ADDRESS 0x7f95d0 BYTE_ORDER MSB_LAST FORMAT "%5.0" /end MEASUREMENT
/begin MEASUREMENT egcp[0].egcp_struct_sigdglsd1.ctr_r_upd_diag_oc_ls_down "Value of handshake counter for last valid resistance value used for diagnosis" UWORD _CNV_A_R_LINEAR_____1_CM 1 0. 0. 65535. DISPLAY_IDENTIFIER CTR_R_UPD_DIAG_OC_LS_DOWN_1_ ECU_ADDRESS 0x7f95d2 BYTE_ORDER MSB_LAST FORMAT "%5.0" /end MEASUREMENT
/begin MEASUREMENT egcp[0].egcp_struct_sigdglsd1.ctr_sym_diag_scg_ls_down "Detection time for SCG " UBYTE _CNV_A_R_LINEAR_____1_CM 1 0. 0. 255. DISPLAY_IDENTIFIER CTR_SYM_DIAG_SCG_LS_DOWN_1_ ECU_ADDRESS 0x7f95d4 FORMAT "%3.0" /end MEASUREMENT
/begin MEASUREMENT egcp[0].egcp_struct_sigdglsd1.lv_err_el_ls_down "Boolean error flag, electrical fault currently present on downstream oxygen sensor signal" UBYTE _CNV_S_2_RANGE__0___88_CM 1 0. 0. 1. DISPLAY_IDENTIFIER LV_ERR_EL_LS_DOWN_1_ ECU_ADDRESS 0x7f95d5 BIT_MASK 0x1 /end MEASUREMENT
/begin MEASUREMENT egcp[0].egcp_struct_sigdglsd1.lv_diag_act_req_ls_down "Request for starting the downstream sensor active plausibility check" UBYTE _CNV_S_2_RANGE__0___88_CM 1 0. 0. 1. DISPLAY_IDENTIFIER LV_DIAG_ACT_REQ_LS_DOWN_1_ ECU_ADDRESS 0x7f95d6 BIT_MASK 0x1 /end MEASUREMENT
/begin MEASUREMENT egcp[0].egcp_struct_sigdglsd1.lv_r_it_vld_diag_oc_ls_down "Valid conditions of resistance of downstream oxygen sensor open circuit diagnosis" UBYTE _CNV_S_2_RANGE__0___88_CM 1 0. 0. 1. DISPLAY_IDENTIFIER LV_R_IT_VLD_DIAG_OC_LS_DOWN_1_ ECU_ADDRESS 0x7f95d7 BIT_MASK 0x1 /end MEASUREMENT
/begin MEASUREMENT egcp[0].egcp_struct_sigdglsd1.lv_t_cdn_diag_oc_ls_down "Boolean error flag, short to plus fault currently present on downstream oxygen sensor signal" UBYTE _CNV_S_2_RANGE__0___88_CM 1 0. 0. 1. DISPLAY_IDENTIFIER LV_T_CDN_DIAG_OC_LS_DOWN_1_ ECU_ADDRESS 0x7f95d8 BIT_MASK 0x1 /end MEASUREMENT
/begin MEASUREMENT egcp[0].egcp_struct_sigdglsdi1.lv_inh_diag_oc_ls_down "Boolean flag indicating project specific application conditions for downstream open line diagnosis not met" UBYTE _CNV_S_2_RANGE__0___88_CM 1 0. 0. 1. DISPLAY_IDENTIFIER LV_INH_DIAG_OC_LS_DOWN_1_ ECU_ADDRESS 0x7f95da BIT_MASK 0x1 /end MEASUREMENT
/begin MEASUREMENT egcp[0].egcp_struct_sigdglsdi1.lv_inh_diag_puc_ls_down "Boolean flag indicating project specific application conditions for downstream PUC diagnosis not met" UBYTE _CNV_S_2_RANGE__0___88_CM 1 0. 0. 1. DISPLAY_IDENTIFIER LV_INH_DIAG_PUC_LS_DOWN_1_ ECU_ADDRESS 0x7f95db BIT_MASK 0x1 /end MEASUREMENT
/begin MEASUREMENT egcp[0].egcp_struct_sigdglsdi1.lv_inh_diag_fl_ls_down "Boolean flag indicating project specific application conditions for downstream FL diagnosis not met" UBYTE _CNV_S_2_RANGE__0___88_CM 1 0. 0. 1. DISPLAY_IDENTIFIER LV_INH_DIAG_FL_LS_DOWN_1_ ECU_ADDRESS 0x7f95dc BIT_MASK 0x1 /end MEASUREMENT
/begin MEASUREMENT egcp[0].egcp_struct_sigdglsdi1.lv_inh_diag_scg_ls_down "Boolean flag indicating project specific application conditions for downstream SCG diagnosis not met" UBYTE _CNV_S_2_RANGE__0___88_CM 1 0. 0. 1. DISPLAY_IDENTIFIER LV_INH_DIAG_SCG_LS_DOWN_1_ ECU_ADDRESS 0x7f95dd BIT_MASK 0x1 /end MEASUREMENT
/begin MEASUREMENT egcp[0].egcp_struct_sigdglsdi1.lv_inh_diag_scp_ls_down "Boolean flag indicating project specific application conditions for downstream short to plus diagnosis not met" UBYTE _CNV_S_2_RANGE__0___88_CM 1 0. 0. 1. DISPLAY_IDENTIFIER LV_INH_DIAG_SCP_LS_DOWN_1_ ECU_ADDRESS 0x7f95de BIT_MASK 0x1 /end MEASUREMENT
/begin MEASUREMENT egcp[0].egcp_struct_sigdglsla0.ctr_iplsl_sym_diag_lsl_up "Error debounce counter" UWORD _CNV_A_R_LINEAR_____1_CM 1 0. 0. 65535. DISPLAY_IDENTIFIER CTR_IPLSL_SYM_DIAG_LSL_UP_1_ ECU_ADDRESS 0x7f95e0 BYTE_ORDER MSB_LAST FORMAT "%5.0" /end MEASUREMENT
/begin MEASUREMENT egcp[0].egcp_struct_sigdglsla0.t_diag_oc_lsl_up "Open Circuit Diagnosis Timer" UWORD _CNV_A_R_LINEAR_____234_CM 1 0. 0. 6553.5 DISPLAY_IDENTIFIER T_DIAG_OC_LSL_UP_1_ ECU_ADDRESS 0x7f95e2 BYTE_ORDER MSB_LAST FORMAT "%6.1" /end MEASUREMENT
/begin MEASUREMENT egcp[0].egcp_struct_sigdglsla0.t_vls_up_min_diag_oc_lsl_up "Timer for LSL signal under voltage" UWORD _CNV_A_R_LINEAR_____234_CM 1 0. 0. 6553.5 DISPLAY_IDENTIFIER T_VLS_UP_MIN_DIAG_OC_LSL_UP_1_ ECU_ADDRESS 0x7f95e4 BYTE_ORDER MSB_LAST FORMAT "%6.1" /end MEASUREMENT
/begin MEASUREMENT egcp[0].egcp_struct_sigdglsla0.iplsl_sym_diag_lsl_up "Symptoms of the WRAF sensor Pump Current Controller Diagnosis" UBYTE _CNV_S_3_EGCP_RANGE_505_CM 1 0. 0. 2. DISPLAY_IDENTIFIER IPLSL_SYM_DIAG_LSL_UP_1_ ECU_ADDRESS 0x7f95e6 /end MEASUREMENT
/begin MEASUREMENT egcp[0].egcp_struct_sigdglsla0.state_err_el_lsl_up "State to get visible the separate OBD-I failures" UBYTE _CNV_S_11_EGCP_RANGE_506_CM 1 0. 0. 10. DISPLAY_IDENTIFIER STATE_ERR_EL_LSL_UP_1_ ECU_ADDRESS 0x7f95e7 /end MEASUREMENT
/begin MEASUREMENT egcp[0].egcp_struct_sigdglsla0.state_diag_oc_lsl_up "Status of the LSL Open Circuit Diagnosis" UBYTE _CNV_S_3_EGCP_RANGE_507_CM 1 0. 0. 2. DISPLAY_IDENTIFIER STATE_DIAG_OC_LSL_UP_1_ ECU_ADDRESS 0x7f95e8 /end MEASUREMENT
/begin MEASUREMENT egcp[0].egcp_struct_sigdglsla0.lv_lsl_up_spi_com_inh "Inhibit bit for the SPI-communication" UBYTE _CNV_S_2_RANGE__0___88_CM 1 0. 0. 1. DISPLAY_IDENTIFIER LV_LSL_UP_SPI_COM_INH_1_ ECU_ADDRESS 0x7f95e9 BIT_MASK 0x1 /end MEASUREMENT
/begin MEASUREMENT egcp[0].egcp_struct_sigdglsla0.lv_diag_iplsl_sym_lsl_up "Pump Current Controller in Limitation for too long time" UBYTE _CNV_S_2_RANGE__0___88_CM 1 0. 0. 1. DISPLAY_IDENTIFIER LV_DIAG_IPLSL_SYM_LSL_UP_1_ ECU_ADDRESS 0x7f95ea BIT_MASK 0x1 /end MEASUREMENT
/begin MEASUREMENT egcp[0].egcp_struct_sigdglsla0.lv_diag_iplsl_cdn_lsl_up "Conditions to run the WRAF sensor Pump Current Controller Diagnosis" UBYTE _CNV_S_2_RANGE__0___88_CM 1 0. 0. 1. DISPLAY_IDENTIFIER LV_DIAG_IPLSL_CDN_LSL_UP_1_ ECU_ADDRESS 0x7f95eb BIT_MASK 0x1 /end MEASUREMENT
/begin MEASUREMENT egcp[0].egcp_struct_sigdglsla0.lv_diag_oc_if_osc_di_lsl_up "Request stop oscillator used to determine sensor internal resistance" UBYTE _CNV_S_2_RANGE__0___88_CM 1 0. 0. 1. DISPLAY_IDENTIFIER LV_DIAG_OC_IF_OSC_DI_LSL_UP_1_ ECU_ADDRESS 0x7f95ec BIT_MASK 0x1 /end MEASUREMENT
/begin MEASUREMENT egcp[0].egcp_struct_sigdglsla0.lv_vls_up_min_diag_oc_lsl_up "Bit indicating LSL undervoltage " UBYTE _CNV_S_2_RANGE__0___88_CM 1 0. 0. 1. DISPLAY_IDENTIFIER LV_VLS_UP_MIN_DIAG_OC_LSL_UP_1_ ECU_ADDRESS 0x7f95ed BIT_MASK 0x1 /end MEASUREMENT
/begin MEASUREMENT egcp[0].egcp_struct_sigdglslai0.lv_inh_diag_el_lsl_up "Deactivation of \"HW-Based Diagnosis with the CJ120\"" UBYTE _CNV_S_2_RANGE__0___88_CM 1 0. 0. 1. DISPLAY_IDENTIFIER LV_INH_DIAG_EL_LSL_UP_1_ ECU_ADDRESS 0x7f95ee BIT_MASK 0x1 /end MEASUREMENT
/begin MEASUREMENT egcp[0].egcp_struct_sigdglslai0.lv_inh_diag_oc_lsl_up "Deactivation of \"Open Circuit Diagnosis\"" UBYTE _CNV_S_2_RANGE__0___88_CM 1 0. 0. 1. DISPLAY_IDENTIFIER LV_INH_DIAG_OC_LSL_UP_1_ ECU_ADDRESS 0x7f95ef BIT_MASK 0x1 /end MEASUREMENT
/begin MEASUREMENT egcp[0].egcp_struct_sigdglslai0.lv_iplsl_diag_inh_lsl_up "Deactivation of \"HW-Based Diagnosis with the CJ120\"" UBYTE _CNV_S_2_RANGE__0___88_CM 1 0. 0. 1. DISPLAY_IDENTIFIER LV_IPLSL_DIAG_INH_LSL_UP_1_ ECU_ADDRESS 0x7f95f0 BIT_MASK 0x1 /end MEASUREMENT
/begin MEASUREMENT egcp[0].egcp_struct_pladgft0.lamb_delta_i_save_diag "I-share from trim controller  - to be transmitted to the Scan Tool mode06" SWORD _CNV_A_R_LINEAR_____499_CM 1 0. -0.125 0.125 DISPLAY_IDENTIFIER LAMB_DELTA_I_SAVE_DIAG_1_ ECU_ADDRESS 0x7f95f2 BYTE_ORDER MSB_LAST FORMAT "%8.5" /end MEASUREMENT
/begin MEASUREMENT egcp[0].egcp_struct_pladgft0.lam_mmv_vls_dif_dly_ldc "Floating mean value for limited lambda deviation" SWORD _CNV_A_R_LINEAR_____508_CM 1 0. -50. 49.9984741210938 DISPLAY_IDENTIFIER LAM_MMV_VLS_DIF_DLY_LDC_1_ ECU_ADDRESS 0x7f95f4 BYTE_ORDER MSB_LAST FORMAT "%7.3" /end MEASUREMENT
/begin MEASUREMENT egcp[0].egcp_struct_pladgft0.maf_int_vls_dif_dly_min "MAF integral for lower VLS_DIF_DLY deviation" UWORD _CNV_A_R_LINEAR_____475_CM 1 0. 0. 1820.42 DISPLAY_IDENTIFIER MAF_INT_VLS_DIF_DLY_MIN_1_ ECU_ADDRESS 0x7f95f6 BYTE_ORDER MSB_LAST FORMAT "%7.2" /end MEASUREMENT
/begin MEASUREMENT egcp[0].egcp_struct_pladgft0.maf_int_vls_dif_dly_max "MAF integral for upper VLS_DIF_DLY deviation" UWORD _CNV_A_R_LINEAR_____475_CM 1 0. 0. 1820.42 DISPLAY_IDENTIFIER MAF_INT_VLS_DIF_DLY_MAX_1_ ECU_ADDRESS 0x7f95f8 BYTE_ORDER MSB_LAST FORMAT "%7.2" /end MEASUREMENT
/begin MEASUREMENT egcp[0].egcp_struct_pladgft0.maf_int_vls_dif_dly_ldc "Integral of mass air flow since limited dynamic conditions fulfilled" UWORD _CNV_A_R_EGCP_LINEA_509_CM 1 0. 0. 1389. DISPLAY_IDENTIFIER MAF_INT_VLS_DIF_DLY_LDC_1_ ECU_ADDRESS 0x7f95fa BYTE_ORDER MSB_LAST FORMAT "%7.2" /end MEASUREMENT
/begin MEASUREMENT egcp[0].egcp_struct_pladgft0.t_sum_max_diag_lam_adj "Total duration over C_LAMB_DELTA_I_MAX_DIAG" UWORD _CNV_A_R_LINEAR_____32_CM 1 0. 0. 65535. DISPLAY_IDENTIFIER T_SUM_MAX_DIAG_LAM_ADJ_1_ ECU_ADDRESS 0x7f95fc BYTE_ORDER MSB_LAST FORMAT "%5.0" /end MEASUREMENT
/begin MEASUREMENT egcp[0].egcp_struct_pladgft0.t_sum_min_diag_lam_adj "Total duration over C_LAMB_DELTA_I_MIN_DIAG" UWORD _CNV_A_R_LINEAR_____32_CM 1 0. 0. 65535. DISPLAY_IDENTIFIER T_SUM_MIN_DIAG_LAM_ADJ_1_ ECU_ADDRESS 0x7f95fe BYTE_ORDER MSB_LAST FORMAT "%5.0" /end MEASUREMENT
/begin MEASUREMENT egcp[0].egcp_struct_pladgft0.t_rst_sum_diag_lam_adj "Time counter to reset T_SUM_MIN_DIAG_LAM_ADJ[NC_CBK_EX_NR] and T_SUM_MAX_DIAG_LAM_ADJ[NC_CBK_EX_NR]" UWORD _CNV_A_R_LINEAR_____32_CM 1 0. 0. 65535. DISPLAY_IDENTIFIER T_RST_SUM_DIAG_LAM_ADJ_1_ ECU_ADDRESS 0x7f9600 BYTE_ORDER MSB_LAST FORMAT "%5.0" /end MEASUREMENT
/begin MEASUREMENT egcp[0].egcp_struct_pladgft0.t_vls_down_dif_end_diag "Time counter to set T_VLS_DOWN_DIF_END_DIAG[NC_CBK_EX_NR]" UWORD _CNV_A_R_LINEAR_____32_CM 1 0. 0. 65535. DISPLAY_IDENTIFIER T_VLS_DOWN_DIF_END_DIAG_1_ ECU_ADDRESS 0x7f9602 BYTE_ORDER MSB_LAST FORMAT "%5.0" /end MEASUREMENT
/begin MEASUREMENT egcp[0].egcp_struct_pladgft0.t_vls_down_dif_sum_rst_diag "Time counter to reset T_VLS_DOWN_DIF_SUM_MIN_DIAG[NC_CBK_EX_NR] and T_VLS_DOWN_DIF_SUM_MAX_DIAG[NC_CBK_EX_NR]" UWORD _CNV_A_R_LINEAR_____32_CM 1 0. 0. 65535. DISPLAY_IDENTIFIER T_VLS_DOWN_DIF_SUM_RST_DIAG_1_ ECU_ADDRESS 0x7f9604 BYTE_ORDER MSB_LAST FORMAT "%5.0" /end MEASUREMENT
/begin MEASUREMENT egcp[0].egcp_struct_pladgft0.t_end_diag_lam_adj "Time counter to set T_END_DIAG_LAM_ADJ[i]" UWORD _CNV_A_R_LINEAR_____32_CM 1 0. 0. 65535. DISPLAY_IDENTIFIER T_END_DIAG_LAM_ADJ_1_ ECU_ADDRESS 0x7f9606 BYTE_ORDER MSB_LAST FORMAT "%5.0" /end MEASUREMENT
/begin MEASUREMENT egcp[0].egcp_struct_pladgft0.state_err_vls_down_dif "Symptoms of trim control errors" UBYTE _CNV_S_3_EGCP_RANGE_510_CM 1 0. 0. 2. DISPLAY_IDENTIFIER STATE_ERR_VLS_DOWN_DIF_1_ ECU_ADDRESS 0x7f9608 /end MEASUREMENT
/begin MEASUREMENT egcp[0].egcp_struct_pladgft0.state_err_delta_i_lam_adj "Symptoms of the lambda trim control errors" UBYTE _CNV_S_3_EGCP_RANGE_505_CM 1 0. 0. 2. DISPLAY_IDENTIFIER STATE_ERR_DELTA_I_LAM_ADJ_1_ ECU_ADDRESS 0x7f9609 /end MEASUREMENT
/begin MEASUREMENT egcp[0].egcp_struct_pladgft0.lv_vls_down_dif_end_diag "Trim controller deviation diagnostic available" UBYTE _CNV_S_2_RANGE__0___88_CM 1 0. 0. 1. DISPLAY_IDENTIFIER LV_VLS_DOWN_DIF_END_DIAG_1_ ECU_ADDRESS 0x7f960a BIT_MASK 0x1 /end MEASUREMENT
/begin MEASUREMENT egcp[0].egcp_struct_pladgft0.lv_vls_down_dif_cdn_diag "Condition to activate trim controller deviation diagnosis" UBYTE _CNV_S_2_RANGE__0___88_CM 1 0. 0. 1. DISPLAY_IDENTIFIER LV_VLS_DOWN_DIF_CDN_DIAG_1_ ECU_ADDRESS 0x7f960b BIT_MASK 0x1 /end MEASUREMENT
/begin MEASUREMENT egcp[0].egcp_struct_pladgft0.lv_vls_down_dif_sym_diag "Symptom detected (VLS_DIF_DLY deviation)" UBYTE _CNV_S_2_RANGE__0___88_CM 1 0. 0. 1. DISPLAY_IDENTIFIER LV_VLS_DOWN_DIF_SYM_DIAG_1_ ECU_ADDRESS 0x7f960c BIT_MASK 0x1 /end MEASUREMENT
/begin MEASUREMENT egcp[0].egcp_struct_pladgft0.lv_delta_i_lam_adj_cdn_diag "Diagnosis condition of lambda trim control" UBYTE _CNV_S_2_RANGE__0___88_CM 1 0. 0. 1. DISPLAY_IDENTIFIER LV_DELTA_I_LAM_ADJ_CDN_DIAG_1_ ECU_ADDRESS 0x7f960d BIT_MASK 0x1 /end MEASUREMENT
/begin MEASUREMENT egcp[0].egcp_struct_pladgft0.lv_delta_i_lam_adj_sym_diag "Status diagnostic result of lambda trim control" UBYTE _CNV_S_2_RANGE__0___88_CM 1 0. 0. 1. DISPLAY_IDENTIFIER LV_DELTA_I_LAM_ADJ_SYM_DIAG_1_ ECU_ADDRESS 0x7f960e BIT_MASK 0x1 /end MEASUREMENT
/begin MEASUREMENT egcp[0].egcp_struct_pladgft0.lv_delta_i_lam_adj_end_diag "Diagnostic cycle for lambda trim control complete" UBYTE _CNV_S_2_RANGE__0___88_CM 1 0. 0. 1. DISPLAY_IDENTIFIER LV_DELTA_I_LAM_ADJ_END_DIAG_1_ ECU_ADDRESS 0x7f960f BIT_MASK 0x1 /end MEASUREMENT
/begin MEASUREMENT egcp[0].egcp_struct_pladgft0.lv_vls_dif_dly_ldc "Status limited dynamic for the function \"Monitoring Trim Controller Deviation\"" UBYTE _CNV_S_2_RANGE__0___88_CM 1 0. 0. 1. DISPLAY_IDENTIFIER LV_VLS_DIF_DLY_LDC_1_ ECU_ADDRESS 0x7f9610 BIT_MASK 0x1 /end MEASUREMENT
/begin MEASUREMENT egcp[0].egcp_struct_pladgft0.lv_vls_dif_dly_ldc_lam_mv "Status limited dynamic FAC_LAM_MV[i]" UBYTE _CNV_S_2_RANGE__0___88_CM 1 0. 0. 1. DISPLAY_IDENTIFIER LV_VLS_DIF_DLY_LDC_LAM_MV_1_ ECU_ADDRESS 0x7f9611 BIT_MASK 0x1 /end MEASUREMENT
/begin MEASUREMENT egcp[0].egcp_struct_pladgfti0.lv_inh_diag_dly_lam "Inhibition condition for the dynamic fuel trim diagnosis" UBYTE _CNV_S_2_RANGE__0___88_CM 1 0. 0. 1. DISPLAY_IDENTIFIER LV_INH_DIAG_DLY_LAM_1_ ECU_ADDRESS 0x7f9612 BIT_MASK 0x1 /end MEASUREMENT
/begin MEASUREMENT egcp[0].egcp_struct_fctdglslh0.ttip_mes_ls_up_obd_lsh_up "Most current oxygen sensor temperature (Mode 6 information)" SWORD _CNV_A_R_EGCP_LINEA_461_CM 1 0. -2048. 2047.9375 DISPLAY_IDENTIFIER TTIP_MES_LS_UP_OBD_LSH_UP_1_ ECU_ADDRESS 0x7f9614 BYTE_ORDER MSB_LAST FORMAT "%10.4" /end MEASUREMENT
/begin MEASUREMENT egcp[0].egcp_struct_fctdglslh0.tcc_vld_obd_lsh_up "Number of completed diagnosis cycles" UWORD _CNV_A_R_LINEAR_____1_CM 1 0. 0. 65535. DISPLAY_IDENTIFIER TCC_VLD_OBD_LSH_UP_1_ ECU_ADDRESS 0x7f9616 BYTE_ORDER MSB_LAST FORMAT "%5.0" /end MEASUREMENT
/begin MEASUREMENT egcp[0].egcp_struct_fctdglslh0.tcc_err_obd_lsh_up "Number of diagnosis cycles in which temperature deviation exceeding limits present" UWORD _CNV_A_R_LINEAR_____1_CM 1 0. 0. 65535. DISPLAY_IDENTIFIER TCC_ERR_OBD_LSH_UP_1_ ECU_ADDRESS 0x7f9618 BYTE_ORDER MSB_LAST FORMAT "%5.0" /end MEASUREMENT
/begin MEASUREMENT egcp[0].egcp_struct_fctdglslh0.state_sym_obd_lsl_lsh_up "Variable indicating status of each symptom, updated each recurrence & at diagnosis completion" UBYTE _CNV_S_4_EGCP_RANGE_511_CM 1 0. 0. 4. DISPLAY_IDENTIFIER STATE_SYM_OBD_LSL_LSH_UP_1_ ECU_ADDRESS 0x7f961a /end MEASUREMENT
/begin MEASUREMENT egcp[0].egcp_struct_fctdglslh0.lv_lamb_pls_req_diag_lsh_up "Boolean flag requesting exaggerated forced stimulation" UBYTE _CNV_S_2_RANGE__0___88_CM 1 0. 0. 1. DISPLAY_IDENTIFIER LV_LAMB_PLS_REQ_DIAG_LSH_UP_1_ ECU_ADDRESS 0x7f961b BIT_MASK 0x1 /end MEASUREMENT
/begin MEASUREMENT egcp[0].egcp_struct_fctdglslh0.lv_diag_obd_cdn_lsh_up "Boolean flag indicating that conditions for diagnosis met" UBYTE _CNV_S_2_RANGE__0___88_CM 1 0. 0. 1. DISPLAY_IDENTIFIER LV_DIAG_OBD_CDN_LSH_UP_1_ ECU_ADDRESS 0x7f961c BIT_MASK 0x1 /end MEASUREMENT
/begin MEASUREMENT egcp[0].egcp_struct_fctdglslh0.lv_diag_obd_sym_lsh_up "Boolean flag indicating that fault is present and has been debounced" UBYTE _CNV_S_2_RANGE__0___88_CM 1 0. 0. 1. DISPLAY_IDENTIFIER LV_DIAG_OBD_SYM_LSH_UP_1_ ECU_ADDRESS 0x7f961d BIT_MASK 0x1 /end MEASUREMENT
/begin MEASUREMENT egcp[0].egcp_struct_fctdglslh0.lv_diag_obd_end_lsh_up "Boolean flag indicating that diagnosis has been completed" UBYTE _CNV_S_2_RANGE__0___88_CM 1 0. 0. 1. DISPLAY_IDENTIFIER LV_DIAG_OBD_END_LSH_UP_1_ ECU_ADDRESS 0x7f961e BIT_MASK 0x1 /end MEASUREMENT
/begin MEASUREMENT egcp[0].egcp_struct_fctdglshd1.r_it_thd_obd_lsh_down "Threshold for most current downstream oxygen sensor internal resistance used for diagnosis cycle, Mode 6 information" UWORD _CNV_A_R_LINEAR_____1_CM 1 0. 0. 65535. DISPLAY_IDENTIFIER R_IT_THD_OBD_LSH_DOWN_1_ ECU_ADDRESS 0x7f9620 BYTE_ORDER MSB_LAST FORMAT "%5.0" /end MEASUREMENT
/begin MEASUREMENT egcp[0].egcp_struct_fctdglshd1.r_it_obd_lsh_down "Most current downstream oxygen sensor internal resistance used for diagnosis cycle, Mode 6 information" UWORD _CNV_A_R_LINEAR_____1_CM 1 0. 0. 65535. DISPLAY_IDENTIFIER R_IT_OBD_LSH_DOWN_1_ ECU_ADDRESS 0x7f9622 BYTE_ORDER MSB_LAST FORMAT "%5.0" /end MEASUREMENT
/begin MEASUREMENT egcp[0].egcp_struct_fctdglshd1.temp_dif_obd_lsh_down "Indicates difference in temperature between set operating temperature & exhaust gas at sensor location" UWORD _CNV_A_R_EGCP_LINEA_512_CM 1 0. 0. 2047. DISPLAY_IDENTIFIER TEMP_DIF_OBD_LSH_DOWN_1_ ECU_ADDRESS 0x7f9624 BYTE_ORDER MSB_LAST FORMAT "%4.0" /end MEASUREMENT
/begin MEASUREMENT egcp[0].egcp_struct_fctdglshd1.pow_int_obd_lsh_down "Integral indicates measure of cooling energy of exhaust gas at sensor location" UWORD _CNV_A_R_LINEAR_____482_CM 1 0. 0. 65535. DISPLAY_IDENTIFIER POW_INT_OBD_LSH_DOWN_1_ ECU_ADDRESS 0x7f9626 BYTE_ORDER MSB_LAST FORMAT "%5.0" /end MEASUREMENT
/begin MEASUREMENT egcp[0].egcp_struct_fctdglshd1.tcc_vld_obd_lsh_down "Number of completed valid diagnosis cycles" UWORD _CNV_A_R_LINEAR_____1_CM 1 0. 0. 1023. DISPLAY_IDENTIFIER TCC_VLD_OBD_LSH_DOWN_1_ ECU_ADDRESS 0x7f9628 BYTE_ORDER MSB_LAST FORMAT "%4.0" /end MEASUREMENT
/begin MEASUREMENT egcp[0].egcp_struct_fctdglshd1.tcc_err_obd_lsh_down "Number of faults detected during valid diagnosis cycles" UWORD _CNV_A_R_LINEAR_____1_CM 1 0. 0. 1023. DISPLAY_IDENTIFIER TCC_ERR_OBD_LSH_DOWN_1_ ECU_ADDRESS 0x7f962a BYTE_ORDER MSB_LAST FORMAT "%4.0" /end MEASUREMENT
/begin MEASUREMENT egcp[0].egcp_struct_fctdglshd1.ctr_cycnr_r_it_obd_ls_down "Value of handshake counter for last valid resistance value used for diagnosis" UWORD _CNV_A_R_LINEAR_____1_CM 1 0. 0. 65535. DISPLAY_IDENTIFIER CTR_CYCNR_R_IT_OBD_LS_DOWN_1_ ECU_ADDRESS 0x7f962c BYTE_ORDER MSB_LAST FORMAT "%5.0" /end MEASUREMENT
/begin MEASUREMENT egcp[0].egcp_struct_fctdglshd1.state_obd_lsh_down "Indicates current phase of oxygen sensor heater OBDII diagnosis" UBYTE _CNV_S_9_EGCP_RANGE_513_CM 1 0. 0. 8. DISPLAY_IDENTIFIER STATE_OBD_LSH_DOWN_1_ ECU_ADDRESS 0x7f962e /end MEASUREMENT
/begin MEASUREMENT egcp[0].egcp_struct_fctdglshdi1.lv_inh_diag_obd_lsh_down "Boolean inhibit flag for O2 sensor heater OBDII monitoring" UBYTE _CNV_S_2_RANGE__0___88_CM 1 0. 0. 1. DISPLAY_IDENTIFIER LV_INH_DIAG_OBD_LSH_DOWN_1_ ECU_ADDRESS 0x7f9630 BIT_MASK 0x1 /end MEASUREMENT
/begin MEASUREMENT egcp[0].egcp_struct_sigdglsd2.vls_dif_diag_rgn_nt_ls_down "Difference of VLS_DOWN_i values from the beginning to the end of the MAF_INT_RGN_NT_END calculation" SWORD _CNV_A_R_LINEAR_____514_CM 1 0. -5.00000000000182 4.99511718999747 DISPLAY_IDENTIFIER VLS_DIF_DIAG_RGN_NT_LS_DOWN_1_ ECU_ADDRESS 0x7f9632 BYTE_ORDER MSB_LAST /end MEASUREMENT
/begin MEASUREMENT egcp[0].egcp_struct_sigdglsd2.vls_down_tran_puc "Monitor sensor voltage on activating the trailing throttle fuel cut-off, Bank i" UWORD _CNV_A_R_LINEAR_____260_CM 1 0. 0. 4.9951171875 DISPLAY_IDENTIFIER VLS_DOWN_TRAN_PUC_1_ ECU_ADDRESS 0x7f9634 BYTE_ORDER MSB_LAST FORMAT "%5.3" /end MEASUREMENT
/begin MEASUREMENT egcp[0].egcp_struct_sigdglsd2.vls_down_pue "Monitor sensor voltage at the time of leaving PUC, Bank i (i=1.2)" UWORD _CNV_A_R_LINEAR_____260_CM 1 0. 0. 4.9951171875 DISPLAY_IDENTIFIER VLS_DOWN_PUE_1_ ECU_ADDRESS 0x7f9636 BYTE_ORDER MSB_LAST FORMAT "%5.3" /end MEASUREMENT
/begin MEASUREMENT egcp[0].egcp_struct_sigdglsd2.vls_dif_diag_pue_ls_down "difference of VLS_DOWN_i values from the beginning to the end of the MAF_INT_PUE calculation" UWORD _CNV_A_R_LINEAR_____260_CM 1 0. 0. 4.9951171875 DISPLAY_IDENTIFIER VLS_DIF_DIAG_PUE_LS_DOWN_1_ ECU_ADDRESS 0x7f9638 BYTE_ORDER MSB_LAST FORMAT "%5.3" /end MEASUREMENT
/begin MEASUREMENT egcp[0].egcp_struct_sigdglsd2.vls_dif_save_diag_ls_down "Difference of VLS_DOWN_i values from the beginning to the end of the MAF_INT_PUE calculation for scantool" UWORD _CNV_A_R_LINEAR_____260_CM 1 0. 0. 4.9951171875 DISPLAY_IDENTIFIER VLS_DIF_SAVE_DIAG_LS_DOWN_1_ ECU_ADDRESS 0x7f963a BYTE_ORDER MSB_LAST FORMAT "%5.3" /end MEASUREMENT
/begin MEASUREMENT egcp[0].egcp_struct_sigdglsd2.vls_down_rgn_nt_end "Monitor sensor voltage at the time of leaving regeneration phase of NOx trap, Bank i (i=1.2)" UWORD _CNV_A_R_LINEAR_____260_CM 1 0. 0. 4.9951171875 DISPLAY_IDENTIFIER VLS_DOWN_RGN_NT_END_1_ ECU_ADDRESS 0x7f963c BYTE_ORDER MSB_LAST FORMAT "%5.3" /end MEASUREMENT
/begin MEASUREMENT egcp[0].egcp_struct_sigdglsd2.ctr_end_diag_pue_ls_down "Counter to set LV_END_DIAG_VLS_DOWN_PUE_i" UWORD _CNV_A_R_LINEAR_____1_CM 1 0. 0. 65535. DISPLAY_IDENTIFIER CTR_END_DIAG_PUE_LS_DOWN_1_ ECU_ADDRESS 0x7f963e BYTE_ORDER MSB_LAST FORMAT "%5.0" /end MEASUREMENT
/begin MEASUREMENT egcp[0].egcp_struct_sigdglsd2.ctr_quo_sum_swt_ls_down "Sum of weighted CTR_SWT_ACT_LS_DOWN[NC_CBK_EX_NR], Bank i" UWORD _CNV_A_R_LINEAR_____248_CM 1 0. 0. 255.99609375 DISPLAY_IDENTIFIER CTR_QUO_SUM_SWT_LS_DOWN_1_ ECU_ADDRESS 0x7f9640 BYTE_ORDER MSB_LAST FORMAT "%10.6" /end MEASUREMENT
/begin MEASUREMENT egcp[0].egcp_struct_sigdglsd2.ctr_quo_swt_ls_down "Weighted value CTR_SWT_ACT_LS_DOWN[NC_CBK_EX_NR ]" UWORD _CNV_A_R_LINEAR_____248_CM 1 0. 0. 255.99609375 DISPLAY_IDENTIFIER CTR_QUO_SWT_LS_DOWN_1_ ECU_ADDRESS 0x7f9642 BYTE_ORDER MSB_LAST FORMAT "%10.6" /end MEASUREMENT
/begin MEASUREMENT egcp[0].egcp_struct_sigdglsd2.ctr_swt_act_ls_down "Cycle counter for switching time determination, Bank i" UBYTE _CNV_A_R_LINEAR_____434_CM 1 0. 0. 5100. DISPLAY_IDENTIFIER CTR_SWT_ACT_LS_DOWN_1_ ECU_ADDRESS 0x7f9644 FORMAT "%4.0" /end MEASUREMENT
/begin MEASUREMENT egcp[0].egcp_struct_sigdglsd2.ctr_swt_ls_down "Number of valid switching times from rich to lean" UBYTE _CNV_A_R_LINEAR_____1_CM 1 0. 0. 255. DISPLAY_IDENTIFIER CTR_SWT_LS_DOWN_1_ ECU_ADDRESS 0x7f9645 FORMAT "%3.0" /end MEASUREMENT
/begin MEASUREMENT egcp[0].egcp_struct_sigdglsd2.ctr_cycnr_swt_ls_down "Sum of weighted CTR_SWT_ACT_LS_DOWN[NC_CBK_EX_NR], Bank i" UBYTE _CNV_A_R_LINEAR_____240_CM 1 0. 0. 1.9921875 DISPLAY_IDENTIFIER CTR_CYCNR_SWT_LS_DOWN_1_ ECU_ADDRESS 0x7f9646 FORMAT "%8.6" /end MEASUREMENT
/begin MEASUREMENT egcp[0].egcp_struct_sigdglsd2.ctr_save_swt_ls_down "Mean value of the ratio between the monitor sensor switching time and the threshold value for scantool" UBYTE _CNV_A_R_LINEAR_____240_CM 1 0. 0. 1.9921875 DISPLAY_IDENTIFIER CTR_SAVE_SWT_LS_DOWN_1_ ECU_ADDRESS 0x7f9647 FORMAT "%8.6" /end MEASUREMENT
/begin MEASUREMENT egcp[0].egcp_struct_sigdglsd2.ctr_sym_diag_pue_ls_down "Counter for anti-bounce of LS_DOWN_PUE diagnosis" UBYTE _CNV_A_R_LINEAR_____1_CM 1 0. 0. 255. DISPLAY_IDENTIFIER CTR_SYM_DIAG_PUE_LS_DOWN_1_ ECU_ADDRESS 0x7f9648 FORMAT "%3.0" /end MEASUREMENT
/begin MEASUREMENT egcp[0].egcp_struct_sigdglsd2.lv_diag_pue_vld_ls_down "Debounced diagnosis result of pull end plausibility" UBYTE _CNV_S_2_RANGE__0___88_CM 1 0. 0. 1. DISPLAY_IDENTIFIER LV_DIAG_PUE_VLD_LS_DOWN_1_ ECU_ADDRESS 0x7f9649 BIT_MASK 0x1 /end MEASUREMENT
/begin MEASUREMENT egcp[0].egcp_struct_sigdglsd2.lv_diag_mpl_cdn_ls_down "Status of permission for diagnosis" UBYTE _CNV_S_2_RANGE__0___88_CM 1 0. 0. 1. DISPLAY_IDENTIFIER LV_DIAG_MPL_CDN_LS_DOWN_1_ ECU_ADDRESS 0x7f964a BIT_MASK 0x1 /end MEASUREMENT
/begin MEASUREMENT egcp[0].egcp_struct_sigdglsd2.lv_diag_mpl_end_ls_down "Bit to indicate end of complete monitor sensor diagnosis" UBYTE _CNV_S_2_RANGE__0___88_CM 1 0. 0. 1. DISPLAY_IDENTIFIER LV_DIAG_MPL_END_LS_DOWN_1_ ECU_ADDRESS 0x7f964b BIT_MASK 0x1 /end MEASUREMENT
/begin MEASUREMENT egcp[0].egcp_struct_sigdglsd2.lv_swt_diag_vld_ls_down "Validity bit of the current switching time check" UBYTE _CNV_S_2_RANGE__0___88_CM 1 0. 0. 1. DISPLAY_IDENTIFIER LV_SWT_DIAG_VLD_LS_DOWN_1_ ECU_ADDRESS 0x7f964c BIT_MASK 0x1 /end MEASUREMENT
/begin MEASUREMENT egcp[0].egcp_struct_sigdglsl1.lv_err_ls_up "Final diagnostic of the upstream oxygen sensor" UBYTE _CNV_S_2_RANGE__0___88_CM 1 0. 0. 1. DISPLAY_IDENTIFIER LV_ERR_LS_UP_1_ ECU_ADDRESS 0x7f964e BIT_MASK 0x1 /end MEASUREMENT
/begin MEASUREMENT egcp[0].egcp_struct_sigdglsl1.lv_err_ls_down "Final diagnostic of the downstream oxygen sensor" UBYTE _CNV_S_2_RANGE__0___88_CM 1 0. 0. 1. DISPLAY_IDENTIFIER LV_ERR_LS_DOWN_1_ ECU_ADDRESS 0x7f964f BIT_MASK 0x1 /end MEASUREMENT
/begin MEASUREMENT egcp[0].egcp_struct_pladglsl1.lamb_sp_delta_ls_up_down "Increment of lambda setpoint" SWORD _CNV_A_R_EGCP_LINEA_515_CM 1 0. -32. 31.999023 DISPLAY_IDENTIFIER LAMB_SP_DELTA_LS_UP_DOWN_1_ ECU_ADDRESS 0x7f9650 BYTE_ORDER MSB_LAST FORMAT "%9.6" /end MEASUREMENT
/begin MEASUREMENT egcp[0].egcp_struct_pladglsl1.maf_int_diag_ls_up_down "Integral of air mass flow  while check is active" UWORD _CNV_A_R_LINEAR_____475_CM 1 0. 0. 1820.42 DISPLAY_IDENTIFIER MAF_INT_DIAG_LS_UP_DOWN_1_ ECU_ADDRESS 0x7f9652 BYTE_ORDER MSB_LAST FORMAT "%7.2" /end MEASUREMENT
/begin MEASUREMENT egcp[0].egcp_struct_pladglsl1.lamb_sp_beg_diag_ls_up_down "Inicial value of lambda set point " UWORD _CNV_A_R_LINEAR_____458_CM 1 0. 0. 31.9990234375 DISPLAY_IDENTIFIER LAMB_SP_BEG_DIAG_LS_UP_DOWN_1_ ECU_ADDRESS 0x7f9654 BYTE_ORDER MSB_LAST FORMAT "%7.4" /end MEASUREMENT
/begin MEASUREMENT egcp[0].egcp_struct_pladglsl1.t_diag_act_afr_ls_up_down "Timer for plauisibility test under rich AF conditions" UWORD _CNV_A_R_LINEAR_____234_CM 1 0. 0. 6553.5 DISPLAY_IDENTIFIER T_DIAG_ACT_AFR_LS_UP_DOWN_1_ ECU_ADDRESS 0x7f9656 BYTE_ORDER MSB_LAST FORMAT "%6.1" /end MEASUREMENT
/begin MEASUREMENT egcp[0].egcp_struct_pladglsl1.t_diag_act_afl_ls_up_down "Timer for plauisibility test under lean AF conditions" UWORD _CNV_A_R_LINEAR_____234_CM 1 0. 0. 6553.5 DISPLAY_IDENTIFIER T_DIAG_ACT_AFL_LS_UP_DOWN_1_ ECU_ADDRESS 0x7f9658 BYTE_ORDER MSB_LAST FORMAT "%6.1" /end MEASUREMENT
/begin MEASUREMENT egcp[0].egcp_struct_pladglsl1.lamb_sp_diag_ls_up_down "Lambda set point for active plausibility test" UWORD _CNV_A_R_LINEAR_____458_CM 1 0. 0. 31.9990234375 DISPLAY_IDENTIFIER LAMB_SP_DIAG_LS_UP_DOWN_1_ ECU_ADDRESS 0x7f965a BYTE_ORDER MSB_LAST FORMAT "%7.4" /end MEASUREMENT
/begin MEASUREMENT egcp[0].egcp_struct_pladglsl1.ctr_sum_rst_afr_chk_lsl_up "Reset counter for the rich active test" UWORD _CNV_A_R_LINEAR_____1_CM 1 0. 0. 65535. DISPLAY_IDENTIFIER CTR_SUM_RST_AFR_CHK_LSL_UP_1_ ECU_ADDRESS 0x7f965c BYTE_ORDER MSB_LAST FORMAT "%5.0" /end MEASUREMENT
/begin MEASUREMENT egcp[0].egcp_struct_pladglsl1.ctr_sum_rst_afl_chk_lsl_up "Reset counter for the rich active test" UWORD _CNV_A_R_LINEAR_____1_CM 1 0. 0. 65535. DISPLAY_IDENTIFIER CTR_SUM_RST_AFL_CHK_LSL_UP_1_ ECU_ADDRESS 0x7f965e BYTE_ORDER MSB_LAST FORMAT "%5.0" /end MEASUREMENT
/begin MEASUREMENT egcp[0].egcp_struct_pladglsl1.ctr_afr_chk_lsl_up "Debounce counter for the rich test" UWORD _CNV_A_R_LINEAR_____1_CM 1 0. 0. 65535. DISPLAY_IDENTIFIER CTR_AFR_CHK_LSL_UP_1_ ECU_ADDRESS 0x7f9660 BYTE_ORDER MSB_LAST FORMAT "%5.0" /end MEASUREMENT
/begin MEASUREMENT egcp[0].egcp_struct_pladglsl1.ctr_afl_chk_lsl_up "Debounce counter for the lean test" UWORD _CNV_A_R_LINEAR_____1_CM 1 0. 0. 65535. DISPLAY_IDENTIFIER CTR_AFL_CHK_LSL_UP_1_ ECU_ADDRESS 0x7f9662 BYTE_ORDER MSB_LAST FORMAT "%5.0" /end MEASUREMENT
/begin MEASUREMENT egcp[0].egcp_struct_pladglsl1.state_diag_act_ls_up_down "State of check of downstream oxygen sensor signal for lambda sensor error manager" UBYTE _CNV_S_4_EGCP_RANGE_516_CM 1 0. 0. 3. DISPLAY_IDENTIFIER STATE_DIAG_ACT_LS_UP_DOWN_1_ ECU_ADDRESS 0x7f9664 /end MEASUREMENT
/begin MEASUREMENT egcp[0].egcp_struct_pladglsl1.lv_diag_afl_cdn_ls_up_down "Boolean flag, condition to execute AFL active check of the oxygen sensors" UBYTE _CNV_S_2_RANGE__0___88_CM 1 0. 0. 1. DISPLAY_IDENTIFIER LV_DIAG_AFL_CDN_LS_UP_DOWN_1_ ECU_ADDRESS 0x7f9665 BIT_MASK 0x1 /end MEASUREMENT
/begin MEASUREMENT egcp[0].egcp_struct_pladglsl1.lv_diag_afr_cdn_ls_up_down "Boolean flag, condition to execute AFR active check of the oxygen sensors" UBYTE _CNV_S_2_RANGE__0___88_CM 1 0. 0. 1. DISPLAY_IDENTIFIER LV_DIAG_AFR_CDN_LS_UP_DOWN_1_ ECU_ADDRESS 0x7f9666 BIT_MASK 0x1 /end MEASUREMENT
/begin MEASUREMENT egcp[0].egcp_struct_pladglsl1.lv_diag_act_end_ls_up_down "Boolean flag, end of active check of the oxygen sensors" UBYTE _CNV_S_2_RANGE__0___88_CM 1 0. 0. 1. DISPLAY_IDENTIFIER LV_DIAG_ACT_END_LS_UP_DOWN_1_ ECU_ADDRESS 0x7f9667 BIT_MASK 0x1 /end MEASUREMENT
/begin MEASUREMENT egcp[0].egcp_struct_pladglsl1.lv_lamb_sp_afr_req_diag_act "Trigger function to change lambda set point for AFR active plauisibility test" UBYTE _CNV_S_2_RANGE__0___88_CM 1 0. 0. 1. DISPLAY_IDENTIFIER LV_LAMB_SP_AFR_REQ_DIAG_ACT_1_ ECU_ADDRESS 0x7f9668 BIT_MASK 0x1 /end MEASUREMENT
/begin MEASUREMENT egcp[0].egcp_struct_pladglsl1.lv_lamb_sp_afl_req_diag_act "Trigger function to change lambda set point for AFL active plauisibility test" UBYTE _CNV_S_2_RANGE__0___88_CM 1 0. 0. 1. DISPLAY_IDENTIFIER LV_LAMB_SP_AFL_REQ_DIAG_ACT_1_ ECU_ADDRESS 0x7f9669 BIT_MASK 0x1 /end MEASUREMENT
/begin MEASUREMENT egcp[0].egcp_struct_pladglsl1.lv_lamb_sp_req_diag_act "Lambda coordination request to change set point for active plausibility test" UBYTE _CNV_S_2_RANGE__0___88_CM 1 0. 0. 1. DISPLAY_IDENTIFIER LV_LAMB_SP_REQ_DIAG_ACT_1_ ECU_ADDRESS 0x7f966a BIT_MASK 0x1 /end MEASUREMENT
/begin MEASUREMENT egcp[0].egcp_struct_pladglsl1.lv_diag_cyc_end_ls_down "End of cycle of active test of downstream sensor" UBYTE _CNV_S_2_RANGE__0___88_CM 1 0. 0. 1. DISPLAY_IDENTIFIER LV_DIAG_CYC_END_LS_DOWN_1_ ECU_ADDRESS 0x7f966b BIT_MASK 0x1 /end MEASUREMENT
/begin MEASUREMENT egcp[0].egcp_struct_pladglsl1.lv_lam_di_req "Request disable close loop operation of the lambda controller" UBYTE _CNV_S_2_RANGE__0___88_CM 1 0. 0. 1. DISPLAY_IDENTIFIER LV_LAM_DI_REQ_1_ ECU_ADDRESS 0x7f966c BIT_MASK 0x1 /end MEASUREMENT
/begin MEASUREMENT egcp[0].egcp_struct_pladglsl1.lv_diag_afr_end_ls_up_down "Boolean flag indicating the end of RICH active check" UBYTE _CNV_S_2_RANGE__0___88_CM 1 0. 0. 1. DISPLAY_IDENTIFIER LV_DIAG_AFR_END_LS_UP_DOWN_1_ ECU_ADDRESS 0x7f966d BIT_MASK 0x1 /end MEASUREMENT
/begin MEASUREMENT egcp[0].egcp_struct_pladglsl1.lv_diag_afl_end_ls_up_down "Boolean flag indicating the end of LEAN active check" UBYTE _CNV_S_2_RANGE__0___88_CM 1 0. 0. 1. DISPLAY_IDENTIFIER LV_DIAG_AFL_END_LS_UP_DOWN_1_ ECU_ADDRESS 0x7f966e BIT_MASK 0x1 /end MEASUREMENT
/begin MEASUREMENT egcp[0].egcp_struct_pladglsl1.lv_diag_afr_chk_sym_lsl_up "Debounced failure in the upstream sensor during the RICH active check " UBYTE _CNV_S_2_RANGE__0___88_CM 1 0. 0. 1. DISPLAY_IDENTIFIER LV_DIAG_AFR_CHK_SYM_LSL_UP_1_ ECU_ADDRESS 0x7f966f BIT_MASK 0x1 /end MEASUREMENT
/begin MEASUREMENT egcp[0].egcp_struct_pladglsl1.lv_diag_afl_chk_sym_lsl_up "Debounced failure in the upstream sensor during the LEAN active check" UBYTE _CNV_S_2_RANGE__0___88_CM 1 0. 0. 1. DISPLAY_IDENTIFIER LV_DIAG_AFL_CHK_SYM_LSL_UP_1_ ECU_ADDRESS 0x7f9670 BIT_MASK 0x1 /end MEASUREMENT
/begin MEASUREMENT egcp[0].egcp_struct_pladglsl1.lv_diag_act_chk_cdn_lsl_up "Conditions to run active test of upstream sensor fulfilled" UBYTE _CNV_S_2_RANGE__0___88_CM 1 0. 0. 1. DISPLAY_IDENTIFIER LV_DIAG_ACT_CHK_CDN_LSL_UP_1_ ECU_ADDRESS 0x7f9671 BIT_MASK 0x1 /end MEASUREMENT
/begin MEASUREMENT egcp[0].egcp_struct_pladglsl1.lv_diag_act_chk_end_lsl_up "End active test of upstream sensor" UBYTE _CNV_S_2_RANGE__0___88_CM 1 0. 0. 1. DISPLAY_IDENTIFIER LV_DIAG_ACT_CHK_END_LSL_UP_1_ ECU_ADDRESS 0x7f9672 BIT_MASK 0x1 /end MEASUREMENT
/begin MEASUREMENT egcp[0].egcp_struct_pladgtipa0.v_ofs_mes_r_it_obd_ls_up "Offset voltage of internal resistance determination circuit in measurement mode (Mode 6 information)" UWORD _CNV_A_R_EGCP_LINEA_502_CM 1 0. 0. 4.995 DISPLAY_IDENTIFIER V_OFS_MES_R_IT_OBD_LS_UP_1_ ECU_ADDRESS 0x7f9674 BYTE_ORDER MSB_LAST FORMAT "%5.3" /end MEASUREMENT
/begin MEASUREMENT egcp[0].egcp_struct_pladgtipa0.v_ofs_adj_r_it_obd_ls_up "Offset voltage of internal resistance determination circuit in adjust mode (Mode 6 information)" UWORD _CNV_A_R_EGCP_LINEA_502_CM 1 0. 0. 4.995 DISPLAY_IDENTIFIER V_OFS_ADJ_R_IT_OBD_LS_UP_1_ ECU_ADDRESS 0x7f9676 BYTE_ORDER MSB_LAST FORMAT "%5.3" /end MEASUREMENT
/begin MEASUREMENT egcp[0].egcp_struct_pladgtipa0.fac_gain_h_r_it_obd_ls_up "High gain of oxygen sensor internal resistance determination circuit (Mode 6 information)" UWORD _CNV_A_R_EGCP_LINEA_503_CM 1 0. 0. 23.999634 DISPLAY_IDENTIFIER FAC_GAIN_H_R_IT_OBD_LS_UP_1_ ECU_ADDRESS 0x7f9678 BYTE_ORDER MSB_LAST FORMAT "%7.4" /end MEASUREMENT
/begin MEASUREMENT egcp[0].egcp_struct_pladgtipa0.fac_gain_l_r_it_obd_ls_up "Low gain of oxygen sensor internal resistance determination circuit (Mode 6 information)" UWORD _CNV_A_R_EGCP_LINEA_503_CM 1 0. 0. 23.999634 DISPLAY_IDENTIFIER FAC_GAIN_L_R_IT_OBD_LS_UP_1_ ECU_ADDRESS 0x7f967a BYTE_ORDER MSB_LAST FORMAT "%7.4" /end MEASUREMENT
/begin MEASUREMENT egcp[0].egcp_struct_pladgtipa0.lv_ttip_obd_rep_ls_up "Boolean flag interface to ceramic temperature function to reset counters, indicates diagnosis complete" UBYTE _CNV_S_2_RANGE__0___88_CM 1 0. 0. 1. DISPLAY_IDENTIFIER LV_TTIP_OBD_REP_LS_UP_1_ ECU_ADDRESS 0x7f967c BIT_MASK 0x1 /end MEASUREMENT
/begin MEASUREMENT egcp[0].egcp_struct_sigdglsdi2.lv_diag_mpl_inh_ls_down "OBD II function dowmstream sensor: application incidences for inhibition" UBYTE _CNV_S_2_RANGE__0___88_CM 1 0. 0. 1. DISPLAY_IDENTIFIER LV_DIAG_MPL_INH_LS_DOWN_1_ ECU_ADDRESS 0x7f967e BIT_MASK 0x1 /end MEASUREMENT
/begin MEASUREMENT egcp[0].egcp_struct_fctdglslhi0.lv_inh_diag_obd_lsh_up "Boolean inhibit flag for O2 sensor heater OBDII monitoring" UBYTE _CNV_S_2_RANGE__0___88_CM 1 0. 0. 1. DISPLAY_IDENTIFIER LV_INH_DIAG_OBD_LSH_UP_1_ ECU_ADDRESS 0x7f967f BIT_MASK 0x1 /end MEASUREMENT
/begin MEASUREMENT egcp[0].egcp_struct_sigdglsl2.t_on_thd_lsh_diag_st_lsl_up "Timer how long the recovery process is active" UWORD _CNV_A_R_LINEAR_____234_CM 1 0. 0. 6553.5 DISPLAY_IDENTIFIER T_ON_THD_LSH_DIAG_ST_LSL_UP_1_ ECU_ADDRESS 0x7f9680 BYTE_ORDER MSB_LAST FORMAT "%6.1" /end MEASUREMENT
/begin MEASUREMENT egcp[0].egcp_struct_sigdglsl2.vls_up_save_diag_puc_lsl_up "Upstream sensor voltage - value used during the diagnosis and transmitted to the Scan Tool in mode06" UWORD _CNV_A_R_LINEAR_____260_CM 1 0. 0. 4.9951171875 DISPLAY_IDENTIFIER VLS_UP_SAVE_DIAG_PUC_LSL_UP_1_ ECU_ADDRESS 0x7f9682 BYTE_ORDER MSB_LAST FORMAT "%5.3" /end MEASUREMENT
/begin MEASUREMENT egcp[0].egcp_struct_sigdglsl2.t_sym_diag_air_lsl_up "Timer to debounce an error" UWORD _CNV_A_R_LINEAR_____234_CM 1 0. 0. 6553.5 DISPLAY_IDENTIFIER T_SYM_DIAG_AIR_LSL_UP_1_ ECU_ADDRESS 0x7f9684 BYTE_ORDER MSB_LAST FORMAT "%6.1" /end MEASUREMENT
/begin MEASUREMENT egcp[0].egcp_struct_sigdglsl2.t_end_diag_air_lsl_up "Timer to have a diagnostic available" UWORD _CNV_A_R_LINEAR_____234_CM 1 0. 0. 6553.5 DISPLAY_IDENTIFIER T_END_DIAG_AIR_LSL_UP_1_ ECU_ADDRESS 0x7f9686 BYTE_ORDER MSB_LAST FORMAT "%6.1" /end MEASUREMENT
/begin MEASUREMENT egcp[0].egcp_struct_sigdglsl2.t_end_diag_plaus_lsl_up "Timer to have a diagnostic available" UWORD _CNV_A_R_LINEAR_____234_CM 1 0. 0. 6553.5 DISPLAY_IDENTIFIER T_END_DIAG_PLAUS_LSL_UP_1_ ECU_ADDRESS 0x7f9688 BYTE_ORDER MSB_LAST FORMAT "%6.1" /end MEASUREMENT
/begin MEASUREMENT egcp[0].egcp_struct_sigdglsl2.t_diag_end_puc_lsl_up "Timer to have a diagnostic available" UWORD _CNV_A_R_LINEAR_____234_CM 1 0. 0. 6553.5 DISPLAY_IDENTIFIER T_DIAG_END_PUC_LSL_UP_1_ ECU_ADDRESS 0x7f968a BYTE_ORDER MSB_LAST FORMAT "%6.1" /end MEASUREMENT
/begin MEASUREMENT egcp[0].egcp_struct_sigdglsl2.t_dly_diag_puc_lsl_up "Delay Time to activate the diagnosis" UWORD _CNV_A_R_LINEAR_____234_CM 1 0. 0. 6553.5 DISPLAY_IDENTIFIER T_DLY_DIAG_PUC_LSL_UP_1_ ECU_ADDRESS 0x7f968c BYTE_ORDER MSB_LAST FORMAT "%6.1" /end MEASUREMENT
/begin MEASUREMENT egcp[0].egcp_struct_sigdglsl2.t_diag_sym_puc_lsl_up "Symptom debouncer timer" UWORD _CNV_A_R_LINEAR_____234_CM 1 0. 0. 6553.5 DISPLAY_IDENTIFIER T_DIAG_SYM_PUC_LSL_UP_1_ ECU_ADDRESS 0x7f968e BYTE_ORDER MSB_LAST FORMAT "%6.1" /end MEASUREMENT
/begin MEASUREMENT egcp[0].egcp_struct_sigdglsl2.t_sym_diag_plaus_lsl_up "Time for the plausibility symptom (compensation of the catalyst delay)" UWORD _CNV_A_R_LINEAR_____234_CM 1 0. 0. 6553.5 DISPLAY_IDENTIFIER T_SYM_DIAG_PLAUS_LSL_UP_1_ ECU_ADDRESS 0x7f9690 BYTE_ORDER MSB_LAST FORMAT "%6.1" /end MEASUREMENT
/begin MEASUREMENT egcp[0].egcp_struct_sigdglsl2.lamb_min_diag_dyn_lsl_up "Minimum value of the lambda sensor signal (per sample period)" UWORD _CNV_A_R_LINEAR_____458_CM 1 0. 0. 31.9990234375 DISPLAY_IDENTIFIER LAMB_MIN_DIAG_DYN_LSL_UP_1_ ECU_ADDRESS 0x7f9692 BYTE_ORDER MSB_LAST FORMAT "%7.4" /end MEASUREMENT
/begin MEASUREMENT egcp[0].egcp_struct_sigdglsl2.lamb_max_diag_dyn_lsl_up "Maximum value of the lambda sensor signal (per sample period)" UWORD _CNV_A_R_LINEAR_____458_CM 1 0. 0. 31.9990234375 DISPLAY_IDENTIFIER LAMB_MAX_DIAG_DYN_LSL_UP_1_ ECU_ADDRESS 0x7f9694 BYTE_ORDER MSB_LAST FORMAT "%7.4" /end MEASUREMENT
/begin MEASUREMENT egcp[0].egcp_struct_sigdglsl2.lamb_ampl_int_diag_dyn_lsl_up "Integral over carried out single sensor signal amplitude measurement" UWORD _CNV_A_R_LINEAR_____458_CM 1 0. 0. 31.9990234375 DISPLAY_IDENTIFIER LAMB_AMPL_INT_DIAG_DYN_LSL_UP_1_ ECU_ADDRESS 0x7f9696 BYTE_ORDER MSB_LAST FORMAT "%7.4" /end MEASUREMENT
/begin MEASUREMENT egcp[0].egcp_struct_sigdglsl2.fac_value_diag_dyn_lsl_up "Normalized single sensor signal amplitude" UWORD _CNV_A_R_LINEAR_____458_CM 1 0. 0. 31.9990234375 DISPLAY_IDENTIFIER FAC_VALUE_DIAG_DYN_LSL_UP_1_ ECU_ADDRESS 0x7f9698 BYTE_ORDER MSB_LAST FORMAT "%7.4" /end MEASUREMENT
/begin MEASUREMENT egcp[0].egcp_struct_sigdglsl2.fac_sum_diag_dyn_lsl_up "Summation over all normalized single sensor signal amplitude" UWORD _CNV_A_R_EGCP_LINEA_476_CM 1 0. 0. 63.99886 DISPLAY_IDENTIFIER FAC_SUM_DIAG_DYN_LSL_UP_1_ ECU_ADDRESS 0x7f969a BYTE_ORDER MSB_LAST FORMAT "%7.4" /end MEASUREMENT
/begin MEASUREMENT egcp[0].egcp_struct_sigdglsl2.fac_ad_min_diag_dyn_lsl_up "Lowest admissible adaption factor to the modeled sensor time constant" UWORD _CNV_A_R_LINEAR_____458_CM 1 0. 0. 31.9990234375 DISPLAY_IDENTIFIER FAC_AD_MIN_DIAG_DYN_LSL_UP_1_ ECU_ADDRESS 0x7f969c BYTE_ORDER MSB_LAST FORMAT "%7.4" /end MEASUREMENT
/begin MEASUREMENT egcp[0].egcp_struct_sigdglsl2.fac_mv_diag_dyn_lsl_up "Mean value of normalized single sensor signal amplitude" UWORD _CNV_A_R_LINEAR_____458_CM 1 0. 0. 31.9990234375 DISPLAY_IDENTIFIER FAC_MV_DIAG_DYN_LSL_UP_1_ ECU_ADDRESS 0x7f969e BYTE_ORDER MSB_LAST FORMAT "%7.4" /end MEASUREMENT
/begin MEASUREMENT egcp[0].egcp_struct_sigdglsl2.fac_ad_max_diag_dyn_lsl_up "Highest admissible adaption factor to the modeled sensor time constant" UWORD _CNV_A_R_LINEAR_____458_CM 1 0. 0. 31.9990234375 DISPLAY_IDENTIFIER FAC_AD_MAX_DIAG_DYN_LSL_UP_1_ ECU_ADDRESS 0x7f96a0 BYTE_ORDER MSB_LAST FORMAT "%7.4" /end MEASUREMENT
/begin MEASUREMENT egcp[0].egcp_struct_sigdglsl2.fac_diag_dyn_lsl_up "Adaption factor to the modeled sensor time constant" UWORD _CNV_A_R_LINEAR_____458_CM 1 0. 0. 1. DISPLAY_IDENTIFIER FAC_DIAG_DYN_LSL_UP_1_ ECU_ADDRESS 0x7f96a2 BYTE_ORDER MSB_LAST FORMAT "%6.4" /end MEASUREMENT
/begin MEASUREMENT egcp[0].egcp_struct_sigdglsl2.t_eng_st_diag_st_lsl_up "Starting time of the engine" UBYTE _CNV_A_R_LINEAR_____234_CM 1 0. 0. 25.5 DISPLAY_IDENTIFIER T_ENG_ST_DIAG_ST_LSL_UP_1_ ECU_ADDRESS 0x7f96a4 FORMAT "%4.1" /end MEASUREMENT
/begin MEASUREMENT egcp[0].egcp_struct_sigdglsl2.ctr_err_diag_st_lsl_up "Remaining heating cycle counter to purify the reference air as a result of the engines false start" UBYTE _CNV_A_R_LINEAR_____1_CM 1 0. 0. 255. DISPLAY_IDENTIFIER CTR_ERR_DIAG_ST_LSL_UP_1_ ECU_ADDRESS 0x7f96a5 FORMAT "%3.0" /end MEASUREMENT
/begin MEASUREMENT egcp[0].egcp_struct_sigdglsl2.t_lam_lim_diag_st_lsl_up "Time, how long the lambda controller must be in limitation" UBYTE _CNV_A_R_LINEAR_____234_CM 1 0. 0. 25.5 DISPLAY_IDENTIFIER T_LAM_LIM_DIAG_ST_LSL_UP_1_ ECU_ADDRESS 0x7f96a6 FORMAT "%4.1" /end MEASUREMENT
/begin MEASUREMENT egcp[0].egcp_struct_sigdglsl2.ctr_diag_plaus_lsl_up "Debounce counter" UBYTE _CNV_A_R_LINEAR_____1_CM 1 0. 0. 255. DISPLAY_IDENTIFIER CTR_DIAG_PLAUS_LSL_UP_1_ ECU_ADDRESS 0x7f96a7 FORMAT "%3.0" /end MEASUREMENT
/begin MEASUREMENT egcp[0].egcp_struct_sigdglsl2.lamb_ampl_diag_dyn_lsl_up "Carried out single sensor signal amplitude measurement" UBYTE _CNV_A_R_EGCP_LINEA_517_CM 1 0. 0. 0.124968 DISPLAY_IDENTIFIER LAMB_AMPL_DIAG_DYN_LSL_UP_1_ ECU_ADDRESS 0x7f96a8 FORMAT "%8.6" /end MEASUREMENT
/begin MEASUREMENT egcp[0].egcp_struct_sigdglsl2.lamb_ampl_min_diag_dyn_lsl_up "Minimun acceptable carried out single sensor signal amplitude measurement" UBYTE _CNV_A_R_EGCP_LINEA_517_CM 1 0. 0. 0.124968 DISPLAY_IDENTIFIER LAMB_AMPL_MIN_DIAG_DYN_LSL_UP_1_ ECU_ADDRESS 0x7f96a9 FORMAT "%8.6" /end MEASUREMENT
/begin MEASUREMENT egcp[0].egcp_struct_sigdglsl2.lamb_ampl_max_diag_dyn_lsl_up "Maximun acceptable carried out single sensor signal amplitude measurement" UBYTE _CNV_A_R_EGCP_LINEA_517_CM 1 0. 0. 0.124968 DISPLAY_IDENTIFIER LAMB_AMPL_MAX_DIAG_DYN_LSL_UP_1_ ECU_ADDRESS 0x7f96aa FORMAT "%8.6" /end MEASUREMENT
/begin MEASUREMENT egcp[0].egcp_struct_sigdglsl2.lamb_ampl_mv_diag_dyn_lsl_up "Sensor signal amplitude mean value" UBYTE _CNV_A_R_EGCP_LINEA_517_CM 1 0. 0. 0.124968 DISPLAY_IDENTIFIER LAMB_AMPL_MV_DIAG_DYN_LSL_UP_1_ ECU_ADDRESS 0x7f96ab FORMAT "%8.6" /end MEASUREMENT
/begin MEASUREMENT egcp[0].egcp_struct_sigdglsl2.ctr_diag_dyn_lsl_up "Number of  carried out single valid amplitude measurements" UBYTE _CNV_A_R_LINEAR_____1_CM 1 0. 0. 255. DISPLAY_IDENTIFIER CTR_DIAG_DYN_LSL_UP_1_ ECU_ADDRESS 0x7f96ac FORMAT "%3.0" /end MEASUREMENT
/begin MEASUREMENT egcp[0].egcp_struct_sigdglsl2.ctr_wait_diag_dyn_lsl_up "Number of forced stimulation periods before carrying out amplitude measurements" UBYTE _CNV_A_R_LINEAR_____1_CM 1 0. 0. 255. DISPLAY_IDENTIFIER CTR_WAIT_DIAG_DYN_LSL_UP_1_ ECU_ADDRESS 0x7f96ad FORMAT "%3.0" /end MEASUREMENT
/begin MEASUREMENT egcp[0].egcp_struct_sigdglsl2.cycnr_diag_dyn_lsl_up "Number of cycles necessary to finish the diagnosis" UBYTE _CNV_A_R_LINEAR_____1_CM 1 0. 0. 255. DISPLAY_IDENTIFIER CYCNR_DIAG_DYN_LSL_UP_1_ ECU_ADDRESS 0x7f96ae FORMAT "%3.0" /end MEASUREMENT
/begin MEASUREMENT egcp[0].egcp_struct_sigdglsl2.state_sym_diag_plaus_lsl_up "Symptom of of the heater coupling diagnosis" UBYTE _CNV_S_4_EGCP_RANGE_518_CM 1 0. 0. 4. DISPLAY_IDENTIFIER STATE_SYM_DIAG_PLAUS_LSL_UP_1_ ECU_ADDRESS 0x7f96af /end MEASUREMENT
/begin MEASUREMENT egcp[0].egcp_struct_sigdglsl2.state_sym_diag_puc_lsl_up "Symptom of of the signal plausibility from the upstraem sensor during PUC" UBYTE _CNV_S_3_EGCP_RANGE_519_CM 1 0. 0. 2. DISPLAY_IDENTIFIER STATE_SYM_DIAG_PUC_LSL_UP_1_ ECU_ADDRESS 0x7f96b0 /end MEASUREMENT
/begin MEASUREMENT egcp[0].egcp_struct_sigdglsl2.state_sym_diag_st_lsl_up "Symptom of the false start identification without consideration abnormal lambda regulation behaviour" UBYTE _CNV_S_2_EGCP_RANGE_520_CM 1 0. 0. 1. DISPLAY_IDENTIFIER STATE_SYM_DIAG_ST_LSL_UP_1_ ECU_ADDRESS 0x7f96b1 /end MEASUREMENT
/begin MEASUREMENT egcp[0].egcp_struct_sigdglsl2.state_dyn_diag "State shows the condition of the forced stimulation " UBYTE _CNV_S_4_EGCP_RANGE_521_CM 1 0. 0. 3. DISPLAY_IDENTIFIER STATE_DYN_DIAG_1_ ECU_ADDRESS 0x7f96b2 /end MEASUREMENT
/begin MEASUREMENT egcp[0].egcp_struct_sigdglsl2.lv_diag_plaus_sym_lsl_up "Debounced diagnosis result of the signal plausibility for the wide range A/F sensor" UBYTE _CNV_S_2_RANGE__0___88_CM 1 0. 0. 1. DISPLAY_IDENTIFIER LV_DIAG_PLAUS_SYM_LSL_UP_1_ ECU_ADDRESS 0x7f96b3 BIT_MASK 0x1 /end MEASUREMENT
/begin MEASUREMENT egcp[0].egcp_struct_sigdglsl2.lv_diag_cdn_plaus_lsl_up "Diagnosis condition" UBYTE _CNV_S_2_RANGE__0___88_CM 1 0. 0. 1. DISPLAY_IDENTIFIER LV_DIAG_CDN_PLAUS_LSL_UP_1_ ECU_ADDRESS 0x7f96b4 BIT_MASK 0x1 /end MEASUREMENT
/begin MEASUREMENT egcp[0].egcp_struct_sigdglsl2.lv_diag_plaus_end_lsl_up "Result of diagnosis exists" UBYTE _CNV_S_2_RANGE__0___88_CM 1 0. 0. 1. DISPLAY_IDENTIFIER LV_DIAG_PLAUS_END_LSL_UP_1_ ECU_ADDRESS 0x7f96b5 BIT_MASK 0x1 /end MEASUREMENT
/begin MEASUREMENT egcp[0].egcp_struct_sigdglsl2.lv_diag_dyn_sym_lsl_up "Debounce diagnosis value of the sensor dynamics" UBYTE _CNV_S_2_RANGE__0___88_CM 1 0. 0. 1. DISPLAY_IDENTIFIER LV_DIAG_DYN_SYM_LSL_UP_1_ ECU_ADDRESS 0x7f96b6 BIT_MASK 0x1 /end MEASUREMENT
/begin MEASUREMENT egcp[0].egcp_struct_sigdglsl2.lv_diag_dyn_end_lsl_up "Result of diagnosis exists" UBYTE _CNV_S_2_RANGE__0___88_CM 1 0. 0. 1. DISPLAY_IDENTIFIER LV_DIAG_DYN_END_LSL_UP_1_ ECU_ADDRESS 0x7f96b7 BIT_MASK 0x1 /end MEASUREMENT
/begin MEASUREMENT egcp[0].egcp_struct_sigdglsl2.lv_diag_dyn_cdn_lsl_up "Diagnosis condition" UBYTE _CNV_S_2_RANGE__0___88_CM 1 0. 0. 1. DISPLAY_IDENTIFIER LV_DIAG_DYN_CDN_LSL_UP_1_ ECU_ADDRESS 0x7f96b8 BIT_MASK 0x1 /end MEASUREMENT
/begin MEASUREMENT egcp[0].egcp_struct_sigdglsl2.lv_diag_puc_sym_lsl_up "Debounced diagnosis result of the signal plausibility from the upstream sensor during PUC" UBYTE _CNV_S_2_RANGE__0___88_CM 1 0. 0. 1. DISPLAY_IDENTIFIER LV_DIAG_PUC_SYM_LSL_UP_1_ ECU_ADDRESS 0x7f96b9 BIT_MASK 0x1 /end MEASUREMENT
/begin MEASUREMENT egcp[0].egcp_struct_sigdglsl2.lv_diag_cdn_puc_lsl_up "Diagnosis condition" UBYTE _CNV_S_2_RANGE__0___88_CM 1 0. 0. 1. DISPLAY_IDENTIFIER LV_DIAG_CDN_PUC_LSL_UP_1_ ECU_ADDRESS 0x7f96ba BIT_MASK 0x1 /end MEASUREMENT
/begin MEASUREMENT egcp[0].egcp_struct_sigdglsl2.lv_diag_puc_end_lsl_up "Result of diagnosis exists" UBYTE _CNV_S_2_RANGE__0___88_CM 1 0. 0. 1. DISPLAY_IDENTIFIER LV_DIAG_PUC_END_LSL_UP_1_ ECU_ADDRESS 0x7f96bb BIT_MASK 0x1 /end MEASUREMENT
/begin MEASUREMENT egcp[0].egcp_struct_sigdglsl2.lv_diag_st_sym_lsl_up "False start affecting to the sensor behaviour recognised" UBYTE _CNV_S_2_RANGE__0___88_CM 1 0. 0. 1. DISPLAY_IDENTIFIER LV_DIAG_ST_SYM_LSL_UP_1_ ECU_ADDRESS 0x7f96bc BIT_MASK 0x1 /end MEASUREMENT
/begin MEASUREMENT egcp[0].egcp_struct_sigdglsl2.lv_diag_cdn_st_lsl_up "Diagnosis condition" UBYTE _CNV_S_2_RANGE__0___88_CM 1 0. 0. 1. DISPLAY_IDENTIFIER LV_DIAG_CDN_ST_LSL_UP_1_ ECU_ADDRESS 0x7f96bd BIT_MASK 0x1 /end MEASUREMENT
/begin MEASUREMENT egcp[0].egcp_struct_sigdglsl2.lv_diag_st_end_lsl_up "Result of diagnosis exist" UBYTE _CNV_S_2_RANGE__0___88_CM 1 0. 0. 1. DISPLAY_IDENTIFIER LV_DIAG_ST_END_LSL_UP_1_ ECU_ADDRESS 0x7f96be BIT_MASK 0x1 /end MEASUREMENT
/begin MEASUREMENT egcp[0].egcp_struct_sigdglsl2.lv_lamb_pls_req_diag_dyn_lsl_up "Request forced stimulation parameters specific for the WRAF sensor dynamic" UBYTE _CNV_S_2_RANGE__0___88_CM 1 0. 0. 1. DISPLAY_IDENTIFIER LV_LAMB_PLS_REQ_DIAG_DYN_LSL_UP_ ECU_ADDRESS 0x7f96bf BIT_MASK 0x1 /end MEASUREMENT
/begin MEASUREMENT egcp[0].egcp_struct_sigdglsl2.lv_lam_adj_req_diag_dyn_lsl_up "Request dynamic trim controller parameters specific for the WRAF sensor dynamic" UBYTE _CNV_S_2_RANGE__0___88_CM 1 0. 0. 1. DISPLAY_IDENTIFIER LV_LAM_ADJ_REQ_DIAG_DYN_LSL_UP_1 ECU_ADDRESS 0x7f96c0 BIT_MASK 0x1 /end MEASUREMENT
/begin MEASUREMENT egcp[0].egcp_struct_sigdglsli2.lv_inh_diag_st_lsl_up "Inhibition of false start recognition  diagnosis" UBYTE _CNV_S_2_RANGE__0___88_CM 1 0. 0. 1. DISPLAY_IDENTIFIER LV_INH_DIAG_ST_LSL_UP_1_ ECU_ADDRESS 0x7f96c2 BIT_MASK 0x1 /end MEASUREMENT
/begin MEASUREMENT egcp[0].egcp_struct_sigdglsli2.lv_diag_plaus_inh_lsl_up "Deactivation of \"Plausibility check of the sensor signal\"" UBYTE _CNV_S_2_RANGE__0___88_CM 1 0. 0. 1. DISPLAY_IDENTIFIER LV_DIAG_PLAUS_INH_LSL_UP_1_ ECU_ADDRESS 0x7f96c3 BIT_MASK 0x1 /end MEASUREMENT
/begin MEASUREMENT egcp[0].egcp_struct_sigdglsli2.lv_diag_dyn_inh_lsl_up "Deactivation of \"Diagnosis of the WRAF Sensor Dynamic\"" UBYTE _CNV_S_2_RANGE__0___88_CM 1 0. 0. 1. DISPLAY_IDENTIFIER LV_DIAG_DYN_INH_LSL_UP_1_ ECU_ADDRESS 0x7f96c4 BIT_MASK 0x1 /end MEASUREMENT
/begin MEASUREMENT egcp[0].egcp_struct_sigdglsli2.lv_inh_diag_air_lsl_up "Deactivation of \"Monitoring Upstream Sensor Signal \"" UBYTE _CNV_S_2_RANGE__0___88_CM 1 0. 0. 1. DISPLAY_IDENTIFIER LV_INH_DIAG_AIR_LSL_UP_1_ ECU_ADDRESS 0x7f96c5 BIT_MASK 0x1 /end MEASUREMENT
/begin MEASUREMENT egcp[0].egcp_struct_sigdglsli2.lv_inh_diag_puc_lsl_up "Deactivation of \"Monitoring Upstream Sensor Signal during PUC\"" UBYTE _CNV_S_2_RANGE__0___88_CM 1 0. 0. 1. DISPLAY_IDENTIFIER LV_INH_DIAG_PUC_LSL_UP_1_ ECU_ADDRESS 0x7f96c6 BIT_MASK 0x1 /end MEASUREMENT
/begin MEASUREMENT egcp[0].egcp_struct_sigdglsli2.lv_diag_eol_dyn_ls_up "Status variable for activaton of lambda sensor diagnosis function via short trip" UBYTE _CNV_S_2_RANGE__0___88_CM 1 0. 0. 1. DISPLAY_IDENTIFIER LV_DIAG_EOL_DYN_LS_UP_1_ ECU_ADDRESS 0x7f96c7 BIT_MASK 0x1 /end MEASUREMENT
/begin MEASUREMENT egcp[0].egcp_struct_pladgtipai0.lv_inh_diag_ttip_obd_ls_up "Boolean inhibit flag for O2 sensor temperature OBDII monitoring" UBYTE _CNV_S_2_RANGE__0___88_CM 1 0. 0. 1. DISPLAY_IDENTIFIER LV_INH_DIAG_TTIP_OBD_LS_UP_1_ ECU_ADDRESS 0x7f96c8 BIT_MASK 0x1 /end MEASUREMENT
/begin MEASUREMENT egcp[0].egcp_struct_pladglsli1.lv_diag_act_inh_ls_up_down "Inhibit sensor signal plausibility active test" UBYTE _CNV_S_2_RANGE__0___88_CM 1 0. 0. 1. DISPLAY_IDENTIFIER LV_DIAG_ACT_INH_LS_UP_DOWN_1_ ECU_ADDRESS 0x7f96c9 BIT_MASK 0x1 /end MEASUREMENT
/begin MEASUREMENT egcp[0].egcp_struct_pladglsli1.lv_diag_afr_inh_ls_up_down "Inhibit sensor signal plausibility active test under air-fuel rich conditons" UBYTE _CNV_S_2_RANGE__0___88_CM 1 0. 0. 1. DISPLAY_IDENTIFIER LV_DIAG_AFR_INH_LS_UP_DOWN_1_ ECU_ADDRESS 0x7f96ca BIT_MASK 0x1 /end MEASUREMENT
/begin MEASUREMENT egcp[0].egcp_struct_pladglsli1.lv_diag_afl_inh_ls_up_down "Inhibit sensor signal plausibility active test under air-fuel lean conditons" UBYTE _CNV_S_2_RANGE__0___88_CM 1 0. 0. 1. DISPLAY_IDENTIFIER LV_DIAG_AFL_INH_LS_UP_DOWN_1_ ECU_ADDRESS 0x7f96cb BIT_MASK 0x1 /end MEASUREMENT
/begin MEASUREMENT egcp[0].egcp_struct_pladglsli1.lv_diag_eol_req_ls_up_down "Status variable for activaton of lambda sensor diagnosis function via short trip" UBYTE _CNV_S_2_RANGE__0___88_CM 1 0. 0. 1. DISPLAY_IDENTIFIER LV_DIAG_EOL_REQ_LS_UP_DOWN_1_ ECU_ADDRESS 0x7f96cc BIT_MASK 0x1 /end MEASUREMENT
/begin MEASUREMENT egcp[0].egcp_struct_sigdglsl3.lamb_delta_rise_lpf "Calculated value for heater coupling (rising value)" SWORD _CNV_A_R_LINEAR_____499_CM 1 0. -2. 1.99993896484375 DISPLAY_IDENTIFIER LAMB_DELTA_RISE_LPF_1_ ECU_ADDRESS 0x7f96ce BYTE_ORDER MSB_LAST FORMAT "%8.5" /end MEASUREMENT
/begin MEASUREMENT egcp[0].egcp_struct_sigdglsl3.lamb_delta_fall_lpf "Calculated value for heater coupling (falling value)" SWORD _CNV_A_R_LINEAR_____499_CM 1 0. -2. 1.99993896484375 DISPLAY_IDENTIFIER LAMB_DELTA_FALL_LPF_1_ ECU_ADDRESS 0x7f96d0 BYTE_ORDER MSB_LAST FORMAT "%8.5" /end MEASUREMENT
/begin MEASUREMENT egcp[0].egcp_struct_sigdglsl3.lamb_syn_lshpwm_fall "Lambda value just after lshpwm signal falls" UWORD _CNV_A_R_LINEAR_____499_CM 1 0. 0. 1.99993896484375 DISPLAY_IDENTIFIER LAMB_SYN_LSHPWM_FALL_1_ ECU_ADDRESS 0x7f96d2 BYTE_ORDER MSB_LAST FORMAT "%7.5" /end MEASUREMENT
/begin MEASUREMENT egcp[0].egcp_struct_sigdglsl3.lamb_syn_lshpwm_rise "Lambda value just after lshpwm signal rises" UWORD _CNV_A_R_LINEAR_____499_CM 1 0. 0. 1.99993896484375 DISPLAY_IDENTIFIER LAMB_SYN_LSHPWM_RISE_1_ ECU_ADDRESS 0x7f96d4 BYTE_ORDER MSB_LAST FORMAT "%7.5" /end MEASUREMENT
/begin MEASUREMENT egcp[0].egcp_struct_sigdglsl3.lamb_delta_rise "Variation of lambda value before and after lshpwm signal rises" SWORD _CNV_A_R_LINEAR_____499_CM 1 0. -2. 1.99993896484375 DISPLAY_IDENTIFIER LAMB_DELTA_RISE_1_ ECU_ADDRESS 0x7f96d6 BYTE_ORDER MSB_LAST FORMAT "%8.5" /end MEASUREMENT
/begin MEASUREMENT egcp[0].egcp_struct_sigdglsl3.lamb_delta_fall "Variation of lambda value before and after lshpwm signal falls" SWORD _CNV_A_R_LINEAR_____499_CM 1 0. -2. 1.99993896484375 DISPLAY_IDENTIFIER LAMB_DELTA_FALL_1_ ECU_ADDRESS 0x7f96d8 BYTE_ORDER MSB_LAST FORMAT "%8.5" /end MEASUREMENT
/begin MEASUREMENT egcp[0].egcp_struct_sigdglsl3.ctr_sym_diag_lsh_lsl_up "Number of met diagnosis conditions" UBYTE _CNV_A_R_LINEAR_____1_CM 1 0. 0. 255. DISPLAY_IDENTIFIER CTR_SYM_DIAG_LSH_LSL_UP_1_ ECU_ADDRESS 0x7f96da FORMAT "%3.0" /end MEASUREMENT
/begin MEASUREMENT egcp[0].egcp_struct_sigdglsl3.cycnr_diag_lsh_lsl_up "Cycle counter of successfully carried out functions" UBYTE _CNV_A_R_LINEAR_____1_CM 1 0. 0. 255. DISPLAY_IDENTIFIER CYCNR_DIAG_LSH_LSL_UP_1_ ECU_ADDRESS 0x7f96db FORMAT "%3.0" /end MEASUREMENT
/begin MEASUREMENT egcp[0].egcp_struct_sigdglsl3.t_dly_trig_lsh_up "Time delay to trigger oxygen sensor signal and lambda model" UBYTE _CNV_A_R_EGCP_LINEA_522_CM 1 0. 0. 0.255 DISPLAY_IDENTIFIER T_DLY_TRIG_LSH_UP_1_ ECU_ADDRESS 0x7f96dc FORMAT "%5.3" /end MEASUREMENT
/begin MEASUREMENT egcp[0].egcp_struct_sigdglsli3.lv_inh_diag_lsh_lsl_up "Deactivation of \"Diagnosis of the Heater Coupling in the Sensor Signal\"" UBYTE _CNV_S_2_RANGE__0___88_CM 1 0. 0. 1. DISPLAY_IDENTIFIER LV_INH_DIAG_LSH_LSL_UP_1_ ECU_ADDRESS 0x7f96de BIT_MASK 0x1 /end MEASUREMENT
/begin CHARACTERISTIC c_lshpwm_max_diag_lsh_up "Maximum O2-Sensor heater duty cycle to perform the electrical diagnosis" VALUE 0x840e3c _REC_VAL_20_u1 99.609375 _CNV_A_R_LINEAR_____479_CM 0. 99.609375 DISPLAY_IDENTIFIER C_LSHPWM_MAX_DIAG_LSH_UP FORMAT "%9.6" /end CHARACTERISTIC
/begin CHARACTERISTIC c_teg_dyn_min_diag_lsh_up "Minimum exhaust gas temperature threshold to permit SCP to set fault during LSH power rise state" VALUE 0x840f14 _REC_VAL_20_u2 2047. _CNV_A_R_EGCP_LINEA_461_CM 0. 2047. DISPLAY_IDENTIFIER C_TEG_DYN_MIN_DIAG_LSH_UP FORMAT "%9.4" /end CHARACTERISTIC
/begin CHARACTERISTIC c_lshpwm_min_diag_lsh_up "Minimum O2-Sensor heater duty cycle to perform the electrical diagnosis" VALUE 0x840e40 _REC_VAL_20_u1 99.609375 _CNV_A_R_LINEAR_____479_CM 0. 99.609375 DISPLAY_IDENTIFIER C_LSHPWM_MIN_DIAG_LSH_UP FORMAT "%9.6" /end CHARACTERISTIC
/begin MEASUREMENT lv_err_lsh_up_1 "Error flag for upstream heater diagnosis OBD I after debouncing " UBYTE _CNV_S_2_RANGE__0___88_CM 1 0. 0. 1. DISPLAY_IDENTIFIER LV_ERR_LSH_UP_1_ ECU_ADDRESS 0x7fb56a BIT_MASK 0x1 /end MEASUREMENT
/begin CHARACTERISTIC c_lshpwm_max_diag_lsh_down "Maximum O2-Sensor heater duty cycle to perform the electrical diagnosis" VALUE 0x840e3a _REC_VAL_20_u1 99.609375 _CNV_A_R_LINEAR_____479_CM 0. 99.609375 DISPLAY_IDENTIFIER C_LSHPWM_MAX_DIAG_LSH_DOWN FORMAT "%9.6" /end CHARACTERISTIC
/begin CHARACTERISTIC c_lshpwm_min_diag_lsh_down "Minimum O2-Sensor heater duty cycle to perform the electrical diagnosis" VALUE 0x840e3e _REC_VAL_20_u1 99.609375 _CNV_A_R_LINEAR_____479_CM 0. 99.609375 DISPLAY_IDENTIFIER C_LSHPWM_MIN_DIAG_LSH_DOWN FORMAT "%9.6" /end CHARACTERISTIC
/begin CHARACTERISTIC c_teg_cat_mdl_down_min_lsh_down "Minimum exhaust gas temperature threshold to permit SCP to set fault during LSH power rise state" VALUE 0x840f0c _REC_VAL_20_u2 2047. _CNV_A_R_EGCP_LINEA_461_CM 0. 2047. DISPLAY_IDENTIFIER C_TEG_CAT_MDL_DOWN_MIN_LSH_DOWN FORMAT "%9.4" /end CHARACTERISTIC
/begin MEASUREMENT lv_err_lsh_down_1 "Error flag for downstream heater diagnosis OBD I after debouncing " UBYTE _CNV_S_2_RANGE__0___88_CM 1 0. 0. 1. DISPLAY_IDENTIFIER LV_ERR_LSH_DOWN_1_ ECU_ADDRESS 0x7fb56b BIT_MASK 0x1 /end MEASUREMENT
/begin CHARACTERISTIC c_abc_inc_diag_lsh_down "Anti-bounce counter increment for downstream O2-sensor heater signal diagnosis." VALUE 0x840d6b _REC_VAL_20_u1 255. _CNV_A_R_LINEAR_____1_CM 0. 255. DISPLAY_IDENTIFIER C_ABC_INC_DIAG_LSH_DOWN FORMAT "%3.0" /end CHARACTERISTIC
/begin CHARACTERISTIC c_abc_max_diag_lsh_down "Maximum value of the anti-bounce counter for downstream O2-sensor heater command signal diagnosis." VALUE 0x840d77 _REC_VAL_20_u1 254. _CNV_A_R_LINEAR_____1_CM 1. 255. DISPLAY_IDENTIFIER C_ABC_MAX_DIAG_LSH_DOWN FORMAT "%3.0" /end CHARACTERISTIC
/begin CHARACTERISTIC c_abc_inc_diag_lsh_up "Anti-bounce counter increment for upstream O2-sensor heater diagnosis." VALUE 0x840d6c _REC_VAL_20_u1 255. _CNV_A_R_LINEAR_____1_CM 0. 255. DISPLAY_IDENTIFIER C_ABC_INC_DIAG_LSH_UP FORMAT "%3.0" /end CHARACTERISTIC
/begin CHARACTERISTIC c_abc_max_diag_lsh_up "Maximum value of the anti-bounce counter for upstream O2-sensor heater diagnosis." VALUE 0x840d78 _REC_VAL_20_u1 254. _CNV_A_R_LINEAR_____1_CM 1. 255. DISPLAY_IDENTIFIER C_ABC_MAX_DIAG_LSH_UP FORMAT "%3.0" /end CHARACTERISTIC
/begin CHARACTERISTIC c_lamb_delta_i_max_diag "Maximum limit of LAMB_DELTA_I" VALUE 0x840e0c _REC_VAL_20_s2 0.25 _CNV_A_R_LINEAR_____499_CM -0.125 0.125 DISPLAY_IDENTIFIER C_LAMB_DELTA_I_MAX_DIAG FORMAT "%8.5" /end CHARACTERISTIC
/begin CHARACTERISTIC c_lamb_delta_i_min_diag "Minimum limit of LAMB_DELTA_I" VALUE 0x840e0e _REC_VAL_20_s2 0.25 _CNV_A_R_LINEAR_____499_CM -0.125 0.125 DISPLAY_IDENTIFIER C_LAMB_DELTA_I_MIN_DIAG FORMAT "%8.5" /end CHARACTERISTIC
/begin CHARACTERISTIC c_t_sum_max_diag_lam_adj "Total duration over T_SUM_MAX_DIAG_LAM_ADJ[NC_CBK_EX_NR]" VALUE 0x840ee6 _REC_VAL_20_u2 65535. _CNV_A_R_LINEAR_____32_CM 0. 65535. DISPLAY_IDENTIFIER C_T_SUM_MAX_DIAG_LAM_ADJ FORMAT "%5.0" /end CHARACTERISTIC
/begin CHARACTERISTIC c_t_sum_min_diag_lam_adj "Total duration over T_SUM_MIN_DIAG_LAM_ADJ[NC_CBK_EX_NR]" VALUE 0x840ee8 _REC_VAL_20_u2 65535. _CNV_A_R_LINEAR_____32_CM 0. 65535. DISPLAY_IDENTIFIER C_T_SUM_MIN_DIAG_LAM_ADJ FORMAT "%5.0" /end CHARACTERISTIC
/begin CHARACTERISTIC c_t_end_diag_lam_adj "Time counter to set T_END_DIAG_LAM_ADJ[NC_CBK_EX_NR]" VALUE 0x840ebe _REC_VAL_20_u2 65535. _CNV_A_R_LINEAR_____32_CM 0. 65535. DISPLAY_IDENTIFIER C_T_END_DIAG_LAM_ADJ FORMAT "%5.0" /end CHARACTERISTIC
/begin CHARACTERISTIC c_vls_dif_max_diag "Maximum threshold for VLS_DIF_DLY deviation" VALUE 0x840f5c _REC_VAL_20_s2 9.99511718999929 _CNV_A_R_LINEAR_____514_CM -5.00000000000182 4.99511718999747 DISPLAY_IDENTIFIER C_VLS_DIF_MAX_DIAG /end CHARACTERISTIC
/begin CHARACTERISTIC c_vls_dif_min_diag "Minimum threshold for VLS_DIF_DLY deviation" VALUE 0x840f5e _REC_VAL_20_s2 9.99511718999929 _CNV_A_R_LINEAR_____514_CM -5.00000000000182 4.99511718999747 DISPLAY_IDENTIFIER C_VLS_DIF_MIN_DIAG /end CHARACTERISTIC
/begin CHARACTERISTIC c_t_rst_sum_diag_lam_adj "Time counter to reset T_SUM_MIN_DIAG_LAM_ADJ[NC_CBK_EX_NR] and T_SUM_MAX_DIAG_LAM_ADJ[NC_CBK_EX_NR]" VALUE 0x840ee4 _REC_VAL_20_u2 65535. _CNV_A_R_LINEAR_____32_CM 0. 65535. DISPLAY_IDENTIFIER C_T_RST_SUM_DIAG_LAM_ADJ FORMAT "%5.0" /end CHARACTERISTIC
/begin CHARACTERISTIC c_t_vls_down_dif_end_diag "Time counter to set T_VLS_DOWN_DIF_END_DIAG[NC_CBK_EX_NR]" VALUE 0x840eec _REC_VAL_20_u2 65535. _CNV_A_R_LINEAR_____32_CM 0. 65535. DISPLAY_IDENTIFIER C_T_VLS_DOWN_DIF_END_DIAG FORMAT "%5.0" /end CHARACTERISTIC
/begin CHARACTERISTIC c_t_vls_down_dif_rst_sum_diag "Time counter to set T_VLS_DOWN_DIF_SUM_RST_DIAG[NC_CBK_EX_NR]" VALUE 0x840eee _REC_VAL_20_u2 65535. _CNV_A_R_LINEAR_____32_CM 0. 65535. DISPLAY_IDENTIFIER C_T_VLS_DOWN_DIF_RST_SUM_DIAG FORMAT "%5.0" /end CHARACTERISTIC
/begin MEASUREMENT lv_err_lam_adj_1 "Status diagnostic result of lambda trim control" UBYTE _CNV_S_2_RANGE__0___88_CM 1 0. 0. 1. DISPLAY_IDENTIFIER LV_ERR_LAM_ADJ_1_ ECU_ADDRESS 0x7fb570 BIT_MASK 0x1 /end MEASUREMENT
/begin CHARACTERISTIC c_maf_int_vls_dif_dly_min "Maximum MAF integral of VLS_DIF_DLY deviation (rich side)" VALUE 0x840e64 _REC_VAL_20_u2 1820.42 _CNV_A_R_LINEAR_____475_CM 0. 1820.42 DISPLAY_IDENTIFIER C_MAF_INT_VLS_DIF_DLY_MIN FORMAT "%7.2" /end CHARACTERISTIC
/begin CHARACTERISTIC c_maf_int_vls_dif_dly_max "Maximum MAF integral of VLS_DIF_DLY deviation (lean side)" VALUE 0x840e62 _REC_VAL_20_u2 1820.42 _CNV_A_R_LINEAR_____475_CM 0. 1820.42 DISPLAY_IDENTIFIER C_MAF_INT_VLS_DIF_DLY_MAX FORMAT "%7.2" /end CHARACTERISTIC
/begin MEASUREMENT lv_vls_dif_dly_ldc_n "Status limited dynamic N" UBYTE _CNV_S_2_RANGE__0___88_CM 1 0. 0. 1. DISPLAY_IDENTIFIER LV_VLS_DIF_DLY_LDC_N ECU_ADDRESS 0x7fb2db BIT_MASK 0x1 /end MEASUREMENT
/begin MEASUREMENT lv_vls_dif_dly_ldc_maf "Status limited dynamic MAF" UBYTE _CNV_S_2_RANGE__0___88_CM 1 0. 0. 1. DISPLAY_IDENTIFIER LV_VLS_DIF_DLY_LDC_MAF ECU_ADDRESS 0x7fb2da BIT_MASK 0x1 /end MEASUREMENT
/begin MEASUREMENT n_mmv_vls_dif_dly_ldc "Floating mean value for limited engine speed" UWORD _CNV_A_R_LINEAR_____257_CM 1 0. 0. 8160. DISPLAY_IDENTIFIER N_MMV_VLS_DIF_DLY_LDC ECU_ADDRESS 0x7f96e8 BYTE_ORDER MSB_LAST FORMAT "%4.0" /end MEASUREMENT
/begin MEASUREMENT maf_mmv_vls_dif_dly_ldc "Floating mean value for limited MAF" UWORD _CNV_A_R_LINEAR_____483_CM 1 0. 0. 1389. DISPLAY_IDENTIFIER MAF_MMV_VLS_DIF_DLY_LDC ECU_ADDRESS 0x7f96e6 BYTE_ORDER MSB_LAST FORMAT "%7.2" /end MEASUREMENT
/begin CHARACTERISTIC c_n_ldc_vls_dif_dly "Threshold limited dynamic engine speed" VALUE 0x840e78 _REC_VAL_20_u2 8160. _CNV_A_R_LINEAR_____257_CM 0. 8160. DISPLAY_IDENTIFIER C_N_LDC_VLS_DIF_DLY FORMAT "%4.0" /end CHARACTERISTIC
/begin CHARACTERISTIC c_maf_ldc_vls_dif_dly "Threshold limited dynamic engine MAF " VALUE 0x840e6e _REC_VAL_20_u2 1389. _CNV_A_R_LINEAR_____483_CM 0. 1389. DISPLAY_IDENTIFIER C_MAF_LDC_VLS_DIF_DLY FORMAT "%7.2" /end CHARACTERISTIC
/begin CHARACTERISTIC c_lam_mv_ldc_vls_dif_dly "Threshold limited dynamic lambda " VALUE 0x840df6 _REC_VAL_20_u2 99.99847412109381 _CNV_A_R_LINEAR_____252_CM 0. 99.99847412109381 DISPLAY_IDENTIFIER C_LAM_MV_LDC_VLS_DIF_DLY /end CHARACTERISTIC
/begin CHARACTERISTIC c_n_crlc_ldc_vls_dif_dly "Correlation constant floating mean value calculation engine speed" VALUE 0x840e76 _REC_VAL_20_u2 0.9999847412109381 _CNV_A_R_LINEAR_____300_CM 0. 0.9999847412109381 DISPLAY_IDENTIFIER C_N_CRLC_LDC_VLS_DIF_DLY FORMAT "%7.5" /end CHARACTERISTIC
/begin CHARACTERISTIC c_maf_crlc_ldc_vls_dif_dly "Correlation constant floating mean value calculation MAF" VALUE 0x840e44 _REC_VAL_20_u2 0.9999847412109381 _CNV_A_R_LINEAR_____300_CM 0. 0.9999847412109381 DISPLAY_IDENTIFIER C_MAF_CRLC_LDC_VLS_DIF_DLY FORMAT "%7.5" /end CHARACTERISTIC
/begin CHARACTERISTIC c_lam_mv_crlc_ldc_vls_dif_dly "Correlation constant floating mean value calculation lambda" VALUE 0x840df4 _REC_VAL_20_u2 0.9999847412109381 _CNV_A_R_LINEAR_____300_CM 0. 0.9999847412109381 DISPLAY_IDENTIFIER C_LAM_MV_CRLC_LDC_VLS_DIF_DLY FORMAT "%7.5" /end CHARACTERISTIC
/begin CHARACTERISTIC c_maf_int_min_vls_dif_dly_ldc "Maximum value of the mass air flow integral after limited dynamic conditions were fulfilled" VALUE 0x840e5a _REC_VAL_20_u2 1389. _CNV_A_R_EGCP_LINEA_509_CM 0. 1389. DISPLAY_IDENTIFIER C_MAF_INT_MIN_VLS_DIF_DLY_LDC FORMAT "%7.2" /end CHARACTERISTIC
/begin MEASUREMENT lv_err_chg_ls_up "Debounced error: upstream sensor of banks 1and 2 interchanged" UBYTE _CNV_S_2_RANGE__0___88_CM 1 0. 0. 1. DISPLAY_IDENTIFIER LV_ERR_CHG_LS_UP ECU_ADDRESS 0x7fb581 BIT_MASK 0x1 /end MEASUREMENT
/begin MEASUREMENT lv_err_chg_ls_down "Debounced error: downstream sensor of banks 1and 2 interchanged" UBYTE _CNV_S_2_RANGE__0___88_CM 1 0. 0. 1. DISPLAY_IDENTIFIER LV_ERR_CHG_LS_DOWN ECU_ADDRESS 0x7fb582 BIT_MASK 0x1 /end MEASUREMENT
/begin MEASUREMENT maf_int_diag_chg_ls_up "MAF integral value when  ERR_SYM_... ¹  \"NO_SYM\"" UWORD _CNV_A_R_LINEAR_____475_CM 1 0. 0. 1820.42 DISPLAY_IDENTIFIER MAF_INT_DIAG_CHG_LS_UP ECU_ADDRESS 0x7fa512 BYTE_ORDER MSB_LAST FORMAT "%7.2" /end MEASUREMENT
/begin MEASUREMENT maf_int_diag_chg_ls_down "MAF integral value when  ERR_SYM_... ¹  \"NO_SYM\"" UWORD _CNV_A_R_LINEAR_____475_CM 1 0. 0. 1820.42 DISPLAY_IDENTIFIER MAF_INT_DIAG_CHG_LS_DOWN ECU_ADDRESS 0x7fa510 BYTE_ORDER MSB_LAST FORMAT "%7.2" /end MEASUREMENT
/begin MEASUREMENT t_end_diag_chg_ls_up "Timer to set LV_END_... = 1" UWORD _CNV_A_R_LINEAR_____234_CM 1 0. 0. 6553.5 DISPLAY_IDENTIFIER T_END_DIAG_CHG_LS_UP ECU_ADDRESS 0x7fa51a BYTE_ORDER MSB_LAST FORMAT "%6.1" /end MEASUREMENT
/begin MEASUREMENT t_end_diag_chg_ls_down "Timer to set LV_END_... = 1" UWORD _CNV_A_R_LINEAR_____234_CM 1 0. 0. 6553.5 DISPLAY_IDENTIFIER T_END_DIAG_CHG_LS_DOWN ECU_ADDRESS 0x7fa518 BYTE_ORDER MSB_LAST FORMAT "%6.1" /end MEASUREMENT
/begin CHARACTERISTIC c_t_end_diag_chg_ls_up "Max. time to set LV_END_... = 1" VALUE 0x840ebc _REC_VAL_20_u2 6553.5 _CNV_A_R_LINEAR_____234_CM 0. 6553.5 DISPLAY_IDENTIFIER C_T_END_DIAG_CHG_LS_UP FORMAT "%6.1" /end CHARACTERISTIC
/begin CHARACTERISTIC c_t_end_diag_chg_ls_down "Max. time to set LV_END_... = 1" VALUE 0x840eba _REC_VAL_20_u2 6553.5 _CNV_A_R_LINEAR_____234_CM 0. 6553.5 DISPLAY_IDENTIFIER C_T_END_DIAG_CHG_LS_DOWN FORMAT "%6.1" /end CHARACTERISTIC
/begin CHARACTERISTIC c_maf_int_diag_chg_ls_up "Max. MAF integral value when  ERR_SYM_... ¹  \"NO_SYM\" " VALUE 0x840e48 _REC_VAL_20_u2 1820.42 _CNV_A_R_LINEAR_____475_CM 0. 1820.42 DISPLAY_IDENTIFIER C_MAF_INT_DIAG_CHG_LS_UP FORMAT "%7.2" /end CHARACTERISTIC
/begin CHARACTERISTIC c_maf_int_diag_chg_ls_down "Max. MAF integral value when  ERR_SYM_... ¹  \"NO_SYM\" " VALUE 0x840e46 _REC_VAL_20_u2 1820.42 _CNV_A_R_LINEAR_____475_CM 0. 1820.42 DISPLAY_IDENTIFIER C_MAF_INT_DIAG_CHG_LS_DOWN FORMAT "%7.2" /end CHARACTERISTIC
/begin CHARACTERISTIC c_fac_lam_lim_max_chg_ls_up "Max. Threshold to detect a interchanged sensor" VALUE 0x840dd0 _REC_VAL_20_s2 99.99847412109381 _CNV_A_R_LINEAR_____508_CM -50. 49.9984741210938 DISPLAY_IDENTIFIER C_FAC_LAM_LIM_MAX_CHG_LS_UP FORMAT "%7.3" /end CHARACTERISTIC
/begin CHARACTERISTIC c_fac_lam_lim_min_chg_ls_up "Min. Threshold to detect a interchanged sensor" VALUE 0x840dd2 _REC_VAL_20_s2 99.99847412109381 _CNV_A_R_LINEAR_____508_CM -50. 49.9984741210938 DISPLAY_IDENTIFIER C_FAC_LAM_LIM_MIN_CHG_LS_UP FORMAT "%7.3" /end CHARACTERISTIC
/begin CHARACTERISTIC c_fac_int_chg_ls_up "Gain factor for the MAF integral" VALUE 0x840dcd _REC_VAL_20_u1 1.9921875 _CNV_A_R_LINEAR_____240_CM 0. 1.9921875 DISPLAY_IDENTIFIER C_FAC_INT_CHG_LS_UP FORMAT "%8.6" /end CHARACTERISTIC
/begin CHARACTERISTIC c_vls_down_max_chg_ls_down "Max. Threshold to detect a interchanged sensor" VALUE 0x840f6e _REC_VAL_20_u2 4.9951171875 _CNV_A_R_LINEAR_____260_CM 0. 4.9951171875 DISPLAY_IDENTIFIER C_VLS_DOWN_MAX_CHG_LS_DOWN FORMAT "%5.3" /end CHARACTERISTIC
/begin CHARACTERISTIC c_vls_down_min_chg_ls_down "Min. Threshold to detect a interchanged sensor" VALUE 0x840f72 _REC_VAL_20_u2 4.9951171875 _CNV_A_R_LINEAR_____260_CM 0. 4.9951171875 DISPLAY_IDENTIFIER C_VLS_DOWN_MIN_CHG_LS_DOWN FORMAT "%5.3" /end CHARACTERISTIC
/begin CHARACTERISTIC c_fac_int_chg_ls_down "Gain factor for the MAF integral" VALUE 0x840dcc _REC_VAL_20_u1 1.9921875 _CNV_A_R_LINEAR_____240_CM 0. 1.9921875 DISPLAY_IDENTIFIER C_FAC_INT_CHG_LS_DOWN FORMAT "%8.6" /end CHARACTERISTIC
/begin MEASUREMENT lv_err_puc_ls_down_1 "Boolean error flag, PUC plausibility fault currently present on downstream oxygen sensor signal" UBYTE _CNV_S_2_RANGE__0___88_CM 1 0. 0. 1. DISPLAY_IDENTIFIER LV_ERR_PUC_LS_DOWN_1_ ECU_ADDRESS 0x7fb572 BIT_MASK 0x1 /end MEASUREMENT
/begin MEASUREMENT lv_err_fl_ls_down_1 "Boolean error flag, FL plausibility fault currently present on downstream oxygen sensor signal" UBYTE _CNV_S_2_RANGE__0___88_CM 1 0. 0. 1. DISPLAY_IDENTIFIER LV_ERR_FL_LS_DOWN_1_ ECU_ADDRESS 0x7fb573 BIT_MASK 0x1 /end MEASUREMENT
/begin CHARACTERISTIC c_maf_int_max_diag_puc_ls_down "Maximum threshold for MAF integral to end downstream PUC signal plausibility" VALUE 0x840e54 _REC_VAL_20_u2 1820.42 _CNV_A_R_LINEAR_____475_CM 0. 1820.42 DISPLAY_IDENTIFIER C_MAF_INT_MAX_DIAG_PUC_LS_DOWN FORMAT "%7.2" /end CHARACTERISTIC
/begin CHARACTERISTIC c_maf_int_max_diag_fl_ls_down "Maximum threshold for MAF integral to end downstream FL signal plausibility" VALUE 0x840e52 _REC_VAL_20_u2 1820.42 _CNV_A_R_LINEAR_____475_CM 0. 1820.42 DISPLAY_IDENTIFIER C_MAF_INT_MAX_DIAG_FL_LS_DOWN FORMAT "%7.2" /end CHARACTERISTIC
/begin CHARACTERISTIC c_maf_int_min_diag_puc_ls_down "Minimum threshold for MAF integral required to start downstream PUC signal plausibility" VALUE 0x840e58 _REC_VAL_20_u2 1820.42 _CNV_A_R_LINEAR_____475_CM 0. 1820.42 DISPLAY_IDENTIFIER C_MAF_INT_MIN_DIAG_PUC_LS_DOWN FORMAT "%7.2" /end CHARACTERISTIC
/begin CHARACTERISTIC c_maf_int_min_diag_fl_ls_down "Minimum threshold for MAF integral required to start downstream FL signal plausibility" VALUE 0x840e56 _REC_VAL_20_u2 1820.42 _CNV_A_R_LINEAR_____475_CM 0. 1820.42 DISPLAY_IDENTIFIER C_MAF_INT_MIN_DIAG_FL_LS_DOWN FORMAT "%7.2" /end CHARACTERISTIC
/begin CHARACTERISTIC c_vls_min_diag_puc_ls_down "VLS voltage threshold for PUC fault detection" VALUE 0x840f86 _REC_VAL_20_u2 4.9951171875 _CNV_A_R_LINEAR_____260_CM 0. 4.9951171875 DISPLAY_IDENTIFIER C_VLS_MIN_DIAG_PUC_LS_DOWN FORMAT "%5.3" /end CHARACTERISTIC
/begin MEASUREMENT maf_int_fl "integral of air mass flow  while FL active" UWORD _CNV_A_R_LINEAR_____475_CM 1 0. 0. 1820.42 DISPLAY_IDENTIFIER MAF_INT_FL ECU_ADDRESS 0x7f96e4 BYTE_ORDER MSB_LAST FORMAT "%7.2" /end MEASUREMENT
/begin CHARACTERISTIC c_vls_max_diag_fl_ls_down "VLS voltage threshold for FL fault detection" VALUE 0x840f84 _REC_VAL_20_u2 4.9951171875 _CNV_A_R_LINEAR_____260_CM 0. 4.9951171875 DISPLAY_IDENTIFIER C_VLS_MAX_DIAG_FL_LS_DOWN FORMAT "%5.3" /end CHARACTERISTIC
/begin MEASUREMENT lv_inh_diag_chg_ls_up "Inhibit diagnosis interchanged upstream sensors" UBYTE _CNV_S_2_RANGE__0___88_CM 1 0. 0. 1. DISPLAY_IDENTIFIER LV_INH_DIAG_CHG_LS_UP ECU_ADDRESS 0x7fb2d7 BIT_MASK 0x1 /end MEASUREMENT
/begin MEASUREMENT lv_inh_diag_chg_ls_down "Inhibit diagnosis interchanged upstream sensors" UBYTE _CNV_S_2_RANGE__0___88_CM 1 0. 0. 1. DISPLAY_IDENTIFIER LV_INH_DIAG_CHG_LS_DOWN ECU_ADDRESS 0x7fb2d6 BIT_MASK 0x1 /end MEASUREMENT
/begin CHARACTERISTIC c_maf_int_diag_ls_up_down "Minimum threshold for MAF integral required to start active test" VALUE 0x840e4a _REC_VAL_20_u2 1820.42 _CNV_A_R_LINEAR_____475_CM 0. 1820.42 DISPLAY_IDENTIFIER C_MAF_INT_DIAG_LS_UP_DOWN FORMAT "%7.2" /end CHARACTERISTIC
/begin CHARACTERISTIC c_t_max_diag_afr_ls_up_down "Timer threshold for plausibility test under rich AF conditions" VALUE 0x840eca _REC_VAL_20_u2 6553.5 _CNV_A_R_LINEAR_____234_CM 0. 6553.5 DISPLAY_IDENTIFIER C_T_MAX_DIAG_AFR_LS_UP_DOWN FORMAT "%6.1" /end CHARACTERISTIC
/begin CHARACTERISTIC c_t_max_diag_afl_ls_up_down "Timer threshold for plausibility test under lean AF conditions" VALUE 0x840ec8 _REC_VAL_20_u2 6553.5 _CNV_A_R_LINEAR_____234_CM 0. 6553.5 DISPLAY_IDENTIFIER C_T_MAX_DIAG_AFL_LS_UP_DOWN FORMAT "%6.1" /end CHARACTERISTIC
/begin CHARACTERISTIC c_t_diag_eol_ls_up_down "Initialization of timer in case EOL to reduce the required minimum activity test time" VALUE 0x840e9a _REC_VAL_20_u2 6553.5 _CNV_A_R_LINEAR_____234_CM 0. 6553.5 DISPLAY_IDENTIFIER C_T_DIAG_EOL_LS_UP_DOWN FORMAT "%6.1" /end CHARACTERISTIC
/begin CHARACTERISTIC c_maf_int_eol_diag_ls_up_down "Initialization of MAF integral to reduce required minimum MAF value to start active test" VALUE 0x840e50 _REC_VAL_20_u2 1820.42 _CNV_A_R_LINEAR_____475_CM 0. 1820.42 DISPLAY_IDENTIFIER C_MAF_INT_EOL_DIAG_LS_UP_DOWN FORMAT "%7.2" /end CHARACTERISTIC
/begin CHARACTERISTIC c_lamb_afl_min_diag_ls_up_down "Min. lambda set point for lean fault detection " VALUE 0x840dfc _REC_VAL_20_u2 31.9990234375 _CNV_A_R_LINEAR_____458_CM 0. 31.9990234375 DISPLAY_IDENTIFIER C_LAMB_AFL_MIN_DIAG_LS_UP_DOWN FORMAT "%7.4" /end CHARACTERISTIC
/begin CHARACTERISTIC c_lamb_afl_max_diag_ls_up_down "Max. lambda set point for lean fault detection " VALUE 0x840dfa _REC_VAL_20_u2 31.9990234375 _CNV_A_R_LINEAR_____458_CM 0. 31.9990234375 DISPLAY_IDENTIFIER C_LAMB_AFL_MAX_DIAG_LS_UP_DOWN FORMAT "%7.4" /end CHARACTERISTIC
/begin CHARACTERISTIC c_lamb_afr_min_diag_ls_up_down "Min. lambda set point for rich fault detection " VALUE 0x840e04 _REC_VAL_20_u2 31.9990234375 _CNV_A_R_LINEAR_____458_CM 0. 31.9990234375 DISPLAY_IDENTIFIER C_LAMB_AFR_MIN_DIAG_LS_UP_DOWN FORMAT "%7.4" /end CHARACTERISTIC
/begin CHARACTERISTIC c_lamb_afr_max_diag_ls_up_down "Max. lambda set point for rich fault detection " VALUE 0x840e02 _REC_VAL_20_u2 31.9990234375 _CNV_A_R_LINEAR_____458_CM 0. 31.9990234375 DISPLAY_IDENTIFIER C_LAMB_AFR_MAX_DIAG_LS_UP_DOWN FORMAT "%7.4" /end CHARACTERISTIC
/begin CHARACTERISTIC c_abc_max_chk_ls_down "Maximum value for debounce algorithmus" VALUE 0x840d73 _REC_VAL_20_u1 254. _CNV_A_R_LINEAR_____1_CM 1. 255. DISPLAY_IDENTIFIER C_ABC_MAX_CHK_LS_DOWN FORMAT "%3.0" /end CHARACTERISTIC
/begin CHARACTERISTIC c_vls_afr_thd_diag_act_ls_down "VLS voltage threshold for rich fault detection (downstream sensor)" VALUE 0x840f58 _REC_VAL_20_u2 4.9951171875 _CNV_A_R_LINEAR_____260_CM 0. 4.9951171875 DISPLAY_IDENTIFIER C_VLS_AFR_THD_DIAG_ACT_LS_DOWN FORMAT "%5.3" /end CHARACTERISTIC
/begin CHARACTERISTIC c_vls_afl_thd_diag_act_ls_down "VLS voltage threshold for lean fault detection (downstream sensor)" VALUE 0x840f52 _REC_VAL_20_u2 4.9951171875 _CNV_A_R_LINEAR_____260_CM 0. 4.9951171875 DISPLAY_IDENTIFIER C_VLS_AFL_THD_DIAG_ACT_LS_DOWN FORMAT "%5.3" /end CHARACTERISTIC
/begin CHARACTERISTIC c_lamb_sp_afr_diag_ls_up_down "Lambda set point for rich fault detection " VALUE 0x840e22 _REC_VAL_20_u2 31.9990234375 _CNV_A_R_LINEAR_____458_CM 0. 31.9990234375 DISPLAY_IDENTIFIER C_LAMB_SP_AFR_DIAG_LS_UP_DOWN FORMAT "%7.4" /end CHARACTERISTIC
/begin CHARACTERISTIC c_lamb_sp_afl_diag_ls_up_down "Lambda set point for lean fault detection " VALUE 0x840e1e _REC_VAL_20_u2 31.9990234375 _CNV_A_R_LINEAR_____458_CM 0. 31.9990234375 DISPLAY_IDENTIFIER C_LAMB_SP_AFL_DIAG_LS_UP_DOWN FORMAT "%7.4" /end CHARACTERISTIC
/begin CHARACTERISTIC c_abc_inc_chk_ls_down "Increment for debounce algorithmus" VALUE 0x840d68 _REC_VAL_20_u1 255. _CNV_A_R_LINEAR_____1_CM 0. 255. DISPLAY_IDENTIFIER C_ABC_INC_CHK_LS_DOWN FORMAT "%3.0" /end CHARACTERISTIC
/begin CHARACTERISTIC c_lamb_sp_step_diag_ls_up_down "Number of recurrences to achieve the desired lambda set point" VALUE 0x840e2c _REC_VAL_20_u1 254. _CNV_A_R_LINEAR_____1_CM 1. 255. DISPLAY_IDENTIFIER C_LAMB_SP_STEP_DIAG_LS_UP_DOWN FORMAT "%3.0" /end CHARACTERISTIC
/begin MEASUREMENT lv_err_chk_ls_down_1 "Debounced failure in the downstream sensor " UBYTE _CNV_S_2_RANGE__0___88_CM 1 0. 0. 1. DISPLAY_IDENTIFIER LV_ERR_CHK_LS_DOWN_1_ ECU_ADDRESS 0x7fb571 BIT_MASK 0x1 /end MEASUREMENT
/begin CHARACTERISTIC lc_diag_auth_chk_ls_up_down "Boolean switch allowing the active test" VALUE 0x840f9f _REC_VAL_20_u1 1. _CNV_A_R_LINEAR_____1_CM 0. 1. DISPLAY_IDENTIFIER LC_DIAG_AUTH_CHK_LS_UP_DOWN FORMAT "%1.0" /end CHARACTERISTIC
/begin CHARACTERISTIC c_abc_inc_chk_lsl_up "Increment for debounce algorithmus" VALUE 0x840d69 _REC_VAL_20_u1 255. _CNV_A_R_LINEAR_____1_CM 0. 255. DISPLAY_IDENTIFIER C_ABC_INC_CHK_LSL_UP FORMAT "%3.0" /end CHARACTERISTIC
/begin CHARACTERISTIC c_lamb_afr_thd_diag_act_lsl_up "Lambda value threshold for rich fault detection (upstream sensor)" VALUE 0x840e06 _REC_VAL_20_u2 31.9990234375 _CNV_A_R_LINEAR_____458_CM 0. 31.9990234375 DISPLAY_IDENTIFIER C_LAMB_AFR_THD_DIAG_ACT_LSL_UP FORMAT "%7.4" /end CHARACTERISTIC
/begin CHARACTERISTIC c_lamb_afl_thd_diag_act_lsl_up "Lambda value threshold for lean fault detection (upstream sensor)" VALUE 0x840dfe _REC_VAL_20_u2 31.9990234375 _CNV_A_R_LINEAR_____458_CM 0. 31.9990234375 DISPLAY_IDENTIFIER C_LAMB_AFL_THD_DIAG_ACT_LSL_UP FORMAT "%7.4" /end CHARACTERISTIC
/begin CHARACTERISTIC c_ctr_sum_rst_afr_chk_lsl_up "Reset debounce counter for Richt test" VALUE 0x840dac _REC_VAL_20_u2 65535. _CNV_A_R_LINEAR_____1_CM 0. 65535. DISPLAY_IDENTIFIER C_CTR_SUM_RST_AFR_CHK_LSL_UP FORMAT "%5.0" /end CHARACTERISTIC
/begin CHARACTERISTIC c_ctr_sum_rst_afl_chk_lsl_up "Reset debounce counter for Lean test" VALUE 0x840daa _REC_VAL_20_u2 65535. _CNV_A_R_LINEAR_____1_CM 0. 65535. DISPLAY_IDENTIFIER C_CTR_SUM_RST_AFL_CHK_LSL_UP FORMAT "%5.0" /end CHARACTERISTIC
/begin CHARACTERISTIC c_abc_max_chk_lsl_up "Maximum value for debounce algorithmus" VALUE 0x840d74 _REC_VAL_20_u2 65535. _CNV_A_R_LINEAR_____1_CM 0. 65535. DISPLAY_IDENTIFIER C_ABC_MAX_CHK_LSL_UP FORMAT "%5.0" /end CHARACTERISTIC
/begin MEASUREMENT lv_err_lsl_up_if_1 "Present error in the CJ120 WRAF sensor controller" UBYTE _CNV_S_2_RANGE__0___88_CM 1 0. 0. 1. DISPLAY_IDENTIFIER LV_ERR_LSL_UP_IF_1_ ECU_ADDRESS 0x7fb576 BIT_MASK 0x1 /end MEASUREMENT
/begin CHARACTERISTIC c_ctr_max_spi_com_lsl_up[0] "Max. allowed number of SPI comunication errors" VALUE 0x840da6 _REC_VAL_20_u1 255. _CNV_A_R_LINEAR_____1_CM 0. 255. DISPLAY_IDENTIFIER C_CTR_MAX_SPI_COM_LSL_UP_1_ FORMAT "%3.0" /end CHARACTERISTIC
/begin CHARACTERISTIC c_t_rst_max_diag_lsl_up_if[0] "Max. waiting time for the initialization of the WRAF sensor controller" VALUE 0x840ee2 _REC_VAL_20_u2 655.35 _CNV_A_R_LINEAR_____223_CM 0. 655.35 DISPLAY_IDENTIFIER C_T_RST_MAX_DIAG_LSL_UP_IF_1_ FORMAT "%6.2" /end CHARACTERISTIC
/begin CHARACTERISTIC c_t_end_diag_lsl_up_if[0] "Time to diagnostic availability" VALUE 0x840ec0 _REC_VAL_20_u2 655.35 _CNV_A_R_LINEAR_____223_CM 0. 655.35 DISPLAY_IDENTIFIER C_T_END_DIAG_LSL_UP_IF_1_ FORMAT "%6.2" /end CHARACTERISTIC
/begin CHARACTERISTIC c_tcc_fac_gain_max_ttip_ls_up "Number of valid diagnosis cycles over which statistical evaluation to be carried out" VALUE 0x840ef8 _REC_VAL_20_u2 65535. _CNV_A_R_LINEAR_____1_CM 0. 65535. DISPLAY_IDENTIFIER C_TCC_FAC_GAIN_MAX_TTIP_LS_UP FORMAT "%5.0" /end CHARACTERISTIC
/begin CHARACTERISTIC c_tcc_err_max_ttip_obd_ls_up "Fault detection threshold, when exceeded, ceramic temperature determined to be defective" VALUE 0x840ef6 _REC_VAL_20_u2 65535. _CNV_A_R_LINEAR_____1_CM 0. 65535. DISPLAY_IDENTIFIER C_TCC_ERR_MAX_TTIP_OBD_LS_UP FORMAT "%5.0" /end CHARACTERISTIC
/begin CHARACTERISTIC lc_ttip_obd_rep_ls_up "Logical constant permitting diagnosis to be repeated within one driving cycle" VALUE 0x840fba _REC_VAL_20_u1 1. _CNV_A_R_LINEAR_____1_CM 0. 1. DISPLAY_IDENTIFIER LC_TTIP_OBD_REP_LS_UP FORMAT "%1.0" /end CHARACTERISTIC
/begin CHARACTERISTIC lc_ttip_obd_ls_up "Logical constant permitting diagnosis to be carried out" VALUE 0x840fb9 _REC_VAL_20_u1 1. _CNV_A_R_LINEAR_____1_CM 0. 1. DISPLAY_IDENTIFIER LC_TTIP_OBD_LS_UP FORMAT "%1.0" /end CHARACTERISTIC
/begin MEASUREMENT lv_err_ttip_obd_ls_up_1 "" UBYTE _CNV_S_2_RANGE__0___88_CM 1 0. 0. 1. DISPLAY_IDENTIFIER LV_ERR_TTIP_OBD_LS_UP_1_ ECU_ADDRESS 0x7fb578 BIT_MASK 0x1 /end MEASUREMENT
/begin CHARACTERISTIC c_state_lsl_if_spi_wr_ini "Initialisation data of SPI register INIT_REG_1" VALUE 0x840e8b _REC_VAL_20_u1 255. _CNV_A_R_LINEAR_____1_CM 0. 255. DISPLAY_IDENTIFIER C_STATE_LSL_IF_SPI_WR_INI FORMAT "%3.0" /end CHARACTERISTIC
/begin CHARACTERISTIC c_state_lsl_if_conf_spi_wr_ini "Initialisation data of SPI register INIT_REG_2" VALUE 0x840e8a _REC_VAL_20_u1 255. _CNV_A_R_LINEAR_____1_CM 0. 255. DISPLAY_IDENTIFIER C_STATE_LSL_IF_CONF_SPI_WR_INI FORMAT "%3.0" /end CHARACTERISTIC
/begin CHARACTERISTIC c_t_dly_di_lsl_if "Configuration of sensor protection time" VALUE 0x840ea0 _REC_VAL_20_u1 7. _CNV_A_R_LINEAR_____0_CM 0. 7. DISPLAY_IDENTIFIER C_T_DLY_DI_LSL_IF FORMAT "%1.0" /end CHARACTERISTIC
/begin AXIS_PTS ldp_r_it_ls_up_ip_ttip_ls_up "" 0x8408e4 online_dummy _REC_AXS_20_u2 16383.75 _CNV_A_R_EGCP_LINEA_459_CM 8 0. 16383.75 FORMAT "%9.2" /end AXIS_PTS
/begin CHARACTERISTIC ip_ttip_mes_ls_up "Oxygen sensor temperature vs. internal resistance characteristic" CURVE 0x840d04 _REC_CUR_20_u2_u2 2047.9375 _CNV_A_R_EGCP_LINEA_461_CM 0. 2047.9375 DISPLAY_IDENTIFIER IP_TTIP_MES_LS_UP FORMAT "%7.2"
 /begin AXIS_DESCR COM_AXIS online_dummy _CNV_A_R_EGCP_LINEA_459_CM 8 0. 16383.75 FORMAT "%9.2" AXIS_PTS_REF ldp_r_it_ls_up_ip_ttip_ls_up /end AXIS_DESCR
/end CHARACTERISTIC
/begin CHARACTERISTIC c_t_dly_ofs_adj_r_it_ls_up "Delay required from switching from internal resistance measurement offset to adjust offset mode" VALUE 0x840eb1 _REC_VAL_20_u1 2.55 _CNV_A_R_LINEAR_____223_CM 0. 2.55 DISPLAY_IDENTIFIER C_T_DLY_OFS_ADJ_R_IT_LS_UP FORMAT "%4.2" /end CHARACTERISTIC
/begin CHARACTERISTIC c_t_dly_fac_gain_r_it_ls_up "Delay required from switching from internal resistance adjust offset to adjust gain mode" VALUE 0x840ea8 _REC_VAL_20_u1 2.55 _CNV_A_R_LINEAR_____223_CM 0. 2.55 DISPLAY_IDENTIFIER C_T_DLY_FAC_GAIN_R_IT_LS_UP FORMAT "%4.2" /end CHARACTERISTIC
/begin CHARACTERISTIC c_t_dly_clc_r_it_ls_up "Delay required from switching from internal resistance adjust gain to measurement mode" VALUE 0x840e9e _REC_VAL_20_u1 2.55 _CNV_A_R_LINEAR_____223_CM 0. 2.55 DISPLAY_IDENTIFIER C_T_DLY_CLC_R_IT_LS_UP FORMAT "%4.2" /end CHARACTERISTIC
/begin CHARACTERISTIC c_t_dly_ofs_mes_r_it_ls_up "Delay required from switching oscillator off or internal resistance measurement to measurement offset mode" VALUE 0x840eb2 _REC_VAL_20_u1 2.55 _CNV_A_R_LINEAR_____223_CM 0. 2.55 DISPLAY_IDENTIFIER C_T_DLY_OFS_MES_R_IT_LS_UP FORMAT "%4.2" /end CHARACTERISTIC
/begin CHARACTERISTIC c_t_max_v_ofs_adj_r_it_ls_up "Maximum permitted time for offset measurement in adjust mode" VALUE 0x840ed8 _REC_VAL_20_u2 655.35 _CNV_A_R_LINEAR_____223_CM 0. 655.35 DISPLAY_IDENTIFIER C_T_MAX_V_OFS_ADJ_R_IT_LS_UP FORMAT "%6.2" /end CHARACTERISTIC
/begin CHARACTERISTIC c_t_max_fac_gain_r_it_ls_up "Maximum permitted time for gain adjust measurement" VALUE 0x840ecc _REC_VAL_20_u2 655.35 _CNV_A_R_LINEAR_____223_CM 0. 655.35 DISPLAY_IDENTIFIER C_T_MAX_FAC_GAIN_R_IT_LS_UP FORMAT "%6.2" /end CHARACTERISTIC
/begin CHARACTERISTIC c_t_max_v_ofs_mes_r_it_ls_up "Maximum permitted time for offset measurement in measurement mode" VALUE 0x840eda _REC_VAL_20_u2 655.35 _CNV_A_R_LINEAR_____223_CM 0. 655.35 DISPLAY_IDENTIFIER C_T_MAX_V_OFS_MES_R_IT_LS_UP FORMAT "%6.2" /end CHARACTERISTIC
/begin CHARACTERISTIC c_v_dif_max_ofs_adj_r_it_ls_up "Maximum permitted deviation of V_OFS_ADJ_R_IT_LS_UP[NC_CBK_EX_NR] to nominal reference value" VALUE 0x840f34 _REC_VAL_20_u2 4.995 _CNV_A_R_EGCP_LINEA_502_CM 0. 4.995 DISPLAY_IDENTIFIER C_V_DIF_MAX_OFS_ADJ_R_IT_LS_UP FORMAT "%5.3" /end CHARACTERISTIC
/begin CHARACTERISTIC c_v_dif_max_ofs_mes_r_it_ls_up "Maximum permitted deviation of V_OFS_MES_R_IT_LS_UP[NC_CBK_EX_NR] to nominal reference value" VALUE 0x840f36 _REC_VAL_20_u2 4.995 _CNV_A_R_EGCP_LINEA_502_CM 0. 4.995 DISPLAY_IDENTIFIER C_V_DIF_MAX_OFS_MES_R_IT_LS_UP FORMAT "%5.3" /end CHARACTERISTIC
/begin CHARACTERISTIC lc_r_rng_req_ls_up_lsl_if "Boolean flag selecting internal resistance determination circuit gain when manual switching enabled" VALUE 0x840fb6 _REC_VAL_20_u1 1. _CNV_A_R_LINEAR_____1_CM 0. 1. DISPLAY_IDENTIFIER LC_R_RNG_REQ_LS_UP_LSL_IF FORMAT "%1.0" /end CHARACTERISTIC
/begin CHARACTERISTIC lc_r_rng_req_swi_ls_up_lsl_if "Boolean flag enabling manual switching of internal resistance determination circuit gain" VALUE 0x840fb7 _REC_VAL_20_u1 1. _CNV_A_R_LINEAR_____1_CM 0. 1. DISPLAY_IDENTIFIER LC_R_RNG_REQ_SWI_LS_UP_LSL_IF FORMAT "%1.0" /end CHARACTERISTIC
/begin CHARACTERISTIC c_fac_gain_r_it_ls_up "Factor used when determining high gain = (C_R_IT_REF_LS_UP+R5+R6)/(5V*(R5+R6)" VALUE 0x840dca _REC_VAL_20_u2 76.7988 _CNV_A_R_EGCP_LINEA_525_CM 0. 76.7988 DISPLAY_IDENTIFIER C_FAC_GAIN_R_IT_LS_UP /end CHARACTERISTIC
/begin CHARACTERISTIC c_r_it_ref_ls_up "Reference current pulse resistor for internal resistance determination circuit = (R2*R1)/(R2+R1)" VALUE 0x840e88 _REC_VAL_20_u2 65535. _CNV_A_R_LINEAR_____480_CM 0. 65535. DISPLAY_IDENTIFIER C_R_IT_REF_LS_UP FORMAT "%5.0" /end CHARACTERISTIC
/begin CHARACTERISTIC c_fac_gain_h_dif_r_it_ls_up "Maximum permitted deviation of measured FAC_GAIN_H_R_IT_LS_UP[NC_CBK_EX_NR] from nominal reference value" VALUE 0x840dc2 _REC_VAL_20_u2 23.999634 _CNV_A_R_EGCP_LINEA_503_CM 0. 23.999634 DISPLAY_IDENTIFIER C_FAC_GAIN_H_DIF_R_IT_LS_UP FORMAT "%7.4" /end CHARACTERISTIC
/begin CHARACTERISTIC c_fac_gain_h_r_it_ls_up "Reference high gain for internal resistance determination circuit" VALUE 0x840dc4 _REC_VAL_20_u2 23.999634 _CNV_A_R_EGCP_LINEA_503_CM 0. 23.999634 DISPLAY_IDENTIFIER C_FAC_GAIN_H_R_IT_LS_UP FORMAT "%7.4" /end CHARACTERISTIC
/begin CHARACTERISTIC c_fac_gain_l_dif_r_it_ls_up "Maximum permitted deviation of measured FAC_GAIN_L_R_IT_LS_UP[NC_CBK_EX_NR] from nominal reference value" VALUE 0x840dc6 _REC_VAL_20_u2 23.999634 _CNV_A_R_EGCP_LINEA_503_CM 0. 23.999634 DISPLAY_IDENTIFIER C_FAC_GAIN_L_DIF_R_IT_LS_UP FORMAT "%7.4" /end CHARACTERISTIC
/begin CHARACTERISTIC c_fac_gain_l_r_it_ls_up "Reference low gain for internal resistance determination circuit" VALUE 0x840dc8 _REC_VAL_20_u2 23.999634 _CNV_A_R_EGCP_LINEA_503_CM 0. 23.999634 DISPLAY_IDENTIFIER C_FAC_GAIN_L_R_IT_LS_UP FORMAT "%7.4" /end CHARACTERISTIC
/begin CHARACTERISTIC c_v_ofs_ref_r_it_ls_up "Reference offset voltage for internal resistance determination circuit" VALUE 0x840f4c _REC_VAL_20_u2 4.995 _CNV_A_R_EGCP_LINEA_502_CM 0. 4.995 DISPLAY_IDENTIFIER C_V_OFS_REF_R_IT_LS_UP FORMAT "%5.3" /end CHARACTERISTIC
/begin CHARACTERISTIC c_frq_r_it_osc_lsl_if "Coded information for Ri determination oscillator frequency" VALUE 0x840de5 _REC_VAL_20_u1 127. _CNV_A_R_LINEAR_____1_CM 0. 127. DISPLAY_IDENTIFIER C_FRQ_R_IT_OSC_LSL_IF FORMAT "%3.0" /end CHARACTERISTIC
/begin CHARACTERISTIC lc_v_ref_r_it_ls_up "Boolean flag enabling internal resistance determination circuit reference measurement" VALUE 0x840fbb _REC_VAL_20_u1 1. _CNV_A_R_LINEAR_____1_CM 0. 1. DISPLAY_IDENTIFIER LC_V_REF_R_IT_LS_UP FORMAT "%1.0" /end CHARACTERISTIC
/begin CHARACTERISTIC c_ctr_min_diag_scg_ls_down "Minimum duration required for continious low VLS_DOWN[i] detection" VALUE 0x840da9 _REC_VAL_20_u1 255. _CNV_A_R_LINEAR_____1_CM 0. 255. DISPLAY_IDENTIFIER C_CTR_MIN_DIAG_SCG_LS_DOWN FORMAT "%3.0" /end CHARACTERISTIC
/begin CHARACTERISTIC c_maf_kgh_min_diag_scg_ls_down "Minimum MAF_KGH flow required for continious low VLS_DOWN[i] detection" VALUE 0x840e6c _REC_VAL_20_u2 2047.96875 _CNV_A_R_LINEAR_____472_CM 0. 2047.96875 DISPLAY_IDENTIFIER C_MAF_KGH_MIN_DIAG_SCG_LS_DOWN FORMAT "%10.5" /end CHARACTERISTIC
/begin CHARACTERISTIC c_vls_thd_diag_scp_ls_down "Oxygen sensor voltage threshold over which short to Vbatt present" VALUE 0x840f92 _REC_VAL_20_u2 4.9951171875 _CNV_A_R_LINEAR_____260_CM 0. 4.9951171875 DISPLAY_IDENTIFIER C_VLS_THD_DIAG_SCP_LS_DOWN FORMAT "%5.3" /end CHARACTERISTIC
/begin CHARACTERISTIC c_r_it_max_diag_scg_ls_down "Maximum resistance threshold oxygen sensor internal resistance during short to ground sensor" VALUE 0x840e84 _REC_VAL_20_u2 65535. _CNV_A_R_LINEAR_____480_CM 0. 65535. DISPLAY_IDENTIFIER C_R_IT_MAX_DIAG_SCG_LS_DOWN FORMAT "%5.0" /end CHARACTERISTIC
/begin CHARACTERISTIC c_r_it_min_diag_oc_ls_down "Minimum resistance threshold oxygen sensor internal resistance during open circuit sensor" VALUE 0x840e86 _REC_VAL_20_u2 65535. _CNV_A_R_LINEAR_____480_CM 0. 65535. DISPLAY_IDENTIFIER C_R_IT_MIN_DIAG_OC_LS_DOWN FORMAT "%5.0" /end CHARACTERISTIC
/begin CHARACTERISTIC c_t_cdn_diag_oc_ls_down "Minimum required duration where voltage lies outside of the limits for operable sensor to detect fault" VALUE 0x840e92 _REC_VAL_20_u2 6553.5 _CNV_A_R_LINEAR_____234_CM 0. 6553.5 DISPLAY_IDENTIFIER C_T_CDN_DIAG_OC_LS_DOWN FORMAT "%6.1" /end CHARACTERISTIC
/begin CHARACTERISTIC c_t_dly_diag_oc_ls_down "Minimum required duration where voltage lies outside of the limits for operable sensor to detect fault" VALUE 0x840ea2 _REC_VAL_20_u2 6553.5 _CNV_A_R_LINEAR_____234_CM 0. 6553.5 DISPLAY_IDENTIFIER C_T_DLY_DIAG_OC_LS_DOWN FORMAT "%6.1" /end CHARACTERISTIC
/begin CHARACTERISTIC c_t_dly_diag_scg_ls_down "Minimum duration required for low VLS_DOWN[i] detection" VALUE 0x840ea6 _REC_VAL_20_u2 6553.5 _CNV_A_R_LINEAR_____234_CM 0. 6553.5 DISPLAY_IDENTIFIER C_T_DLY_DIAG_SCG_LS_DOWN FORMAT "%6.1" /end CHARACTERISTIC
/begin CHARACTERISTIC c_teg_cat_min_diag_oc_ls_down "Minimum requested exhaust gas temperature for diagnosis" VALUE 0x840f0e _REC_VAL_20_u2 2047. _CNV_A_R_EGCP_LINEA_461_CM 0. 2047. DISPLAY_IDENTIFIER C_TEG_CAT_MIN_DIAG_OC_LS_DOWN FORMAT "%9.4" /end CHARACTERISTIC
/begin CHARACTERISTIC c_vls_thd_diag_scg_ls_down "Oxygen sensor voltage threshold under which short to GND may be present" VALUE 0x840f90 _REC_VAL_20_u2 4.9951171875 _CNV_A_R_LINEAR_____260_CM 0. 4.9951171875 DISPLAY_IDENTIFIER C_VLS_THD_DIAG_SCG_LS_DOWN FORMAT "%5.3" /end CHARACTERISTIC
/begin CHARACTERISTIC c_vls_afl_thd_diag_oc_ls_down "Oxygen sensor voltage-lean mixture threshold for diagnosis" VALUE 0x840f54 _REC_VAL_20_u2 4.9951171875 _CNV_A_R_LINEAR_____260_CM 0. 4.9951171875 DISPLAY_IDENTIFIER C_VLS_AFL_THD_DIAG_OC_LS_DOWN FORMAT "%5.3" /end CHARACTERISTIC
/begin CHARACTERISTIC c_vls_afr_thd_diag_oc_ls_down "Oxygen sensor voltage-rich mixture threshold for diagnosis" VALUE 0x840f5a _REC_VAL_20_u2 4.9951171875 _CNV_A_R_LINEAR_____260_CM 0. 4.9951171875 DISPLAY_IDENTIFIER C_VLS_AFR_THD_DIAG_OC_LS_DOWN FORMAT "%5.3" /end CHARACTERISTIC
/begin MEASUREMENT lv_err_scp_ls_down_1 "Boolean error flag, short to plus fault currently present on downstream oxygen sensor signal" UBYTE _CNV_S_2_RANGE__0___88_CM 1 0. 0. 1. DISPLAY_IDENTIFIER LV_ERR_SCP_LS_DOWN_1_ ECU_ADDRESS 0x7fb56d BIT_MASK 0x1 /end MEASUREMENT
/begin MEASUREMENT lv_err_scg_ls_down_1 "Boolean error flag, short to ground fault currently present on downstream oxygen sensor signal" UBYTE _CNV_S_2_RANGE__0___88_CM 1 0. 0. 1. DISPLAY_IDENTIFIER LV_ERR_SCG_LS_DOWN_1_ ECU_ADDRESS 0x7fb56c BIT_MASK 0x1 /end MEASUREMENT
/begin MEASUREMENT lv_err_oc_ls_down_1 "Boolean error flag, open circuit fault currently present on downstream oxygen sensor signal" UBYTE _CNV_S_2_RANGE__0___88_CM 1 0. 0. 1. DISPLAY_IDENTIFIER LV_ERR_OC_LS_DOWN_1_ ECU_ADDRESS 0x7fb56e BIT_MASK 0x1 /end MEASUREMENT
/begin CHARACTERISTIC c_tco_min_diag_mpl_ls_down "Minimum coolant temperature for diagnosis of the monitor sensors" VALUE 0x840f02 _REC_VAL_20_u1 190.5 _CNV_A_R_LINEAR_____251_CM -48. 142.5 DISPLAY_IDENTIFIER C_TCO_MIN_DIAG_MPL_LS_DOWN FORMAT "%6.2" /end CHARACTERISTIC
/begin CHARACTERISTIC c_vs_min_diag_mpl_ls_down "Minimum vehicle speed for diagnosis of the monitor sensors" VALUE 0x840f9e _REC_VAL_20_u1 255. _CNV_A_R_LINEAR_____239_CM 0. 255. DISPLAY_IDENTIFIER C_VS_MIN_DIAG_MPL_LS_DOWN FORMAT "%3.0" /end CHARACTERISTIC
/begin CHARACTERISTIC c_vs_max_diag_mpl_ls_down "Maximum vehicle speed for diagnosis of the monitor sensors" VALUE 0x840f9d _REC_VAL_20_u1 255. _CNV_A_R_LINEAR_____239_CM 0. 255. DISPLAY_IDENTIFIER C_VS_MAX_DIAG_MPL_LS_DOWN FORMAT "%3.0" /end CHARACTERISTIC
/begin CHARACTERISTIC c_temp_cat_min_diag_mpl_ls_down "Catalyst temperature threshold for diagnosis of the monitor sensors" VALUE 0x840f1a _REC_VAL_20_u1 1020. _CNV_A_R_EGCP_LINEA_526_CM -33. 987. DISPLAY_IDENTIFIER C_TEMP_CAT_MIN_DIAG_MPL_LS_DOWN FORMAT "%3.0" /end CHARACTERISTIC
/begin MEASUREMENT maf_kgh_min_puc "Minimum value of MAF_KGH while switching time calculation" UWORD _CNV_A_R_LINEAR_____472_CM 1 0. 0. 2047.96875 DISPLAY_IDENTIFIER MAF_KGH_MIN_PUC ECU_ADDRESS 0x7fa516 BYTE_ORDER MSB_LAST FORMAT "%10.5" /end MEASUREMENT
/begin AXIS_PTS ldp_maf_kgh_ip_fac_ls_down "" 0x840876 maf_kgh _REC_AXS_20_u2 2047.96875 _CNV_A_R_LINEAR_____472_CM 8 0. 2047.96875 FORMAT "%10.5" /end AXIS_PTS
/begin CHARACTERISTIC ip_fac_cycnr_max_ls_down_act "Weighting factor for CTR_SWT_ACT_LS_DOWN[NC_CBK_EX_NR]" CURVE 0x840b10 _REC_CUR_20_u1_u2 5100. _CNV_A_R_LINEAR_____434_CM 0. 5100. DISPLAY_IDENTIFIER IP_FAC_CYCNR_MAX_LS_DOWN_ACT FORMAT "%4.0"
 /begin AXIS_DESCR COM_AXIS maf_kgh _CNV_A_R_LINEAR_____472_CM 8 0. 2047.96875 FORMAT "%10.5" AXIS_PTS_REF ldp_maf_kgh_ip_fac_ls_down /end AXIS_DESCR
/end CHARACTERISTIC
/begin CHARACTERISTIC c_maf_int_puc_diag_pue_ls_down "Threshold for activation of the diagnosis" VALUE 0x840e5c _REC_VAL_20_u2 1820.42 _CNV_A_R_LINEAR_____475_CM 0. 1820.42 DISPLAY_IDENTIFIER C_MAF_INT_PUC_DIAG_PUE_LS_DOWN FORMAT "%7.2" /end CHARACTERISTIC
/begin CHARACTERISTIC c_maf_int_diag_pue_ls_down "Threshold for start of the diagnosis" VALUE 0x840e4e _REC_VAL_20_u2 1820.42 _CNV_A_R_LINEAR_____475_CM 0. 1820.42 DISPLAY_IDENTIFIER C_MAF_INT_DIAG_PUE_LS_DOWN FORMAT "%7.2" /end CHARACTERISTIC
/begin CHARACTERISTIC c_ctr_swt_diag_ls_down "Condition for the start of the lambda sensor switching time check" VALUE 0x840dae _REC_VAL_20_u1 255. _CNV_A_R_LINEAR_____1_CM 0. 255. DISPLAY_IDENTIFIER C_CTR_SWT_DIAG_LS_DOWN FORMAT "%3.0" /end CHARACTERISTIC
/begin CHARACTERISTIC c_ctr_sym_inc_diag_pue_ls_down "Counter increment for PUE_VLS_DOWN diagnosis" VALUE 0x840db1 _REC_VAL_20_u1 255. _CNV_A_R_LINEAR_____1_CM 0. 255. DISPLAY_IDENTIFIER C_CTR_SYM_INC_DIAG_PUE_LS_DOWN FORMAT "%3.0" /end CHARACTERISTIC
/begin CHARACTERISTIC c_ctr_sym_max_diag_pue_ls_down "Maximum value of  counter for PUE_VLS_DOWN diagnosis" VALUE 0x840db2 _REC_VAL_20_u1 255. _CNV_A_R_LINEAR_____1_CM 0. 255. DISPLAY_IDENTIFIER C_CTR_SYM_MAX_DIAG_PUE_LS_DOWN FORMAT "%3.0" /end CHARACTERISTIC
/begin CHARACTERISTIC c_vls_dif_min_diag_pue_ls_down "Threshold for VLS_DIF_DIAG_PUE_LS_DOWN[NC_CBK_EX_NR]" VALUE 0x840f60 _REC_VAL_20_u2 4.9951171875 _CNV_A_R_LINEAR_____260_CM 0. 4.9951171875 DISPLAY_IDENTIFIER C_VLS_DIF_MIN_DIAG_PUE_LS_DOWN FORMAT "%5.3" /end CHARACTERISTIC
/begin CHARACTERISTIC c_ctr_swt_ls_down "Diagnostic threshold for CTR_CYCNR_SWT_LS_DOWN[NC_CBK_EX_NR]" VALUE 0x840daf _REC_VAL_20_u1 1.9921875 _CNV_A_R_LINEAR_____240_CM 0. 1.9921875 DISPLAY_IDENTIFIER C_CTR_SWT_LS_DOWN FORMAT "%8.6" /end CHARACTERISTIC
/begin CHARACTERISTIC c_maf_puc_max_diag_swt_ls_down "Mass air flow threshold for diagnosis of the switching times" VALUE 0x840e70 _REC_VAL_20_u2 2047.96875 _CNV_A_R_LINEAR_____472_CM 0. 2047.96875 DISPLAY_IDENTIFIER C_MAF_PUC_MAX_DIAG_SWT_LS_DOWN FORMAT "%10.5" /end CHARACTERISTIC
/begin CHARACTERISTIC c_maf_puc_min_diag_swt_ls_down "Mass air flow threshold for diagnosis of the switching times" VALUE 0x840e72 _REC_VAL_20_u2 2047.96875 _CNV_A_R_LINEAR_____472_CM 0. 2047.96875 DISPLAY_IDENTIFIER C_MAF_PUC_MIN_DIAG_SWT_LS_DOWN FORMAT "%10.5" /end CHARACTERISTIC
/begin CHARACTERISTIC c_fac_vls_max_diag_swt_ls_down "Reduction factor for start of switching time determination" VALUE 0x840de3 _REC_VAL_20_u1 0.99609375 _CNV_A_R_LINEAR_____248_CM 0. 0.99609375 DISPLAY_IDENTIFIER C_FAC_VLS_MAX_DIAG_SWT_LS_DOWN FORMAT "%5.3" /end CHARACTERISTIC
/begin CHARACTERISTIC c_vls_hys_diag_swt_ls_down "Monitor sensor voltage hysteresis" VALUE 0x840f82 _REC_VAL_20_u2 4.9951171875 _CNV_A_R_LINEAR_____260_CM 0. 4.9951171875 DISPLAY_IDENTIFIER C_VLS_HYS_DIAG_SWT_LS_DOWN FORMAT "%5.3" /end CHARACTERISTIC
/begin CHARACTERISTIC c_vls_puc_min_diag_swt_ls_down "Voltage threshold for monitor sensor diagnosis" VALUE 0x840f8e _REC_VAL_20_u2 4.9951171875 _CNV_A_R_LINEAR_____260_CM 0. 4.9951171875 DISPLAY_IDENTIFIER C_VLS_PUC_MIN_DIAG_SWT_LS_DOWN FORMAT "%5.3" /end CHARACTERISTIC
/begin CHARACTERISTIC c_fac_vls_min_diag_swt_ls_down "Reduction factor for end of switching time determination" VALUE 0x840de4 _REC_VAL_20_u1 0.99609375 _CNV_A_R_LINEAR_____248_CM 0. 0.99609375 DISPLAY_IDENTIFIER C_FAC_VLS_MIN_DIAG_SWT_LS_DOWN FORMAT "%5.3" /end CHARACTERISTIC
/begin CHARACTERISTIC c_ctr_end_diag_pue_ls_down "Counter threshold for CTR_END_DIAG_PUE_LS_DOWN[NC_CBK_EX_NR]" VALUE 0x840d98 _REC_VAL_20_u2 65535. _CNV_A_R_LINEAR_____1_CM 0. 65535. DISPLAY_IDENTIFIER C_CTR_END_DIAG_PUE_LS_DOWN FORMAT "%5.0" /end CHARACTERISTIC
/begin MEASUREMENT lv_err_pue_ls_down_1 "Debounced diagnosis result of pull end plausibility" UBYTE _CNV_S_2_RANGE__0___88_CM 1 0. 0. 1. DISPLAY_IDENTIFIER LV_ERR_PUE_LS_DOWN_1_ ECU_ADDRESS 0x7fb580 BIT_MASK 0x1 /end MEASUREMENT
/begin MEASUREMENT lv_err_swt_ls_down_1 "Error bit of the switching time diagnosis" UBYTE _CNV_S_2_RANGE__0___88_CM 1 0. 0. 1. DISPLAY_IDENTIFIER LV_ERR_SWT_LS_DOWN_1_ ECU_ADDRESS 0x7fb57f BIT_MASK 0x1 /end MEASUREMENT
/begin CHARACTERISTIC c_abc_max_scg_ls_down "Debounce counter maximum for short to ground electrical check" VALUE 0x840d7d _REC_VAL_20_u1 255. _CNV_A_R_LINEAR_____1_CM 0. 255. DISPLAY_IDENTIFIER C_ABC_MAX_SCG_LS_DOWN FORMAT "%3.0" /end CHARACTERISTIC
/begin CHARACTERISTIC c_abc_inc_scg_ls_down "Debounce counter increment for short to ground electrical check" VALUE 0x840d71 _REC_VAL_20_u1 255. _CNV_A_R_LINEAR_____1_CM 0. 255. DISPLAY_IDENTIFIER C_ABC_INC_SCG_LS_DOWN FORMAT "%3.0" /end CHARACTERISTIC
/begin CHARACTERISTIC c_abc_inc_oc_ls_down "Debounce counter increment for open line electrical check" VALUE 0x840d6e _REC_VAL_20_u1 255. _CNV_A_R_LINEAR_____1_CM 0. 255. DISPLAY_IDENTIFIER C_ABC_INC_OC_LS_DOWN FORMAT "%3.0" /end CHARACTERISTIC
/begin CHARACTERISTIC c_abc_max_oc_ls_down "Debounce counter maximum for open line electrical check" VALUE 0x840d7a _REC_VAL_20_u1 255. _CNV_A_R_LINEAR_____1_CM 0. 255. DISPLAY_IDENTIFIER C_ABC_MAX_OC_LS_DOWN FORMAT "%3.0" /end CHARACTERISTIC
/begin CHARACTERISTIC c_abc_max_scp_ls_down "Debounce counter increment for short to plus electrical check" VALUE 0x840d7e _REC_VAL_20_u1 255. _CNV_A_R_LINEAR_____1_CM 0. 255. DISPLAY_IDENTIFIER C_ABC_MAX_SCP_LS_DOWN FORMAT "%3.0" /end CHARACTERISTIC
/begin CHARACTERISTIC c_abc_inc_scp_ls_down "Debounce counter maximum for short to plus electrical check" VALUE 0x840d72 _REC_VAL_20_u1 255. _CNV_A_R_LINEAR_____1_CM 0. 255. DISPLAY_IDENTIFIER C_ABC_INC_SCP_LS_DOWN FORMAT "%3.0" /end CHARACTERISTIC
/begin CHARACTERISTIC c_abc_inc_puc_ls_down "Debounce counter increment for PUC plausibility" VALUE 0x840d6f _REC_VAL_20_u1 255. _CNV_A_R_LINEAR_____1_CM 0. 255. DISPLAY_IDENTIFIER C_ABC_INC_PUC_LS_DOWN FORMAT "%3.0" /end CHARACTERISTIC
/begin CHARACTERISTIC c_abc_inc_fl_ls_down "Debounce counter increment for FL plausibility" VALUE 0x840d6d _REC_VAL_20_u1 255. _CNV_A_R_LINEAR_____1_CM 0. 255. DISPLAY_IDENTIFIER C_ABC_INC_FL_LS_DOWN FORMAT "%3.0" /end CHARACTERISTIC
/begin CHARACTERISTIC c_abc_max_puc_ls_down "Debounce counter maximum for PUC plausibility" VALUE 0x840d7b _REC_VAL_20_u1 255. _CNV_A_R_LINEAR_____1_CM 0. 255. DISPLAY_IDENTIFIER C_ABC_MAX_PUC_LS_DOWN FORMAT "%3.0" /end CHARACTERISTIC
/begin CHARACTERISTIC c_abc_max_fl_ls_down "Debounce counter maximum for FL plausibility" VALUE 0x840d79 _REC_VAL_20_u1 255. _CNV_A_R_LINEAR_____1_CM 0. 255. DISPLAY_IDENTIFIER C_ABC_MAX_FL_LS_DOWN FORMAT "%3.0" /end CHARACTERISTIC
/begin CHARACTERISTIC c_abc_inc_rgn_nt_ls_down "Anti-bounce counter increment for VLS_DOWN_RGN_NT diagnosis" VALUE 0x840d70 _REC_VAL_20_u1 255. _CNV_A_R_LINEAR_____1_CM 0. 255. DISPLAY_IDENTIFIER C_ABC_INC_RGN_NT_LS_DOWN FORMAT "%3.0" /end CHARACTERISTIC
/begin CHARACTERISTIC c_abc_max_rgn_nt_ls_down "Maximum value of anti-bounce counter for VLS_DOWN_RGN_NT diagnosis" VALUE 0x840d7c _REC_VAL_20_u1 254. _CNV_A_R_LINEAR_____1_CM 1. 255. DISPLAY_IDENTIFIER C_ABC_MAX_RGN_NT_LS_DOWN FORMAT "%3.0" /end CHARACTERISTIC
/begin MEASUREMENT lv_err_obd_vld_lsh_up_1 "Boolean flag indicating the validation of correspondent symptom (transmitted to the error management)" UBYTE _CNV_S_2_RANGE__0___88_CM 1 0. 0. 1. DISPLAY_IDENTIFIER LV_ERR_OBD_VLD_LSH_UP_1_ ECU_ADDRESS 0x7fb57b BIT_MASK 0x1 /end MEASUREMENT
/begin MEASUREMENT lv_err_puc_vld_ls_up_1 "Boolean flag indicating the validation of correspondent symptom (transmitted to the error management)" UBYTE _CNV_S_2_RANGE__0___88_CM 1 0. 0. 1. DISPLAY_IDENTIFIER LV_ERR_PUC_VLD_LS_UP_1_ ECU_ADDRESS 0x7fb57a BIT_MASK 0x1 /end MEASUREMENT
/begin CHARACTERISTIC lc_err_dyn_vld_ls_up "Allow Sensor Dynamic Fault to be considered as Sensor Failure (stops closed loop AF control)" VALUE 0x840fa1 _REC_VAL_20_u1 1. _CNV_A_R_LINEAR_____1_CM 0. 1. DISPLAY_IDENTIFIER LC_ERR_DYN_VLD_LS_UP FORMAT "%1.0" /end CHARACTERISTIC
/begin MEASUREMENT lv_err_dyn_vld_ls_up_1 "Boolean flag indicating the validation of correspondent symptom (transmitted to the error management)" UBYTE _CNV_S_2_RANGE__0___88_CM 1 0. 0. 1. DISPLAY_IDENTIFIER LV_ERR_DYN_VLD_LS_UP_1_ ECU_ADDRESS 0x7fb579 BIT_MASK 0x1 /end MEASUREMENT
/begin MEASUREMENT lv_err_shift_afl_lsl_up_1 "WRAF Sensor characteristic line shift to lean ERROR detected" UBYTE _CNV_S_2_RANGE__0___88_CM 1 0. 0. 1. DISPLAY_IDENTIFIER LV_ERR_SHIFT_AFL_LSL_UP_1_ ECU_ADDRESS 0x7fb57c BIT_MASK 0x1 /end MEASUREMENT
/begin MEASUREMENT lv_err_shift_afr_lsl_up_1 "WRAF Sensor characteristic line shift to rich ERROR detected" UBYTE _CNV_S_2_RANGE__0___88_CM 1 0. 0. 1. DISPLAY_IDENTIFIER LV_ERR_SHIFT_AFR_LSL_UP_1_ ECU_ADDRESS 0x7fb57d BIT_MASK 0x1 /end MEASUREMENT
/begin CHARACTERISTIC c_t_on_thd_lsh_diag_st_lsl_up "Minimum duration of heater activation after starting time exceeded" VALUE 0x840ede _REC_VAL_20_u2 6553.5 _CNV_A_R_LINEAR_____234_CM 0. 6553.5 DISPLAY_IDENTIFIER C_T_ON_THD_LSH_DIAG_ST_LSL_UP FORMAT "%6.1" /end CHARACTERISTIC
/begin CHARACTERISTIC c_t_lam_lim_diag_st_lsl_up "Minimum duration of the lambda controller manipulated value limitation to assure false start recognition" VALUE 0x840ec4 _REC_VAL_20_u1 25.5 _CNV_A_R_LINEAR_____234_CM 0. 25.5 DISPLAY_IDENTIFIER C_T_LAM_LIM_DIAG_ST_LSL_UP FORMAT "%4.1" /end CHARACTERISTIC
/begin AXIS_PTS ldp_tco_ip_t_max_diag_st_lsl_up "" 0x840922 tco_st _REC_AXS_20_u1 190.5 _CNV_A_R_LINEAR_____251_CM 4 -48. 142.5 FORMAT "%6.2" /end AXIS_PTS
/begin CHARACTERISTIC ip_t_max_diag_st_lsl_up "Maximum value of the starting time for a normal start" CURVE 0x840cd6 _REC_CUR_20_u1_u1 25.5 _CNV_A_R_LINEAR_____234_CM 0. 25.5 DISPLAY_IDENTIFIER IP_T_MAX_DIAG_ST_LSL_UP FORMAT "%4.1"
 /begin AXIS_DESCR COM_AXIS tco_st _CNV_A_R_LINEAR_____251_CM 4 -48. 142.5 FORMAT "%6.2" AXIS_PTS_REF ldp_tco_ip_t_max_diag_st_lsl_up /end AXIS_DESCR
/end CHARACTERISTIC
/begin CHARACTERISTIC c_vls_down_min_plaus_lsl_up "Minimum voltage of the oxygen sensor to carry out the plausibility" VALUE 0x840f74 _REC_VAL_20_u2 4.9951171875 _CNV_A_R_LINEAR_____260_CM 0. 4.9951171875 DISPLAY_IDENTIFIER C_VLS_DOWN_MIN_PLAUS_LSL_UP FORMAT "%5.3" /end CHARACTERISTIC
/begin CHARACTERISTIC c_vls_down_max_plaus_lsl_up "Maximum voltage of the oxygen sensor to carry out the plausibility" VALUE 0x840f70 _REC_VAL_20_u2 4.9951171875 _CNV_A_R_LINEAR_____260_CM 0. 4.9951171875 DISPLAY_IDENTIFIER C_VLS_DOWN_MAX_PLAUS_LSL_UP FORMAT "%5.3" /end CHARACTERISTIC
/begin CHARACTERISTIC c_temp_cat_min_plaus_lsl_up "Minimum temperature of the catalyst to carry out the plausibility" VALUE 0x840f1c _REC_VAL_20_u2 1023.984375 _CNV_A_R_LINEAR_____523_CM -33. 990.984375 DISPLAY_IDENTIFIER C_TEMP_CAT_MIN_PLAUS_LSL_UP FORMAT "%10.6" /end CHARACTERISTIC
/begin CHARACTERISTIC c_temp_cat_max_plaus_lsl_up "Maximum temperature of the catalyst to carry out the plausibility" VALUE 0x840f18 _REC_VAL_20_u2 1023.984375 _CNV_A_R_LINEAR_____523_CM -33. 990.984375 DISPLAY_IDENTIFIER C_TEMP_CAT_MAX_PLAUS_LSL_UP FORMAT "%10.6" /end CHARACTERISTIC
/begin CHARACTERISTIC c_maf_kgh_min_diag_plaus_lsl_up "Minimum mass air flow to carry out the plausibility" VALUE 0x840e6a _REC_VAL_20_u2 2047.96875 _CNV_A_R_LINEAR_____472_CM 0. 2047.96875 DISPLAY_IDENTIFIER C_MAF_KGH_MIN_DIAG_PLAUS_LSL_UP FORMAT "%10.5" /end CHARACTERISTIC
/begin CHARACTERISTIC c_maf_kgh_max_diag_plaus_lsl_up "Maximum mass air flow to carry out the plausibility" VALUE 0x840e66 _REC_VAL_20_u2 2047.96875 _CNV_A_R_LINEAR_____472_CM 0. 2047.96875 DISPLAY_IDENTIFIER C_MAF_KGH_MAX_DIAG_PLAUS_LSL_UP FORMAT "%10.5" /end CHARACTERISTIC
/begin CHARACTERISTIC c_eff_cat_diag_plaus_lsl_up "Maximum value of the catalyst efficiency diagnosis to carry out the plausibility" VALUE 0x840db8 _REC_VAL_20_u1 1.9921875 _CNV_A_R_LINEAR_____240_CM 0. 1.9921875 DISPLAY_IDENTIFIER C_EFF_CAT_DIAG_PLAUS_LSL_UP FORMAT "%8.6" /end CHARACTERISTIC
/begin CHARACTERISTIC c_vls_down_afl_plaus_lsl_up "Lean-mixture threshold of the downstream sensor voltage" VALUE 0x840f62 _REC_VAL_20_u2 4.9951171875 _CNV_A_R_LINEAR_____260_CM 0. 4.9951171875 DISPLAY_IDENTIFIER C_VLS_DOWN_AFL_PLAUS_LSL_UP FORMAT "%5.3" /end CHARACTERISTIC
/begin CHARACTERISTIC c_vls_down_afr_plaus_lsl_up "Rich-mixture threshold of the downstream sensor voltage" VALUE 0x840f66 _REC_VAL_20_u2 4.9951171875 _CNV_A_R_LINEAR_____260_CM 0. 4.9951171875 DISPLAY_IDENTIFIER C_VLS_DOWN_AFR_PLAUS_LSL_UP FORMAT "%5.3" /end CHARACTERISTIC
/begin CHARACTERISTIC c_lamb_afl_diag_plaus_lsl_up "Lean-mixture threshold of the upstream sensor voltage" VALUE 0x840df8 _REC_VAL_20_u2 31.9990234375 _CNV_A_R_LINEAR_____458_CM 0. 31.9990234375 DISPLAY_IDENTIFIER C_LAMB_AFL_DIAG_PLAUS_LSL_UP FORMAT "%7.4" /end CHARACTERISTIC
/begin CHARACTERISTIC c_lamb_afr_diag_plaus_lsl_up "Rich-mixture threshold of the upstream sensor voltage" VALUE 0x840e00 _REC_VAL_20_u2 31.9990234375 _CNV_A_R_LINEAR_____458_CM 0. 31.9990234375 DISPLAY_IDENTIFIER C_LAMB_AFR_DIAG_PLAUS_LSL_UP FORMAT "%7.4" /end CHARACTERISTIC
/begin CHARACTERISTIC c_lamb_min_diag_plaus_lsl_up "Minimum threshold of the upstream sensor to carry out a signal plausibility" VALUE 0x840e1c _REC_VAL_20_u2 31.9990234375 _CNV_A_R_LINEAR_____458_CM 0. 31.9990234375 DISPLAY_IDENTIFIER C_LAMB_MIN_DIAG_PLAUS_LSL_UP FORMAT "%7.4" /end CHARACTERISTIC
/begin CHARACTERISTIC c_lamb_max_diag_plaus_lsl_up "Maximum threshold of the upstream sensor to carry out a signal plausibility" VALUE 0x840e18 _REC_VAL_20_u2 31.9990234375 _CNV_A_R_LINEAR_____458_CM 0. 31.9990234375 DISPLAY_IDENTIFIER C_LAMB_MAX_DIAG_PLAUS_LSL_UP FORMAT "%7.4" /end CHARACTERISTIC
/begin CHARACTERISTIC c_tco_min_diag_plaus_lsl_up "Minimum threshold of the cooling-water temperature to activate the function" VALUE 0x840f03 _REC_VAL_20_u1 190.5 _CNV_A_R_LINEAR_____251_CM -48. 142.5 DISPLAY_IDENTIFIER C_TCO_MIN_DIAG_PLAUS_LSL_UP FORMAT "%6.2" /end CHARACTERISTIC
/begin AXIS_PTS ldp_maf_kgh_ip_t_diag_lsl_up "" 0x840888 maf_kgh _REC_AXS_20_u2 2047.96875 _CNV_A_R_LINEAR_____472_CM 4 0. 2047.96875 FORMAT "%10.5" /end AXIS_PTS
/begin CHARACTERISTIC ip_t_sym_diag_plaus_lsl_up "First anti-bounce filter: Time to debounce a plausibility error (compensation of the catalyst delay)" CURVE 0x840cda _REC_CUR_20_u2_u2 6553.5 _CNV_A_R_LINEAR_____234_CM 0. 6553.5 DISPLAY_IDENTIFIER IP_T_SYM_DIAG_PLAUS_LSL_UP FORMAT "%6.1"
 /begin AXIS_DESCR COM_AXIS maf_kgh _CNV_A_R_LINEAR_____472_CM 4 0. 2047.96875 FORMAT "%10.5" AXIS_PTS_REF ldp_maf_kgh_ip_t_diag_lsl_up /end AXIS_DESCR
/end CHARACTERISTIC
/begin CHARACTERISTIC c_t_end_diag_plaus_lsl_up "Time to have a diagnostic available" VALUE 0x840fbc _REC_VAL_20_u2 6553.5 _CNV_A_R_LINEAR_____234_CM 0. 6553.5 DISPLAY_IDENTIFIER C_T_END_DIAG_PLAUS_LSL_UP FORMAT "%6.1" /end CHARACTERISTIC
/begin CHARACTERISTIC c_ctr_err_ini_diag_st_lsl_up "Initial value in case of a false start" VALUE 0x840d9a _REC_VAL_20_u1 255. _CNV_A_R_LINEAR_____1_CM 0. 255. DISPLAY_IDENTIFIER C_CTR_ERR_INI_DIAG_ST_LSL_UP FORMAT "%3.0" /end CHARACTERISTIC
/begin CHARACTERISTIC c_ctr_inc_diag_plaus_lsl_up "Second anti-bounce filter: counter increment" VALUE 0x840da0 _REC_VAL_20_u1 255. _CNV_A_R_LINEAR_____1_CM 0. 255. DISPLAY_IDENTIFIER C_CTR_INC_DIAG_PLAUS_LSL_UP FORMAT "%3.0" /end CHARACTERISTIC
/begin CHARACTERISTIC c_ctr_dec_diag_plaus_lsl_up "Second anti-bounce filter: counter decrement" VALUE 0x840d96 _REC_VAL_20_u1 255. _CNV_A_R_LINEAR_____1_CM 0. 255. DISPLAY_IDENTIFIER C_CTR_DEC_DIAG_PLAUS_LSL_UP FORMAT "%3.0" /end CHARACTERISTIC
/begin CHARACTERISTIC c_ctr_thd_diag_plaus_lsl_up "Second anti-bounce filter: max. counter threshold" VALUE 0x840db3 _REC_VAL_20_u1 255. _CNV_A_R_LINEAR_____1_CM 0. 255. DISPLAY_IDENTIFIER C_CTR_THD_DIAG_PLAUS_LSL_UP FORMAT "%3.0" /end CHARACTERISTIC
/begin CHARACTERISTIC c_vls_up_max_diag_air_lsl_up "Upstream sensor signal max. threshold during engine operation (PUC excepted)" VALUE 0x840f94 _REC_VAL_20_u2 4.9951171875 _CNV_A_R_LINEAR_____260_CM 0. 4.9951171875 DISPLAY_IDENTIFIER C_VLS_UP_MAX_DIAG_AIR_LSL_UP FORMAT "%5.3" /end CHARACTERISTIC
/begin CHARACTERISTIC c_t_sym_diag_air_lsl_up "Time filter to detect a symptom" VALUE 0x840eea _REC_VAL_20_u2 6553.5 _CNV_A_R_LINEAR_____234_CM 0. 6553.5 DISPLAY_IDENTIFIER C_T_SYM_DIAG_AIR_LSL_UP FORMAT "%6.1" /end CHARACTERISTIC
/begin CHARACTERISTIC c_t_end_diag_air_lsl_up "Time to have a diagnostic available" VALUE 0x840eb8 _REC_VAL_20_u2 6553.5 _CNV_A_R_LINEAR_____234_CM 0. 6553.5 DISPLAY_IDENTIFIER C_T_END_DIAG_AIR_LSL_UP FORMAT "%6.1" /end CHARACTERISTIC
/begin CHARACTERISTIC c_t_diag_sym_puc_lsl_up "Time filter to detect a symptom" VALUE 0x840e9c _REC_VAL_20_u2 6553.5 _CNV_A_R_LINEAR_____234_CM 0. 6553.5 DISPLAY_IDENTIFIER C_T_DIAG_SYM_PUC_LSL_UP FORMAT "%6.1" /end CHARACTERISTIC
/begin CHARACTERISTIC c_t_dly_diag_puc_lsl_up "Waiting time after beginning of PUC to test sensor signal " VALUE 0x840ea4 _REC_VAL_20_u2 6553.5 _CNV_A_R_LINEAR_____234_CM 0. 6553.5 DISPLAY_IDENTIFIER C_T_DLY_DIAG_PUC_LSL_UP FORMAT "%6.1" /end CHARACTERISTIC
/begin CHARACTERISTIC c_vls_up_min_diag_puc_lsl_up "Minimum admissible upstream sensor output voltage in PUC" VALUE 0x840f9a _REC_VAL_20_u2 4.9951171875 _CNV_A_R_LINEAR_____260_CM 0. 4.9951171875 DISPLAY_IDENTIFIER C_VLS_UP_MIN_DIAG_PUC_LSL_UP FORMAT "%5.3" /end CHARACTERISTIC
/begin CHARACTERISTIC c_vls_up_max_diag_puc_lsl_up "Maximum admissible upstream sensor output voltage in PUC" VALUE 0x840f96 _REC_VAL_20_u2 4.9951171875 _CNV_A_R_LINEAR_____260_CM 0. 4.9951171875 DISPLAY_IDENTIFIER C_VLS_UP_MAX_DIAG_PUC_LSL_UP FORMAT "%5.3" /end CHARACTERISTIC
/begin CHARACTERISTIC c_teg_dyn_min_diag_puc_ls_up "Minimum admissible exhaust gas temperature in PUC" VALUE 0x840f16 _REC_VAL_20_u2 2047.9375 _CNV_A_R_EGCP_LINEA_461_CM 0. 2047.9375 DISPLAY_IDENTIFIER C_TEG_DYN_MIN_DIAG_PUC_LS_UP FORMAT "%7.2" /end CHARACTERISTIC
/begin CHARACTERISTIC c_t_diag_end_puc_lsl_up "Time to have a diagnostic available" VALUE 0x840e98 _REC_VAL_20_u2 6553.5 _CNV_A_R_LINEAR_____234_CM 0. 6553.5 DISPLAY_IDENTIFIER C_T_DIAG_END_PUC_LSL_UP FORMAT "%6.1" /end CHARACTERISTIC
/begin MEASUREMENT lv_err_air_lsl_up_1 "Debounced diagnosis result of upstream sensor signal monitoring" UBYTE _CNV_S_2_RANGE__0___88_CM 1 0. 0. 1. DISPLAY_IDENTIFIER LV_ERR_AIR_LSL_UP_1_ ECU_ADDRESS 0x7fb577 BIT_MASK 0x1 /end MEASUREMENT
/begin CHARACTERISTIC c_ctr_min_diag_dyn_lsl_up "Number of  single functions until to the calculation of the mean diagnosis value" VALUE 0x840da7 _REC_VAL_20_u1 255. _CNV_A_R_LINEAR_____1_CM 0. 255. DISPLAY_IDENTIFIER C_CTR_MIN_DIAG_DYN_LSL_UP FORMAT "%3.0" /end CHARACTERISTIC
/begin CHARACTERISTIC c_ctr_min_diag_eol_dyn_lsl_up "Number of  single functions until to the calculation of the mean diagnosis value (at the short test)" VALUE 0x840da8 _REC_VAL_20_u1 255. _CNV_A_R_LINEAR_____1_CM 0. 255. DISPLAY_IDENTIFIER C_CTR_MIN_DIAG_EOL_DYN_LSL_UP FORMAT "%3.0" /end CHARACTERISTIC
/begin CHARACTERISTIC c_ctr_wait_diag_dyn_lsl_up "Number of  forced stimulation cycles to wait until begin calculation of sensor signal amplitude" VALUE 0x840db4 _REC_VAL_20_u1 255. _CNV_A_R_LINEAR_____1_CM 0. 255. DISPLAY_IDENTIFIER C_CTR_WAIT_DIAG_DYN_LSL_UP FORMAT "%3.0" /end CHARACTERISTIC
/begin CHARACTERISTIC c_cycnr_ls_up_dyn_min "Minimun number of cycles necessary to finish the diagnosis" VALUE 0x840db5 _REC_VAL_20_u1 255. _CNV_A_R_LINEAR_____1_CM 0. 255. DISPLAY_IDENTIFIER C_CYCNR_LS_UP_DYN_MIN FORMAT "%3.0" /end CHARACTERISTIC
/begin CHARACTERISTIC c_cycnr_ls_up_dyn_min_ext_req "Minimun number of cycles necessary to finish the diagnosis for teh short test" VALUE 0x840db6 _REC_VAL_20_u1 255. _CNV_A_R_LINEAR_____1_CM 0. 255. DISPLAY_IDENTIFIER C_CYCNR_LS_UP_DYN_MIN_EXT_REQ FORMAT "%3.0" /end CHARACTERISTIC
/begin CHARACTERISTIC c_n_min_ls_dyn "Minimum number of revolutions to activate the diagnosis" VALUE 0x840e7b _REC_VAL_20_u1 8160. _CNV_A_R_LINEAR_____84_CM 0. 8160. DISPLAY_IDENTIFIER C_N_MIN_LS_DYN FORMAT "%4.0" /end CHARACTERISTIC
/begin CHARACTERISTIC c_n_max_ls_dyn "Maximum number of revolutions to activate the diagnosis" VALUE 0x840e7a _REC_VAL_20_u1 8160. _CNV_A_R_LINEAR_____84_CM 0. 8160. DISPLAY_IDENTIFIER C_N_MAX_LS_DYN FORMAT "%4.0" /end CHARACTERISTIC
/begin CHARACTERISTIC c_ls_dyn_diag_maf_max "Maximum mass flow to activate the diagnosis function" VALUE 0x840e36 _REC_VAL_20_u2 1389. _CNV_A_R_LINEAR_____483_CM 0. 1389. DISPLAY_IDENTIFIER C_LS_DYN_DIAG_MAF_MAX FORMAT "%7.2" /end CHARACTERISTIC
/begin CHARACTERISTIC c_ls_dyn_diag_maf_min "Minimum mass flow to activate the diagnosis function" VALUE 0x840e38 _REC_VAL_20_u2 1389. _CNV_A_R_LINEAR_____483_CM 0. 1389. DISPLAY_IDENTIFIER C_LS_DYN_DIAG_MAF_MIN FORMAT "%7.2" /end CHARACTERISTIC
/begin CHARACTERISTIC c_lamb_min_diag_dyn_lsl_up "Lowest allowed sensor signal min value" VALUE 0x840e1a _REC_VAL_20_u2 31.9990234375 _CNV_A_R_LINEAR_____458_CM 0. 31.9990234375 DISPLAY_IDENTIFIER C_LAMB_MIN_DIAG_DYN_LSL_UP FORMAT "%7.4" /end CHARACTERISTIC
/begin CHARACTERISTIC c_lamb_max_diag_dyn_lsl_up "Highest allowed sensor signal max value" VALUE 0x840e16 _REC_VAL_20_u2 31.9990234375 _CNV_A_R_LINEAR_____458_CM 0. 31.9990234375 DISPLAY_IDENTIFIER C_LAMB_MAX_DIAG_DYN_LSL_UP FORMAT "%7.4" /end CHARACTERISTIC
/begin CHARACTERISTIC c_fac_mv_thd_dyn_ls_up "Limited diagnosis value for the error diagnosis" VALUE 0x840dda _REC_VAL_20_u2 31.9990234375 _CNV_A_R_LINEAR_____458_CM 0. 31.9990234375 DISPLAY_IDENTIFIER C_FAC_MV_THD_DYN_LS_UP FORMAT "%7.4" /end CHARACTERISTIC
/begin CHARACTERISTIC c_fac_ad_thd_dyn_ls_up "Diagnosis value threshold for begin adaption of sensor time constant model" VALUE 0x840dbe _REC_VAL_20_u2 31.9990234375 _CNV_A_R_LINEAR_____458_CM 0. 31.9990234375 DISPLAY_IDENTIFIER C_FAC_AD_THD_DYN_LS_UP FORMAT "%7.4" /end CHARACTERISTIC
/begin CHARACTERISTIC c_fac_ad_delta_ls_up_dyn "Diagnosis value window allowed" VALUE 0x840dba _REC_VAL_20_u2 31.9990234375 _CNV_A_R_LINEAR_____458_CM 0. 31.9990234375 DISPLAY_IDENTIFIER C_FAC_AD_DELTA_LS_UP_DYN FORMAT "%7.4" /end CHARACTERISTIC
/begin CHARACTERISTIC c_fac_ad_lpf_dyn_ls_up "Low pass filter coeficient to calculate diagnosis mean value " VALUE 0x840dbc _REC_VAL_20_u1 0.99609375 _CNV_A_R_LINEAR_____248_CM 0. 0.99609375 DISPLAY_IDENTIFIER C_FAC_AD_LPF_DYN_LS_UP FORMAT "%5.3" /end CHARACTERISTIC
/begin CHARACTERISTIC lc_diag_dyn_lsl_up_cat_syn "Synchronize sensor dynamic diagnosis with the catalyst efficiency diagnosis" VALUE 0x840fa0 _REC_VAL_20_u1 1. _CNV_A_R_LINEAR_____1_CM 0. 1. DISPLAY_IDENTIFIER LC_DIAG_DYN_LSL_UP_CAT_SYN FORMAT "%1.0" /end CHARACTERISTIC
/begin CHARACTERISTIC lc_t1_ad_diag_dyn_lsl_up "Allow adaption of modeled sensor time constant T1_LAMB" VALUE 0x840fb8 _REC_VAL_20_u1 1. _CNV_A_R_LINEAR_____1_CM 0. 1. DISPLAY_IDENTIFIER LC_T1_AD_DIAG_DYN_LSL_UP FORMAT "%1.0" /end CHARACTERISTIC
/begin CHARACTERISTIC c_lamb_ampl_max_dyn_lsl_up "Calibration data for adjust the expected amplitude:  high range" VALUE 0x840e08 _REC_VAL_20_u1 0.124968 _CNV_A_R_EGCP_LINEA_517_CM 0. 0.124968 DISPLAY_IDENTIFIER C_LAMB_AMPL_MAX_DYN_LSL_UP FORMAT "%8.6" /end CHARACTERISTIC
/begin CHARACTERISTIC c_lamb_ampl_min_dyn_lsl_up "Calibration data for adjust the expected amplitude:  low range" VALUE 0x840e09 _REC_VAL_20_u1 0.124968 _CNV_A_R_EGCP_LINEA_517_CM 0. 0.124968 DISPLAY_IDENTIFIER C_LAMB_AMPL_MIN_DYN_LSL_UP FORMAT "%8.6" /end CHARACTERISTIC
/begin CHARACTERISTIC ip_lamb_ampl_max_dyn_lsl_up "Ampitude of nominal sensor by forced stimulation" MAP 0x840bca _REC_MAP_20_u1_u1_u1 0.124968 _CNV_A_R_EGCP_LINEA_517_CM 0. 0.124968 DISPLAY_IDENTIFIER IP_LAMB_AMPL_MAX_DYN_LSL_UP FORMAT "%8.6"
 /begin AXIS_DESCR COM_AXIS n_32 _CNV_A_R_LINEAR_____84_CM 8 0. 8160. FORMAT "%4.0" AXIS_PTS_REF ldpm_n_32_ls_up_dyn /end AXIS_DESCR
 /begin AXIS_DESCR COM_AXIS maf_hb _CNV_A_R_LINEAR_____368_CM 8 0. 1389. FORMAT "%4.0" AXIS_PTS_REF ldpm_maf_hb_ls_up_dyn /end AXIS_DESCR
/end CHARACTERISTIC
/begin CHARACTERISTIC ip_lamb_ampl_min_dyn_lsl_up "Ampitude of dynamic limit sensor by forced stimulation" MAP 0x840c0a _REC_MAP_20_u1_u1_u1 0.124968 _CNV_A_R_EGCP_LINEA_517_CM 0. 0.124968 DISPLAY_IDENTIFIER IP_LAMB_AMPL_MIN_DYN_LSL_UP FORMAT "%8.6"
 /begin AXIS_DESCR COM_AXIS n_32 _CNV_A_R_LINEAR_____84_CM 8 0. 8160. FORMAT "%4.0" AXIS_PTS_REF ldpm_n_32_ls_up_dyn /end AXIS_DESCR
 /begin AXIS_DESCR COM_AXIS maf_hb _CNV_A_R_LINEAR_____368_CM 8 0. 1389. FORMAT "%4.0" AXIS_PTS_REF ldpm_maf_hb_ls_up_dyn /end AXIS_DESCR
/end CHARACTERISTIC
/begin MEASUREMENT ctr_min_diag_dyn_lsl_up "Minimum number of  carried out single valid amplitude measurements" UBYTE _CNV_A_R_LINEAR_____1_CM 1 0. 0. 255. DISPLAY_IDENTIFIER CTR_MIN_DIAG_DYN_LSL_UP ECU_ADDRESS 0x7fb920 FORMAT "%3.0" /end MEASUREMENT
/begin MEASUREMENT maf_int_diag_lsh_lsl_up "Integral of the air flow, for the activation of the heater coupling diagnosis" UWORD _CNV_A_R_LINEAR_____475_CM 1 0. 0. 1820.42 DISPLAY_IDENTIFIER MAF_INT_DIAG_LSH_LSL_UP ECU_ADDRESS 0x7fa514 BYTE_ORDER MSB_LAST FORMAT "%7.2" /end MEASUREMENT
/begin CHARACTERISTIC c_lamb_delta_lpf_thd "Threshold for the maximum transition of the sensor signal" VALUE 0x840e10 _REC_VAL_20_u2 1.99993896484375 _CNV_A_R_LINEAR_____499_CM 0. 1.99993896484375 DISPLAY_IDENTIFIER C_LAMB_DELTA_LPF_THD FORMAT "%7.5" /end CHARACTERISTIC
/begin CHARACTERISTIC c_cycnr_max_diag_lsh_lsl_up "Quantity of valid diagnosis values in one function cycle" VALUE 0x840db7 _REC_VAL_20_u1 255. _CNV_A_R_LINEAR_____1_CM 0. 255. DISPLAY_IDENTIFIER C_CYCNR_MAX_DIAG_LSH_LSL_UP FORMAT "%3.0" /end CHARACTERISTIC
/begin CHARACTERISTIC c_ctr_sym_diag_lsh_lsl_up "Limit value of the diagnosis results to diagnose the heater coupling" VALUE 0x840db0 _REC_VAL_20_u1 255. _CNV_A_R_LINEAR_____1_CM 0. 255. DISPLAY_IDENTIFIER C_CTR_SYM_DIAG_LSH_LSL_UP FORMAT "%3.0" /end CHARACTERISTIC
/begin CHARACTERISTIC c_lamb_sp_de_diag_lsh_lsl_up "Maximum value of the forced excitation amplitude to activate the diagnosis" VALUE 0x840e26 _REC_VAL_20_u1 0.124968 _CNV_A_R_EGCP_LINEA_517_CM 0. 0.124968 DISPLAY_IDENTIFIER C_LAMB_SP_DE_DIAG_LSH_LSL_UP FORMAT "%8.6" /end CHARACTERISTIC
/begin CHARACTERISTIC c_teg_dyn_min_diag_lsh_lsl_up "Minimum value of the exhaust temperature to activate  the function" VALUE 0x840f12 _REC_VAL_20_u2 2047.9375 _CNV_A_R_EGCP_LINEA_461_CM 0. 2047.9375 DISPLAY_IDENTIFIER C_TEG_DYN_MIN_DIAG_LSH_LSL_UP FORMAT "%7.2" /end CHARACTERISTIC
/begin CHARACTERISTIC c_maf_int_diag_lsh_lsl_up "Threshold for the activation of the MAF-Integral" VALUE 0x840e4c _REC_VAL_20_u2 1820.42 _CNV_A_R_LINEAR_____475_CM 0. 1820.42 DISPLAY_IDENTIFIER C_MAF_INT_DIAG_LSH_LSL_UP FORMAT "%7.2" /end CHARACTERISTIC
/begin CHARACTERISTIC c_t_per_lamb_de_diag_lsh_lsl_up "Threshold of the MAF-Integral to activate the heater-coupling diagnosis" VALUE 0x840ee0 _REC_VAL_20_u2 655.35 _CNV_A_R_LINEAR_____223_CM 0. 655.35 DISPLAY_IDENTIFIER C_T_PER_LAMB_DE_DIAG_LSH_LSL_UP FORMAT "%6.2" /end CHARACTERISTIC
/begin CHARACTERISTIC c_crlc_lpf_fall_diag_lsh_lsl_up "Filter constant for Fall" VALUE 0x840d89 _REC_VAL_20_u1 0.99609375 _CNV_A_R_LINEAR_____248_CM 0. 0.99609375 DISPLAY_IDENTIFIER C_CRLC_LPF_FALL_DIAG_LSH_LSL_UP FORMAT "%5.3" /end CHARACTERISTIC
/begin CHARACTERISTIC c_crlc_lpf_rise_diag_lsh_lsl_up "Filter constant for Rise" VALUE 0x840d8a _REC_VAL_20_u1 0.99609375 _CNV_A_R_LINEAR_____248_CM 0. 0.99609375 DISPLAY_IDENTIFIER C_CRLC_LPF_RISE_DIAG_LSH_LSL_UP FORMAT "%5.3" /end CHARACTERISTIC
/begin CHARACTERISTIC c_lshpwm_min_diag_lsh_lsl_up "Minimum heater PWM value allowed to carry out the heater coupling diagnosis" VALUE 0x840e3f _REC_VAL_20_u1 99.609375 _CNV_A_R_LINEAR_____479_CM 0. 99.609375 DISPLAY_IDENTIFIER C_LSHPWM_MIN_DIAG_LSH_LSL_UP FORMAT "%9.6" /end CHARACTERISTIC
/begin CHARACTERISTIC c_lshpwm_max_diag_lsh_lsl_up "Maximum heater PWM value allowed to carry out the heater coupling diagnosis" VALUE 0x840e3b _REC_VAL_20_u1 99.609375 _CNV_A_R_LINEAR_____479_CM 0. 99.609375 DISPLAY_IDENTIFIER C_LSHPWM_MAX_DIAG_LSH_LSL_UP FORMAT "%9.6" /end CHARACTERISTIC
/begin MEASUREMENT lv_err_lsh_lsl_up_1 "Debounced heater coupling diagnosis value" UBYTE _CNV_S_2_RANGE__0___88_CM 1 0. 0. 1. DISPLAY_IDENTIFIER LV_ERR_LSH_LSL_UP_1_ ECU_ADDRESS 0x7fb57e BIT_MASK 0x1 /end MEASUREMENT
/begin AXIS_PTS ldp_lshpwm_up_ip_t_dly_acq_vls "" 0x840852 online_dummy _REC_AXS_20_u1 99.609375 _CNV_A_R_LINEAR_____479_CM 8 0. 99.609375 FORMAT "%9.6" /end AXIS_PTS
/begin CHARACTERISTIC ip_t_dly_trig_lsh_up "Time delay to trigger oxygen sensor signal and lambda model" CURVE 0x840cce _REC_CUR_20_u1_u1 0.255 _CNV_A_R_EGCP_LINEA_522_CM 0. 0.255 DISPLAY_IDENTIFIER IP_T_DLY_TRIG_LSH_UP FORMAT "%5.3"
 /begin AXIS_DESCR COM_AXIS online_dummy _CNV_A_R_LINEAR_____479_CM 8 0. 99.609375 FORMAT "%9.6" AXIS_PTS_REF ldp_lshpwm_up_ip_t_dly_acq_vls /end AXIS_DESCR
/end CHARACTERISTIC
/begin MEASUREMENT lv_err_el_lsl_up_1 "Debounced diagnosis value caused by an OBD-I error at the WRAF-Sensor" UBYTE _CNV_S_2_RANGE__0___88_CM 1 0. 0. 1. DISPLAY_IDENTIFIER LV_ERR_EL_LSL_UP_1_ ECU_ADDRESS 0x7fb574 BIT_MASK 0x1 /end MEASUREMENT
/begin CHARACTERISTIC c_ctr_iplsl_sym_diag_lsl_up "Max. error debounce counter" VALUE 0x840da4 _REC_VAL_20_u2 65535. _CNV_A_R_LINEAR_____1_CM 0. 65535. DISPLAY_IDENTIFIER C_CTR_IPLSL_SYM_DIAG_LSL_UP FORMAT "%5.0" /end CHARACTERISTIC
/begin CHARACTERISTIC c_lamb_sp_afr_iplsl_diag_lsl_up "Max. rich lambda set point to activate the IP diagnosis" VALUE 0x840e24 _REC_VAL_20_u2 31.9990234375 _CNV_A_R_LINEAR_____458_CM 0. 31.9990234375 DISPLAY_IDENTIFIER C_LAMB_SP_AFR_IPLSL_DIAG_LSL_UP FORMAT "%7.4" /end CHARACTERISTIC
/begin CHARACTERISTIC c_lamb_sp_afl_iplsl_diag_lsl_up "Min. lean lambda set point to activate the IP diagnosis" VALUE 0x840e20 _REC_VAL_20_u2 31.9990234375 _CNV_A_R_LINEAR_____458_CM 0. 31.9990234375 DISPLAY_IDENTIFIER C_LAMB_SP_AFL_IPLSL_DIAG_LSL_UP FORMAT "%7.4" /end CHARACTERISTIC
/begin MEASUREMENT lv_err_oc_lsl_up_1 "Debounced open circuit failure detected" UBYTE _CNV_S_2_RANGE__0___88_CM 1 0. 0. 1. DISPLAY_IDENTIFIER LV_ERR_OC_LSL_UP_1_ ECU_ADDRESS 0x7fb575 BIT_MASK 0x1 /end MEASUREMENT
/begin CHARACTERISTIC c_t_oc_lsl_diag "Max. waiting time before begin diagnosis" VALUE 0x840edc _REC_VAL_20_u2 6553.5 _CNV_A_R_LINEAR_____234_CM 0. 6553.5 DISPLAY_IDENTIFIER C_T_OC_LSL_DIAG FORMAT "%6.1" /end CHARACTERISTIC
/begin CHARACTERISTIC c_t_vls_up_min_diag_oc_lsl_up "Max allowed time for LSL undervoltage" VALUE 0x840ef0 _REC_VAL_20_u2 6553.5 _CNV_A_R_LINEAR_____234_CM 0. 6553.5 DISPLAY_IDENTIFIER C_T_VLS_UP_MIN_DIAG_OC_LSL_UP FORMAT "%6.1" /end CHARACTERISTIC
/begin CHARACTERISTIC c_vls_up_min_diag_oc_lsl_up "LSL undervoltage threshold" VALUE 0x840f98 _REC_VAL_20_u2 4.9951171875 _CNV_A_R_LINEAR_____260_CM 0. 4.9951171875 DISPLAY_IDENTIFIER C_VLS_UP_MIN_DIAG_OC_LSL_UP FORMAT "%5.3" /end CHARACTERISTIC
/begin CHARACTERISTIC c_abc_inc_diag_el_lsl_up "Increment of OBD-I Diagnosis debouncer counter" VALUE 0x840d6a _REC_VAL_20_u1 255. _CNV_A_R_LINEAR_____1_CM 0. 255. DISPLAY_IDENTIFIER C_ABC_INC_DIAG_EL_LSL_UP FORMAT "%3.0" /end CHARACTERISTIC
/begin CHARACTERISTIC c_abc_max_diag_el_lsl_up "Maximum threshold of OBD-I Diagnosis debouncer counter" VALUE 0x840d76 _REC_VAL_20_u1 254. _CNV_A_R_LINEAR_____1_CM 1. 255. DISPLAY_IDENTIFIER C_ABC_MAX_DIAG_EL_LSL_UP FORMAT "%3.0" /end CHARACTERISTIC
/begin MEASUREMENT lv_inh_diag_ls_up_dyn_cp "Canister Purge Load too high" UBYTE _CNV_S_2_RANGE__0___88_CM 1 0. 0. 1. DISPLAY_IDENTIFIER LV_INH_DIAG_LS_UP_DYN_CP ECU_ADDRESS 0x7fb2d8 BIT_MASK 0x1 /end MEASUREMENT
/begin CHARACTERISTIC c_cl_mmv_ls_up_diag_max "Maximum degree of saturation of the evaporative canister to activate the function" VALUE 0x840d82 _REC_VAL_20_u2 1.99996948242188 _CNV_A_R_LINEAR_____469_CM 0. 1.99996948242188 DISPLAY_IDENTIFIER C_CL_MMV_LS_UP_DIAG_MAX FORMAT "%7.5" /end CHARACTERISTIC
/begin AXIS_PTS ldpm_temp_ini_ls_up_1_egcp "" 0x840a30 online_dummy _REC_AXS_20_u2 4095.9375 _CNV_A_R_EGCP_LINEA_462_CM 6 -2048. 2047.9375 FORMAT "%10.4" /end AXIS_PTS
/begin AXIS_PTS ldpm_maf_kgh_3_egcp "" 0x8409c8 maf_kgh _REC_AXS_20_u2 2047.96875 _CNV_A_R_LINEAR_____472_CM 6 0. 2047.96875 FORMAT "%10.5" /end AXIS_PTS
/begin AXIS_PTS ldpm_n_32_ls_up_dyn "" 0x8409ed n_32 _REC_AXS_20_u1 8160. _CNV_A_R_LINEAR_____84_CM 8 0. 8160. FORMAT "%4.0" /end AXIS_PTS
/begin AXIS_PTS ldpm_maf_hb_ls_up_dyn "" 0x8409ac maf_hb _REC_AXS_20_u1 1389. _CNV_A_R_LINEAR_____368_CM 8 0. 1389. FORMAT "%4.0" /end AXIS_PTS
/begin COMPU_METHOD _CNV_A_R_LINEAR_____0_CM "" RAT_FUNC "%6.3" "[-]" COEFFS 0 1. 0. 0 0 1 /end COMPU_METHOD
/begin COMPU_METHOD _CNV_A_R_LINEAR_____1_CM "" RAT_FUNC "%6.3" "-" COEFFS 0 1. 0. 0 0 1 /end COMPU_METHOD
/begin COMPU_METHOD _CNV_A_R_LINEAR_____32_CM "" RAT_FUNC "%6.3" "s" COEFFS 0 1. 0. 0 0 1 /end COMPU_METHOD
/begin COMPU_METHOD _CNV_A_R_LINEAR_____84_CM "" RAT_FUNC "%6.3" "rpm" COEFFS 0 3.125e-002 0. 0 0 1 /end COMPU_METHOD
/begin COMPU_METHOD _CNV_S_2_RANGE__0___88_CM "" TAB_VERB "%6.3" "-" COMPU_TAB_REF _CNV_S_2_RANGE__0___88 /end COMPU_METHOD
/begin COMPU_VTAB _CNV_S_2_RANGE__0___88 "" TAB_VERB 2 0 "0" 1 "1" /end COMPU_VTAB
/begin COMPU_METHOD _CNV_A_R_LINEAR_____223_CM "" RAT_FUNC "%6.3" "s" COEFFS 0 100. 0. 0 0 1 /end COMPU_METHOD
/begin COMPU_METHOD _CNV_A_R_LINEAR_____234_CM "" RAT_FUNC "%6.3" "s" COEFFS 0 10. 0. 0 0 1 /end COMPU_METHOD
/begin COMPU_METHOD _CNV_A_R_LINEAR_____239_CM "" RAT_FUNC "%6.3" "km/h" COEFFS 0 1. 0. 0 0 1 /end COMPU_METHOD
/begin COMPU_METHOD _CNV_A_R_LINEAR_____240_CM "" RAT_FUNC "%6.3" "-" COEFFS 0 128. 0. 0 0 1 /end COMPU_METHOD
/begin COMPU_METHOD _CNV_A_R_LINEAR_____248_CM "" RAT_FUNC "%6.3" "-" COEFFS 0 256. 0. 0 0 1 /end COMPU_METHOD
/begin COMPU_METHOD _CNV_A_R_LINEAR_____251_CM "" RAT_FUNC "%6.3" "°C" COEFFS 0 1.333333333333333 64. 0 0 1 /end COMPU_METHOD
/begin COMPU_METHOD _CNV_A_R_LINEAR_____252_CM "" RAT_FUNC "%6.3" "%" COEFFS 0 655.3599999999997 0. 0 0 1 /end COMPU_METHOD
/begin COMPU_METHOD _CNV_A_R_LINEAR_____257_CM "" RAT_FUNC "%6.3" "rpm" COEFFS 0 1. 0. 0 0 1 /end COMPU_METHOD
/begin COMPU_METHOD _CNV_A_R_LINEAR_____260_CM "" RAT_FUNC "%6.3" "V" COEFFS 0 204.8 0. 0 0 1 /end COMPU_METHOD
/begin COMPU_METHOD _CNV_A_R_LINEAR_____300_CM "" RAT_FUNC "%6.3" "-" COEFFS 0 65535.99999999996 0. 0 0 1 /end COMPU_METHOD
/begin COMPU_METHOD _CNV_A_R_LINEAR_____368_CM "" RAT_FUNC "%6.3" "mg/stk" COEFFS 0 0.183585313174946 0. 0 0 1 /end COMPU_METHOD
/begin COMPU_METHOD _CNV_A_R_LINEAR_____434_CM "" RAT_FUNC "%6.3" "ms" COEFFS 0 5.e-002 0. 0 0 1 /end COMPU_METHOD
/begin COMPU_METHOD _CNV_A_R_LINEAR_____458_CM "" RAT_FUNC "%6.3" "-" COEFFS 0 1024. 0. 0 0 1 /end COMPU_METHOD
/begin COMPU_METHOD _CNV_A_R_EGCP_LINEA_459_CM "" RAT_FUNC "%6.3" "Ohm" COEFFS 0 4. 0. 0 0 1 /end COMPU_METHOD
/begin COMPU_METHOD _CNV_A_R_EGCP_LINEA_461_CM "Battery voltage" RAT_FUNC "%6.3" "°C" COEFFS 0 16. 0. 0 0 1 /end COMPU_METHOD
/begin COMPU_METHOD _CNV_A_R_EGCP_LINEA_462_CM "Battery voltage" RAT_FUNC "%6.3" "°C" COEFFS 0 16. 32768. 0 0 1 /end COMPU_METHOD
/begin COMPU_METHOD _CNV_A_R_LINEAR_____469_CM "" RAT_FUNC "%6.3" "-" COEFFS 0 32767.99999999992 0. 0 0 1 /end COMPU_METHOD
/begin COMPU_METHOD _CNV_A_R_LINEAR_____472_CM "" RAT_FUNC "%6.3" "kg/h" COEFFS 0 32. 0. 0 0 1 /end COMPU_METHOD
/begin COMPU_METHOD _CNV_A_R_LINEAR_____475_CM "" RAT_FUNC "%6.3" "g" COEFFS 0 35.99993408114611 0. 0 0 1 /end COMPU_METHOD
/begin COMPU_METHOD _CNV_A_R_EGCP_LINEA_476_CM "Battery voltage" RAT_FUNC "%6.3" "-" COEFFS 0 1024.002615046581 0. 0 0 1 /end COMPU_METHOD
/begin COMPU_METHOD _CNV_A_R_LINEAR_____479_CM "" RAT_FUNC "%6.3" "%" COEFFS 0 2.56 0. 0 0 1 /end COMPU_METHOD
/begin COMPU_METHOD _CNV_A_R_LINEAR_____480_CM "" RAT_FUNC "%6.3" "Ohm" COEFFS 0 1. 0. 0 0 1 /end COMPU_METHOD
/begin COMPU_METHOD _CNV_A_R_EGCP_LINEA_481_CM "" RAT_FUNC "%6.3" "J/K" COEFFS 0 16. 0. 0 0 1 /end COMPU_METHOD
/begin COMPU_METHOD _CNV_A_R_LINEAR_____482_CM "" RAT_FUNC "%6.3" "J" COEFFS 0 1. 0. 0 0 1 /end COMPU_METHOD
/begin COMPU_METHOD _CNV_A_R_LINEAR_____483_CM "" RAT_FUNC "%6.3" "mg/stk" COEFFS 0 47.18142548596112 0. 0 0 1 /end COMPU_METHOD
/begin COMPU_METHOD _CNV_A_R_LINEAR_____499_CM "" RAT_FUNC "%6.3" "-" COEFFS 0 16384. 0. 0 0 1 /end COMPU_METHOD
/begin COMPU_METHOD _CNV_A_R_EGCP_LINEA_502_CM "" RAT_FUNC "%6.3" "V" COEFFS 0 819.2192192192192 0. 0 0 1 /end COMPU_METHOD
/begin COMPU_METHOD _CNV_A_R_EGCP_LINEA_503_CM "" RAT_FUNC "%6.3" "-" COEFFS 0 2730.666642666301 0. 0 0 1 /end COMPU_METHOD
/begin COMPU_METHOD _CNV_S_5_EGCP_RANGE_504_CM "" TAB_VERB "%6.3" "-" COMPU_TAB_REF _CNV_S_5_EGCP_RANGE_504 /end COMPU_METHOD
/begin COMPU_VTAB _CNV_S_5_EGCP_RANGE_504 "" TAB_VERB 5 0 "OFF" 1 "MES_OFS" 2 "ADJ_OFS" 3 "ADJ_GAIN" 4 "MES" /end COMPU_VTAB
/begin COMPU_METHOD _CNV_S_3_EGCP_RANGE_505_CM "" TAB_VERB "%6.3" "-" COMPU_TAB_REF _CNV_S_3_EGCP_RANGE_505 /end COMPU_METHOD
/begin COMPU_VTAB _CNV_S_3_EGCP_RANGE_505 "" TAB_VERB 3 0 "NO_SYM" 1 "SYM_0" 2 "SYM_1" /end COMPU_VTAB
/begin COMPU_METHOD _CNV_S_11_EGCP_RANGE_506_CM "" TAB_VERB "%6.3" "-" COMPU_TAB_REF _CNV_S_11_EGCP_RANGE_506 /end COMPU_METHOD
/begin COMPU_VTAB _CNV_S_11_EGCP_RANGE_506 "" TAB_VERB 11 0 "No Fault" 1 "SCG line RCD" 2 "SCG line VIP" 3 "SCG line VG" 4 "SCG line VN" 5 "SCG" 6 "SCBat line RCD" 7 "SCBat line VIP" 8 "SCBat line VG" 9 "SCBat line VN" 10 "SCBat" /end COMPU_VTAB
/begin COMPU_METHOD _CNV_S_3_EGCP_RANGE_507_CM "" TAB_VERB "%6.3" "-" COMPU_TAB_REF _CNV_S_3_EGCP_RANGE_507 /end COMPU_METHOD
/begin COMPU_VTAB _CNV_S_3_EGCP_RANGE_507 "" TAB_VERB 3 0 "PASSIVE" 1 "ACTIVE" 2 "END" /end COMPU_VTAB
/begin COMPU_METHOD _CNV_A_R_LINEAR_____508_CM "" RAT_FUNC "%6.3" "%" COEFFS 0 655.3599999999997 -1.455191522836685e-011 0 0 1 /end COMPU_METHOD
/begin COMPU_METHOD _CNV_A_R_EGCP_LINEA_509_CM "" RAT_FUNC "%6.3" "g" COEFFS 0 47.18142548596112 0. 0 0 1 /end COMPU_METHOD
/begin COMPU_METHOD _CNV_S_3_EGCP_RANGE_510_CM "" TAB_VERB "%6.3" "-" COMPU_TAB_REF _CNV_S_3_EGCP_RANGE_510 /end COMPU_METHOD
/begin COMPU_VTAB _CNV_S_3_EGCP_RANGE_510 "" TAB_VERB 3 0 "NO_SYM" 1 "AF too RICH" 2 "AF too LEAN" /end COMPU_VTAB
/begin COMPU_METHOD _CNV_S_4_EGCP_RANGE_511_CM "" TAB_VERB "%6.3" "-" COMPU_TAB_REF _CNV_S_4_EGCP_RANGE_511 /end COMPU_METHOD
/begin COMPU_VTAB _CNV_S_4_EGCP_RANGE_511 "" TAB_VERB 4 0 "NO_SYM" 1 "TTIP_ERR" 2 "READY_ERR" 4 "TTIP_MES_ERR" /end COMPU_VTAB
/begin COMPU_METHOD _CNV_A_R_EGCP_LINEA_512_CM "" RAT_FUNC "%6.3" "K" COEFFS 0 1. 0. 0 0 1 /end COMPU_METHOD
/begin COMPU_METHOD _CNV_S_9_EGCP_RANGE_513_CM "" TAB_VERB "%6.3" "-" COMPU_TAB_REF _CNV_S_9_EGCP_RANGE_513 /end COMPU_METHOD
/begin COMPU_VTAB _CNV_S_9_EGCP_RANGE_513 "" TAB_VERB 9 0 "DIAG_OFF" 1 "DIAG_INIT" 2 "LS_READY" 3 "OBD1_DLY" 4 "OBD1_CHK" 5 "TEG_THD" 6 "POW_INT" 7 "DIAG_ACT" 8 "DIAG_END" /end COMPU_VTAB
/begin COMPU_METHOD _CNV_A_R_LINEAR_____514_CM "" RAT_FUNC "%6.3" "V" COEFFS 0 204.7999999487896 -2.556795379859977e-007 0 0 1 /end COMPU_METHOD
/begin COMPU_METHOD _CNV_A_R_EGCP_LINEA_515_CM "" RAT_FUNC "%6.3" "-" COEFFS 0 1024.000007000107 2.240034154965542e-004 0 0 1 /end COMPU_METHOD
/begin COMPU_METHOD _CNV_S_4_EGCP_RANGE_516_CM "" TAB_VERB "%6.3" "-" COMPU_TAB_REF _CNV_S_4_EGCP_RANGE_516 /end COMPU_METHOD
/begin COMPU_VTAB _CNV_S_4_EGCP_RANGE_516 "" TAB_VERB 4 0 "PASSIVE" 1 "RICH CHECK" 2 "LEAN CHECK" 3 "CHECK FINISHED" /end COMPU_VTAB
/begin COMPU_METHOD _CNV_A_R_EGCP_LINEA_517_CM "" RAT_FUNC "%6.3" "-" COEFFS 0 1016.260162601626 0. 0 0 1 /end COMPU_METHOD
/begin COMPU_METHOD _CNV_S_4_EGCP_RANGE_518_CM "" TAB_VERB "%6.3" "-" COMPU_TAB_REF _CNV_S_4_EGCP_RANGE_518 /end COMPU_METHOD
/begin COMPU_VTAB _CNV_S_4_EGCP_RANGE_518 "" TAB_VERB 4 0 "NO_SYM" 1 "Sensor too lean" 2 "Sensor too rich" 4 "Sensor not active" /end COMPU_VTAB
/begin COMPU_METHOD _CNV_S_3_EGCP_RANGE_519_CM "" TAB_VERB "%6.3" "-" COMPU_TAB_REF _CNV_S_3_EGCP_RANGE_519 /end COMPU_METHOD
/begin COMPU_VTAB _CNV_S_3_EGCP_RANGE_519 "" TAB_VERB 3 0 "NO_SYM" 1 "SIGNAL TOO_LOW" 2 "SIGNAL TOO_HIGH" /end COMPU_VTAB
/begin COMPU_METHOD _CNV_S_2_EGCP_RANGE_520_CM "" TAB_VERB "%6.3" "-" COMPU_TAB_REF _CNV_S_2_EGCP_RANGE_520 /end COMPU_METHOD
/begin COMPU_VTAB _CNV_S_2_EGCP_RANGE_520 "" TAB_VERB 2 0 "NO_SYM" 1 "SYM_0" /end COMPU_VTAB
/begin COMPU_METHOD _CNV_S_4_EGCP_RANGE_521_CM "" TAB_VERB "%6.3" "-" COMPU_TAB_REF _CNV_S_4_EGCP_RANGE_521 /end COMPU_METHOD
/begin COMPU_VTAB _CNV_S_4_EGCP_RANGE_521 "" TAB_VERB 4 0 "PASSIVE" 1 "WAIT" 2 "ACQUISITION" 3 "END" /end COMPU_VTAB
/begin COMPU_METHOD _CNV_A_R_EGCP_LINEA_522_CM "" RAT_FUNC "%6.3" "s" COEFFS 0 1000. 0. 0 0 1 /end COMPU_METHOD
/begin COMPU_METHOD _CNV_A_R_LINEAR_____523_CM "" RAT_FUNC "%6.3" "°C" COEFFS 0 64. 2112. 0 0 1 /end COMPU_METHOD
/begin COMPU_METHOD _CNV_A_R_EGCP_LINEA_525_CM "Battery voltage" RAT_FUNC "%6.3" "1/V" COEFFS 0 853.3336458382162 0. 0 0 1 /end COMPU_METHOD
/begin COMPU_METHOD _CNV_A_R_EGCP_LINEA_526_CM "" RAT_FUNC "%6.3" "°C" COEFFS 0 0.25 8.25 0 0 1 /end COMPU_METHOD
/begin RECORD_LAYOUT _REC_VAL_20_u1 FNC_VALUES 1 UBYTE COLUMN_DIR DIRECT /end RECORD_LAYOUT
/begin RECORD_LAYOUT _REC_AXS_20_u2 NO_AXIS_PTS_X 1 UWORD AXIS_PTS_X 2 UWORD INDEX_INCR DIRECT /end RECORD_LAYOUT
/begin RECORD_LAYOUT _REC_CUR_20_u1_u2 FNC_VALUES 1 UBYTE COLUMN_DIR DIRECT /end RECORD_LAYOUT
/begin RECORD_LAYOUT _REC_VAL_20_u2 FNC_VALUES 1 UWORD COLUMN_DIR DIRECT /end RECORD_LAYOUT
/begin RECORD_LAYOUT _REC_VAL_20_s2 FNC_VALUES 1 SWORD COLUMN_DIR DIRECT /end RECORD_LAYOUT
/begin RECORD_LAYOUT _REC_AXS_20_u1 NO_AXIS_PTS_X 1 UBYTE AXIS_PTS_X 2 UBYTE INDEX_INCR DIRECT /end RECORD_LAYOUT
/begin RECORD_LAYOUT _REC_CUR_20_u2_u2 FNC_VALUES 1 UWORD COLUMN_DIR DIRECT /end RECORD_LAYOUT
/begin RECORD_LAYOUT _REC_CUR_20_u1_u1 FNC_VALUES 1 UBYTE COLUMN_DIR DIRECT /end RECORD_LAYOUT
/begin RECORD_LAYOUT _REC_MAP_20_u1_u1_u1 FNC_VALUES 1 UBYTE COLUMN_DIR DIRECT /end RECORD_LAYOUT
/begin FUNCTION EGCP_ls_ceramic_temperature "_ls_ceramic_temperature"
 /begin DEF_CHARACTERISTIC ldp_r_it_ls_up_ip_ttip_ls_up ip_ttip_mes_ls_up c_t_dly_ofs_adj_r_it_ls_up c_t_dly_fac_gain_r_it_ls_up c_t_dly_clc_r_it_ls_up c_t_dly_ofs_mes_r_it_ls_up c_t_max_v_ofs_adj_r_it_ls_up c_t_max_fac_gain_r_it_ls_up c_t_max_v_ofs_mes_r_it_ls_up c_v_dif_max_ofs_adj_r_it_ls_up c_v_dif_max_ofs_mes_r_it_ls_up lc_r_rng_req_ls_up_lsl_if lc_r_rng_req_swi_ls_up_lsl_if c_fac_gain_r_it_ls_up c_r_it_ref_ls_up c_fac_gain_h_dif_r_it_ls_up c_fac_gain_h_r_it_ls_up c_fac_gain_l_dif_r_it_ls_up c_fac_gain_l_r_it_ls_up c_v_ofs_ref_r_it_ls_up c_frq_r_it_osc_lsl_if lc_v_ref_r_it_ls_up /end DEF_CHARACTERISTIC
 /begin OUT_MEASUREMENT egcp[0].egcp_struct_sigcvtipa0.ttip_mes_ls_up egcp[0].egcp_struct_sigcvtipa0.r_it_ls_up egcp[0].egcp_struct_sigcvtipa0.tcc_v_ofs_mes_r_it_ls_up egcp[0].egcp_struct_sigcvtipa0.tcc_v_ofs_adj_r_it_ls_up egcp[0].egcp_struct_sigcvtipa0.tcc_fac_gain_h_r_it_ls_up egcp[0].egcp_struct_sigcvtipa0.tcc_fac_gain_l_r_it_ls_up egcp[0].egcp_struct_sigcvtipa0.tcc_err_v_ofs_mes_r_it_ls_up egcp[0].egcp_struct_sigcvtipa0.tcc_err_v_ofs_adj_r_it_ls_up egcp[0].egcp_struct_sigcvtipa0.tcc_err_fac_gain_h_r_ls_up egcp[0].egcp_struct_sigcvtipa0.tcc_err_fac_gain_l_r_ls_up egcp[0].egcp_struct_sigcvtipa0.v_ofs_adj_r_it_ls_up egcp[0].egcp_struct_sigcvtipa0.v_ofs_mes_r_it_ls_up egcp[0].egcp_struct_sigcvtipa0.fac_gain_h_r_it_ls_up egcp[0].egcp_struct_sigcvtipa0.fac_gain_l_r_it_ls_up egcp[0].egcp_struct_sigcvtipa0.frq_r_it_osc_lsl_if_spi_wr egcp[0].egcp_struct_sigcvtipa0.state_ttip_mes_ls_up egcp[0].egcp_struct_sigcvtipa0.lv_fac_gain_h_vld_r_it_ls_up egcp[0].egcp_struct_sigcvtipa0.lv_fac_gain_l_vld_r_it_ls_up egcp[0].egcp_struct_sigcvtipa0.lv_r_it_cal_ena_lsl_if egcp[0].egcp_struct_sigcvtipa0.lv_r_it_osc_ena_lsl_if egcp[0].egcp_struct_sigcvtipa0.lv_r_it_swi_rng_lsl_if egcp[0].egcp_struct_sigcvtipa0.lv_ttip_mes_vld_ls_up egcp[0].egcp_struct_sigcvtipa0.lv_v_ofs_adj_vld_r_it_ls_up egcp[0].egcp_struct_sigcvtipa0.lv_v_ofs_mes_vld_r_it_ls_up egcp[0].egcp_struct_sigcvtipa0.lv_v_ref_vld_r_it_ls_up egcp[0].egcp_struct_sigcvtipa0.lv_r_it_req_ls_up /end OUT_MEASUREMENT
/end FUNCTION
/begin FUNCTION EGCP_WRAF_IF_BSW_ASW_ATIC42 "_WRAF_IF_BSW_ASW_ATIC42" /begin DEF_CHARACTERISTIC c_state_lsl_if_spi_wr_ini c_state_lsl_if_conf_spi_wr_ini /end DEF_CHARACTERISTIC
 /begin OUT_MEASUREMENT egcp[0].egcp_struct_sigcvif2.state_lsl_if_spi_wr egcp[0].egcp_struct_sigcvif2.state_lsl_if_conf_spi_wr egcp[0].egcp_struct_sigcvif2.lv_lsl_if_spi_rst_end /end OUT_MEASUREMENT
/end FUNCTION
/begin FUNCTION EGCP_Appl_Inc_ATIC42_ASW_BSW_IF "_Appl_Inc_ATIC42_ASW_BSW_IF" /begin DEF_CHARACTERISTIC c_t_dly_di_lsl_if /end DEF_CHARACTERISTIC
 /begin OUT_MEASUREMENT egcp[0].egcp_struct_sigcvifi2.t_dly_di_lsl_if egcp[0].egcp_struct_sigcvifi2.lv_lsl_ena_lsl_if egcp[0].egcp_struct_sigcvifi2.lv_lsl_if_rst egcp[0].egcp_struct_sigcvifi2.lv_swi_gain_lsl_if egcp[0].egcp_struct_sigcvifi2.lv_lsl_ena_tmp_lsl_if /end OUT_MEASUREMENT
/end FUNCTION
/begin FUNCTION EGCP_Appl_Inc_ls_temperature "_Appl_Inc_ls_temperature" /begin OUT_MEASUREMENT egcp[0].egcp_struct_sigcvtipai0.lv_inh_ttip_ls_up /end OUT_MEASUREMENT /end FUNCTION
/begin FUNCTION EGCP_Appl_Inc_downst_ls_intern_R "_Appl_Inc_ls_internal_R" /end FUNCTION
/begin FUNCTION C_A_EGCP "C_A_EGCP"
 /begin SUB_FUNCTION EGCP_Upst_ls_heat_OBDI_diag EGCP_Downst_ls_sig_mon EGCP_Downst_ls_heat_OBDI_diag EGCP_Signal_plausibily_mon EGCP_HW_based_DIAG_ATIC42 EGCP_WRAF_sensor_ctl_DIAG EGCP_A_I_WRAF_sens_electric_DIAG EGCP_A_I_WRAF_sens_ctl_DIAG EGCP_A_I_upst_ls_heat_OBDI_DIAG EGCP_downst_ls_heat_OBDI_DIAG_AI EGCP_A_I_downst_ls_probe_DIAG /end SUB_FUNCTION
/end FUNCTION
/begin FUNCTION EGCP_Upst_ls_heat_OBDI_diag "_Upstream_ls_heat_OBDI_diag"
 /begin DEF_CHARACTERISTIC c_lshpwm_max_diag_lsh_up c_teg_dyn_min_diag_lsh_up c_lshpwm_min_diag_lsh_up /end DEF_CHARACTERISTIC
 /begin OUT_MEASUREMENT egcp[0].egcp_struct_outdglsh0.err_diag_lsh_up egcp[0].egcp_struct_outdglsh0.cdn_diag_lsh_up egcp[0].egcp_struct_outdglsh0.lv_lsh_scg_act_lsh_up lv_err_lsh_up_1 /end OUT_MEASUREMENT
/end FUNCTION
/begin FUNCTION EGCP_Downst_ls_sig_mon "_Downstream_ls_sig_mon"
 /begin DEF_CHARACTERISTIC c_ctr_min_diag_scg_ls_down c_maf_kgh_min_diag_scg_ls_down c_vls_thd_diag_scp_ls_down c_r_it_max_diag_scg_ls_down c_r_it_min_diag_oc_ls_down c_t_cdn_diag_oc_ls_down c_t_dly_diag_oc_ls_down c_t_dly_diag_scg_ls_down c_teg_cat_min_diag_oc_ls_down c_vls_thd_diag_scg_ls_down c_vls_afl_thd_diag_oc_ls_down c_vls_afr_thd_diag_oc_ls_down /end DEF_CHARACTERISTIC
 /begin OUT_MEASUREMENT egcp[0].egcp_struct_sigdglsd1.t_act_pls_diag_scg_ls_down egcp[0].egcp_struct_sigdglsd1.t_act_pls_diag_oc_ls_down egcp[0].egcp_struct_sigdglsd1.t_cdn_diag_oc_ls_down egcp[0].egcp_struct_sigdglsd1.ctr_r_upd_diag_scg_ls_down egcp[0].egcp_struct_sigdglsd1.ctr_r_upd_diag_oc_ls_down egcp[0].egcp_struct_sigdglsd1.ctr_sym_diag_scg_ls_down egcp[0].egcp_struct_sigdglsd1.lv_err_el_ls_down egcp[0].egcp_struct_sigdglsd1.lv_diag_act_req_ls_down egcp[0].egcp_struct_sigdglsd1.lv_r_it_vld_diag_oc_ls_down egcp[0].egcp_struct_sigdglsd1.lv_t_cdn_diag_oc_ls_down lv_err_scp_ls_down_1 lv_err_scg_ls_down_1 lv_err_oc_ls_down_1 /end OUT_MEASUREMENT
/end FUNCTION
/begin FUNCTION EGCP_Downst_ls_heat_OBDI_diag "_Downstream_ls_heat_OBDI_diag"
 /begin DEF_CHARACTERISTIC c_lshpwm_max_diag_lsh_down c_lshpwm_min_diag_lsh_down c_teg_cat_mdl_down_min_lsh_down /end DEF_CHARACTERISTIC
 /begin OUT_MEASUREMENT egcp[0].egcp_struct_outdglshd0.err_diag_lsh_down egcp[0].egcp_struct_outdglshd0.cdn_diag_lsh_down lv_err_lsh_down_1 /end OUT_MEASUREMENT
/end FUNCTION
/begin FUNCTION EGCP_Signal_plausibily_mon "_Signal_plausibily_mon"
 /begin DEF_CHARACTERISTIC c_maf_int_max_diag_puc_ls_down c_maf_int_max_diag_fl_ls_down c_maf_int_min_diag_puc_ls_down c_maf_int_min_diag_fl_ls_down c_vls_min_diag_puc_ls_down c_vls_max_diag_fl_ls_down /end DEF_CHARACTERISTIC
 /begin OUT_MEASUREMENT egcp[0].egcp_struct_pladglsd2.lv_diag_cdn_plaus_ls_down egcp[0].egcp_struct_pladglsd2.lv_err_plaus_ls_down lv_err_puc_ls_down_1 lv_err_fl_ls_down_1 maf_int_fl /end OUT_MEASUREMENT
/end FUNCTION
/begin FUNCTION EGCP_HW_based_DIAG_ATIC42 "_HW_based_DIAG_ATIC42"
 /begin DEF_CHARACTERISTIC c_ctr_iplsl_sym_diag_lsl_up c_lamb_sp_afr_iplsl_diag_lsl_up c_lamb_sp_afl_iplsl_diag_lsl_up c_t_oc_lsl_diag c_t_vls_up_min_diag_oc_lsl_up c_vls_up_min_diag_oc_lsl_up /end DEF_CHARACTERISTIC
 /begin OUT_MEASUREMENT egcp[0].egcp_struct_sigdglsla0.ctr_iplsl_sym_diag_lsl_up egcp[0].egcp_struct_sigdglsla0.t_diag_oc_lsl_up egcp[0].egcp_struct_sigdglsla0.t_vls_up_min_diag_oc_lsl_up egcp[0].egcp_struct_sigdglsla0.iplsl_sym_diag_lsl_up egcp[0].egcp_struct_sigdglsla0.state_err_el_lsl_up egcp[0].egcp_struct_sigdglsla0.state_diag_oc_lsl_up egcp[0].egcp_struct_sigdglsla0.lv_lsl_up_spi_com_inh egcp[0].egcp_struct_sigdglsla0.lv_diag_iplsl_sym_lsl_up egcp[0].egcp_struct_sigdglsla0.lv_diag_iplsl_cdn_lsl_up egcp[0].egcp_struct_sigdglsla0.lv_diag_oc_if_osc_di_lsl_up egcp[0].egcp_struct_sigdglsla0.lv_vls_up_min_diag_oc_lsl_up lv_err_el_lsl_up_1 lv_err_oc_lsl_up_1 /end OUT_MEASUREMENT
/end FUNCTION
/begin FUNCTION EGCP_WRAF_sensor_ctl_DIAG "_WRAF_sensor_controller_DIAG"
 /begin DEF_CHARACTERISTIC c_ctr_max_spi_com_lsl_up[0] c_t_rst_max_diag_lsl_up_if[0] c_t_end_diag_lsl_up_if[0] /end DEF_CHARACTERISTIC
 /begin OUT_MEASUREMENT egcp[0].egcp_struct_pladgspi0.ctr_err_save_diag_lsl_up_if lv_err_lsl_up_if_1 /end OUT_MEASUREMENT
/end FUNCTION
/begin FUNCTION EGCP_A_I_WRAF_sens_electric_DIAG "_A_I_WRAF_sens_electric_DIAG" /begin DEF_CHARACTERISTIC c_abc_inc_diag_el_lsl_up c_abc_max_diag_el_lsl_up /end DEF_CHARACTERISTIC
 /begin OUT_MEASUREMENT egcp[0].egcp_struct_sigdglslai0.lv_inh_diag_el_lsl_up egcp[0].egcp_struct_sigdglslai0.lv_inh_diag_oc_lsl_up egcp[0].egcp_struct_sigdglslai0.lv_iplsl_diag_inh_lsl_up /end OUT_MEASUREMENT
/end FUNCTION
/begin FUNCTION EGCP_A_I_WRAF_sens_ctl_DIAG "_A_I_WRAF_sens_controller_DIAG" /begin OUT_MEASUREMENT egcp[0].egcp_struct_pladgspii0.lv_inh_diag_lsl_up_if /end OUT_MEASUREMENT /end FUNCTION
/begin FUNCTION EGCP_A_I_upst_ls_heat_OBDI_DIAG "_A_I_upst_ls_heat_OBDI_DIAG" /begin DEF_CHARACTERISTIC c_abc_inc_diag_lsh_up c_abc_max_diag_lsh_up /end DEF_CHARACTERISTIC /begin OUT_MEASUREMENT egcp[0].egcp_struct_outdglshi0.lv_inh_diag_lsh_up /end OUT_MEASUREMENT /end FUNCTION
/begin FUNCTION EGCP_downst_ls_heat_OBDI_DIAG_AI "_downst_ls_heat_OBDI_DIAG_AI" /begin DEF_CHARACTERISTIC c_abc_inc_diag_lsh_down c_abc_max_diag_lsh_down /end DEF_CHARACTERISTIC /begin OUT_MEASUREMENT egcp[0].egcp_struct_outdglshdi0.lv_inh_diag_lsh_down /end OUT_MEASUREMENT /end FUNCTION
/begin FUNCTION EGCP_A_I_downst_ls_probe_DIAG "_A_I_downst_ls_probe_DIAG"
 /begin DEF_CHARACTERISTIC c_abc_max_scg_ls_down c_abc_inc_scg_ls_down c_abc_inc_oc_ls_down c_abc_max_oc_ls_down c_abc_max_scp_ls_down c_abc_inc_scp_ls_down c_abc_inc_puc_ls_down c_abc_inc_fl_ls_down c_abc_max_puc_ls_down c_abc_max_fl_ls_down /end DEF_CHARACTERISTIC
 /begin OUT_MEASUREMENT egcp[0].egcp_struct_sigdglsdi1.lv_inh_diag_oc_ls_down egcp[0].egcp_struct_sigdglsdi1.lv_inh_diag_puc_ls_down egcp[0].egcp_struct_sigdglsdi1.lv_inh_diag_fl_ls_down egcp[0].egcp_struct_sigdglsdi1.lv_inh_diag_scg_ls_down egcp[0].egcp_struct_sigdglsdi1.lv_inh_diag_scp_ls_down /end OUT_MEASUREMENT
/end FUNCTION
/begin FUNCTION C_B_EGCP "C_B_EGCP"
 /begin SUB_FUNCTION EGCP_Dynamic_fuel_trim_diag EGCP_Dynamic_fuel_trim_diag_inci EGCP_O2_sensor_up_heater_diag EGCP_O2_sensor_down_heater_diag EGCP_O2_sensor_down_heat_diag_ai EGCP_O2_sensor_downstream_diag EGCP_O2_sensor_inter_signal_diag EGCP_O2_sensor_diag_management EGCP_O2_sensor_swap_sig_diag_ai EGCP_O2_sensor_swap_sig_diag EGCP_O2_sensor_probe_diag_plaus EGCP_O2_sensor_temperature EGCP_O2_sensor_down_diag_inci EGCP_O2_sensor_up_heater_diag_ai EGCP_Linear_O2_sensor_diag EGCP_Linear_O2_sensor_diag_inci EGCP_O2_sensor_temperature_inci EGCP_O2_sensor_diag_manag_inci EGCP_O2_sensor_probe_diag_inci EGCP_Down_O2_sensor_resist_inci EGCP_Linear_O2_sensor_hea_diag EGCP_Linear_O2_sens_hea_diag_AI /end SUB_FUNCTION
/end FUNCTION
/begin FUNCTION EGCP_Dynamic_fuel_trim_diag "Dynamic_fuel_trim_diag"
 /begin DEF_CHARACTERISTIC c_lamb_delta_i_max_diag c_lamb_delta_i_min_diag c_t_sum_max_diag_lam_adj c_t_sum_min_diag_lam_adj c_t_end_diag_lam_adj c_vls_dif_max_diag c_vls_dif_min_diag c_t_rst_sum_diag_lam_adj c_t_vls_down_dif_end_diag c_t_vls_down_dif_rst_sum_diag c_maf_int_vls_dif_dly_min c_maf_int_vls_dif_dly_max c_n_ldc_vls_dif_dly c_maf_ldc_vls_dif_dly c_lam_mv_ldc_vls_dif_dly c_n_crlc_ldc_vls_dif_dly c_maf_crlc_ldc_vls_dif_dly c_lam_mv_crlc_ldc_vls_dif_dly c_maf_int_min_vls_dif_dly_ldc /end DEF_CHARACTERISTIC
 /begin OUT_MEASUREMENT egcp[0].egcp_struct_pladgft0.lamb_delta_i_save_diag egcp[0].egcp_struct_pladgft0.lam_mmv_vls_dif_dly_ldc egcp[0].egcp_struct_pladgft0.maf_int_vls_dif_dly_min egcp[0].egcp_struct_pladgft0.maf_int_vls_dif_dly_max egcp[0].egcp_struct_pladgft0.maf_int_vls_dif_dly_ldc egcp[0].egcp_struct_pladgft0.t_sum_max_diag_lam_adj egcp[0].egcp_struct_pladgft0.t_sum_min_diag_lam_adj egcp[0].egcp_struct_pladgft0.t_rst_sum_diag_lam_adj egcp[0].egcp_struct_pladgft0.t_vls_down_dif_end_diag egcp[0].egcp_struct_pladgft0.t_vls_down_dif_sum_rst_diag egcp[0].egcp_struct_pladgft0.t_end_diag_lam_adj egcp[0].egcp_struct_pladgft0.state_err_vls_down_dif egcp[0].egcp_struct_pladgft0.state_err_delta_i_lam_adj egcp[0].egcp_struct_pladgft0.lv_vls_down_dif_end_diag egcp[0].egcp_struct_pladgft0.lv_vls_down_dif_cdn_diag egcp[0].egcp_struct_pladgft0.lv_vls_down_dif_sym_diag egcp[0].egcp_struct_pladgft0.lv_delta_i_lam_adj_cdn_diag egcp[0].egcp_struct_pladgft0.lv_delta_i_lam_adj_sym_diag egcp[0].egcp_struct_pladgft0.lv_delta_i_lam_adj_end_diag egcp[0].egcp_struct_pladgft0.lv_vls_dif_dly_ldc egcp[0].egcp_struct_pladgft0.lv_vls_dif_dly_ldc_lam_mv lv_err_lam_adj_1 lv_vls_dif_dly_ldc_n lv_vls_dif_dly_ldc_maf n_mmv_vls_dif_dly_ldc maf_mmv_vls_dif_dly_ldc /end OUT_MEASUREMENT
/end FUNCTION
/begin FUNCTION EGCP_Dynamic_fuel_trim_diag_inci "Dynamic_fuel_trim_diag_inci" /begin OUT_MEASUREMENT egcp[0].egcp_struct_pladgfti0.lv_inh_diag_dly_lam /end OUT_MEASUREMENT /end FUNCTION
/begin FUNCTION EGCP_O2_sensor_up_heater_diag "O2_sensor_up_heater_diag"
 /begin DEF_CHARACTERISTIC c_lshpwm_min_lsh_up c_ttip_min_obd_lsh_up c_ttip_max_obd_lsh_up c_tcc_thd_obd_lsh_up c_tcc_thd_err_obd_lsh_up lc_obd_rep_lsh_up ip_t_dly_ls_up_ready_raw_lsh_up ip_t_dly_ls_up_ready_obd_lsh_up lc_obd_lsh_up c_t_dly_pow_ctl_obd_lsh_up c_t_dly_ttip_mes_obd_lsh_up c_t_dly_ttip_res_obd_lsh_up /end DEF_CHARACTERISTIC
 /begin OUT_MEASUREMENT egcp[0].egcp_struct_fctdglslh0.ttip_mes_ls_up_obd_lsh_up egcp[0].egcp_struct_fctdglslh0.tcc_vld_obd_lsh_up egcp[0].egcp_struct_fctdglslh0.tcc_err_obd_lsh_up egcp[0].egcp_struct_fctdglslh0.state_sym_obd_lsl_lsh_up egcp[0].egcp_struct_fctdglslh0.lv_lamb_pls_req_diag_lsh_up egcp[0].egcp_struct_fctdglslh0.lv_diag_obd_cdn_lsh_up egcp[0].egcp_struct_fctdglslh0.lv_diag_obd_sym_lsh_up egcp[0].egcp_struct_fctdglslh0.lv_diag_obd_end_lsh_up /end OUT_MEASUREMENT
/end FUNCTION
/begin FUNCTION EGCP_O2_sensor_down_heater_diag "O2_sensor_down_heater_diag"
 /begin DEF_CHARACTERISTIC c_lshpwm_min_lsh_down c_lshpwm_max_lsh_down c_teg_cat_down_max_obd_lsh_down c_temp_sp_obd_lsh_down ldp_r_it_ls_down_new_lsh_down c_t_dly_obd_lsh_down ip_fac_maf_obd_lsh_down c_tcc_thd_err_obd_lsh_down c_tcc_thd_obd_lsh_down c_pow_int_min_obd_lsh_down ip_r_it_thd_obd_lsh_down /end DEF_CHARACTERISTIC
 /begin OUT_MEASUREMENT lv_err_obd_lsh_down_1 egcp[0].egcp_struct_fctdglshd1.r_it_thd_obd_lsh_down egcp[0].egcp_struct_fctdglshd1.r_it_obd_lsh_down egcp[0].egcp_struct_fctdglshd1.temp_dif_obd_lsh_down egcp[0].egcp_struct_fctdglshd1.pow_int_obd_lsh_down egcp[0].egcp_struct_fctdglshd1.tcc_vld_obd_lsh_down egcp[0].egcp_struct_fctdglshd1.tcc_err_obd_lsh_down egcp[0].egcp_struct_fctdglshd1.ctr_cycnr_r_it_obd_ls_down egcp[0].egcp_struct_fctdglshd1.state_obd_lsh_down /end OUT_MEASUREMENT
/end FUNCTION
/begin FUNCTION EGCP_O2_sensor_down_heat_diag_ai "O2_sensor_down_heater_diag" /begin OUT_MEASUREMENT egcp[0].egcp_struct_fctdglshdi1.lv_inh_diag_obd_lsh_down /end OUT_MEASUREMENT /end FUNCTION
/begin FUNCTION EGCP_O2_sensor_downstream_diag "O2_sensor_down_heater_diag"
 /begin DEF_CHARACTERISTIC c_tco_min_diag_mpl_ls_down c_vs_min_diag_mpl_ls_down c_vs_max_diag_mpl_ls_down c_temp_cat_min_diag_mpl_ls_down ldp_maf_kgh_ip_fac_ls_down ip_fac_cycnr_max_ls_down_act c_maf_int_puc_diag_pue_ls_down c_maf_int_diag_pue_ls_down c_ctr_swt_diag_ls_down c_ctr_sym_inc_diag_pue_ls_down c_ctr_sym_max_diag_pue_ls_down c_vls_dif_min_diag_pue_ls_down c_ctr_swt_ls_down c_maf_puc_max_diag_swt_ls_down c_maf_puc_min_diag_swt_ls_down c_fac_vls_max_diag_swt_ls_down c_vls_hys_diag_swt_ls_down c_vls_puc_min_diag_swt_ls_down c_fac_vls_min_diag_swt_ls_down c_ctr_end_diag_pue_ls_down /end DEF_CHARACTERISTIC
 /begin OUT_MEASUREMENT egcp[0].egcp_struct_sigdglsd2.vls_dif_diag_rgn_nt_ls_down egcp[0].egcp_struct_sigdglsd2.vls_down_tran_puc egcp[0].egcp_struct_sigdglsd2.vls_down_pue egcp[0].egcp_struct_sigdglsd2.vls_dif_diag_pue_ls_down egcp[0].egcp_struct_sigdglsd2.vls_dif_save_diag_ls_down egcp[0].egcp_struct_sigdglsd2.vls_down_rgn_nt_end egcp[0].egcp_struct_sigdglsd2.ctr_end_diag_pue_ls_down egcp[0].egcp_struct_sigdglsd2.ctr_quo_sum_swt_ls_down egcp[0].egcp_struct_sigdglsd2.ctr_quo_swt_ls_down egcp[0].egcp_struct_sigdglsd2.ctr_swt_act_ls_down egcp[0].egcp_struct_sigdglsd2.ctr_swt_ls_down egcp[0].egcp_struct_sigdglsd2.ctr_cycnr_swt_ls_down egcp[0].egcp_struct_sigdglsd2.ctr_save_swt_ls_down egcp[0].egcp_struct_sigdglsd2.ctr_sym_diag_pue_ls_down egcp[0].egcp_struct_sigdglsd2.lv_diag_pue_vld_ls_down egcp[0].egcp_struct_sigdglsd2.lv_diag_mpl_cdn_ls_down egcp[0].egcp_struct_sigdglsd2.lv_diag_mpl_end_ls_down egcp[0].egcp_struct_sigdglsd2.lv_swt_diag_vld_ls_down maf_kgh_min_puc lv_err_pue_ls_down_1 lv_err_swt_ls_down_1 /end OUT_MEASUREMENT
/end FUNCTION
/begin FUNCTION EGCP_O2_sensor_inter_signal_diag "O2_sensor_inter_signal_diag" /end FUNCTION
/begin FUNCTION EGCP_O2_sensor_diag_management "O2_sensor_diag_management" /begin DEF_CHARACTERISTIC lc_err_dyn_vld_ls_up /end DEF_CHARACTERISTIC
 /begin OUT_MEASUREMENT egcp[0].egcp_struct_sigdglsl1.lv_err_ls_up egcp[0].egcp_struct_sigdglsl1.lv_err_ls_down lv_err_obd_vld_lsh_up_1 lv_err_puc_vld_ls_up_1 lv_err_dyn_vld_ls_up_1 lv_err_shift_afl_lsl_up_1 lv_err_shift_afr_lsl_up_1 /end OUT_MEASUREMENT
/end FUNCTION
/begin FUNCTION EGCP_O2_sensor_swap_sig_diag_ai "O2_sensor_swap_sig_diag_ai"
 /begin OUT_MEASUREMENT t_end_diag_chg_ls_up t_end_diag_chg_ls_down lv_inh_diag_chg_ls_up lv_inh_diag_chg_ls_down /end OUT_MEASUREMENT
/end FUNCTION
/begin FUNCTION EGCP_O2_sensor_swap_sig_diag "O2_sensor_swap_sig_diag_ai"
 /begin DEF_CHARACTERISTIC c_t_end_diag_chg_ls_up c_t_end_diag_chg_ls_down c_maf_int_diag_chg_ls_up c_maf_int_diag_chg_ls_down c_fac_lam_lim_max_chg_ls_up c_fac_lam_lim_min_chg_ls_up c_fac_int_chg_ls_up c_vls_down_max_chg_ls_down c_vls_down_min_chg_ls_down c_fac_int_chg_ls_down /end DEF_CHARACTERISTIC
 /begin OUT_MEASUREMENT lv_err_chg_ls_up lv_err_chg_ls_down maf_int_diag_chg_ls_up maf_int_diag_chg_ls_down /end OUT_MEASUREMENT
/end FUNCTION
/begin FUNCTION EGCP_O2_sensor_probe_diag_plaus "O2_sensor_probe_diag_plaus"
 /begin DEF_CHARACTERISTIC c_maf_int_diag_ls_up_down c_t_max_diag_afr_ls_up_down c_t_max_diag_afl_ls_up_down c_t_diag_eol_ls_up_down c_maf_int_eol_diag_ls_up_down c_lamb_afl_min_diag_ls_up_down c_lamb_afl_max_diag_ls_up_down c_lamb_afr_min_diag_ls_up_down c_lamb_afr_max_diag_ls_up_down c_abc_max_chk_ls_down c_vls_afr_thd_diag_act_ls_down c_vls_afl_thd_diag_act_ls_down c_lamb_sp_afr_diag_ls_up_down c_lamb_sp_afl_diag_ls_up_down c_abc_inc_chk_ls_down c_lamb_sp_step_diag_ls_up_down lc_diag_auth_chk_ls_up_down c_abc_inc_chk_lsl_up c_lamb_afr_thd_diag_act_lsl_up c_lamb_afl_thd_diag_act_lsl_up c_ctr_sum_rst_afr_chk_lsl_up c_ctr_sum_rst_afl_chk_lsl_up c_abc_max_chk_lsl_up /end DEF_CHARACTERISTIC
 /begin OUT_MEASUREMENT egcp[0].egcp_struct_pladglsl1.lamb_sp_delta_ls_up_down egcp[0].egcp_struct_pladglsl1.maf_int_diag_ls_up_down egcp[0].egcp_struct_pladglsl1.lamb_sp_beg_diag_ls_up_down egcp[0].egcp_struct_pladglsl1.t_diag_act_afr_ls_up_down egcp[0].egcp_struct_pladglsl1.t_diag_act_afl_ls_up_down egcp[0].egcp_struct_pladglsl1.lamb_sp_diag_ls_up_down egcp[0].egcp_struct_pladglsl1.ctr_sum_rst_afr_chk_lsl_up egcp[0].egcp_struct_pladglsl1.ctr_sum_rst_afl_chk_lsl_up egcp[0].egcp_struct_pladglsl1.ctr_afr_chk_lsl_up egcp[0].egcp_struct_pladglsl1.ctr_afl_chk_lsl_up egcp[0].egcp_struct_pladglsl1.state_diag_act_ls_up_down egcp[0].egcp_struct_pladglsl1.lv_diag_afl_cdn_ls_up_down egcp[0].egcp_struct_pladglsl1.lv_diag_afr_cdn_ls_up_down egcp[0].egcp_struct_pladglsl1.lv_diag_act_end_ls_up_down egcp[0].egcp_struct_pladglsl1.lv_lamb_sp_afr_req_diag_act egcp[0].egcp_struct_pladglsl1.lv_lamb_sp_afl_req_diag_act egcp[0].egcp_struct_pladglsl1.lv_lamb_sp_req_diag_act egcp[0].egcp_struct_pladglsl1.lv_diag_cyc_end_ls_down egcp[0].egcp_struct_pladglsl1.lv_lam_di_req egcp[0].egcp_struct_pladglsl1.lv_diag_afr_end_ls_up_down egcp[0].egcp_struct_pladglsl1.lv_diag_afl_end_ls_up_down egcp[0].egcp_struct_pladglsl1.lv_diag_afr_chk_sym_lsl_up egcp[0].egcp_struct_pladglsl1.lv_diag_afl_chk_sym_lsl_up egcp[0].egcp_struct_pladglsl1.lv_diag_act_chk_cdn_lsl_up egcp[0].egcp_struct_pladglsl1.lv_diag_act_chk_end_lsl_up lv_err_chk_ls_down_1 /end OUT_MEASUREMENT
/end FUNCTION
/begin FUNCTION EGCP_O2_sensor_temperature "O2_sensor_temperature"
 /begin DEF_CHARACTERISTIC c_tcc_fac_gain_max_ttip_ls_up c_tcc_err_max_ttip_obd_ls_up lc_ttip_obd_rep_ls_up lc_ttip_obd_ls_up /end DEF_CHARACTERISTIC
 /begin OUT_MEASUREMENT egcp[0].egcp_struct_pladgtipa0.v_ofs_mes_r_it_obd_ls_up egcp[0].egcp_struct_pladgtipa0.v_ofs_adj_r_it_obd_ls_up egcp[0].egcp_struct_pladgtipa0.fac_gain_h_r_it_obd_ls_up egcp[0].egcp_struct_pladgtipa0.fac_gain_l_r_it_obd_ls_up egcp[0].egcp_struct_pladgtipa0.lv_ttip_obd_rep_ls_up lv_err_ttip_obd_ls_up_1 /end OUT_MEASUREMENT
/end FUNCTION
/begin FUNCTION EGCP_O2_sensor_down_diag_inci "O2_sensor_down_diag_inci" /begin DEF_CHARACTERISTIC c_abc_inc_rgn_nt_ls_down c_abc_max_rgn_nt_ls_down /end DEF_CHARACTERISTIC /begin OUT_MEASUREMENT egcp[0].egcp_struct_sigdglsdi2.lv_diag_mpl_inh_ls_down /end OUT_MEASUREMENT /end FUNCTION
/begin FUNCTION EGCP_O2_sensor_up_heater_diag_ai "O2_sensor_up_heater_diag_ai" /begin OUT_MEASUREMENT egcp[0].egcp_struct_fctdglslhi0.lv_inh_diag_obd_lsh_up /end OUT_MEASUREMENT /end FUNCTION
/begin FUNCTION EGCP_Linear_O2_sensor_diag "Linear_O2_sensor_diag"
 /begin DEF_CHARACTERISTIC c_t_on_thd_lsh_diag_st_lsl_up c_t_lam_lim_diag_st_lsl_up ldp_tco_ip_t_max_diag_st_lsl_up ip_t_max_diag_st_lsl_up c_vls_down_min_plaus_lsl_up c_vls_down_max_plaus_lsl_up c_temp_cat_min_plaus_lsl_up c_temp_cat_max_plaus_lsl_up c_maf_kgh_min_diag_plaus_lsl_up c_maf_kgh_max_diag_plaus_lsl_up c_eff_cat_diag_plaus_lsl_up c_vls_down_afl_plaus_lsl_up c_vls_down_afr_plaus_lsl_up c_lamb_afl_diag_plaus_lsl_up c_lamb_afr_diag_plaus_lsl_up c_lamb_min_diag_plaus_lsl_up c_lamb_max_diag_plaus_lsl_up c_tco_min_diag_plaus_lsl_up ldp_maf_kgh_ip_t_diag_lsl_up ip_t_sym_diag_plaus_lsl_up c_t_end_diag_plaus_lsl_up c_ctr_err_ini_diag_st_lsl_up c_ctr_inc_diag_plaus_lsl_up c_ctr_dec_diag_plaus_lsl_up c_ctr_thd_diag_plaus_lsl_up c_vls_up_max_diag_air_lsl_up c_t_sym_diag_air_lsl_up c_t_end_diag_air_lsl_up c_t_diag_sym_puc_lsl_up c_t_dly_diag_puc_lsl_up c_vls_up_min_diag_puc_lsl_up c_vls_up_max_diag_puc_lsl_up c_teg_dyn_min_diag_puc_ls_up c_t_diag_end_puc_lsl_up c_ctr_min_diag_dyn_lsl_up c_ctr_min_diag_eol_dyn_lsl_up c_ctr_wait_diag_dyn_lsl_up c_cycnr_ls_up_dyn_min c_cycnr_ls_up_dyn_min_ext_req c_n_min_ls_dyn c_n_max_ls_dyn c_ls_dyn_diag_maf_max c_ls_dyn_diag_maf_min c_lamb_min_diag_dyn_lsl_up c_lamb_max_diag_dyn_lsl_up c_fac_mv_thd_dyn_ls_up c_fac_ad_thd_dyn_ls_up c_fac_ad_delta_ls_up_dyn c_fac_ad_lpf_dyn_ls_up lc_diag_dyn_lsl_up_cat_syn lc_t1_ad_diag_dyn_lsl_up c_lamb_ampl_max_dyn_lsl_up c_lamb_ampl_min_dyn_lsl_up ip_lamb_ampl_max_dyn_lsl_up ip_lamb_ampl_min_dyn_lsl_up /end DEF_CHARACTERISTIC
 /begin OUT_MEASUREMENT egcp[0].egcp_struct_sigdglsl2.t_on_thd_lsh_diag_st_lsl_up egcp[0].egcp_struct_sigdglsl2.vls_up_save_diag_puc_lsl_up egcp[0].egcp_struct_sigdglsl2.t_sym_diag_air_lsl_up egcp[0].egcp_struct_sigdglsl2.t_end_diag_air_lsl_up egcp[0].egcp_struct_sigdglsl2.t_end_diag_plaus_lsl_up egcp[0].egcp_struct_sigdglsl2.t_diag_end_puc_lsl_up egcp[0].egcp_struct_sigdglsl2.t_dly_diag_puc_lsl_up egcp[0].egcp_struct_sigdglsl2.t_diag_sym_puc_lsl_up egcp[0].egcp_struct_sigdglsl2.t_sym_diag_plaus_lsl_up egcp[0].egcp_struct_sigdglsl2.lamb_min_diag_dyn_lsl_up egcp[0].egcp_struct_sigdglsl2.lamb_max_diag_dyn_lsl_up egcp[0].egcp_struct_sigdglsl2.lamb_ampl_int_diag_dyn_lsl_up egcp[0].egcp_struct_sigdglsl2.fac_value_diag_dyn_lsl_up egcp[0].egcp_struct_sigdglsl2.fac_sum_diag_dyn_lsl_up egcp[0].egcp_struct_sigdglsl2.fac_ad_min_diag_dyn_lsl_up egcp[0].egcp_struct_sigdglsl2.fac_mv_diag_dyn_lsl_up egcp[0].egcp_struct_sigdglsl2.fac_ad_max_diag_dyn_lsl_up egcp[0].egcp_struct_sigdglsl2.fac_diag_dyn_lsl_up egcp[0].egcp_struct_sigdglsl2.t_eng_st_diag_st_lsl_up egcp[0].egcp_struct_sigdglsl2.ctr_err_diag_st_lsl_up egcp[0].egcp_struct_sigdglsl2.t_lam_lim_diag_st_lsl_up egcp[0].egcp_struct_sigdglsl2.ctr_diag_plaus_lsl_up egcp[0].egcp_struct_sigdglsl2.lamb_ampl_diag_dyn_lsl_up egcp[0].egcp_struct_sigdglsl2.lamb_ampl_min_diag_dyn_lsl_up egcp[0].egcp_struct_sigdglsl2.lamb_ampl_max_diag_dyn_lsl_up egcp[0].egcp_struct_sigdglsl2.lamb_ampl_mv_diag_dyn_lsl_up egcp[0].egcp_struct_sigdglsl2.ctr_diag_dyn_lsl_up egcp[0].egcp_struct_sigdglsl2.ctr_wait_diag_dyn_lsl_up egcp[0].egcp_struct_sigdglsl2.cycnr_diag_dyn_lsl_up egcp[0].egcp_struct_sigdglsl2.state_sym_diag_plaus_lsl_up egcp[0].egcp_struct_sigdglsl2.state_sym_diag_puc_lsl_up egcp[0].egcp_struct_sigdglsl2.state_sym_diag_st_lsl_up egcp[0].egcp_struct_sigdglsl2.state_dyn_diag egcp[0].egcp_struct_sigdglsl2.lv_diag_plaus_sym_lsl_up egcp[0].egcp_struct_sigdglsl2.lv_diag_cdn_plaus_lsl_up egcp[0].egcp_struct_sigdglsl2.lv_diag_plaus_end_lsl_up egcp[0].egcp_struct_sigdglsl2.lv_diag_dyn_sym_lsl_up egcp[0].egcp_struct_sigdglsl2.lv_diag_dyn_end_lsl_up egcp[0].egcp_struct_sigdglsl2.lv_diag_dyn_cdn_lsl_up egcp[0].egcp_struct_sigdglsl2.lv_diag_puc_sym_lsl_up egcp[0].egcp_struct_sigdglsl2.lv_diag_cdn_puc_lsl_up egcp[0].egcp_struct_sigdglsl2.lv_diag_puc_end_lsl_up egcp[0].egcp_struct_sigdglsl2.lv_diag_st_sym_lsl_up egcp[0].egcp_struct_sigdglsl2.lv_diag_cdn_st_lsl_up egcp[0].egcp_struct_sigdglsl2.lv_diag_st_end_lsl_up egcp[0].egcp_struct_sigdglsl2.lv_lamb_pls_req_diag_dyn_lsl_up egcp[0].egcp_struct_sigdglsl2.lv_lam_adj_req_diag_dyn_lsl_up lv_err_air_lsl_up_1 ctr_min_diag_dyn_lsl_up /end OUT_MEASUREMENT
/end FUNCTION
/begin FUNCTION EGCP_Linear_O2_sensor_diag_inci "Linear_O2_sensor_diag_inci" /begin DEF_CHARACTERISTIC c_cl_mmv_ls_up_diag_max /end DEF_CHARACTERISTIC
 /begin OUT_MEASUREMENT egcp[0].egcp_struct_sigdglsli2.lv_inh_diag_st_lsl_up egcp[0].egcp_struct_sigdglsli2.lv_diag_plaus_inh_lsl_up egcp[0].egcp_struct_sigdglsli2.lv_diag_dyn_inh_lsl_up egcp[0].egcp_struct_sigdglsli2.lv_inh_diag_air_lsl_up egcp[0].egcp_struct_sigdglsli2.lv_inh_diag_puc_lsl_up egcp[0].egcp_struct_sigdglsli2.lv_diag_eol_dyn_ls_up lv_inh_diag_ls_up_dyn_cp /end OUT_MEASUREMENT
/end FUNCTION
/begin FUNCTION EGCP_O2_sensor_temperature_inci "O2_sensor_temperature" /begin OUT_MEASUREMENT egcp[0].egcp_struct_pladgtipai0.lv_inh_diag_ttip_obd_ls_up /end OUT_MEASUREMENT /end FUNCTION
/begin FUNCTION EGCP_O2_sensor_diag_manag_inci "O2_sensor_diag_manag_inci" /end FUNCTION
/begin FUNCTION EGCP_O2_sensor_probe_diag_inci "O2_sensor_probe_diag_inci"
 /begin OUT_MEASUREMENT egcp[0].egcp_struct_pladglsli1.lv_diag_act_inh_ls_up_down egcp[0].egcp_struct_pladglsli1.lv_diag_afr_inh_ls_up_down egcp[0].egcp_struct_pladglsli1.lv_diag_afl_inh_ls_up_down egcp[0].egcp_struct_pladglsli1.lv_diag_eol_req_ls_up_down /end OUT_MEASUREMENT
/end FUNCTION
/begin FUNCTION EGCP_Down_O2_sensor_resist_inci "" /begin OUT_MEASUREMENT egcp[0].egcp_struct_sigcvridi0.lv_inh_r_it_ls_down /end OUT_MEASUREMENT /end FUNCTION
/begin FUNCTION EGCP_Linear_O2_sensor_hea_diag "Linear_O2_sensor_hea_diag"
 /begin DEF_CHARACTERISTIC c_lamb_delta_lpf_thd c_cycnr_max_diag_lsh_lsl_up c_ctr_sym_diag_lsh_lsl_up c_lamb_sp_de_diag_lsh_lsl_up c_teg_dyn_min_diag_lsh_lsl_up c_maf_int_diag_lsh_lsl_up c_t_per_lamb_de_diag_lsh_lsl_up c_crlc_lpf_fall_diag_lsh_lsl_up c_crlc_lpf_rise_diag_lsh_lsl_up c_lshpwm_min_diag_lsh_lsl_up c_lshpwm_max_diag_lsh_lsl_up ldp_lshpwm_up_ip_t_dly_acq_vls ip_t_dly_trig_lsh_up /end DEF_CHARACTERISTIC
 /begin OUT_MEASUREMENT egcp[0].egcp_struct_sigdglsl3.lamb_delta_rise_lpf egcp[0].egcp_struct_sigdglsl3.lamb_delta_fall_lpf egcp[0].egcp_struct_sigdglsl3.lamb_syn_lshpwm_fall egcp[0].egcp_struct_sigdglsl3.lamb_syn_lshpwm_rise egcp[0].egcp_struct_sigdglsl3.lamb_delta_rise egcp[0].egcp_struct_sigdglsl3.lamb_delta_fall egcp[0].egcp_struct_sigdglsl3.ctr_sym_diag_lsh_lsl_up egcp[0].egcp_struct_sigdglsl3.cycnr_diag_lsh_lsl_up egcp[0].egcp_struct_sigdglsl3.t_dly_trig_lsh_up maf_int_diag_lsh_lsl_up lv_err_lsh_lsl_up_1 /end OUT_MEASUREMENT
/end FUNCTION
/begin FUNCTION EGCP_Linear_O2_sens_hea_diag_AI "Linear_O2_sens_hea_diag_AI" /begin OUT_MEASUREMENT egcp[0].egcp_struct_sigdglsli3.lv_inh_diag_lsh_lsl_up /end OUT_MEASUREMENT /end FUNCTION
/begin FUNCTION C_X_PECO "" /begin SUB_FUNCTION ENME ACQU ENCO CLCO FOCO TEPL STCO CORD /end SUB_FUNCTION /end FUNCTION
/begin FUNCTION ENME "" /end FUNCTION
/begin FUNCTION ACQU "" /end FUNCTION
/begin FUNCTION ENCO "" /end FUNCTION
/begin FUNCTION CLCO "" /end FUNCTION
/begin FUNCTION FOCO "" /end FUNCTION
/begin FUNCTION TEPL "" /end FUNCTION
/begin FUNCTION STCO "" /end FUNCTION
/begin FUNCTION CORD "" /end FUNCTION
/begin FUNCTION __DDS_EXPA2_DEFAULT_FUNC__ "__DDS_EXPA2_DEFAULT_FUNC__" /end FUNCTION
/end MODULE
/end PROJECT
