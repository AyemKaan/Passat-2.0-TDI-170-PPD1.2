ASAP2_VERSION 1 41
/begin PROJECT SN0 "SIMOS PPD"
/begin HEADER "_default_HeaderComment" PROJECT_NO PRJ_NUM /end HEADER
/begin MODULE _default_ModuleName "_default_ModuleLongIdentifier"
/begin MOD_COMMON "_default_ModCommonComment" DEPOSIT ABSOLUTE BYTE_ORDER MSB_FIRST ALIGNMENT_BYTE 1 ALIGNMENT_WORD 2 ALIGNMENT_LONG 4 ALIGNMENT_FLOAT32_IEEE 4 ALIGNMENT_FLOAT64_IEEE 8 /end MOD_COMMON
/begin MEASUREMENT fac_lam_lim[0] "limited value of lambda controller output" SWORD _CNV_A_R_LINEAR_____99_CM 1 0. -50. 49.9984741210938 DISPLAY_IDENTIFIER FAC_LAM_LIM_0_ ECU_ADDRESS 0x7f96f2 BYTE_ORDER MSB_LAST FORMAT "%5.3" /end MEASUREMENT
/begin MEASUREMENT lv_vb_cdn_obd_1 "Boolean for battery voltage condition fulfilled for OBD-I diagnosis" UBYTE _CNV_S_2_RANGE______11_CM 1 0. 0. 1. DISPLAY_IDENTIFIER LV_VB_CDN_OBD_1 ECU_ADDRESS 0x7fb2e7 /end MEASUREMENT
/begin MEASUREMENT lv_vb_cdn_obd_2[0] "Boolean for battery voltage condition fulfilled for OBD-II diagnosis" UBYTE _CNV_S_2_RANGE______11_CM 1 0. 0. 1. DISPLAY_IDENTIFIER LV_VB_CDN_OBD_2_0_ ECU_ADDRESS 0x7fb2e8 /end MEASUREMENT
/begin MEASUREMENT lv_efp "Logical variable for electrical fuel pump active" UBYTE _CNV_S_2_RANGE______11_CM 1 0. 0. 1. DISPLAY_IDENTIFIER LV_EFP ECU_ADDRESS 0x7fb2e9 /end MEASUREMENT
/begin MEASUREMENT lv_err_cat_diag[0] "Present failure: failure after filtering diagnosis value catalyst diagnose" UBYTE _CNV_S_2_RANGE______11_CM 1 0. 0. 1. DISPLAY_IDENTIFIER LV_ERR_CAT_DIAG_0_ ECU_ADDRESS 0x7fb2ea /end MEASUREMENT
/begin MEASUREMENT lv_err_el_cps "Logical value for present electrical canister purge valve failure" UBYTE _CNV_S_2_RANGE______11_CM 1 0. 0. 1. DISPLAY_IDENTIFIER LV_ERR_EL_CPS ECU_ADDRESS 0x7fb2eb /end MEASUREMENT
/begin MEASUREMENT lv_err_fsd[0] "Present failure: failure after filtering of diagnosis" UBYTE _CNV_S_2_RANGE______11_CM 1 0. 0. 1. DISPLAY_IDENTIFIER LV_ERR_FSD_0_ ECU_ADDRESS 0x7fb2ec /end MEASUREMENT
/begin MEASUREMENT state_err_iv "Error pattern after debouncing for all injectors" UBYTE _CNV_A_R_LINEAR_____0_CM 1 0. 0. 255. DISPLAY_IDENTIFIER STATE_ERR_IV ECU_ADDRESS 0x7fb2dd FORMAT "%3.0" /end MEASUREMENT
/begin MEASUREMENT lv_err_map "MAP sensor error detected" UBYTE _CNV_S_2_RANGE______11_CM 1 0. 0. 1. DISPLAY_IDENTIFIER LV_ERR_MAP ECU_ADDRESS 0x7fb2ed /end MEASUREMENT
/begin MEASUREMENT lv_err_map_plaus "Present failure: failure after filtering of diagnosis XX" UBYTE _CNV_S_2_RANGE______11_CM 1 0. 0. 1. DISPLAY_IDENTIFIER LV_ERR_MAP_PLAUS ECU_ADDRESS 0x7fb2ee /end MEASUREMENT
/begin MEASUREMENT lv_err_mec_open_cps "Indication for faulty functions - functional check CPS" UBYTE _CNV_S_2_RANGE______11_CM 1 0. 0. 1. DISPLAY_IDENTIFIER LV_ERR_MEC_OPEN_CPS ECU_ADDRESS 0x7fb2ef /end MEASUREMENT
/begin MEASUREMENT lv_err_sa_sap "Present failure: Minimum secondary air flow rate failure after filtering" UBYTE _CNV_S_2_RANGE______11_CM 1 0. 0. 1. DISPLAY_IDENTIFIER LV_ERR_SA_SAP ECU_ADDRESS 0x7fb2f0 /end MEASUREMENT
/begin MEASUREMENT lv_err_sa_sav "Present failure: Mechanical jammed SAV after filtering" UBYTE _CNV_S_2_RANGE______11_CM 1 0. 0. 1. DISPLAY_IDENTIFIER LV_ERR_SA_SAV ECU_ADDRESS 0x7fb2f1 /end MEASUREMENT
/begin MEASUREMENT lv_err_tco "Boolean for error currently present on Coolant temperature acquisition" UBYTE _CNV_S_2_RANGE______11_CM 1 0. 0. 1. DISPLAY_IDENTIFIER LV_ERR_TCO ECU_ADDRESS 0x7fb2f2 /end MEASUREMENT
/begin MEASUREMENT lv_err_tco_grd "Boolean for coolant temperature signal gradient error" UBYTE _CNV_S_2_RANGE______11_CM 1 0. 0. 1. DISPLAY_IDENTIFIER LV_ERR_TCO_GRD ECU_ADDRESS 0x7fb2f3 /end MEASUREMENT
/begin MEASUREMENT lv_err_tco_plaus "Boolean for coolant temperature plausibility error" UBYTE _CNV_S_2_RANGE______11_CM 1 0. 0. 1. DISPLAY_IDENTIFIER LV_ERR_TCO_PLAUS ECU_ADDRESS 0x7fb2f4 /end MEASUREMENT
/begin MEASUREMENT lv_err_tco_stuck "Boolean for coolant temperature stuck signal error" UBYTE _CNV_S_2_RANGE______11_CM 1 0. 0. 1. DISPLAY_IDENTIFIER LV_ERR_TCO_STUCK ECU_ADDRESS 0x7fb2f5 /end MEASUREMENT
/begin MEASUREMENT lv_err_tps "Logical variable for TPS error, set if both channels are defective" UBYTE _CNV_S_2_RANGE______11_CM 1 0. 0. 1. DISPLAY_IDENTIFIER LV_ERR_TPS ECU_ADDRESS 0x7fb3ef /end MEASUREMENT
/begin MEASUREMENT lv_fl "Basic function \"Full Load\"" UBYTE _CNV_S_2_RANGE______11_CM 1 0. 0. 1. DISPLAY_IDENTIFIER LV_FL ECU_ADDRESS 0x7fb2f6 /end MEASUREMENT
/begin MEASUREMENT lv_lam_adj_i_act[0] "activation flag for calculation of trim controller I share" UBYTE _CNV_S_2_RANGE______11_CM 1 0. 0. 1. DISPLAY_IDENTIFIER LV_LAM_ADJ_I_ACT_0_ ECU_ADDRESS 0x7fb2f7 /end MEASUREMENT
/begin MEASUREMENT lv_lam_adj_p_act[0] "activation flag for calculation of trim controller P share" UBYTE _CNV_S_2_RANGE______11_CM 1 0. 0. 1. DISPLAY_IDENTIFIER LV_LAM_ADJ_P_ACT_0_ ECU_ADDRESS 0x7fb2f8 /end MEASUREMENT
/begin MEASUREMENT lv_lam_stop[0] "activation signal for the lambda controller stop mode" UBYTE _CNV_S_2_RANGE______11_CM 1 0. 0. 1. DISPLAY_IDENTIFIER LV_LAM_STOP_0_ ECU_ADDRESS 0x7fb2f9 /end MEASUREMENT
/begin MEASUREMENT lv_lam_lscl[0] "activation flag of lambda control" UBYTE _CNV_S_2_RANGE______11_CM 1 0. 0. 1. DISPLAY_IDENTIFIER LV_LAM_LSCL_0_ ECU_ADDRESS 0x7fb2fa /end MEASUREMENT
/begin MEASUREMENT lv_mis_state_a "CARB A misfire criterion confirmed (debounced)" UBYTE _CNV_S_2_RANGE______11_CM 1 0. 0. 1. DISPLAY_IDENTIFIER LV_MIS_STATE_A ECU_ADDRESS 0x7fc084 /end MEASUREMENT
/begin MEASUREMENT lv_mis_state_b1 "CARB B1 misfire criterion confirmed (debounced)" UBYTE _CNV_S_2_RANGE______11_CM 1 0. 0. 1. DISPLAY_IDENTIFIER LV_MIS_STATE_B1 ECU_ADDRESS 0x7fb2fb /end MEASUREMENT
/begin MEASUREMENT lv_mis_state_b4 "CARB B4 misfire criterion confirmed (debounced)" UBYTE _CNV_S_2_RANGE______11_CM 1 0. 0. 1. DISPLAY_IDENTIFIER LV_MIS_STATE_B4 ECU_ADDRESS 0x7fb2fc /end MEASUREMENT
/begin MEASUREMENT lv_err_ratio_chk "Boolean for actual value MAF or TPS ratio check is present (yet available only for interface)" UBYTE _CNV_S_2_RANGE______11_CM 1 0. 0. 1. DISPLAY_IDENTIFIER LV_ERR_RATIO_CHK ECU_ADDRESS 0x7fb2fd /end MEASUREMENT
/begin MEASUREMENT lv_sap "Flag for secondary air pump activation" UBYTE _CNV_S_2_RANGE______11_CM 1 0. 0. 1. DISPLAY_IDENTIFIER LV_SAP ECU_ADDRESS 0x7fb2fe /end MEASUREMENT
/begin MEASUREMENT lv_sav "Flag for secondary air valve activation" UBYTE _CNV_S_2_RANGE______11_CM 1 0. 0. 1. DISPLAY_IDENTIFIER LV_SAV ECU_ADDRESS 0x7fb2ff /end MEASUREMENT
/begin MEASUREMENT lv_teg_cat_down_min_thd[0] "dew-point recognition downstream of catalyst bankselective" UBYTE _CNV_S_2_RANGE______11_CM 1 0. 0. 1. DISPLAY_IDENTIFIER LV_TEG_CAT_DOWN_MIN_THD_0_ ECU_ADDRESS 0x7fb300 /end MEASUREMENT
/begin MEASUREMENT lv_teg_min_thd[0] "dew-point recognition bankselective" UBYTE _CNV_S_2_RANGE______11_CM 1 0. 0. 1. DISPLAY_IDENTIFIER LV_TEG_MIN_THD_0_ ECU_ADDRESS 0x7fb301 /end MEASUREMENT
/begin MEASUREMENT maf_int_puc "integral of mass air flow while active PUC" UWORD _CNV_A_R_LINEAR_____100_CM 1 0. 0. 1820.42 DISPLAY_IDENTIFIER MAF_INT_PUC ECU_ADDRESS 0x7f96f4 BYTE_ORDER MSB_LAST FORMAT "%6.2" /end MEASUREMENT
/begin MEASUREMENT maf_int_pue "integral of mass air flow while PUC is not active" UWORD _CNV_A_R_LINEAR_____100_CM 1 0. 0. 1820.42 DISPLAY_IDENTIFIER MAF_INT_PUE ECU_ADDRESS 0x7f96f6 BYTE_ORDER MSB_LAST FORMAT "%6.2" /end MEASUREMENT
/begin MEASUREMENT teg_cat_down_mdl[0] "modelled exhaust gas temperature, downstream of the catalyst" UWORD _CNV_A_R_LINEAR_____101_CM 1 0. 0. 2047. DISPLAY_IDENTIFIER TEG_CAT_DOWN_MDL_0_ ECU_ADDRESS 0x7f96f8 BYTE_ORDER MSB_LAST FORMAT "%6.2" /end MEASUREMENT
/begin MEASUREMENT teg_cat_up_mdl[0] "modelled exhaust gas temperature, upstream of the catalyst" UWORD _CNV_A_R_LINEAR_____101_CM 1 0. 0. 2047. DISPLAY_IDENTIFIER TEG_CAT_UP_MDL_0_ ECU_ADDRESS 0x7f96fa BYTE_ORDER MSB_LAST FORMAT "%6.2" /end MEASUREMENT
/begin MEASUREMENT teg_dyn "Model or sensor output signal of the exhaust gas temperature" UWORD _CNV_A_R_LINEAR_____101_CM 1 0. 0. 2047. DISPLAY_IDENTIFIER TEG_DYN ECU_ADDRESS 0x7f96fc BYTE_ORDER MSB_LAST FORMAT "%6.2" /end MEASUREMENT
/begin MEASUREMENT temp_cat "modelled catalyst monolith temperature (average value)" UWORD _CNV_A_R_LINEAR_____102_CM 1 0. -33. 990. DISPLAY_IDENTIFIER TEMP_CAT ECU_ADDRESS 0x7f96fe BYTE_ORDER MSB_LAST FORMAT "%5.2" /end MEASUREMENT
/begin MEASUREMENT tia_thr_st "Intake air temperature at Start" UBYTE _CNV_A_R_LINEAR_____103_CM 1 0. -48. 142.5 DISPLAY_IDENTIFIER TIA_THR_ST ECU_ADDRESS 0x7fb2de FORMAT "%4.1" /end MEASUREMENT
/begin MEASUREMENT lv_cp_ramp_open_act "Logical value for active RAMP_OPEN operation" UBYTE _CNV_S_2_RANGE______11_CM 1 0. 0. 1. DISPLAY_IDENTIFIER LV_CP_RAMP_OPEN_ACT ECU_ADDRESS 0x7fb302 /end MEASUREMENT
/begin MEASUREMENT eff_cat_diag[0] "Catalyst diagnosis value in OSC range" UBYTE _CNV_A_R_LINEAR_____24_CM 1 0. 0. 1.9921875 DISPLAY_IDENTIFIER EFF_CAT_DIAG_0_ ECU_ADDRESS 0x7fb2df FORMAT "%4.3" /end MEASUREMENT
/begin MEASUREMENT cl_mmv "Moving mean value of the canister load CL" UWORD _CNV_A_R_LINEAR_____104_CM 1 0. 0. 1.99996948242188 DISPLAY_IDENTIFIER CL_MMV ECU_ADDRESS 0x7f9700 BYTE_ORDER MSB_LAST FORMAT "%6.5" /end MEASUREMENT
/begin MEASUREMENT cppwm "PWM signal for CPS opening" UBYTE _CNV_A_R_LINEAR_____82_CM 1 0. 0. 99.609375 DISPLAY_IDENTIFIER CPPWM ECU_ADDRESS 0x7fb2e0 FORMAT "%3.1" /end MEASUREMENT
/begin MEASUREMENT crk_cyl_lam[0] "Value of phase displacement" UBYTE _CNV_A_R_LINEAR_____105_CM 1 0. 0. 1440. DISPLAY_IDENTIFIER CRK_CYL_LAM_0_ ECU_ADDRESS 0x7fb2e1 FORMAT "%4.0" /end MEASUREMENT
/begin MEASUREMENT lamb_delta_lam_adj[0] "Total output (P share + I share) from trim control" SWORD _CNV_A_R_LINEAR_____15_CM 1 0. -0.125 0.125 DISPLAY_IDENTIFIER LAMB_DELTA_LAM_ADJ_0_ ECU_ADDRESS 0x7f9702 BYTE_ORDER MSB_LAST FORMAT "%6.5" /end MEASUREMENT
/begin MEASUREMENT lamb_delta_i_lam_adj[0] "I share from trim control" SWORD _CNV_A_R_LINEAR_____15_CM 1 0. -0.125 0.125 DISPLAY_IDENTIFIER LAMB_DELTA_I_LAM_ADJ_0_ ECU_ADDRESS 0x7f9704 BYTE_ORDER MSB_LAST FORMAT "%6.5" /end MEASUREMENT
/begin MEASUREMENT lamb_pls[0] "Lambda deviation for the lambda controller" SBYTE _CNV_A_R_LINEAR_____106_CM 1 0. -0.125 0.1240234375 DISPLAY_IDENTIFIER LAMB_PLS_0_ ECU_ADDRESS 0x7fb2e2 FORMAT "%5.4" /end MEASUREMENT
/begin MEASUREMENT lamb_sp_fil_hom[0] "output signal of the WRAF sensor model for homogeneous mode" UWORD _CNV_A_R_LINEAR_____15_CM 1 0. 0. 1.99993896484375 DISPLAY_IDENTIFIER LAMB_SP_FIL_HOM_0_ ECU_ADDRESS 0x7f9706 BYTE_ORDER MSB_LAST FORMAT "%6.5" /end MEASUREMENT
/begin MEASUREMENT lamb_sp[0] "lambda setpoint" UWORD _CNV_A_R_LINEAR_____106_CM 1 0. 0. 31.9990234375 DISPLAY_IDENTIFIER LAMB_SP_0_ ECU_ADDRESS 0x7f9708 BYTE_ORDER MSB_LAST FORMAT "%6.4" /end MEASUREMENT
/begin MEASUREMENT state_cat_diag[0] "State of diagnosis" UBYTE _CNV_S_5_EGCP_RANGE_107_CM 1 0. 0. 4. DISPLAY_IDENTIFIER STATE_CAT_DIAG_0_ ECU_ADDRESS 0x7fb2e3 /end MEASUREMENT
/begin MEASUREMENT state_cp "State of Evaporative Emission Control Function" UBYTE _CNV_S_9_EGCP_RANGE_108_CM 1 0. 0. 11. DISPLAY_IDENTIFIER STATE_CP ECU_ADDRESS 0x7fb2e4 /end MEASUREMENT
/begin MEASUREMENT lv_cat_purge_act[0] "Status of catalyst purge activation" UBYTE _CNV_S_2_RANGE______11_CM 1 0. 0. 1. DISPLAY_IDENTIFIER LV_CAT_PURGE_ACT_0_ ECU_ADDRESS 0x7fb303 /end MEASUREMENT
/begin MEASUREMENT lv_cl_clc_avl "interface flag to cat.diag.: CL known" UBYTE _CNV_S_2_RANGE______11_CM 1 0. 0. 1. DISPLAY_IDENTIFIER LV_CL_CLC_AVL ECU_ADDRESS 0x7fb304 /end MEASUREMENT
/begin MEASUREMENT lv_err_igc "OR of the failure" UBYTE _CNV_S_2_RANGE______11_CM 1 0. 0. 1. DISPLAY_IDENTIFIER LV_ERR_IGC ECU_ADDRESS 0x7fb305 /end MEASUREMENT
/begin MEASUREMENT lv_scc[0] "Flag for single cylinder cut off, cylinder bank individual" UBYTE _CNV_S_2_RANGE______11_CM 1 0. 0. 1. DISPLAY_IDENTIFIER LV_SCC_0_ ECU_ADDRESS 0x7fb306 /end MEASUREMENT
/begin MEASUREMENT lv_cat_ldc[0] "status limited dynamic" UBYTE _CNV_S_2_RANGE______11_CM 1 0. 0. 1. DISPLAY_IDENTIFIER LV_CAT_LDC_0_ ECU_ADDRESS 0x7fb307 /end MEASUREMENT
/begin MEASUREMENT lv_lamb_ohp[0] "flag indicating enrichment for overheating prevention" UBYTE _CNV_S_2_RANGE______11_CM 1 0. 0. 1. DISPLAY_IDENTIFIER LV_LAMB_OHP_0_ ECU_ADDRESS 0x7fb308 /end MEASUREMENT
/begin MEASUREMENT fac_lam_mv[0] "Secondary air system diagnosis: application incidence to inhibit the diagnosis" SWORD _CNV_A_R_LINEAR_____99_CM 1 0. -50. 49.9984741210938 DISPLAY_IDENTIFIER FAC_LAM_MV_0_ ECU_ADDRESS 0x7f970a BYTE_ORDER MSB_LAST FORMAT "%5.3" /end MEASUREMENT
/begin MEASUREMENT vls_dif_lam_adj[0] "difference between set point and actual downstream LS signal" SWORD _CNV_A_R_LINEAR_____109_CM 1 0. -5.00000000000182 4.99511718999747 DISPLAY_IDENTIFIER VLS_DIF_LAM_ADJ_0_ ECU_ADDRESS 0x7f970c BYTE_ORDER MSB_LAST FORMAT "%4.3" /end MEASUREMENT
/begin MEASUREMENT lv_fac_lam_lim_max[0] "upper limit of lambda controller output reached" UBYTE _CNV_S_2_RANGE______11_CM 1 0. 0. 1. DISPLAY_IDENTIFIER LV_FAC_LAM_LIM_MAX_0_ ECU_ADDRESS 0x7fb309 /end MEASUREMENT
/begin MEASUREMENT lv_fac_lam_lim_min[0] "lower limit of lambda controller output reached" UBYTE _CNV_S_2_RANGE______11_CM 1 0. 0. 1. DISPLAY_IDENTIFIER LV_FAC_LAM_LIM_MIN_0_ ECU_ADDRESS 0x7fb30a /end MEASUREMENT
/begin MEASUREMENT lv_lamb_pls_act[0] "Activation state variable for the forced stimulation" UBYTE _CNV_S_2_RANGE______11_CM 1 0. 0. 1. DISPLAY_IDENTIFIER LV_LAMB_PLS_ACT_0_ ECU_ADDRESS 0x7fb30b /end MEASUREMENT
/begin MEASUREMENT lv_ldc_lam_adj[0] "limited dynamic conditions for trim control" UBYTE _CNV_S_2_RANGE______11_CM 1 0. 0. 1. DISPLAY_IDENTIFIER LV_LDC_LAM_ADJ_0_ ECU_ADDRESS 0x7fb30c /end MEASUREMENT
/begin MEASUREMENT lv_mff_cst_fup_act "Logical variable indicating that the fuel pressure threshold is exceeded once;" UBYTE _CNV_S_2_RANGE______11_CM 1 0. 0. 1. DISPLAY_IDENTIFIER LV_MFF_CST_FUP_ACT ECU_ADDRESS 0x7fb30d /end MEASUREMENT
/begin MEASUREMENT lv_err_mtc_dr "Logic variable (set if a MTC_DR error is present)" UBYTE _CNV_S_2_RANGE______11_CM 1 0. 0. 1. DISPLAY_IDENTIFIER LV_ERR_MTC_DR ECU_ADDRESS 0x7fb30e /end MEASUREMENT
/begin MEASUREMENT lv_n_lim_etc_lih "Logic variable (set if SAS is requested)" UBYTE _CNV_S_2_RANGE______11_CM 1 0. 0. 1. DISPLAY_IDENTIFIER LV_N_LIM_ETC_LIH ECU_ADDRESS 0x7fb781 /end MEASUREMENT
/begin MEASUREMENT lv_n_lim_tps_ad "Safety PUC" UBYTE _CNV_S_2_RANGE______11_CM 1 0. 0. 1. DISPLAY_IDENTIFIER LV_N_LIM_TPS_AD ECU_ADDRESS 0x7fb30f /end MEASUREMENT
/begin MEASUREMENT lv_map_puc_lim_act_lsl_gain_ad "Logical variable is set if MAP limitation is activated" UBYTE _CNV_S_2_RANGE______11_CM 1 0. 0. 1. DISPLAY_IDENTIFIER LV_MAP_PUC_LIM_ACT_LSL_GAIN_AD ECU_ADDRESS 0x7fb310 /end MEASUREMENT
/begin MEASUREMENT lv_sawup "Secondary air injection time correction active" UBYTE _CNV_S_2_RANGE______11_CM 1 0. 0. 1. DISPLAY_IDENTIFIER LV_SAWUP ECU_ADDRESS 0x7fb311 /end MEASUREMENT
/begin MEASUREMENT maf_hb "same as MAF but with a lower resolution (HB means High Byte)" UBYTE _CNV_A_R_LINEAR_____110_CM 1 0. 0. 1389. DISPLAY_IDENTIFIER MAF_HB ECU_ADDRESS 0x7fb2e5 FORMAT "%4.0" /end MEASUREMENT
/begin MEASUREMENT sp_lamb_de "amplitude of the forced lambda stimulation" UBYTE _CNV_A_R_LINEAR_____111_CM 1 0. 0. 0.124023437 DISPLAY_IDENTIFIER SP_LAMB_DE ECU_ADDRESS 0x7fb2e6 FORMAT "%5.4" /end MEASUREMENT
/begin MEASUREMENT saf_kgh "Actual value of secondary air mass flow" UWORD _CNV_A_R_LINEAR_____112_CM 1 0. 0. 1023.984375 DISPLAY_IDENTIFIER SAF_KGH ECU_ADDRESS 0x7f970e BYTE_ORDER MSB_LAST FORMAT "%6.2" /end MEASUREMENT
/begin MEASUREMENT t_per_lamb_de "period time of the forced lambda stimulation" UWORD _CNV_A_R_LINEAR_____113_CM 1 0. 0. 655.35 DISPLAY_IDENTIFIER T_PER_LAMB_DE ECU_ADDRESS 0x7f9710 BYTE_ORDER MSB_LAST FORMAT "%5.2" /end MEASUREMENT
/begin MEASUREMENT lv_err_maf "MAF sensor error detected" UBYTE _CNV_S_2_RANGE______11_CM 1 0. 0. 1. DISPLAY_IDENTIFIER LV_ERR_MAF ECU_ADDRESS 0x7fb312 /end MEASUREMENT
/begin MEASUREMENT t_teg_min_thd "Timer for save dewpoint exeedance" UWORD _CNV_A_R_LINEAR_____59_CM 1 0. 0. 655.35 DISPLAY_IDENTIFIER T_TEG_MIN_THD ECU_ADDRESS 0x7fa51c BYTE_ORDER MSB_LAST FORMAT "%5.2" /end MEASUREMENT
/begin CHARACTERISTIC c_t_max_teg_min_thd "Time delay for save dewpoint exeedance" VALUE 0x848686 _REC_VAL_20_u2 655.35 _CNV_A_R_LINEAR_____59_CM 0. 655.35 DISPLAY_IDENTIFIER C_T_MAX_TEG_MIN_THD FORMAT "%5.2" /end CHARACTERISTIC
/begin CHARACTERISTIC c_temp_min_teg_min_thd "Min temp for save dewpoint exeedance" VALUE 0x8486e0 _REC_VAL_20_u1 255. _CNV_A_R_LINEAR_____18_CM -50. 205. DISPLAY_IDENTIFIER C_TEMP_MIN_TEG_MIN_THD FORMAT "%3.0" /end CHARACTERISTIC
/begin MEASUREMENT tqi_st_add "additive start torque" SWORD _CNV_A_R_LINEAR_____62_CM 1 0. -1024. 1023.96875 DISPLAY_IDENTIFIER TQI_ST_ADD ECU_ADDRESS 0x7f9c16 BYTE_ORDER MSB_LAST FORMAT "%6.2" /end MEASUREMENT
/begin MEASUREMENT lv_req_is_ctl "request idle speed control active" UBYTE _CNV_S_2_RANGE______11_CM 1 0. 0. 1. DISPLAY_IDENTIFIER LV_REQ_IS_CTL ECU_ADDRESS 0x7fb63e /end MEASUREMENT
/begin MEASUREMENT t_ais_req "timer after idle speed request" UWORD _CNV_A_R_LINEAR_____19_CM 1 0. 0. 6553.5 DISPLAY_IDENTIFIER T_AIS_REQ ECU_ADDRESS 0x7f9c1e BYTE_ORDER MSB_LAST FORMAT "%5.1" /end MEASUREMENT
/begin CHARACTERISTIC ip_n_is_add_tco "AIS_CTL: additive engine speed for activation idle speed standing car" CURVE 0x8554cc _REC_CUR_20_u2_u1 6375. _CNV_A_R_LINEAR_____5_CM 0. 6375. DISPLAY_IDENTIFIER IP_N_IS_ADD_TCO FORMAT "%4.0"
 /begin AXIS_DESCR COM_AXIS tco _CNV_A_R_LINEAR_____18_CM 8 -50. 205. FORMAT "%3.0" AXIS_PTS_REF ldp_tco_ip_n_is_add /end AXIS_DESCR
/end CHARACTERISTIC
/begin AXIS_PTS ldp_tco_ip_n_is_add "additive engine speed for activation idle speed standing car" 0x842816 tco _REC_AXS_20_u1 255. _CNV_A_R_LINEAR_____18_CM 8 -50. 205. FORMAT "%3.0" /end AXIS_PTS
/begin CHARACTERISTIC id_n_add_dri "AIS_CTL: additive engine speed for activation idle speed running car" CURVE 0x848da4 _REC_CUR_20_u2_u1 6375. _CNV_A_R_LINEAR_____5_CM 0. 6375. DISPLAY_IDENTIFIER ID_N_ADD_DRI FORMAT "%4.0"
 /begin AXIS_DESCR COM_AXIS dri _CNV_A_R_LINEAR_____0_CM 7 0. 6. FORMAT "%1.0" AXIS_PTS_REF ldpm_dri_id_isc /end AXIS_DESCR
/end CHARACTERISTIC
/begin MEASUREMENT lv_tqi_is_min "additive torque start active" UBYTE _CNV_S_2_RANGE______11_CM 1 0. 0. 1. DISPLAY_IDENTIFIER LV_TQI_IS_MIN ECU_ADDRESS 0x7fb63f /end MEASUREMENT
/begin MEASUREMENT lv_tqi_is_max "additive torque start active" UBYTE _CNV_S_2_RANGE______11_CM 1 0. 0. 1. DISPLAY_IDENTIFIER LV_TQI_IS_MAX ECU_ADDRESS 0x7fb640 /end MEASUREMENT
/begin CHARACTERISTIC c_tqi_is_max "additive torque idle speed controller if air conditioning switched on" VALUE 0x85c1d2 _REC_VAL_20_s2 2047.96875 _CNV_A_R_LINEAR_____62_CM -1024. 1023.96875 DISPLAY_IDENTIFIER C_TQI_IS_MAX FORMAT "%6.2" /end CHARACTERISTIC
/begin CHARACTERISTIC c_tqi_is_min "additive torque idle speed controller if air conditioning switched on" VALUE 0x85c1d4 _REC_VAL_20_s2 2047.96875 _CNV_A_R_LINEAR_____62_CM -1024. 1023.96875 DISPLAY_IDENTIFIER C_TQI_IS_MIN FORMAT "%6.2" /end CHARACTERISTIC
/begin MEASUREMENT tqi_is_min "torque idle speed controller" SWORD _CNV_A_R_LINEAR_____62_CM 1 0. -1024. 1023.96875 DISPLAY_IDENTIFIER TQI_IS_MIN ECU_ADDRESS 0x7f9c28 BYTE_ORDER MSB_LAST FORMAT "%6.2" /end MEASUREMENT
/begin MEASUREMENT tqi_is_max "torque idle speed controller" SWORD _CNV_A_R_LINEAR_____62_CM 1 0. -1024. 1023.96875 DISPLAY_IDENTIFIER TQI_IS_MAX ECU_ADDRESS 0x7f9c26 BYTE_ORDER MSB_LAST FORMAT "%6.2" /end MEASUREMENT
/begin AXIS_PTS ldpm_dri_id_isc "" 0x843454 dri _REC_AXS_20_u1 6. _CNV_A_R_LINEAR_____0_CM 7 0. 6. FORMAT "%1.0" /end AXIS_PTS
/begin AXIS_PTS ldpm_n_32_1_ensd "" 0x840fd1 n_32 _REC_AXS_20_u1 8160. _CNV_A_R_LINEAR_____84_CM 16 0. 8160. FORMAT "%4.0" /end AXIS_PTS
/begin AXIS_PTS ldpm_n_32_2_ensd "" 0x840fe2 n_32 _REC_AXS_20_u1 8160. _CNV_A_R_LINEAR_____84_CM 6 0. 8160. FORMAT "%4.0" /end AXIS_PTS
/begin MEASUREMENT lv_err_cam_tot "Failure of at least one camshaft sensor on a camshaft with IVVT actuator" UBYTE _CNV_S_2_RANGE__0___88_CM 1 0. 0. 1. DISPLAY_IDENTIFIER LV_ERR_CAM_TOT ECU_ADDRESS 0x7fb861 BIT_MASK 0x1 /end MEASUREMENT
/begin MEASUREMENT lv_err_crk "Crankshaft sensor failure" UBYTE _CNV_S_2_RANGE__0___88_CM 1 0. 0. 1. DISPLAY_IDENTIFIER LV_ERR_CRK ECU_ADDRESS 0x7fb854 BIT_MASK 0x1 /end MEASUREMENT
/begin MEASUREMENT lv_inh_diag_crk_syn "Inhibition of crankshaft sensor synchronization diagnosis" UBYTE _CNV_S_2_RANGE__0___88_CM 1 0. 0. 1. DISPLAY_IDENTIFIER LV_INH_DIAG_CRK_SYN ECU_ADDRESS 0x7fb865 BIT_MASK 0x1 /end MEASUREMENT
/begin MEASUREMENT lv_inh_diag_crk_tooth "Inhibition of crankshaft sensor tooth number diagnosis" UBYTE _CNV_S_2_RANGE__0___88_CM 1 0. 0. 1. DISPLAY_IDENTIFIER LV_INH_DIAG_CRK_TOOTH ECU_ADDRESS 0x7fb866 BIT_MASK 0x1 /end MEASUREMENT
/begin MEASUREMENT lv_inh_diag_crk_tooth_per "Inhibition of crankshaft sensor tooth peirod diagnosis" UBYTE _CNV_S_2_RANGE__0___88_CM 1 0. 0. 1. DISPLAY_IDENTIFIER LV_INH_DIAG_CRK_TOOTH_PER ECU_ADDRESS 0x7fb867 BIT_MASK 0x1 /end MEASUREMENT
/begin MEASUREMENT lv_inh_diag_crk_plaus "Inhibition of crankshaft sensor plausibility diagnosis" UBYTE _CNV_S_2_RANGE__0___88_CM 1 0. 0. 1. DISPLAY_IDENTIFIER LV_INH_DIAG_CRK_PLAUS ECU_ADDRESS 0x7fb864 BIT_MASK 0x1 /end MEASUREMENT
/begin MEASUREMENT lv_inh_diag_crk_oc "Inhibition of crankshaft sensor circuit diagnosis" UBYTE _CNV_S_2_RANGE__0___88_CM 1 0. 0. 1. DISPLAY_IDENTIFIER LV_INH_DIAG_CRK_OC ECU_ADDRESS 0x7fb863 BIT_MASK 0x1 /end MEASUREMENT
/begin MEASUREMENT lv_inh_diag_ensd "Inhibition of cam/crk diagnosis during fail safe delay" UBYTE _CNV_S_2_RANGE__0___88_CM 1 0. 0. 1. DISPLAY_IDENTIFIER LV_INH_DIAG_ENSD ECU_ADDRESS 0x7fb868 BIT_MASK 0x1 /end MEASUREMENT
/begin CHARACTERISTIC c_n_not_rest "Engine speed threshold for cam/crk diagnosis deactivation" VALUE 0x84100b _REC_VAL_20_u1 8160. _CNV_A_R_LINEAR_____84_CM 0. 8160. DISPLAY_IDENTIFIER C_N_NOT_REST FORMAT "%4.0" /end CHARACTERISTIC
/begin CHARACTERISTIC c_t_dly_rest_igk "Delay time for diagnosis reactivation after key-off at low engine speed" VALUE 0x841018 _REC_VAL_20_u1 2.55 _CNV_A_R_LINEAR_____223_CM 0. 2.55 DISPLAY_IDENTIFIER C_T_DLY_REST_IGK FORMAT "%4.2" /end CHARACTERISTIC
/begin CHARACTERISTIC c_t_dly_rest_stall "Delay time for diagnosis reactivation after engine stalling" VALUE 0x841019 _REC_VAL_20_u1 2.55 _CNV_A_R_LINEAR_____223_CM 0. 2.55 DISPLAY_IDENTIFIER C_T_DLY_REST_STALL FORMAT "%4.2" /end CHARACTERISTIC
/begin MEASUREMENT idx_diag_mng_in[0].lv_err_cam "Failure of intake camshaft sensor 1" UBYTE _CNV_S_2_RANGE__0___88_CM 1 0. 0. 1. DISPLAY_IDENTIFIER LV_ERR_CAM_IN_1 ECU_ADDRESS 0x7fb878 BIT_MASK 0x1 /end MEASUREMENT
/begin MEASUREMENT idx_diag_mng_in[0].lv_inh_diag_syn_cam "Inhibition of intake camshaft 1 synchronization diagnosis" UBYTE _CNV_S_2_RANGE__0___88_CM 1 0. 0. 1. DISPLAY_IDENTIFIER LV_INH_DIAG_SYN_CAM_IN_1 ECU_ADDRESS 0x7fb879 BIT_MASK 0x1 /end MEASUREMENT
/begin MEASUREMENT idx_diag_mng_in[0].lv_inh_diag_per_cam "Inhibition of intake camshaft 1 period diagnosis" UBYTE _CNV_S_2_RANGE__0___88_CM 1 0. 0. 1. DISPLAY_IDENTIFIER LV_INH_DIAG_PER_CAM_IN_1 ECU_ADDRESS 0x7fb87a BIT_MASK 0x1 /end MEASUREMENT
/begin MEASUREMENT idx_diag_mng_in[0].lv_inh_diag_plaus_cam "Inhibition of intake camshaft 1 plausibility diagnosis" UBYTE _CNV_S_2_RANGE__0___88_CM 1 0. 0. 1. DISPLAY_IDENTIFIER LV_INH_DIAG_PLAUS_CAM_IN_1 ECU_ADDRESS 0x7fb87b BIT_MASK 0x1 /end MEASUREMENT
/begin MEASUREMENT idx_diag_mng_in[0].lv_inh_diag_ref_crk_cam "Inhibition of intake camshaft 1 position diagnosis" UBYTE _CNV_S_2_RANGE__0___88_CM 1 0. 0. 1. DISPLAY_IDENTIFIER LV_INH_DIAG_REF_CRK_CAM_IN_1 ECU_ADDRESS 0x7fb87c BIT_MASK 0x1 /end MEASUREMENT
/begin MEASUREMENT lv_stop_eng "Boolean information for engine stopped" UBYTE _CNV_S_2_RANGE__0___88_CM 1 0. 0. 1. DISPLAY_IDENTIFIER LV_STOP_ENG ECU_ADDRESS 0x7fb870 BIT_MASK 0x1 /end MEASUREMENT
/begin MEASUREMENT lv_run_eng "Boolean information for engine running detection" UBYTE _CNV_S_2_RANGE__0___88_CM 1 0. 0. 1. DISPLAY_IDENTIFIER LV_RUN_ENG ECU_ADDRESS 0x7fb86e BIT_MASK 0x1 /end MEASUREMENT
/begin MEASUREMENT lv_syn_eng "Boolean information for engine synchronization completed" UBYTE _CNV_S_2_RANGE__0___88_CM 1 0. 0. 1. DISPLAY_IDENTIFIER LV_SYN_ENG ECU_ADDRESS 0x7fb871 BIT_MASK 0x1 /end MEASUREMENT
/begin MEASUREMENT lv_syn_vld "Boolean information for engine synchronization validated" UBYTE _CNV_S_2_RANGE__0___88_CM 1 0. 0. 1. DISPLAY_IDENTIFIER LV_SYN_VLD ECU_ADDRESS 0x7fb855 BIT_MASK 0x1 /end MEASUREMENT
/begin MEASUREMENT lv_lih_err_crk "Boolean information for limp home mode with crankshaft sensor failure" UBYTE _CNV_S_2_RANGE__0___88_CM 1 0. 0. 1. DISPLAY_IDENTIFIER LV_LIH_ERR_CRK ECU_ADDRESS 0x7fb86a BIT_MASK 0x1 /end MEASUREMENT
/begin MEASUREMENT lv_lih_err_cam "Camshaft limp-home mode (failure on all camshaft sensors)" UBYTE _CNV_S_2_RANGE__0___88_CM 1 0. 0. 1. DISPLAY_IDENTIFIER LV_LIH_ERR_CAM ECU_ADDRESS 0x7fbca0 BIT_MASK 0x1 /end MEASUREMENT
/begin MEASUREMENT lv_act_crk "Crankshaft acquisition active" UBYTE _CNV_S_2_RANGE__0___88_CM 1 0. 0. 1. DISPLAY_IDENTIFIER LV_ACT_CRK ECU_ADDRESS 0x7fb85b BIT_MASK 0x1 /end MEASUREMENT
/begin MEASUREMENT lv_err_cam "Failure on all camshaft sensor signals in normal mode" UBYTE _CNV_S_2_RANGE__0___88_CM 1 0. 0. 1. DISPLAY_IDENTIFIER LV_ERR_CAM ECU_ADDRESS 0x7fb856 BIT_MASK 0x1 /end MEASUREMENT
/begin MEASUREMENT lv_err_lih_crk_cam "No more camshaft sensor available for crankshaft limp-home mode" UBYTE _CNV_S_2_RANGE__0___88_CM 1 0. 0. 1. DISPLAY_IDENTIFIER LV_ERR_LIH_CRK_CAM ECU_ADDRESS 0x7fbc9f BIT_MASK 0x1 /end MEASUREMENT
/begin MEASUREMENT ctr_vld_cam_syn_crk "Counter for validation of camshaft signal for crankshaft synchronization" UBYTE _CNV_A_R_LINEAR_____1_CM 1 0. 0. 255. DISPLAY_IDENTIFIER CTR_VLD_CAM_SYN_CRK ECU_ADDRESS 0x7fbc9d FORMAT "%3.0" /end MEASUREMENT
/begin CHARACTERISTIC lc_inh_lih_crk "Inhibition of crankshaft limp-home mode" VALUE 0x841023 _REC_VAL_20_u1 1. _CNV_A_R_LINEAR_____1_CM 0. 1. DISPLAY_IDENTIFIER LC_INH_LIH_CRK FORMAT "%1.0" /end CHARACTERISTIC
/begin CHARACTERISTIC lc_inh_lih_cam "Inhibition of camshaft limp-home mode" VALUE 0x841022 _REC_VAL_20_u1 1. _CNV_A_R_LINEAR_____1_CM 0. 1. DISPLAY_IDENTIFIER LC_INH_LIH_CAM FORMAT "%1.0" /end CHARACTERISTIC
/begin CHARACTERISTIC c_nr_vld_cam_syn_crk "Number of camshaft signal edges to validate cam/crk synchronization" VALUE 0x841010 _REC_VAL_20_u1 255. _CNV_A_R_LINEAR_____1_CM 0. 255. DISPLAY_IDENTIFIER C_NR_VLD_CAM_SYN_CRK FORMAT "%3.0" /end CHARACTERISTIC
/begin MEASUREMENT lv_first_vld_tooth "Boolean information for detection of first tooth after engine stop" UBYTE _CNV_S_2_RANGE__0___88_CM 1 0. 0. 1. DISPLAY_IDENTIFIER LV_FIRST_VLD_TOOTH ECU_ADDRESS 0x7fb862 BIT_MASK 0x1 /end MEASUREMENT
/begin MEASUREMENT lv_timeout_cam_syn_crk "Boolean information for time-out detection on the camshaft selected for the CRK/CAM synchronization" UBYTE _CNV_S_2_RANGE__0___88_CM 1 0. 0. 1. DISPLAY_IDENTIFIER LV_TIMEOUT_CAM_SYN_CRK ECU_ADDRESS 0x7fb873 BIT_MASK 0x1 /end MEASUREMENT
/begin MEASUREMENT idx_n_ctl_in[0].lv_act_cam "self synchronization activated on intake camshaft 1" UBYTE _CNV_S_2_RANGE__0___88_CM 1 0. 0. 1. DISPLAY_IDENTIFIER LV_ACT_CAM_IN_1 ECU_ADDRESS 0x7fb87d BIT_MASK 0x1 /end MEASUREMENT
/begin MEASUREMENT idx_n_ctl_in[0].lv_act_lih_crk_cam "crankshaft limp home operating mode activated on intake camshaft 1" UBYTE _CNV_S_2_RANGE__0___88_CM 1 0. 0. 1. DISPLAY_IDENTIFIER LV_ACT_LIH_CRK_CAM_IN_1 ECU_ADDRESS 0x7fb87e BIT_MASK 0x1 /end MEASUREMENT
/begin MEASUREMENT idx_n_ctl_in[0].lv_act_syn_crk_cam "crankshaft synchronization operating mode activated on intake camshaft 1" UBYTE _CNV_S_2_RANGE__0___88_CM 1 0. 0. 1. DISPLAY_IDENTIFIER LV_ACT_SYN_CRK_CAM_IN_1 ECU_ADDRESS 0x7fb87f BIT_MASK 0x1 /end MEASUREMENT
/begin MEASUREMENT n_mmv "Engine speed- moving mean value" UWORD _CNV_A_R_LINEAR_____257_CM 1 0. 0. 8160. DISPLAY_IDENTIFIER N_MMV ECU_ADDRESS 0x7fa2a8 BYTE_ORDER MSB_LAST FORMAT "%4.0" /end MEASUREMENT
/begin MEASUREMENT n_grd "Engine speed gradient" SBYTE _CNV_A_R_LINEAR_____271_CM 1 0. -4096. 4064. DISPLAY_IDENTIFIER N_GRD ECU_ADDRESS 0x7fb874 FORMAT "%5.0" /end MEASUREMENT
/begin MEASUREMENT n_grd_h_res "High resolution engine speed gradient" SWORD _CNV_A_R_ENSD_LINEA_272_CM 1 0. -4096. 4095. DISPLAY_IDENTIFIER N_GRD_H_RES ECU_ADDRESS 0x7fa2a6 BYTE_ORDER MSB_LAST FORMAT "%6.2" /end MEASUREMENT
/begin MEASUREMENT seg_ctr "Continuous segment counter (saturated at maximum value)" UWORD _CNV_A_R_LINEAR_____1_CM 1 0. 0. 65535. DISPLAY_IDENTIFIER SEG_CTR ECU_ADDRESS 0x7fa2b8 BYTE_ORDER MSB_LAST FORMAT "%5.0" /end MEASUREMENT
/begin MEASUREMENT psn_eng_syn_min "Minimum engine position during crankshaft synchronization phase" UWORD _CNV_A_R_LINEAR_____273_CM 1 0. 0. 719.625 DISPLAY_IDENTIFIER PSN_ENG_SYN_MIN ECU_ADDRESS 0x7fa2b6 BYTE_ORDER MSB_LAST FORMAT "%8.3" /end MEASUREMENT
/begin MEASUREMENT psn_eng_syn_max "Maximum engine position during crankshaft synchronization phase" UWORD _CNV_A_R_LINEAR_____273_CM 1 0. 0. 719.625 DISPLAY_IDENTIFIER PSN_ENG_SYN_MAX ECU_ADDRESS 0x7fa2b4 BYTE_ORDER MSB_LAST FORMAT "%8.3" /end MEASUREMENT
/begin CHARACTERISTIC id_crk_pha_cor "Table for crankshaft transmitter phase offset correction" CURVE 0x840fe9 _REC_CUR_20_u1_u1 15.9375 _CNV_A_R_ENSD_LINEA_274_CM 0. 15.9375 DISPLAY_IDENTIFIER ID_CRK_PHA_COR FORMAT "%7.4"
 /begin AXIS_DESCR COM_AXIS n_32 _CNV_A_R_LINEAR_____84_CM 16 0. 8160. FORMAT "%4.0" AXIS_PTS_REF ldp_n_32_id_crk_pha_cor /end AXIS_DESCR
/end CHARACTERISTIC
/begin AXIS_PTS ldp_n_32_id_crk_pha_cor "" 0x840fc0 n_32 _REC_AXS_20_u1 8160. _CNV_A_R_LINEAR_____84_CM 16 0. 8160. FORMAT "%4.0" /end AXIS_PTS
/begin MEASUREMENT n_32 "Engine speed- resolution 32rpm" UBYTE _CNV_A_R_LINEAR_____84_CM 1 0. 0. 8160. DISPLAY_IDENTIFIER N_32 ECU_ADDRESS 0x7fb853 FORMAT "%4.0" /end MEASUREMENT
/begin MEASUREMENT n_tooth "Engine speed calculated on last crankshaft tooth period (update rate 10ms)" UWORD _CNV_A_R_LINEAR_____257_CM 1 0. 0. 8160. DISPLAY_IDENTIFIER N_TOOTH ECU_ADDRESS 0x7fa2aa BYTE_ORDER MSB_LAST FORMAT "%4.0" /end MEASUREMENT
/begin MEASUREMENT t_seg_half_av "Half-segment period" UWORD _CNV_A_R_LINEAR_____275_CM 1 0. 0. 0.26214 DISPLAY_IDENTIFIER T_SEG_HALF_AV ECU_ADDRESS 0x7fa2be BYTE_ORDER MSB_LAST FORMAT "%8.6" /end MEASUREMENT
/begin MEASUREMENT t_crk_win "Crankshaft tooth window at end of segment" UWORD _CNV_A_R_LINEAR_____275_CM 1 0. 0. 0.26214 DISPLAY_IDENTIFIER T_CRK_WIN ECU_ADDRESS 0x7fa2ba BYTE_ORDER MSB_LAST FORMAT "%8.6" /end MEASUREMENT
/begin MEASUREMENT seg_nr "Actual segment number (from 0 to NC_CYL_NR-1)" UBYTE _CNV_A_R_LINEAR_____1_CM 1 0. 0. 7. DISPLAY_IDENTIFIER SEG_NR ECU_ADDRESS 0x7fb875 FORMAT "%3.0" /end MEASUREMENT
/begin MEASUREMENT n "Engine speed- resolution 1rpm" UWORD _CNV_A_R_LINEAR_____257_CM 1 0. 0. 8160. DISPLAY_IDENTIFIER N ECU_ADDRESS 0x7fa2a2 BYTE_ORDER MSB_LAST FORMAT "%4.0" /end MEASUREMENT
/begin MEASUREMENT n_fast "Fast engine speed- resolution 1rpm" UWORD _CNV_A_R_LINEAR_____257_CM 1 0. 0. 8160. DISPLAY_IDENTIFIER N_FAST ECU_ADDRESS 0x7fa2a4 BYTE_ORDER MSB_LAST FORMAT "%4.0" /end MEASUREMENT
/begin CHARACTERISTIC c_n_tooth_end "Engine speed threshold for N_TOOTH calculation (engine start)" VALUE 0x84100c _REC_VAL_20_u1 8160. _CNV_A_R_LINEAR_____84_CM 0. 8160. DISPLAY_IDENTIFIER C_N_TOOTH_END FORMAT "%4.0" /end CHARACTERISTIC
/begin CHARACTERISTIC c_n_fast_swi "Switch case choice for N_FAST calculation mode" VALUE 0x84100a _REC_VAL_20_u1 4. _CNV_A_R_LINEAR_____1_CM 0. 4. DISPLAY_IDENTIFIER C_N_FAST_SWI FORMAT "%3.0" /end CHARACTERISTIC
/begin CHARACTERISTIC c_fac_n_fast "Factor for fast speed prediction" VALUE 0x841008 _REC_VAL_20_u1 0.99609375 _CNV_A_R_LINEAR_____248_CM 0. 0.99609375 DISPLAY_IDENTIFIER C_FAC_N_FAST FORMAT "%5.3" /end CHARACTERISTIC
/begin MEASUREMENT t_seg_av "Exported segment period" UWORD _CNV_A_R_LINEAR_____275_CM 1 0. 0. 0.26214 DISPLAY_IDENTIFIER T_SEG_AV ECU_ADDRESS 0x7fa2bc BYTE_ORDER MSB_LAST FORMAT "%8.6" /end MEASUREMENT
/begin MEASUREMENT id_seg_nr[0] "Segment number array" UBYTE _CNV_A_R_LINEAR_____1_CM 1 0. 0. 255. DISPLAY_IDENTIFIER id_seg_nr_0 ECU_ADDRESS 0x7fb857 FORMAT "%3.0" /end MEASUREMENT
/begin MEASUREMENT id_seg_nr[1] "Segment number array" UBYTE _CNV_A_R_LINEAR_____1_CM 1 0. 0. 255. DISPLAY_IDENTIFIER id_seg_nr_1 ECU_ADDRESS 0x7fb858 FORMAT "%3.0" /end MEASUREMENT
/begin MEASUREMENT id_seg_nr[2] "Segment number array" UBYTE _CNV_A_R_LINEAR_____1_CM 1 0. 0. 255. DISPLAY_IDENTIFIER id_seg_nr_2 ECU_ADDRESS 0x7fb859 FORMAT "%3.0" /end MEASUREMENT
/begin MEASUREMENT id_seg_nr[3] "Segment number array" UBYTE _CNV_A_R_LINEAR_____1_CM 1 0. 0. 255. DISPLAY_IDENTIFIER id_seg_nr_3 ECU_ADDRESS 0x7fb85a FORMAT "%3.0" /end MEASUREMENT
/begin MEASUREMENT lv_orng_tooth_per_crk "Invalid crankshaft tooth period" UBYTE _CNV_S_2_RANGE__0___88_CM 1 0. 0. 1. DISPLAY_IDENTIFIER LV_ORNG_TOOTH_PER_CRK ECU_ADDRESS 0x7fb86d BIT_MASK 0x1 /end MEASUREMENT
/begin MEASUREMENT lv_orng_nr_tooth_crk "Crankshaft tooth count incorrect at reference gap" UBYTE _CNV_S_2_RANGE__0___88_CM 1 0. 0. 1. DISPLAY_IDENTIFIER LV_ORNG_NR_TOOTH_CRK ECU_ADDRESS 0x7fb86c BIT_MASK 0x1 /end MEASUREMENT
/begin MEASUREMENT lv_lost_syn_crk "Crankshaft synchronization lost" UBYTE _CNV_S_2_RANGE__0___88_CM 1 0. 0. 1. DISPLAY_IDENTIFIER LV_LOST_SYN_CRK ECU_ADDRESS 0x7fb86b BIT_MASK 0x1 /end MEASUREMENT
/begin MEASUREMENT lv_crk_syn "Flag for crankshaft acquisition synchronized" UBYTE _CNV_S_2_RANGE__0___88_CM 1 0. 0. 1. DISPLAY_IDENTIFIER LV_CRK_SYN ECU_ADDRESS 0x7fb860 BIT_MASK 0x1 /end MEASUREMENT
/begin CHARACTERISTIC c_t_crk_dly "Sensing delay time after first active crankshaft signal edge" VALUE 0x841014 _REC_VAL_20_u4 3.9999946e-002 _CNV_A_R_ENSD_LINEA_276_CM 0. 3.9999946e-002 DISPLAY_IDENTIFIER C_T_CRK_DLY FORMAT "%8.6" /end CHARACTERISTIC
/begin CHARACTERISTIC id_fac_tol_crk_tooth "Factor for calculation of expected tooth period" CURVE 0x840ff9 _REC_CUR_20_u1_u1 0.9375 _CNV_A_R_LINEAR_____245_CM 0. 0.9375 DISPLAY_IDENTIFIER ID_FAC_TOL_CRK_TOOTH FORMAT "%6.4"
 /begin AXIS_DESCR COM_AXIS n_32 _CNV_A_R_LINEAR_____84_CM 6 0. 8160. FORMAT "%4.0" AXIS_PTS_REF ldpm_n_32_2_ensd /end AXIS_DESCR
/end CHARACTERISTIC
/begin MEASUREMENT t_crk_win_ensd "Crankshaft tooth window at end of segment" ULONG _CNV_A_R_LINEAR_____277_CM 1 0. 0. 1.9965 DISPLAY_IDENTIFIER T_CRK_WIN_ENSD ECU_ADDRESS 0x7f8784 BYTE_ORDER MSB_LAST FORMAT "%8.6" /end MEASUREMENT
/begin MEASUREMENT t_seg_er "Crankshaft segment period for misfire detection (ER algorithm)" ULONG _CNV_A_R_LINEAR_____277_CM 1 0. 0. 1.9965 DISPLAY_IDENTIFIER T_SEG_ER ECU_ADDRESS 0x7f8790 BYTE_ORDER MSB_LAST FORMAT "%8.6" /end MEASUREMENT
/begin CHARACTERISTIC c_grd_ad_max_cam_in "Max permissible drift of reference edge position for continuous adaptation" VALUE 0x841044 _REC_VAL_20_u1 15.9375 _CNV_A_R_ENSD_LINEA_274_CM 0. 15.9375 DISPLAY_IDENTIFIER C_GRD_AD_MAX_CAM_IN FORMAT "%7.4" /end CHARACTERISTIC
/begin CHARACTERISTIC c_grd_ad_ref_max_cam_in "Max permissible drift of reference edge position for reference position adaptation" VALUE 0x841045 _REC_VAL_20_u1 15.9375 _CNV_A_R_ENSD_LINEA_274_CM 0. 15.9375 DISPLAY_IDENTIFIER C_GRD_AD_REF_MAX_CAM_IN FORMAT "%7.4" /end CHARACTERISTIC
/begin CHARACTERISTIC c_crlc_ad_cam_in "Averaging constant for continuous adaptation" VALUE 0x84103b _REC_VAL_20_u1 0.99609375 _CNV_A_R_LINEAR_____248_CM 0. 0.99609375 DISPLAY_IDENTIFIER C_CRLC_AD_CAM_IN FORMAT "%5.3" /end CHARACTERISTIC
/begin CHARACTERISTIC c_crlc_ad_ref_cam_in "Averaging constant for reference position adaptation" VALUE 0x84103c _REC_VAL_20_u1 0.99609375 _CNV_A_R_LINEAR_____248_CM 0. 0.99609375 DISPLAY_IDENTIFIER C_CRLC_AD_REF_CAM_IN FORMAT "%5.3" /end CHARACTERISTIC
/begin CHARACTERISTIC c_nr_rev_ad_ref_cam_in "Number of camshaft revolutions for reference position adaptation" VALUE 0x841047 _REC_VAL_20_u1 255. _CNV_A_R_LINEAR_____1_CM 0. 255. DISPLAY_IDENTIFIER C_NR_REV_AD_REF_CAM_IN FORMAT "%3.0" /end CHARACTERISTIC
/begin MEASUREMENT idx_cam_ad_in[0].psn_ad_cam "adapted intake camshaft position relative to designed passive position" UBYTE _CNV_A_R_LINEAR_____278_CM 1 0. -48. 47.625 DISPLAY_IDENTIFIER PSN_AD_CAM_IN_1 ECU_ADDRESS 0x7f876e FORMAT "%7.3" /end MEASUREMENT
/begin MEASUREMENT idx_cam_ad_in[0].ctr_rev_ad_ref_cam "Intake camshaft reference position adaptation revolution counter" UBYTE _CNV_A_R_LINEAR_____1_CM 1 0. 0. 255. DISPLAY_IDENTIFIER CTR_REV_AD_REF_CAM_IN_1 ECU_ADDRESS 0x7f876f FORMAT "%3.0" /end MEASUREMENT
/begin MEASUREMENT idx_cam_ad_in[0].psn_cam "Actual intake camshaft position relative to adapted passive position" UWORD _CNV_A_R_LINEAR_____279_CM 1 0. -96. 95.625 DISPLAY_IDENTIFIER PSN_CAM_IN_1 ECU_ADDRESS 0x7f876c BYTE_ORDER MSB_LAST FORMAT "%7.3" /end MEASUREMENT
/begin MEASUREMENT idx_cam_ad_in[0].psn_dif_edge_cam "crankshaft angle between the previous and the current intake camshaft position determination" UWORD _CNV_A_R_LINEAR_____273_CM 1 0. 0. 1535.625 DISPLAY_IDENTIFIER PSN_DIF_EDGE_CAM_IN_1 ECU_ADDRESS 0x7f8760 BYTE_ORDER MSB_LAST FORMAT "%8.3" /end MEASUREMENT
/begin MEASUREMENT idx_cam_ad_in[0].psn_edge_cam_old "" UWORD _CNV_A_R_ENSD_LINEA_280_CM 1 0. -128. 127.9375 DISPLAY_IDENTIFIER psn_edge_cam_old_in_1 ECU_ADDRESS 0x7f8762 BYTE_ORDER MSB_LAST FORMAT "%9.4" /end MEASUREMENT
/begin MEASUREMENT idx_cam_ad_in[0].ptr_psn_edge_cam "" UWORD _CNV_A_R_LINEAR_____0_CM 1 0. 0. 65535. DISPLAY_IDENTIFIER IDX_CAM_AD_IN_0__PTR_PSN_EDGE_CA ECU_ADDRESS 0x7f8764 BYTE_ORDER MSB_LAST /end MEASUREMENT
/begin MEASUREMENT idx_cam_ad_in[0].ptr_psn_edge_ad_cam "" UWORD _CNV_A_R_LINEAR_____0_CM 1 0. 0. 65535. DISPLAY_IDENTIFIER IDX_CAM_AD_IN_0__PTR_PSN_EDGE_AD ECU_ADDRESS 0x7f8768 BYTE_ORDER MSB_LAST /end MEASUREMENT
/begin MEASUREMENT idx_cam_ad_in[0].t_dif_edge_cam "Time between the previous and current camshaft signal edge" ULONG _CNV_A_R_LINEAR_____275_CM 1 0. 0. 17179.86918 DISPLAY_IDENTIFIER T_DIF_EDGE_CAM_IN_1 ECU_ADDRESS 0x7f875c BYTE_ORDER MSB_LAST FORMAT "%12.6" /end MEASUREMENT
/begin MEASUREMENT idx_cam_ad_in[0].lv_ad_end_cam "Intake camshaft reference position adaptation successful" UBYTE _CNV_S_2_RANGE__0___88_CM 1 0. 0. 1. DISPLAY_IDENTIFIER LV_AD_END_CAM_IN_1 ECU_ADDRESS 0x7f8770 BIT_MASK 0x1 /end MEASUREMENT
/begin MEASUREMENT idx_psn_edge_ad_cam_in_1[0] "" UWORD _CNV_A_R_LINEAR_____0_CM 1 0. 0. 65535. DISPLAY_IDENTIFIER IDX_PSN_EDGE_AD_CAM_IN_1_0_ ECU_ADDRESS 0x7fa2c0 BYTE_ORDER MSB_LAST /end MEASUREMENT
/begin MEASUREMENT idx_psn_edge_ad_cam_in_1[1] "" UWORD _CNV_A_R_LINEAR_____0_CM 1 0. 0. 65535. DISPLAY_IDENTIFIER IDX_PSN_EDGE_AD_CAM_IN_1_1_ ECU_ADDRESS 0x7fa2c2 BYTE_ORDER MSB_LAST /end MEASUREMENT
/begin MEASUREMENT idx_psn_edge_ad_cam_in_1[2] "" UWORD _CNV_A_R_LINEAR_____0_CM 1 0. 0. 65535. DISPLAY_IDENTIFIER IDX_PSN_EDGE_AD_CAM_IN_1_2_ ECU_ADDRESS 0x7fa2c4 BYTE_ORDER MSB_LAST /end MEASUREMENT
/begin MEASUREMENT idx_psn_edge_ad_cam_in_1[3] "" UWORD _CNV_A_R_LINEAR_____0_CM 1 0. 0. 65535. DISPLAY_IDENTIFIER IDX_PSN_EDGE_AD_CAM_IN_1_3_ ECU_ADDRESS 0x7fa2c6 BYTE_ORDER MSB_LAST /end MEASUREMENT
/begin MEASUREMENT idx_psn_edge_ad_cam_in_1[4] "" UWORD _CNV_A_R_LINEAR_____0_CM 1 0. 0. 65535. DISPLAY_IDENTIFIER IDX_PSN_EDGE_AD_CAM_IN_1_4_ ECU_ADDRESS 0x7fa2c8 BYTE_ORDER MSB_LAST /end MEASUREMENT
/begin MEASUREMENT idx_psn_edge_ad_cam_in_1[5] "" UWORD _CNV_A_R_LINEAR_____0_CM 1 0. 0. 65535. DISPLAY_IDENTIFIER IDX_PSN_EDGE_AD_CAM_IN_1_5_ ECU_ADDRESS 0x7fa2ca BYTE_ORDER MSB_LAST /end MEASUREMENT
/begin MEASUREMENT idx_psn_edge_ad_cam_in_1[6] "" UWORD _CNV_A_R_LINEAR_____0_CM 1 0. 0. 65535. DISPLAY_IDENTIFIER IDX_PSN_EDGE_AD_CAM_IN_1_6_ ECU_ADDRESS 0x7fa2cc BYTE_ORDER MSB_LAST /end MEASUREMENT
/begin MEASUREMENT idx_psn_edge_ad_cam_in_1[7] "" UWORD _CNV_A_R_LINEAR_____0_CM 1 0. 0. 65535. DISPLAY_IDENTIFIER IDX_PSN_EDGE_AD_CAM_IN_1_7_ ECU_ADDRESS 0x7fa2ce BYTE_ORDER MSB_LAST /end MEASUREMENT
/begin MEASUREMENT idx_psn_edge_ad_cam_in_1[8] "" UWORD _CNV_A_R_LINEAR_____0_CM 1 0. 0. 65535. DISPLAY_IDENTIFIER IDX_PSN_EDGE_AD_CAM_IN_1_8_ ECU_ADDRESS 0x7fa2d0 BYTE_ORDER MSB_LAST /end MEASUREMENT
/begin MEASUREMENT idx_psn_edge_ad_cam_in_1[9] "" UWORD _CNV_A_R_LINEAR_____0_CM 1 0. 0. 65535. DISPLAY_IDENTIFIER IDX_PSN_EDGE_AD_CAM_IN_1_9_ ECU_ADDRESS 0x7fa2d2 BYTE_ORDER MSB_LAST /end MEASUREMENT
/begin MEASUREMENT idx_psn_edge_cam_in_1[0] "" UWORD _CNV_A_R_LINEAR_____0_CM 1 0. 0. 65535. DISPLAY_IDENTIFIER IDX_PSN_EDGE_CAM_IN_1_0_ ECU_ADDRESS 0x7fa2d4 BYTE_ORDER MSB_LAST /end MEASUREMENT
/begin MEASUREMENT idx_psn_edge_cam_in_1[1] "" UWORD _CNV_A_R_LINEAR_____0_CM 1 0. 0. 65535. DISPLAY_IDENTIFIER IDX_PSN_EDGE_CAM_IN_1_1_ ECU_ADDRESS 0x7fa2d6 BYTE_ORDER MSB_LAST /end MEASUREMENT
/begin MEASUREMENT idx_psn_edge_cam_in_1[2] "" UWORD _CNV_A_R_LINEAR_____0_CM 1 0. 0. 65535. DISPLAY_IDENTIFIER IDX_PSN_EDGE_CAM_IN_1_2_ ECU_ADDRESS 0x7fa2d8 BYTE_ORDER MSB_LAST /end MEASUREMENT
/begin MEASUREMENT idx_psn_edge_cam_in_1[3] "" UWORD _CNV_A_R_LINEAR_____0_CM 1 0. 0. 65535. DISPLAY_IDENTIFIER IDX_PSN_EDGE_CAM_IN_1_3_ ECU_ADDRESS 0x7fa2da BYTE_ORDER MSB_LAST /end MEASUREMENT
/begin MEASUREMENT idx_psn_edge_cam_in_1[4] "" UWORD _CNV_A_R_LINEAR_____0_CM 1 0. 0. 65535. DISPLAY_IDENTIFIER IDX_PSN_EDGE_CAM_IN_1_4_ ECU_ADDRESS 0x7fa2dc BYTE_ORDER MSB_LAST /end MEASUREMENT
/begin MEASUREMENT idx_psn_edge_cam_in_1[5] "" UWORD _CNV_A_R_LINEAR_____0_CM 1 0. 0. 65535. DISPLAY_IDENTIFIER IDX_PSN_EDGE_CAM_IN_1_5_ ECU_ADDRESS 0x7fa2de BYTE_ORDER MSB_LAST /end MEASUREMENT
/begin MEASUREMENT idx_psn_edge_cam_in_1[6] "" UWORD _CNV_A_R_LINEAR_____0_CM 1 0. 0. 65535. DISPLAY_IDENTIFIER IDX_PSN_EDGE_CAM_IN_1_6_ ECU_ADDRESS 0x7fa2e0 BYTE_ORDER MSB_LAST /end MEASUREMENT
/begin MEASUREMENT idx_psn_edge_cam_in_1[7] "" UWORD _CNV_A_R_LINEAR_____0_CM 1 0. 0. 65535. DISPLAY_IDENTIFIER IDX_PSN_EDGE_CAM_IN_1_7_ ECU_ADDRESS 0x7fa2e2 BYTE_ORDER MSB_LAST /end MEASUREMENT
/begin MEASUREMENT idx_psn_edge_cam_in_1[8] "" UWORD _CNV_A_R_LINEAR_____0_CM 1 0. 0. 65535. DISPLAY_IDENTIFIER IDX_PSN_EDGE_CAM_IN_1_8_ ECU_ADDRESS 0x7fa2e4 BYTE_ORDER MSB_LAST /end MEASUREMENT
/begin MEASUREMENT idx_psn_edge_cam_in_1[9] "" UWORD _CNV_A_R_LINEAR_____0_CM 1 0. 0. 65535. DISPLAY_IDENTIFIER IDX_PSN_EDGE_CAM_IN_1_9_ ECU_ADDRESS 0x7fa2e6 BYTE_ORDER MSB_LAST /end MEASUREMENT
/begin MEASUREMENT lv_err_ref_crk_cam_in_1 "Present intake camshaft 1 failure reference violation" UBYTE _CNV_S_2_RANGE__0___88_CM 1 0. 0. 1. DISPLAY_IDENTIFIER LV_ERR_REF_CRK_CAM_IN_1 ECU_ADDRESS 0x7fb563 BIT_MASK 0x1 /end MEASUREMENT
/begin CHARACTERISTIC c_abc_inc_diag_ref_crk_cam_in "Anti-bounce counter increment for intake camshaft position diagnosis" VALUE 0x841036 _REC_VAL_20_u1 255. _CNV_A_R_LINEAR_____1_CM 0. 255. DISPLAY_IDENTIFIER C_ABC_INC_DIAG_REF_CRK_CAM_IN FORMAT "%3.0" /end CHARACTERISTIC
/begin CHARACTERISTIC c_abc_max_diag_ref_crk_cam_in "Anti-bounce counter maximum for intake camshaft position diagnosis" VALUE 0x841039 _REC_VAL_20_u1 254. _CNV_A_R_LINEAR_____1_CM 1. 255. DISPLAY_IDENTIFIER C_ABC_MAX_DIAG_REF_CRK_CAM_IN FORMAT "%3.0" /end CHARACTERISTIC
/begin CHARACTERISTIC c_tol_ref_crk_cam_in "Reference position tolerance range for intake camshaft" VALUE 0x841048 _REC_VAL_20_u2 31.9375 _CNV_A_R_ENSD_LINEA_274_CM 0. 31.9375 DISPLAY_IDENTIFIER C_TOL_REF_CRK_CAM_IN FORMAT "%7.4" /end CHARACTERISTIC
/begin CHARACTERISTIC c_abc_inc_diag_per_cam_in "Anti-bounce counter increment for intake camshaft segment period diagnosis" VALUE 0x841035 _REC_VAL_20_u1 255. _CNV_A_R_LINEAR_____1_CM 0. 255. DISPLAY_IDENTIFIER C_ABC_INC_DIAG_PER_CAM_IN FORMAT "%3.0" /end CHARACTERISTIC
/begin CHARACTERISTIC c_abc_max_diag_per_cam_in "Anti-bounce counter maximum for intake camshaft segment period diagnosis" VALUE 0x841038 _REC_VAL_20_u1 254. _CNV_A_R_LINEAR_____1_CM 1. 255. DISPLAY_IDENTIFIER C_ABC_MAX_DIAG_PER_CAM_IN FORMAT "%3.0" /end CHARACTERISTIC
/begin CHARACTERISTIC c_abc_inc_diag_syn_cam_in "Anti-bounce counter increment for intake camshaft synchronization diagnosis" VALUE 0x841037 _REC_VAL_20_u1 255. _CNV_A_R_LINEAR_____1_CM 0. 255. DISPLAY_IDENTIFIER C_ABC_INC_DIAG_SYN_CAM_IN FORMAT "%3.0" /end CHARACTERISTIC
/begin CHARACTERISTIC c_abc_max_diag_syn_cam_in "Anti-bounce counter maximum for intake camshaft synchronization diagnosis" VALUE 0x84103a _REC_VAL_20_u1 254. _CNV_A_R_LINEAR_____1_CM 1. 255. DISPLAY_IDENTIFIER C_ABC_MAX_DIAG_SYN_CAM_IN FORMAT "%3.0" /end CHARACTERISTIC
/begin MEASUREMENT lv_err_per_cam_in_1 "Present failure camshaft period too short" UBYTE _CNV_S_2_RANGE__0___88_CM 1 0. 0. 1. DISPLAY_IDENTIFIER LV_ERR_PER_CAM_IN_1 ECU_ADDRESS 0x7fb561 BIT_MASK 0x1 /end MEASUREMENT
/begin MEASUREMENT lv_err_syn_cam_in_1 "Present intake camshaft sensor failure" UBYTE _CNV_S_2_RANGE__0___88_CM 1 0. 0. 1. DISPLAY_IDENTIFIER LV_ERR_SYN_CAM_IN_1 ECU_ADDRESS 0x7fb562 BIT_MASK 0x1 /end MEASUREMENT
/begin MEASUREMENT lv_inh_mis_crk "Inhibition of misfire detection with crankshaft tooth number error" UBYTE _CNV_S_2_RANGE__0___88_CM 1 0. 0. 1. DISPLAY_IDENTIFIER LV_INH_MIS_CRK ECU_ADDRESS 0x7fb869 BIT_MASK 0x1 /end MEASUREMENT
/begin MEASUREMENT lv_err_crk_tooth "Present crankshaft failure tooth number error" UBYTE _CNV_S_2_RANGE__0___88_CM 1 0. 0. 1. DISPLAY_IDENTIFIER LV_ERR_CRK_TOOTH ECU_ADDRESS 0x7fb564 BIT_MASK 0x1 /end MEASUREMENT
/begin MEASUREMENT lv_err_crk_tooth_per "Present crankshaft failure tooth number error" UBYTE _CNV_S_2_RANGE__0___88_CM 1 0. 0. 1. DISPLAY_IDENTIFIER LV_ERR_CRK_TOOTH_PER ECU_ADDRESS 0x7fb565 BIT_MASK 0x1 /end MEASUREMENT
/begin MEASUREMENT lv_err_crk_syn "Present crankshaft failure with loss of synchronization" UBYTE _CNV_S_2_RANGE__0___88_CM 1 0. 0. 1. DISPLAY_IDENTIFIER LV_ERR_CRK_SYN ECU_ADDRESS 0x7fb566 BIT_MASK 0x1 /end MEASUREMENT
/begin CHARACTERISTIC c_abc_inc_diag_crk_tooth_per "Anti-bounce counter increment for crankshaft  tooth period diagnosis" VALUE 0x841002 _REC_VAL_20_u1 255. _CNV_A_R_LINEAR_____1_CM 0. 255. DISPLAY_IDENTIFIER C_ABC_INC_DIAG_CRK_TOOTH_PER FORMAT "%3.0" /end CHARACTERISTIC
/begin CHARACTERISTIC c_abc_inc_diag_crk_tooth "Anti-bounce counter increment for crankshaft tooth number diagnosis" VALUE 0x841001 _REC_VAL_20_u1 255. _CNV_A_R_LINEAR_____1_CM 0. 255. DISPLAY_IDENTIFIER C_ABC_INC_DIAG_CRK_TOOTH FORMAT "%3.0" /end CHARACTERISTIC
/begin CHARACTERISTIC c_abc_inc_diag_crk_syn "Anti-bounce counter increment for crankshaft sensor diagnosis with loss of synchronization" VALUE 0x841000 _REC_VAL_20_u1 255. _CNV_A_R_LINEAR_____1_CM 0. 255. DISPLAY_IDENTIFIER C_ABC_INC_DIAG_CRK_SYN FORMAT "%3.0" /end CHARACTERISTIC
/begin CHARACTERISTIC c_abc_max_diag_crk_tooth "Anti-bounce counter maximum for crankshaft tooth number diagnosis" VALUE 0x841005 _REC_VAL_20_u1 254. _CNV_A_R_LINEAR_____1_CM 1. 255. DISPLAY_IDENTIFIER C_ABC_MAX_DIAG_CRK_TOOTH FORMAT "%3.0" /end CHARACTERISTIC
/begin CHARACTERISTIC c_abc_max_diag_crk_tooth_per "Anti-bounce counter maximum for crankshaft tooth period diagnosis " VALUE 0x841006 _REC_VAL_20_u1 254. _CNV_A_R_LINEAR_____1_CM 1. 255. DISPLAY_IDENTIFIER C_ABC_MAX_DIAG_CRK_TOOTH_PER FORMAT "%3.0" /end CHARACTERISTIC
/begin CHARACTERISTIC c_abc_max_diag_crk_syn "Anti-bounce counter maximum for crankshaft sensor diagnosis with loss of synchronization" VALUE 0x841004 _REC_VAL_20_u1 254. _CNV_A_R_LINEAR_____1_CM 1. 255. DISPLAY_IDENTIFIER C_ABC_MAX_DIAG_CRK_SYN FORMAT "%3.0" /end CHARACTERISTIC
/begin MEASUREMENT lv_err_crk_plaus "Present crankshaft failure synchronization impossible" UBYTE _CNV_S_2_RANGE__0___88_CM 1 0. 0. 1. DISPLAY_IDENTIFIER LV_ERR_CRK_PLAUS ECU_ADDRESS 0x7fb567 BIT_MASK 0x1 /end MEASUREMENT
/begin MEASUREMENT lv_err_plaus_cam_in_1 "Present camshaft failure synchronization impossible" UBYTE _CNV_S_2_RANGE__0___88_CM 1 0. 0. 1. DISPLAY_IDENTIFIER LV_ERR_PLAUS_CAM_IN_1 ECU_ADDRESS 0x7fb568 BIT_MASK 0x1 /end MEASUREMENT
/begin MEASUREMENT ctr_cyc_eng_plaus_cam_in_1 "Engine cycle counter for camshaft signal plausibility diagnosis" UBYTE _CNV_A_R_LINEAR_____1_CM 1 0. 0. 255. DISPLAY_IDENTIFIER CTR_CYC_ENG_PLAUS_CAM_IN_1 ECU_ADDRESS 0x7fb880 FORMAT "%3.0" /end MEASUREMENT
/begin MEASUREMENT lv_err_syn_crk_cam_in_1 "Present intake camshaft failure for crankshaft synchronization" UBYTE _CNV_S_2_RANGE__0___88_CM 1 0. 0. 1. DISPLAY_IDENTIFIER LV_ERR_SYN_CRK_CAM_IN_1 ECU_ADDRESS 0x7fb569 BIT_MASK 0x1 /end MEASUREMENT
/begin MEASUREMENT ctr_orng_cam_syn_crk "failure counter to detect camshaft error for crankshaft synchronization" UBYTE _CNV_A_R_LINEAR_____1_CM 1 0. 0. 255. DISPLAY_IDENTIFIER CTR_ORNG_CAM_SYN_CRK ECU_ADDRESS 0x7fbc9c FORMAT "%3.0" /end MEASUREMENT
/begin CHARACTERISTIC c_nr_edge_cam_ex_syn_crk_max "Number of exhaust camshaft signal edges to detect crankshaft plausibility error before synchronization" VALUE 0x84100e _REC_VAL_20_u1 254. _CNV_A_R_LINEAR_____1_CM 1. 255. DISPLAY_IDENTIFIER C_NR_EDGE_CAM_EX_SYN_CRK_MAX FORMAT "%3.0" /end CHARACTERISTIC
/begin CHARACTERISTIC c_nr_edge_cam_in_syn_crk_max "Number of intake camshaft signal edges to detect crankshaft plausibility error before synchronization" VALUE 0x84100f _REC_VAL_20_u1 254. _CNV_A_R_LINEAR_____1_CM 1. 255. DISPLAY_IDENTIFIER C_NR_EDGE_CAM_IN_SYN_CRK_MAX FORMAT "%3.0" /end CHARACTERISTIC
/begin CHARACTERISTIC c_nr_cyc_eng_plaus_cam_max "Number of engine cycles to detect camshaft plausibility error" VALUE 0x84100d _REC_VAL_20_u1 254. _CNV_A_R_LINEAR_____1_CM 1. 255. DISPLAY_IDENTIFIER C_NR_CYC_ENG_PLAUS_CAM_MAX FORMAT "%3.0" /end CHARACTERISTIC
/begin CHARACTERISTIC c_ctr_orng_cam_syn_crk_max "Failure counter to detect camshaft error for crankshaft synchronization" VALUE 0x841007 _REC_VAL_20_u1 254. _CNV_A_R_LINEAR_____1_CM 1. 255. DISPLAY_IDENTIFIER C_CTR_ORNG_CAM_SYN_CRK_MAX FORMAT "%3.0" /end CHARACTERISTIC
/begin CHARACTERISTIC lc_cam_swi_conf "linked with NC_NR_CONF_CAM ; possibility to switch between two cam configurations" VALUE 0x841021 _REC_VAL_20_u1 1. _CNV_A_R_LINEAR_____1_CM 0. 1. DISPLAY_IDENTIFIER LC_CAM_SWI_CONF FORMAT "%1.0" /end CHARACTERISTIC
/begin MEASUREMENT lv_cam_syn_crk "Camshaft acquisition ready for crankshaft synchronization" UBYTE _CNV_S_2_RANGE__0___88_CM 1 0. 0. 1. DISPLAY_IDENTIFIER LV_CAM_SYN_CRK ECU_ADDRESS 0x7fbc9e BIT_MASK 0x1 /end MEASUREMENT
/begin MEASUREMENT idx_cam_acq_in[0].idx_edge_cam "Index of the last camshaft signal edge" UBYTE _CNV_A_R_LINEAR_____281_CM 1 0. 1. 16. DISPLAY_IDENTIFIER IDX_EDGE_CAM_IN_1 ECU_ADDRESS 0x7f879c FORMAT "%3.0" /end MEASUREMENT
/begin MEASUREMENT idx_cam_acq_in[0].ctr_edge_cam "Continuous camshaft signal edge counter" UBYTE _CNV_A_R_LINEAR_____1_CM 1 0. 0. 255. DISPLAY_IDENTIFIER CTR_EDGE_CAM_IN_1 ECU_ADDRESS 0x7f879d FORMAT "%3.0" /end MEASUREMENT
/begin MEASUREMENT idx_cam_acq_in[0].lv_vld_psn_cam "Intake camshaft position measurement valid" UBYTE _CNV_S_2_RANGE__0___88_CM 1 0. 0. 1. DISPLAY_IDENTIFIER LV_VLD_PSN_CAM_IN_1 ECU_ADDRESS 0x7f879e BIT_MASK 0x1 /end MEASUREMENT
/begin MEASUREMENT idx_cam_acq_in[0].lv_syn_cam "intake camshaft synchronized" UBYTE _CNV_S_2_RANGE__0___88_CM 1 0. 0. 1. DISPLAY_IDENTIFIER LV_SYN_CAM_IN_1 ECU_ADDRESS 0x7f879f BIT_MASK 0x1 /end MEASUREMENT
/begin MEASUREMENT idx_cam_acq_in[0].lv_orng_per_cam "intake camshaft segment period out of range" UBYTE _CNV_S_2_RANGE__0___88_CM 1 0. 0. 1. DISPLAY_IDENTIFIER LV_ORNG_PER_CAM_IN_1 ECU_ADDRESS 0x7f87a0 BIT_MASK 0x1 /end MEASUREMENT
/begin MEASUREMENT idx_cam_acq_in[0].lv_orng_ratio_cam "Intake camshaft segment ratio out of range" UBYTE _CNV_S_2_RANGE__0___88_CM 1 0. 0. 1. DISPLAY_IDENTIFIER LV_ORNG_RATIO_CAM_IN_1 ECU_ADDRESS 0x7f87a1 BIT_MASK 0x1 /end MEASUREMENT
/begin MEASUREMENT idx_cam_acq_in[0].psn_eng_cam "" UWORD _CNV_A_R_ENSD_LINEA_274_CM 1 0. 0. 719.9375 DISPLAY_IDENTIFIER PSN_ENG_CAM_IN_1 ECU_ADDRESS 0x7f87a2 BYTE_ORDER MSB_LAST FORMAT "%8.4" /end MEASUREMENT
/begin MEASUREMENT idx_cam_acq_in[0].t_seg_cam "Camshaft segment period" ULONG _CNV_A_R_LINEAR_____277_CM 1 0. 0. 1.9965 DISPLAY_IDENTIFIER T_SEG_CAM_IN_1 ECU_ADDRESS 0x7f87a4 BYTE_ORDER MSB_LAST FORMAT "%8.6" /end MEASUREMENT
/begin CHARACTERISTIC id_fac_cam_in "Period ratio tolerance factor for intake camshaft" CURVE 0x841025 _REC_CUR_20_u1_u1 14.9375 _CNV_A_R_LINEAR_____245_CM 1. 15.9375 DISPLAY_IDENTIFIER ID_FAC_CAM_IN FORMAT "%7.4"
 /begin AXIS_DESCR COM_AXIS n_32 _CNV_A_R_LINEAR_____84_CM 16 0. 8160. FORMAT "%4.0" AXIS_PTS_REF ldpm_n_32_1_ensd /end AXIS_DESCR
/end CHARACTERISTIC
/begin CHARACTERISTIC c_dyw_cam_crk_syn_rtd_in "Tolerance window retard for intake camshaft to crankshaft reference in crankshaft synchronization mode" VALUE 0x841040 _REC_VAL_20_u2 127.9375 _CNV_A_R_ENSD_LINEA_274_CM 0. 127.9375 DISPLAY_IDENTIFIER C_DYW_CAM_CRK_SYN_RTD_IN FORMAT "%8.4" /end CHARACTERISTIC
/begin CHARACTERISTIC c_dyw_cam_syn_in "Tolerance window for angle between intake camshaft signal edges in crankshaft synchronization mode" VALUE 0x841042 _REC_VAL_20_u2 31.9375 _CNV_A_R_ENSD_LINEA_274_CM 0. 31.9375 DISPLAY_IDENTIFIER C_DYW_CAM_SYN_IN FORMAT "%7.4" /end CHARACTERISTIC
/begin CHARACTERISTIC c_nr_edge_min_vld_cam_in "Number of intake camshaft signal edges for valid position output" VALUE 0x841046 _REC_VAL_20_u1 255. _CNV_A_R_LINEAR_____1_CM 0. 255. DISPLAY_IDENTIFIER C_NR_EDGE_MIN_VLD_CAM_IN FORMAT "%3.0" /end CHARACTERISTIC
/begin CHARACTERISTIC c_crk_ang_dly "Crankshaft angle threshold after start of cranking to reduce the possible engine position range for pre-injection" VALUE 0x84104a _REC_VAL_20_u2 719.9375 _CNV_A_R_ENSD_LINEA_274_CM 0. 719.9375 DISPLAY_IDENTIFIER C_CRK_ANG_DLY FORMAT "%8.4" /end CHARACTERISTIC
/begin CHARACTERISTIC c_psn_max_ofs "Offset angle on maximum engine position for pre-injection when crankshaft threshold is reached" VALUE 0x84104c _REC_VAL_20_u2 719.9375 _CNV_A_R_ENSD_LINEA_274_CM 0. 719.9375 DISPLAY_IDENTIFIER C_PSN_MAX_OFS FORMAT "%8.4" /end CHARACTERISTIC
/begin CHARACTERISTIC c_psn_min_ofs "Offset angle on maximum engine position for pre-injection when crankshaft threshold is reached" VALUE 0x84104e _REC_VAL_20_u2 719.9375 _CNV_A_R_ENSD_LINEA_274_CM 0. 719.9375 DISPLAY_IDENTIFIER C_PSN_MIN_OFS FORMAT "%8.4" /end CHARACTERISTIC
/begin CHARACTERISTIC c_dyw_cam_crk_syn_adc_in "Tolerance window advance for intake camshaft to crankshaft reference in crankshaft synchronization mode" VALUE 0x84103e _REC_VAL_20_u2 127.9375 _CNV_A_R_ENSD_LINEA_274_CM 0. 127.9375 DISPLAY_IDENTIFIER C_DYW_CAM_CRK_SYN_ADC_IN FORMAT "%8.4" /end CHARACTERISTIC
/begin CHARACTERISTIC c_abc_inc_diag_crk_oc "Anti-bounce counter increment for crankshaft sensor circuit diagnosis" VALUE 0x840fff _REC_VAL_20_u1 255. _CNV_A_R_LINEAR_____1_CM 0. 255. DISPLAY_IDENTIFIER C_ABC_INC_DIAG_CRK_OC FORMAT "%3.0" /end CHARACTERISTIC
/begin CHARACTERISTIC c_abc_max_diag_crk_oc "Anti-bounce counter maximum for crankshaft sensor circuit diagnosis" VALUE 0x841003 _REC_VAL_20_u1 254. _CNV_A_R_LINEAR_____1_CM 1. 255. DISPLAY_IDENTIFIER C_ABC_MAX_DIAG_CRK_OC FORMAT "%3.0" /end CHARACTERISTIC
/begin CHARACTERISTIC c_v_mcps_thd "Threshold for A/C amplitude voltage to detect failure" VALUE 0x84101a _REC_VAL_20_u2 4.9951171875 _CNV_A_R_LINEAR_____260_CM 0. 4.9951171875 DISPLAY_IDENTIFIER C_V_MCPS_THD FORMAT "%5.3" /end CHARACTERISTIC
/begin CHARACTERISTIC c_v_mcps_thd_min "Threshold minimum  bias node voltage to detect failure" VALUE 0x84101e _REC_VAL_20_u2 4.9951171875 _CNV_A_R_LINEAR_____260_CM 0. 4.9951171875 DISPLAY_IDENTIFIER C_V_MCPS_THD_MIN FORMAT "%5.3" /end CHARACTERISTIC
/begin CHARACTERISTIC c_v_mcps_thd_max "Threshold maximum bias node voltage to detect failure" VALUE 0x84101c _REC_VAL_20_u2 4.9951171875 _CNV_A_R_LINEAR_____260_CM 0. 4.9951171875 DISPLAY_IDENTIFIER C_V_MCPS_THD_MAX FORMAT "%5.3" /end CHARACTERISTIC
/begin CHARACTERISTIC c_mcps_sample_count "Number of samples per sample period" VALUE 0x841009 _REC_VAL_20_u1 255. _CNV_A_R_LINEAR_____1_CM 0. 255. DISPLAY_IDENTIFIER C_MCPS_SAMPLE_COUNT FORMAT "%3.0" /end CHARACTERISTIC
/begin CHARACTERISTIC lc_rst_v_mcps_diag_dif_max "Logical calibration for reset of V_MCPS_DIAG_DIF_MAX" VALUE 0x841024 _REC_VAL_20_u1 1. _CNV_A_R_LINEAR_____1_CM 0. 1. DISPLAY_IDENTIFIER LC_RST_V_MCPS_DIAG_DIF_MAX FORMAT "%1.0" /end CHARACTERISTIC
/begin MEASUREMENT lv_cam_lih_ext_ena "" UBYTE _CNV_S_2_RANGE__0___88_CM 1 0. 0. 1. DISPLAY_IDENTIFIER LV_CAM_LIH_EXT_ENA ECU_ADDRESS 0x7fb85c BIT_MASK 0x1 /end MEASUREMENT
/begin MEASUREMENT lv_seg_nr_upd_req "" UBYTE _CNV_S_2_RANGE__0___88_CM 1 0. 0. 1. DISPLAY_IDENTIFIER LV_SEG_NR_UPD_REQ ECU_ADDRESS 0x7fb86f BIT_MASK 0x1 /end MEASUREMENT
/begin MEASUREMENT lv_syn_vld_cam_lih "" UBYTE _CNV_S_2_RANGE__0___88_CM 1 0. 0. 1. DISPLAY_IDENTIFIER LV_SYN_VLD_CAM_LIH ECU_ADDRESS 0x7fb872 BIT_MASK 0x1 /end MEASUREMENT
/begin MEASUREMENT tco_cmn "coolant temperature ( ENSD internal )" UBYTE _CNV_A_R_ENSD_LINEA_282_CM 1 0. -50. 205. DISPLAY_IDENTIFIER TCO_CMN ECU_ADDRESS 0x7fb876 FORMAT "%3.0" /end MEASUREMENT
/begin MEASUREMENT vb_cmn "Battery voltage ( ENSD internal )" UBYTE _CNV_A_R_ENSD_LINEA_283_CM 1 0. 0. 28.8 DISPLAY_IDENTIFIER VB_CMN ECU_ADDRESS 0x7fb877 FORMAT "%5.3" /end MEASUREMENT
/begin CHARACTERISTIC c_rom_cks_cal_l "setpoint of ROM test process monitoring (low dword)" VALUE 0x841050 _REC_VAL_20_u4 4294967295. _CNV_A_R_LINEAR_____1_CM 0. 4294967295. DISPLAY_IDENTIFIER C_ROM_CKS_CAL_L FORMAT "%10.0" /end CHARACTERISTIC
/begin CHARACTERISTIC c_rom_cks_cal_h "setpoint of ROM test process monitoring (high dword)" VALUE 0x841054 _REC_VAL_20_u4 4294967295. _CNV_A_R_LINEAR_____1_CM 0. 4294967295. DISPLAY_IDENTIFIER C_ROM_CKS_CAL_H FORMAT "%10.0" /end CHARACTERISTIC
/begin CHARACTERISTIC lc_swi_rom_cks_cal "switch to set fault of the CAL data ROM test inactive" VALUE 0x841058 _REC_VAL_20_u1 255. _CNV_A_R_LINEAR_____1_CM 0. 255. DISPLAY_IDENTIFIER LC_SWI_ROM_CKS_CAL FORMAT "%3.0" /end CHARACTERISTIC
/begin MEASUREMENT rom_cks_cal_clc_l "actual value of CAL data ROM test of process monitoring (low dword)" ULONG _CNV_A_R_LINEAR_____1_CM 1 0. 0. 4294967295. DISPLAY_IDENTIFIER ROM_CKS_CAL_CLC_L ECU_ADDRESS 0x7f9448 BYTE_ORDER MSB_LAST FORMAT "%10.0" /end MEASUREMENT
/begin MEASUREMENT rom_cks_cal_clc_h "actual value of CAL data ROM test of process monitoring (high dword)" ULONG _CNV_A_R_LINEAR_____1_CM 1 0. 0. 4294967295. DISPLAY_IDENTIFIER ROM_CKS_CAL_CLC_H ECU_ADDRESS 0x7f944c BYTE_ORDER MSB_LAST FORMAT "%10.0" /end MEASUREMENT
/begin MEASUREMENT abc_mon2_mu "anti-bounce counter of level 2 test calculation, evaluated on MU, transmitted to MC" UBYTE _CNV_A_R_LINEAR_____1_CM 1 0. 0. 255. DISPLAY_IDENTIFIER ABC_MON2_MU ECU_ADDRESS 0x7fbd6b FORMAT "%3.0" /end MEASUREMENT
/begin MEASUREMENT test_rec_idx_mon2 "start value for the test record of Copy of Process Monitoring" UBYTE _CNV_A_R_LINEAR_____0_CM 1 0. 0. 63. DISPLAY_IDENTIFIER TEST_REC_IDX_MON2 ECU_ADDRESS 0x7fb8f3 FORMAT "%2.0" /end MEASUREMENT
/begin MEASUREMENT acq_mc_0_mon "AD-value of the MC, monitored with RAM test function" UWORD _CNV_A_R_LINEAR_____260_CM 1 0. 0. 4.9951171875 DISPLAY_IDENTIFIER ACQ_MC_0_MON ECU_ADDRESS 0x7fa4ac BYTE_ORDER MSB_LAST FORMAT "%5.3" /end MEASUREMENT
/begin MEASUREMENT acq_mu_0_mon "AD-value of the MU, monitored with RAM test function" UWORD _CNV_A_R_LINEAR_____260_CM 1 0. 0. 4.9951171875 DISPLAY_IDENTIFIER ACQ_MU_0_MON ECU_ADDRESS 0x7fa4b0 BYTE_ORDER MSB_LAST FORMAT "%5.3" /end MEASUREMENT
/begin MEASUREMENT sw_comp_nr_mc "software compatibility reference number of MC, sent to MU in the first communication" UBYTE _CNV_A_R_LINEAR_____1_CM 1 0. 0. 255. DISPLAY_IDENTIFIER SW_COMP_NR_MC ECU_ADDRESS 0x7fbd77 FORMAT "%3.0" /end MEASUREMENT
/begin MEASUREMENT sw_vers_mu[0] "software version label of MU" UBYTE _CNV_A_R_LINEAR_____1_CM 1 0. 0. 255. DISPLAY_IDENTIFIER SW_VERS_MU_0_ ECU_ADDRESS 0x7fbd75 FORMAT "%3.0" /end MEASUREMENT
/begin MEASUREMENT sw_vers_mu[1] "software version label of MU" UBYTE _CNV_A_R_LINEAR_____1_CM 1 0. 0. 255. DISPLAY_IDENTIFIER SW_VERS_MU_1_ ECU_ADDRESS 0x7fbd76 FORMAT "%3.0" /end MEASUREMENT
/begin MEASUREMENT mu_pin_conf "pin configuration of the variant conding of the MU" UBYTE _CNV_A_R_LINEAR_____1_CM 1 0. 0. 255. DISPLAY_IDENTIFIER MU_PIN_CONF ECU_ADDRESS 0x7fbd78 FORMAT "%3.0" /end MEASUREMENT
/begin MEASUREMENT lv_rom_crc_ready "indicates that the ROM test has been finished since last power up if set" UBYTE _CNV_S_2_RANGE__0___88_CM 1 0. 0. 1. DISPLAY_IDENTIFIER LV_ROM_CRC_READY ECU_ADDRESS 0x7f8618 BIT_MASK 0x1 /end MEASUREMENT
/begin MEASUREMENT lv_dr_off_mu_mon "request for wrong answers of the instruction set test to the monitoring unit in order to disable MTC and IV" UBYTE _CNV_S_2_RANGE__0___88_CM 1 0. 0. 1. DISPLAY_IDENTIFIER LV_DR_OFF_MU_MON ECU_ADDRESS 0x7fb8de BIT_MASK 0x1 /end MEASUREMENT
/begin MEASUREMENT lv_err_mc "final request for disabled power stages by processor monitoring on MC" UBYTE _CNV_S_2_RANGE__0___88_CM 1 0. 0. 1. DISPLAY_IDENTIFIER LV_ERR_MC ECU_ADDRESS 0x7fb8e3 BIT_MASK 0x1 /end MEASUREMENT
/begin MEASUREMENT lv_err_mu "request of MU to disable the power stages permanently, sent to MC in DISABLE communication" UBYTE _CNV_S_2_RANGE__0___88_CM 1 0. 0. 1. DISPLAY_IDENTIFIER LV_ERR_MU ECU_ADDRESS 0x7fb8e5 BIT_MASK 0x1 /end MEASUREMENT
/begin MEASUREMENT lv_err_tmp_mc "temporary request for disabled power stages by processor monitoring on MC" UBYTE _CNV_S_2_RANGE__0___88_CM 1 0. 0. 1. DISPLAY_IDENTIFIER LV_ERR_TMP_MC ECU_ADDRESS 0x7fb8e4 BIT_MASK 0x1 /end MEASUREMENT
/begin MEASUREMENT lv_err_tmp_mu "request of MU to disable the power stages temporarily, sent to MC" UBYTE _CNV_S_2_RANGE__0___88_CM 1 0. 0. 1. DISPLAY_IDENTIFIER LV_ERR_TMP_MU ECU_ADDRESS 0x7fb8e6 BIT_MASK 0x1 /end MEASUREMENT
/begin MEASUREMENT lv_err_tmp_mu_mc "reversible diabled power stages by processor monitoring (MC and/or MU)" UBYTE _CNV_S_2_RANGE__0___88_CM 1 0. 0. 1. DISPLAY_IDENTIFIER LV_ERR_TMP_MU_MC ECU_ADDRESS 0x7fb8e2 BIT_MASK 0x1 /end MEASUREMENT
/begin MEASUREMENT lv_err_mu_mc "Irreversible diabled power stages by processor monitoring (MC and/or MU)" UBYTE _CNV_S_2_RANGE__0___88_CM 1 0. 0. 1. DISPLAY_IDENTIFIER LV_ERR_MU_MC ECU_ADDRESS 0x7fb8e1 BIT_MASK 0x1 /end MEASUREMENT
/begin MEASUREMENT err_cod_mc "error code which represents a failure detected by MC" UBYTE _CNV_S_14_TMO3_ERR_C_351_CM 1 0. 0. 13. DISPLAY_IDENTIFIER ERR_COD_MC ECU_ADDRESS 0x7f861a /end MEASUREMENT
/begin MEASUREMENT err_cod_mu "error code which represents an error on MC detected by MC" UBYTE _CNV_S_21_TMO3_ERR_C_352_CM 1 0. 0. 20. DISPLAY_IDENTIFIER ERR_COD_MU ECU_ADDRESS 0x7fbd79 /end MEASUREMENT
/begin MEASUREMENT rst_ctr_mc "reset counter on MC" UBYTE _CNV_A_R_LINEAR_____1_CM 1 0. 0. 255. DISPLAY_IDENTIFIER RST_CTR_MC ECU_ADDRESS 0x7f8619 FORMAT "%3.0" /end MEASUREMENT
/begin MEASUREMENT rst_ctr_mu "reset counter on MU, transmitted to MC after reset" UBYTE _CNV_A_R_LINEAR_____1_CM 1 0. 0. 255. DISPLAY_IDENTIFIER RST_CTR_MU ECU_ADDRESS 0x7fbd60 FORMAT "%3.0" /end MEASUREMENT
/begin MEASUREMENT rst_ctr_mc_save "saved reset counter of main controller, value of RST_CTR_MC after first communication" UBYTE _CNV_A_R_LINEAR_____1_CM 1 0. 0. 255. DISPLAY_IDENTIFIER RST_CTR_MC_SAVE ECU_ADDRESS 0x7fb8db FORMAT "%3.0" /end MEASUREMENT
/begin MEASUREMENT rst_ctr_mu_save "saved reset counter of monitoring unit, value of RST_CTR_MU after first communication on main controller" UBYTE _CNV_A_R_LINEAR_____1_CM 1 0. 0. 255. DISPLAY_IDENTIFIER RST_CTR_MU_SAVE ECU_ADDRESS 0x7fb8dd FORMAT "%3.0" /end MEASUREMENT
/begin MEASUREMENT err_cod_mc_save "saved error code of main controller, value of ERR_COD_MC after first communication" UBYTE _CNV_S_14_TMO3_ERR_C_351_CM 1 0. 0. 13. DISPLAY_IDENTIFIER ERR_COD_MC_SAVE ECU_ADDRESS 0x7fb8da /end MEASUREMENT
/begin MEASUREMENT err_cod_mu_save "saved error code of monitoring unit, value of ERR_COD_MU after first communication on main controller" UBYTE _CNV_S_21_TMO3_ERR_C_352_CM 1 0. 0. 20. DISPLAY_IDENTIFIER ERR_COD_MU_SAVE ECU_ADDRESS 0x7fb8dc /end MEASUREMENT
/begin MEASUREMENT state_dr_mu_mc "state of MU disable request" UBYTE _CNV_S_6_TMO3_STATE_353_CM 1 0. 1. 224. DISPLAY_IDENTIFIER STATE_DR_MU_MC ECU_ADDRESS 0x7fb8e0 /end MEASUREMENT
/begin MEASUREMENT mc_state "state of communication on MC" UBYTE _CNV_S_4_TMO3_MC_ST_354_CM 1 0. 18. 207. DISPLAY_IDENTIFIER MC_STATE ECU_ADDRESS 0x7fbd5f /end MEASUREMENT
/begin MEASUREMENT mu_di_state "state of MU disable request" UBYTE _CNV_S_4_TMO3_MU_DI_355_CM 1 0. 0. 3. DISPLAY_IDENTIFIER MU_DI_STATE ECU_ADDRESS 0x7fb8e7 /end MEASUREMENT
/begin MEASUREMENT t_dgo_pls_mu "diagnosis pulse length" UBYTE _CNV_A_R_TMO3_LINEA_356_CM 1 0. 29. 2069. DISPLAY_IDENTIFIER T_DGO_PLS_MU ECU_ADDRESS 0x7fb907 FORMAT "%4.0" /end MEASUREMENT
/begin MEASUREMENT nr_dgo_pls_mu "port pin number, where diagnosis pulses are generated" UBYTE _CNV_A_R_LINEAR_____1_CM 1 0. 0. 255. DISPLAY_IDENTIFIER NR_DGO_PLS_MU ECU_ADDRESS 0x7fb906 FORMAT "%3.0" /end MEASUREMENT
/begin MEASUREMENT out_port_mu "digital output port extension on MU" UBYTE _CNV_A_R_LINEAR_____1_CM 1 0. 0. 255. DISPLAY_IDENTIFIER OUT_PORT_MU ECU_ADDRESS 0x7fb905 FORMAT "%3.0" /end MEASUREMENT
/begin MEASUREMENT tqi_is_pre_ctl "Pre-controlled torque for idle speed control" SWORD _CNV_A_R_LINEAR_____62_CM 1 0. -1024. 1023.96875 DISPLAY_IDENTIFIER TQI_IS_PRE_CTL ECU_ADDRESS 0x7f9c14 BYTE_ORDER MSB_LAST FORMAT "%7.3" /end MEASUREMENT
/begin MEASUREMENT fmy_stat_imob.ctr_abc "anti bounce counter for diagnosis instance IMOB" UBYTE _CNV_A_R_LINEAR_____1_CM 1 0. 0. 255. DISPLAY_IDENTIFIER CTR_ABC_IMOB ECU_ADDRESS 0x7f994d FORMAT "%3.0" /end MEASUREMENT
/begin MEASUREMENT fmy_stat_imob.ctr_end_diag "counter for end of diagnosis for diagnosis instance IMOB" UBYTE _CNV_A_R_LINEAR_____1_CM 1 0. 0. 255. DISPLAY_IDENTIFIER CTR_ABC_END_DIAG_IMOB ECU_ADDRESS 0x7f994c FORMAT "%3.0" /end MEASUREMENT
/begin MEASUREMENT fmy_stat_imob.err_info_stat.reserved "" UWORD _CNV_A_R_LINEAR_____0_CM 1 0. 0. 65535. DISPLAY_IDENTIFIER FMY_STAT_IMOB_ERR_INFO_STAT_RESE ECU_ADDRESS 0x7f994a BYTE_ORDER MSB_LAST BIT_MASK 0xF800 /end MEASUREMENT
/begin MEASUREMENT fmy_stat_imob.err_info_stat.lv_cdn_diag_stc "Statistical flag for condition of diagnosis of the diagnosis instance IMOB" UWORD _CNV_S_2_RANGE______380_CM 1 0. 0. 1. DISPLAY_IDENTIFIER LV_CDN_DIAG_STC_IMOB ECU_ADDRESS 0x7f994a BYTE_ORDER MSB_LAST BIT_MASK 0x400 /end MEASUREMENT
/begin MEASUREMENT fmy_stat_imob.err_info_stat.lv_lock_diag "lock flag (CPU load optimisation) of the diagnosis instance IMOB" UWORD _CNV_S_2_RANGE______380_CM 1 0. 0. 1. DISPLAY_IDENTIFIER LV_LOCK_DIAG_IMOB ECU_ADDRESS 0x7f994a BYTE_ORDER MSB_LAST BIT_MASK 0x200 /end MEASUREMENT
/begin MEASUREMENT fmy_stat_imob.err_info_stat.lv_err_mem "storage in dynamic failure memory of the diagnosis instance IMOB" UWORD _CNV_S_2_RANGE______380_CM 1 0. 0. 1. DISPLAY_IDENTIFIER LV_ERR_MEM_IMOB ECU_ADDRESS 0x7f994a BYTE_ORDER MSB_LAST BIT_MASK 0x80 /end MEASUREMENT
/begin MEASUREMENT fmy_stat_imob.err_info_stat.lv_ready "readiness status of the diagnosis instance IMOB" UWORD _CNV_S_2_RANGE______380_CM 1 0. 0. 1. DISPLAY_IDENTIFIER LV_READY_IMOB ECU_ADDRESS 0x7f994a BYTE_ORDER MSB_LAST BIT_MASK 0x40 /end MEASUREMENT
/begin MEASUREMENT fmy_stat_imob.err_info_stat.lv_end_diag "end of diagnosis of the diagnosis instance IMOB" UWORD _CNV_S_2_RANGE______380_CM 1 0. 0. 1. DISPLAY_IDENTIFIER LV_END_DIAG_IMOB ECU_ADDRESS 0x7f994a BYTE_ORDER MSB_LAST BIT_MASK 0x20 /end MEASUREMENT
/begin MEASUREMENT fmy_stat_imob.err_info_stat.lv_cdn_diag "diagnosis condition of the diagnosis instance IMOB" UWORD _CNV_S_2_RANGE______380_CM 1 0. 0. 1. DISPLAY_IDENTIFIER LV_CDN_DIAG_IMOB ECU_ADDRESS 0x7f994a BYTE_ORDER MSB_LAST BIT_MASK 0x10 /end MEASUREMENT
/begin MEASUREMENT fmy_stat_imob.err_info_stat.err_sym "symptoms of the diagnosis instance IMOB" UWORD _CNV_S_6_CONV_ERRM__27_CM 1 0. 0. 15. DISPLAY_IDENTIFIER ERR_SYM_IMOB ECU_ADDRESS 0x7f994a BYTE_ORDER MSB_LAST BIT_MASK 0xF /end MEASUREMENT
/begin MEASUREMENT lv_err_ecu_4 "Error flag of diagnosis instance ECU_4" UBYTE _CNV_S_2_RANGE______28_CM 1 0. 0. 1. DISPLAY_IDENTIFIER LV_ERR_ECU_4 ECU_ADDRESS 0x7fb4d8 /end MEASUREMENT
/begin MEASUREMENT fmy_stat_ecu_4.ctr_abc "anti bounce counter for diagnosis instance ECU_4" UBYTE _CNV_A_R_LINEAR_____1_CM 1 0. 0. 255. DISPLAY_IDENTIFIER CTR_ABC_ECU_4 ECU_ADDRESS 0x7f9951 FORMAT "%3.0" /end MEASUREMENT
/begin MEASUREMENT fmy_stat_ecu_4.ctr_end_diag "counter for end of diagnosis for diagnosis instance ECU_4" UBYTE _CNV_A_R_LINEAR_____1_CM 1 0. 0. 255. DISPLAY_IDENTIFIER CTR_ABC_END_DIAG_ECU_4 ECU_ADDRESS 0x7f9950 FORMAT "%3.0" /end MEASUREMENT
/begin MEASUREMENT fmy_stat_ecu_4.err_info_stat.reserved "" UWORD _CNV_A_R_LINEAR_____0_CM 1 0. 0. 65535. DISPLAY_IDENTIFIER FMY_STAT_ECU_4_ERR_INFO_STAT_RES ECU_ADDRESS 0x7f994e BYTE_ORDER MSB_LAST BIT_MASK 0xF800 /end MEASUREMENT
/begin MEASUREMENT fmy_stat_ecu_4.err_info_stat.lv_cdn_diag_stc "Statistical flag for condition of diagnosis of the diagnosis instance ECU_4" UWORD _CNV_S_2_RANGE______380_CM 1 0. 0. 1. DISPLAY_IDENTIFIER LV_CDN_DIAG_STC_ECU_4 ECU_ADDRESS 0x7f994e BYTE_ORDER MSB_LAST BIT_MASK 0x400 /end MEASUREMENT
/begin MEASUREMENT fmy_stat_ecu_4.err_info_stat.lv_lock_diag "lock flag (CPU load optimisation) of the diagnosis instance ECU_4" UWORD _CNV_S_2_RANGE______380_CM 1 0. 0. 1. DISPLAY_IDENTIFIER LV_LOCK_DIAG_ECU_4 ECU_ADDRESS 0x7f994e BYTE_ORDER MSB_LAST BIT_MASK 0x200 /end MEASUREMENT
/begin MEASUREMENT fmy_stat_ecu_4.err_info_stat.lv_err_mem "storage in dynamic failure memory of the diagnosis instance ECU_4" UWORD _CNV_S_2_RANGE______380_CM 1 0. 0. 1. DISPLAY_IDENTIFIER LV_ERR_MEM_ECU_4 ECU_ADDRESS 0x7f994e BYTE_ORDER MSB_LAST BIT_MASK 0x80 /end MEASUREMENT
/begin MEASUREMENT fmy_stat_ecu_4.err_info_stat.lv_ready "readiness status of the diagnosis instance ECU_4" UWORD _CNV_S_2_RANGE______380_CM 1 0. 0. 1. DISPLAY_IDENTIFIER LV_READY_ECU_4 ECU_ADDRESS 0x7f994e BYTE_ORDER MSB_LAST BIT_MASK 0x40 /end MEASUREMENT
/begin MEASUREMENT fmy_stat_ecu_4.err_info_stat.lv_end_diag "end of diagnosis of the diagnosis instance ECU_4" UWORD _CNV_S_2_RANGE______380_CM 1 0. 0. 1. DISPLAY_IDENTIFIER LV_END_DIAG_ECU_4 ECU_ADDRESS 0x7f994e BYTE_ORDER MSB_LAST BIT_MASK 0x20 /end MEASUREMENT
/begin MEASUREMENT fmy_stat_ecu_4.err_info_stat.lv_cdn_diag "diagnosis condition of the diagnosis instance ECU_4" UWORD _CNV_S_2_RANGE______380_CM 1 0. 0. 1. DISPLAY_IDENTIFIER LV_CDN_DIAG_ECU_4 ECU_ADDRESS 0x7f994e BYTE_ORDER MSB_LAST BIT_MASK 0x10 /end MEASUREMENT
/begin MEASUREMENT fmy_stat_ecu_4.err_info_stat.err_sym "symptoms of the diagnosis instance ECU_4" UWORD _CNV_S_6_CONV_ERRM__27_CM 1 0. 0. 15. DISPLAY_IDENTIFIER ERR_SYM_ECU_4 ECU_ADDRESS 0x7f994e BYTE_ORDER MSB_LAST BIT_MASK 0xF /end MEASUREMENT
/begin MEASUREMENT lv_err_ecu_2 "Error flag of diagnosis instance ECU_2" UBYTE _CNV_S_2_RANGE______28_CM 1 0. 0. 1. DISPLAY_IDENTIFIER LV_ERR_ECU_2 ECU_ADDRESS 0x7fb4d9 /end MEASUREMENT
/begin MEASUREMENT fmy_stat_ecu_2.ctr_abc "anti bounce counter for diagnosis instance ECU_2" UBYTE _CNV_A_R_LINEAR_____1_CM 1 0. 0. 255. DISPLAY_IDENTIFIER CTR_ABC_ECU_2 ECU_ADDRESS 0x7f9955 FORMAT "%3.0" /end MEASUREMENT
/begin MEASUREMENT fmy_stat_ecu_2.ctr_end_diag "counter for end of diagnosis for diagnosis instance ECU_2" UBYTE _CNV_A_R_LINEAR_____1_CM 1 0. 0. 255. DISPLAY_IDENTIFIER CTR_ABC_END_DIAG_ECU_2 ECU_ADDRESS 0x7f9954 FORMAT "%3.0" /end MEASUREMENT
/begin MEASUREMENT fmy_stat_ecu_2.err_info_stat.reserved "" UWORD _CNV_A_R_LINEAR_____0_CM 1 0. 0. 65535. DISPLAY_IDENTIFIER FMY_STAT_ECU_2_ERR_INFO_STAT_RES ECU_ADDRESS 0x7f9952 BYTE_ORDER MSB_LAST BIT_MASK 0xF800 /end MEASUREMENT
/begin MEASUREMENT fmy_stat_ecu_2.err_info_stat.lv_cdn_diag_stc "Statistical flag for condition of diagnosis of the diagnosis instance ECU_2" UWORD _CNV_S_2_RANGE______380_CM 1 0. 0. 1. DISPLAY_IDENTIFIER LV_CDN_DIAG_STC_ECU_2 ECU_ADDRESS 0x7f9952 BYTE_ORDER MSB_LAST BIT_MASK 0x400 /end MEASUREMENT
/begin MEASUREMENT fmy_stat_ecu_2.err_info_stat.lv_lock_diag "lock flag (CPU load optimisation) of the diagnosis instance ECU_2" UWORD _CNV_S_2_RANGE______380_CM 1 0. 0. 1. DISPLAY_IDENTIFIER LV_LOCK_DIAG_ECU_2 ECU_ADDRESS 0x7f9952 BYTE_ORDER MSB_LAST BIT_MASK 0x200 /end MEASUREMENT
/begin MEASUREMENT fmy_stat_ecu_2.err_info_stat.lv_err_mem "storage in dynamic failure memory of the diagnosis instance ECU_2" UWORD _CNV_S_2_RANGE______380_CM 1 0. 0. 1. DISPLAY_IDENTIFIER LV_ERR_MEM_ECU_2 ECU_ADDRESS 0x7f9952 BYTE_ORDER MSB_LAST BIT_MASK 0x80 /end MEASUREMENT
/begin MEASUREMENT fmy_stat_ecu_2.err_info_stat.lv_ready "readiness status of the diagnosis instance ECU_2" UWORD _CNV_S_2_RANGE______380_CM 1 0. 0. 1. DISPLAY_IDENTIFIER LV_READY_ECU_2 ECU_ADDRESS 0x7f9952 BYTE_ORDER MSB_LAST BIT_MASK 0x40 /end MEASUREMENT
/begin MEASUREMENT fmy_stat_ecu_2.err_info_stat.lv_end_diag "end of diagnosis of the diagnosis instance ECU_2" UWORD _CNV_S_2_RANGE______380_CM 1 0. 0. 1. DISPLAY_IDENTIFIER LV_END_DIAG_ECU_2 ECU_ADDRESS 0x7f9952 BYTE_ORDER MSB_LAST BIT_MASK 0x20 /end MEASUREMENT
/begin MEASUREMENT fmy_stat_ecu_2.err_info_stat.lv_cdn_diag "diagnosis condition of the diagnosis instance ECU_2" UWORD _CNV_S_2_RANGE______380_CM 1 0. 0. 1. DISPLAY_IDENTIFIER LV_CDN_DIAG_ECU_2 ECU_ADDRESS 0x7f9952 BYTE_ORDER MSB_LAST BIT_MASK 0x10 /end MEASUREMENT
/begin MEASUREMENT fmy_stat_ecu_2.err_info_stat.err_sym "symptoms of the diagnosis instance ECU_2" UWORD _CNV_S_6_CONV_ERRM__27_CM 1 0. 0. 15. DISPLAY_IDENTIFIER ERR_SYM_ECU_2 ECU_ADDRESS 0x7f9952 BYTE_ORDER MSB_LAST BIT_MASK 0xF /end MEASUREMENT
/begin MEASUREMENT lv_err_v_dcdc_rng "Error flag of diagnosis instance V_DCDC_RNG" UBYTE _CNV_S_2_RANGE______28_CM 1 0. 0. 1. DISPLAY_IDENTIFIER LV_ERR_V_DCDC_RNG ECU_ADDRESS 0x7fb4da /end MEASUREMENT
/begin MEASUREMENT fmy_stat_v_dcdc_rng.ctr_abc "anti bounce counter for diagnosis instance V_DCDC_RNG" UBYTE _CNV_A_R_LINEAR_____1_CM 1 0. 0. 255. DISPLAY_IDENTIFIER CTR_ABC_V_DCDC_RNG ECU_ADDRESS 0x7f9959 FORMAT "%3.0" /end MEASUREMENT
/begin MEASUREMENT fmy_stat_v_dcdc_rng.ctr_end_diag "counter for end of diagnosis for diagnosis instance V_DCDC_RNG" UBYTE _CNV_A_R_LINEAR_____1_CM 1 0. 0. 255. DISPLAY_IDENTIFIER CTR_ABC_END_DIAG_V_DCDC_RNG ECU_ADDRESS 0x7f9958 FORMAT "%3.0" /end MEASUREMENT
/begin MEASUREMENT fmy_stat_v_dcdc_rng.err_info_stat.reserved "" UWORD _CNV_A_R_LINEAR_____0_CM 1 0. 0. 65535. DISPLAY_IDENTIFIER FMY_STAT_V_DCDC_RNG_ERR_INFO_STA ECU_ADDRESS 0x7f9956 BYTE_ORDER MSB_LAST BIT_MASK 0xF800 /end MEASUREMENT
/begin MEASUREMENT fmy_stat_v_dcdc_rng.err_info_stat.lv_cdn_diag_stc "Statistical flag for condition of diagnosis of the diagnosis instance V_DCDC_RNG" UWORD _CNV_S_2_RANGE______380_CM 1 0. 0. 1. DISPLAY_IDENTIFIER LV_CDN_DIAG_STC_V_DCDC_RNG ECU_ADDRESS 0x7f9956 BYTE_ORDER MSB_LAST BIT_MASK 0x400 /end MEASUREMENT
/begin MEASUREMENT fmy_stat_v_dcdc_rng.err_info_stat.lv_lock_diag "lock flag (CPU load optimisation) of the diagnosis instance V_DCDC_RNG" UWORD _CNV_S_2_RANGE______380_CM 1 0. 0. 1. DISPLAY_IDENTIFIER LV_LOCK_DIAG_V_DCDC_RNG ECU_ADDRESS 0x7f9956 BYTE_ORDER MSB_LAST BIT_MASK 0x200 /end MEASUREMENT
/begin MEASUREMENT fmy_stat_v_dcdc_rng.err_info_stat.lv_err_mem "storage in dynamic failure memory of the diagnosis instance V_DCDC_RNG" UWORD _CNV_S_2_RANGE______380_CM 1 0. 0. 1. DISPLAY_IDENTIFIER LV_ERR_MEM_V_DCDC_RNG ECU_ADDRESS 0x7f9956 BYTE_ORDER MSB_LAST BIT_MASK 0x80 /end MEASUREMENT
/begin MEASUREMENT fmy_stat_v_dcdc_rng.err_info_stat.lv_ready "readiness status of the diagnosis instance V_DCDC_RNG" UWORD _CNV_S_2_RANGE______380_CM 1 0. 0. 1. DISPLAY_IDENTIFIER LV_READY_V_DCDC_RNG ECU_ADDRESS 0x7f9956 BYTE_ORDER MSB_LAST BIT_MASK 0x40 /end MEASUREMENT
/begin MEASUREMENT fmy_stat_v_dcdc_rng.err_info_stat.lv_end_diag "end of diagnosis of the diagnosis instance V_DCDC_RNG" UWORD _CNV_S_2_RANGE______380_CM 1 0. 0. 1. DISPLAY_IDENTIFIER LV_END_DIAG_V_DCDC_RNG ECU_ADDRESS 0x7f9956 BYTE_ORDER MSB_LAST BIT_MASK 0x20 /end MEASUREMENT
/begin MEASUREMENT fmy_stat_v_dcdc_rng.err_info_stat.lv_cdn_diag "diagnosis condition of the diagnosis instance V_DCDC_RNG" UWORD _CNV_S_2_RANGE______380_CM 1 0. 0. 1. DISPLAY_IDENTIFIER LV_CDN_DIAG_V_DCDC_RNG ECU_ADDRESS 0x7f9956 BYTE_ORDER MSB_LAST BIT_MASK 0x10 /end MEASUREMENT
/begin MEASUREMENT fmy_stat_v_dcdc_rng.err_info_stat.err_sym "symptoms of the diagnosis instance V_DCDC_RNG" UWORD _CNV_S_6_CONV_ERRM__27_CM 1 0. 0. 15. DISPLAY_IDENTIFIER ERR_SYM_V_DCDC_RNG ECU_ADDRESS 0x7f9956 BYTE_ORDER MSB_LAST BIT_MASK 0xF /end MEASUREMENT
/begin MEASUREMENT lv_err_pvs_l_1 "Error flag of diagnosis instance PVS_L_1" UBYTE _CNV_S_2_RANGE______28_CM 1 0. 0. 1. DISPLAY_IDENTIFIER LV_ERR_PVS_L_1 ECU_ADDRESS 0x7fb4db /end MEASUREMENT
/begin MEASUREMENT fmy_stat_pvs_l_1.ctr_abc "anti bounce counter for diagnosis instance PVS_L_1" UBYTE _CNV_A_R_LINEAR_____1_CM 1 0. 0. 255. DISPLAY_IDENTIFIER CTR_ABC_PVS_L_1 ECU_ADDRESS 0x7f995d FORMAT "%3.0" /end MEASUREMENT
/begin MEASUREMENT fmy_stat_pvs_l_1.ctr_end_diag "counter for end of diagnosis for diagnosis instance PVS_L_1" UBYTE _CNV_A_R_LINEAR_____1_CM 1 0. 0. 255. DISPLAY_IDENTIFIER CTR_ABC_END_DIAG_PVS_L_1 ECU_ADDRESS 0x7f995c FORMAT "%3.0" /end MEASUREMENT
/begin MEASUREMENT fmy_stat_pvs_l_1.err_info_stat.reserved "" UWORD _CNV_A_R_LINEAR_____0_CM 1 0. 0. 65535. DISPLAY_IDENTIFIER FMY_STAT_PVS_L_1_ERR_INFO_STAT_R ECU_ADDRESS 0x7f995a BYTE_ORDER MSB_LAST BIT_MASK 0xF800 /end MEASUREMENT
/begin MEASUREMENT fmy_stat_pvs_l_1.err_info_stat.lv_cdn_diag_stc "Statistical flag for condition of diagnosis of the diagnosis instance PVS_L_1" UWORD _CNV_S_2_RANGE______380_CM 1 0. 0. 1. DISPLAY_IDENTIFIER LV_CDN_DIAG_STC_PVS_L_1 ECU_ADDRESS 0x7f995a BYTE_ORDER MSB_LAST BIT_MASK 0x400 /end MEASUREMENT
/begin MEASUREMENT fmy_stat_pvs_l_1.err_info_stat.lv_lock_diag "lock flag (CPU load optimisation) of the diagnosis instance PVS_L_1" UWORD _CNV_S_2_RANGE______380_CM 1 0. 0. 1. DISPLAY_IDENTIFIER LV_LOCK_DIAG_PVS_L_1 ECU_ADDRESS 0x7f995a BYTE_ORDER MSB_LAST BIT_MASK 0x200 /end MEASUREMENT
/begin MEASUREMENT fmy_stat_pvs_l_1.err_info_stat.lv_err_mem "storage in dynamic failure memory of the diagnosis instance PVS_L_1" UWORD _CNV_S_2_RANGE______380_CM 1 0. 0. 1. DISPLAY_IDENTIFIER LV_ERR_MEM_PVS_L_1 ECU_ADDRESS 0x7f995a BYTE_ORDER MSB_LAST BIT_MASK 0x80 /end MEASUREMENT
/begin MEASUREMENT fmy_stat_pvs_l_1.err_info_stat.lv_ready "readiness status of the diagnosis instance PVS_L_1" UWORD _CNV_S_2_RANGE______380_CM 1 0. 0. 1. DISPLAY_IDENTIFIER LV_READY_PVS_L_1 ECU_ADDRESS 0x7f995a BYTE_ORDER MSB_LAST BIT_MASK 0x40 /end MEASUREMENT
/begin MEASUREMENT fmy_stat_pvs_l_1.err_info_stat.lv_end_diag "end of diagnosis of the diagnosis instance PVS_L_1" UWORD _CNV_S_2_RANGE______380_CM 1 0. 0. 1. DISPLAY_IDENTIFIER LV_END_DIAG_PVS_L_1 ECU_ADDRESS 0x7f995a BYTE_ORDER MSB_LAST BIT_MASK 0x20 /end MEASUREMENT
/begin MEASUREMENT fmy_stat_pvs_l_1.err_info_stat.lv_cdn_diag "diagnosis condition of the diagnosis instance PVS_L_1" UWORD _CNV_S_2_RANGE______380_CM 1 0. 0. 1. DISPLAY_IDENTIFIER LV_CDN_DIAG_PVS_L_1 ECU_ADDRESS 0x7f995a BYTE_ORDER MSB_LAST BIT_MASK 0x10 /end MEASUREMENT
/begin MEASUREMENT fmy_stat_pvs_l_1.err_info_stat.err_sym "symptoms of the diagnosis instance PVS_L_1" UWORD _CNV_S_6_CONV_ERRM__27_CM 1 0. 0. 15. DISPLAY_IDENTIFIER ERR_SYM_PVS_L_1 ECU_ADDRESS 0x7f995a BYTE_ORDER MSB_LAST BIT_MASK 0xF /end MEASUREMENT
/begin MEASUREMENT lv_err_pvs_l_2 "Error flag of diagnosis instance PVS_L_2" UBYTE _CNV_S_2_RANGE______28_CM 1 0. 0. 1. DISPLAY_IDENTIFIER LV_ERR_PVS_L_2 ECU_ADDRESS 0x7fb4dc /end MEASUREMENT
/begin MEASUREMENT fmy_stat_pvs_l_2.ctr_abc "anti bounce counter for diagnosis instance PVS_L_2" UBYTE _CNV_A_R_LINEAR_____1_CM 1 0. 0. 255. DISPLAY_IDENTIFIER CTR_ABC_PVS_L_2 ECU_ADDRESS 0x7f9961 FORMAT "%3.0" /end MEASUREMENT
/begin MEASUREMENT fmy_stat_pvs_l_2.ctr_end_diag "counter for end of diagnosis for diagnosis instance PVS_L_2" UBYTE _CNV_A_R_LINEAR_____1_CM 1 0. 0. 255. DISPLAY_IDENTIFIER CTR_ABC_END_DIAG_PVS_L_2 ECU_ADDRESS 0x7f9960 FORMAT "%3.0" /end MEASUREMENT
/begin MEASUREMENT fmy_stat_pvs_l_2.err_info_stat.reserved "" UWORD _CNV_A_R_LINEAR_____0_CM 1 0. 0. 65535. DISPLAY_IDENTIFIER FMY_STAT_PVS_L_2_ERR_INFO_STAT_R ECU_ADDRESS 0x7f995e BYTE_ORDER MSB_LAST BIT_MASK 0xF800 /end MEASUREMENT
/begin MEASUREMENT fmy_stat_pvs_l_2.err_info_stat.lv_cdn_diag_stc "Statistical flag for condition of diagnosis of the diagnosis instance PVS_L_2" UWORD _CNV_S_2_RANGE______380_CM 1 0. 0. 1. DISPLAY_IDENTIFIER LV_CDN_DIAG_STC_PVS_L_2 ECU_ADDRESS 0x7f995e BYTE_ORDER MSB_LAST BIT_MASK 0x400 /end MEASUREMENT
/begin MEASUREMENT fmy_stat_pvs_l_2.err_info_stat.lv_lock_diag "lock flag (CPU load optimisation) of the diagnosis instance PVS_L_2" UWORD _CNV_S_2_RANGE______380_CM 1 0. 0. 1. DISPLAY_IDENTIFIER LV_LOCK_DIAG_PVS_L_2 ECU_ADDRESS 0x7f995e BYTE_ORDER MSB_LAST BIT_MASK 0x200 /end MEASUREMENT
/begin MEASUREMENT fmy_stat_pvs_l_2.err_info_stat.lv_err_mem "storage in dynamic failure memory of the diagnosis instance PVS_L_2" UWORD _CNV_S_2_RANGE______380_CM 1 0. 0. 1. DISPLAY_IDENTIFIER LV_ERR_MEM_PVS_L_2 ECU_ADDRESS 0x7f995e BYTE_ORDER MSB_LAST BIT_MASK 0x80 /end MEASUREMENT
/begin MEASUREMENT fmy_stat_pvs_l_2.err_info_stat.lv_ready "readiness status of the diagnosis instance PVS_L_2" UWORD _CNV_S_2_RANGE______380_CM 1 0. 0. 1. DISPLAY_IDENTIFIER LV_READY_PVS_L_2 ECU_ADDRESS 0x7f995e BYTE_ORDER MSB_LAST BIT_MASK 0x40 /end MEASUREMENT
/begin MEASUREMENT fmy_stat_pvs_l_2.err_info_stat.lv_end_diag "end of diagnosis of the diagnosis instance PVS_L_2" UWORD _CNV_S_2_RANGE______380_CM 1 0. 0. 1. DISPLAY_IDENTIFIER LV_END_DIAG_PVS_L_2 ECU_ADDRESS 0x7f995e BYTE_ORDER MSB_LAST BIT_MASK 0x20 /end MEASUREMENT
/begin MEASUREMENT fmy_stat_pvs_l_2.err_info_stat.lv_cdn_diag "diagnosis condition of the diagnosis instance PVS_L_2" UWORD _CNV_S_2_RANGE______380_CM 1 0. 0. 1. DISPLAY_IDENTIFIER LV_CDN_DIAG_PVS_L_2 ECU_ADDRESS 0x7f995e BYTE_ORDER MSB_LAST BIT_MASK 0x10 /end MEASUREMENT
/begin MEASUREMENT fmy_stat_pvs_l_2.err_info_stat.err_sym "symptoms of the diagnosis instance PVS_L_2" UWORD _CNV_S_6_CONV_ERRM__27_CM 1 0. 0. 15. DISPLAY_IDENTIFIER ERR_SYM_PVS_L_2 ECU_ADDRESS 0x7f995e BYTE_ORDER MSB_LAST BIT_MASK 0xF /end MEASUREMENT
/begin MEASUREMENT lv_err_pvs_h_1 "Error flag of diagnosis instance PVS_H_1" UBYTE _CNV_S_2_RANGE______28_CM 1 0. 0. 1. DISPLAY_IDENTIFIER LV_ERR_PVS_H_1 ECU_ADDRESS 0x7fb4dd /end MEASUREMENT
/begin MEASUREMENT fmy_stat_pvs_h_1.ctr_abc "anti bounce counter for diagnosis instance PVS_H_1" UBYTE _CNV_A_R_LINEAR_____1_CM 1 0. 0. 255. DISPLAY_IDENTIFIER CTR_ABC_PVS_H_1 ECU_ADDRESS 0x7f9965 FORMAT "%3.0" /end MEASUREMENT
/begin MEASUREMENT fmy_stat_pvs_h_1.ctr_end_diag "counter for end of diagnosis for diagnosis instance PVS_H_1" UBYTE _CNV_A_R_LINEAR_____1_CM 1 0. 0. 255. DISPLAY_IDENTIFIER CTR_ABC_END_DIAG_PVS_H_1 ECU_ADDRESS 0x7f9964 FORMAT "%3.0" /end MEASUREMENT
/begin MEASUREMENT fmy_stat_pvs_h_1.err_info_stat.reserved "" UWORD _CNV_A_R_LINEAR_____0_CM 1 0. 0. 65535. DISPLAY_IDENTIFIER FMY_STAT_PVS_H_1_ERR_INFO_STAT_R ECU_ADDRESS 0x7f9962 BYTE_ORDER MSB_LAST BIT_MASK 0xF800 /end MEASUREMENT
/begin MEASUREMENT fmy_stat_pvs_h_1.err_info_stat.lv_cdn_diag_stc "Statistical flag for condition of diagnosis of the diagnosis instance PVS_H_1" UWORD _CNV_S_2_RANGE______380_CM 1 0. 0. 1. DISPLAY_IDENTIFIER LV_CDN_DIAG_STC_PVS_H_1 ECU_ADDRESS 0x7f9962 BYTE_ORDER MSB_LAST BIT_MASK 0x400 /end MEASUREMENT
/begin MEASUREMENT fmy_stat_pvs_h_1.err_info_stat.lv_lock_diag "lock flag (CPU load optimisation) of the diagnosis instance PVS_H_1" UWORD _CNV_S_2_RANGE______380_CM 1 0. 0. 1. DISPLAY_IDENTIFIER LV_LOCK_DIAG_PVS_H_1 ECU_ADDRESS 0x7f9962 BYTE_ORDER MSB_LAST BIT_MASK 0x200 /end MEASUREMENT
/begin MEASUREMENT fmy_stat_pvs_h_1.err_info_stat.lv_err_mem "storage in dynamic failure memory of the diagnosis instance PVS_H_1" UWORD _CNV_S_2_RANGE______380_CM 1 0. 0. 1. DISPLAY_IDENTIFIER LV_ERR_MEM_PVS_H_1 ECU_ADDRESS 0x7f9962 BYTE_ORDER MSB_LAST BIT_MASK 0x80 /end MEASUREMENT
/begin MEASUREMENT fmy_stat_pvs_h_1.err_info_stat.lv_ready "readiness status of the diagnosis instance PVS_H_1" UWORD _CNV_S_2_RANGE______380_CM 1 0. 0. 1. DISPLAY_IDENTIFIER LV_READY_PVS_H_1 ECU_ADDRESS 0x7f9962 BYTE_ORDER MSB_LAST BIT_MASK 0x40 /end MEASUREMENT
/begin MEASUREMENT fmy_stat_pvs_h_1.err_info_stat.lv_end_diag "end of diagnosis of the diagnosis instance PVS_H_1" UWORD _CNV_S_2_RANGE______380_CM 1 0. 0. 1. DISPLAY_IDENTIFIER LV_END_DIAG_PVS_H_1 ECU_ADDRESS 0x7f9962 BYTE_ORDER MSB_LAST BIT_MASK 0x20 /end MEASUREMENT
/begin MEASUREMENT fmy_stat_pvs_h_1.err_info_stat.lv_cdn_diag "diagnosis condition of the diagnosis instance PVS_H_1" UWORD _CNV_S_2_RANGE______380_CM 1 0. 0. 1. DISPLAY_IDENTIFIER LV_CDN_DIAG_PVS_H_1 ECU_ADDRESS 0x7f9962 BYTE_ORDER MSB_LAST BIT_MASK 0x10 /end MEASUREMENT
/begin MEASUREMENT fmy_stat_pvs_h_1.err_info_stat.err_sym "symptoms of the diagnosis instance PVS_H_1" UWORD _CNV_S_6_CONV_ERRM__27_CM 1 0. 0. 15. DISPLAY_IDENTIFIER ERR_SYM_PVS_H_1 ECU_ADDRESS 0x7f9962 BYTE_ORDER MSB_LAST BIT_MASK 0xF /end MEASUREMENT
/begin MEASUREMENT lv_err_pvs_h_2 "Error flag of diagnosis instance PVS_H_2" UBYTE _CNV_S_2_RANGE______28_CM 1 0. 0. 1. DISPLAY_IDENTIFIER LV_ERR_PVS_H_2 ECU_ADDRESS 0x7fb4de /end MEASUREMENT
/begin MEASUREMENT fmy_stat_pvs_h_2.ctr_abc "anti bounce counter for diagnosis instance PVS_H_2" UBYTE _CNV_A_R_LINEAR_____1_CM 1 0. 0. 255. DISPLAY_IDENTIFIER CTR_ABC_PVS_H_2 ECU_ADDRESS 0x7f9969 FORMAT "%3.0" /end MEASUREMENT
/begin MEASUREMENT fmy_stat_pvs_h_2.ctr_end_diag "counter for end of diagnosis for diagnosis instance PVS_H_2" UBYTE _CNV_A_R_LINEAR_____1_CM 1 0. 0. 255. DISPLAY_IDENTIFIER CTR_ABC_END_DIAG_PVS_H_2 ECU_ADDRESS 0x7f9968 FORMAT "%3.0" /end MEASUREMENT
/begin MEASUREMENT fmy_stat_pvs_h_2.err_info_stat.reserved "" UWORD _CNV_A_R_LINEAR_____0_CM 1 0. 0. 65535. DISPLAY_IDENTIFIER FMY_STAT_PVS_H_2_ERR_INFO_STAT_R ECU_ADDRESS 0x7f9966 BYTE_ORDER MSB_LAST BIT_MASK 0xF800 /end MEASUREMENT
/begin MEASUREMENT fmy_stat_pvs_h_2.err_info_stat.lv_cdn_diag_stc "Statistical flag for condition of diagnosis of the diagnosis instance PVS_H_2" UWORD _CNV_S_2_RANGE______380_CM 1 0. 0. 1. DISPLAY_IDENTIFIER LV_CDN_DIAG_STC_PVS_H_2 ECU_ADDRESS 0x7f9966 BYTE_ORDER MSB_LAST BIT_MASK 0x400 /end MEASUREMENT
/begin MEASUREMENT fmy_stat_pvs_h_2.err_info_stat.lv_lock_diag "lock flag (CPU load optimisation) of the diagnosis instance PVS_H_2" UWORD _CNV_S_2_RANGE______380_CM 1 0. 0. 1. DISPLAY_IDENTIFIER LV_LOCK_DIAG_PVS_H_2 ECU_ADDRESS 0x7f9966 BYTE_ORDER MSB_LAST BIT_MASK 0x200 /end MEASUREMENT
/begin MEASUREMENT fmy_stat_pvs_h_2.err_info_stat.lv_err_mem "storage in dynamic failure memory of the diagnosis instance PVS_H_2" UWORD _CNV_S_2_RANGE______380_CM 1 0. 0. 1. DISPLAY_IDENTIFIER LV_ERR_MEM_PVS_H_2 ECU_ADDRESS 0x7f9966 BYTE_ORDER MSB_LAST BIT_MASK 0x80 /end MEASUREMENT
/begin MEASUREMENT fmy_stat_pvs_h_2.err_info_stat.lv_ready "readiness status of the diagnosis instance PVS_H_2" UWORD _CNV_S_2_RANGE______380_CM 1 0. 0. 1. DISPLAY_IDENTIFIER LV_READY_PVS_H_2 ECU_ADDRESS 0x7f9966 BYTE_ORDER MSB_LAST BIT_MASK 0x40 /end MEASUREMENT
/begin MEASUREMENT fmy_stat_pvs_h_2.err_info_stat.lv_end_diag "end of diagnosis of the diagnosis instance PVS_H_2" UWORD _CNV_S_2_RANGE______380_CM 1 0. 0. 1. DISPLAY_IDENTIFIER LV_END_DIAG_PVS_H_2 ECU_ADDRESS 0x7f9966 BYTE_ORDER MSB_LAST BIT_MASK 0x20 /end MEASUREMENT
/begin MEASUREMENT fmy_stat_pvs_h_2.err_info_stat.lv_cdn_diag "diagnosis condition of the diagnosis instance PVS_H_2" UWORD _CNV_S_2_RANGE______380_CM 1 0. 0. 1. DISPLAY_IDENTIFIER LV_CDN_DIAG_PVS_H_2 ECU_ADDRESS 0x7f9966 BYTE_ORDER MSB_LAST BIT_MASK 0x10 /end MEASUREMENT
/begin MEASUREMENT fmy_stat_pvs_h_2.err_info_stat.err_sym "symptoms of the diagnosis instance PVS_H_2" UWORD _CNV_S_6_CONV_ERRM__27_CM 1 0. 0. 15. DISPLAY_IDENTIFIER ERR_SYM_PVS_H_2 ECU_ADDRESS 0x7f9966 BYTE_ORDER MSB_LAST BIT_MASK 0xF /end MEASUREMENT
/begin MEASUREMENT lv_err_pvs_ratio "Error flag of diagnosis instance PVS_RATIO" UBYTE _CNV_S_2_RANGE______28_CM 1 0. 0. 1. DISPLAY_IDENTIFIER LV_ERR_PVS_RATIO ECU_ADDRESS 0x7fb4df /end MEASUREMENT
/begin MEASUREMENT fmy_stat_pvs_ratio.ctr_abc "anti bounce counter for diagnosis instance PVS_RATIO" UBYTE _CNV_A_R_LINEAR_____1_CM 1 0. 0. 255. DISPLAY_IDENTIFIER CTR_ABC_PVS_RATIO ECU_ADDRESS 0x7f996d FORMAT "%3.0" /end MEASUREMENT
/begin MEASUREMENT fmy_stat_pvs_ratio.ctr_end_diag "counter for end of diagnosis for diagnosis instance PVS_RATIO" UBYTE _CNV_A_R_LINEAR_____1_CM 1 0. 0. 255. DISPLAY_IDENTIFIER CTR_ABC_END_DIAG_PVS_RATIO ECU_ADDRESS 0x7f996c FORMAT "%3.0" /end MEASUREMENT
/begin MEASUREMENT fmy_stat_pvs_ratio.err_info_stat.reserved "" UWORD _CNV_A_R_LINEAR_____0_CM 1 0. 0. 65535. DISPLAY_IDENTIFIER FMY_STAT_PVS_RATIO_ERR_INFO_STAT ECU_ADDRESS 0x7f996a BYTE_ORDER MSB_LAST BIT_MASK 0xF800 /end MEASUREMENT
/begin MEASUREMENT fmy_stat_pvs_ratio.err_info_stat.lv_cdn_diag_stc "Statistical flag for condition of diagnosis of the diagnosis instance PVS_RATIO" UWORD _CNV_S_2_RANGE______380_CM 1 0. 0. 1. DISPLAY_IDENTIFIER LV_CDN_DIAG_STC_PVS_RATIO ECU_ADDRESS 0x7f996a BYTE_ORDER MSB_LAST BIT_MASK 0x400 /end MEASUREMENT
/begin MEASUREMENT fmy_stat_pvs_ratio.err_info_stat.lv_lock_diag "lock flag (CPU load optimisation) of the diagnosis instance PVS_RATIO" UWORD _CNV_S_2_RANGE______380_CM 1 0. 0. 1. DISPLAY_IDENTIFIER LV_LOCK_DIAG_PVS_RATIO ECU_ADDRESS 0x7f996a BYTE_ORDER MSB_LAST BIT_MASK 0x200 /end MEASUREMENT
/begin MEASUREMENT fmy_stat_pvs_ratio.err_info_stat.lv_err_mem "storage in dynamic failure memory of the diagnosis instance PVS_RATIO" UWORD _CNV_S_2_RANGE______380_CM 1 0. 0. 1. DISPLAY_IDENTIFIER LV_ERR_MEM_PVS_RATIO ECU_ADDRESS 0x7f996a BYTE_ORDER MSB_LAST BIT_MASK 0x80 /end MEASUREMENT
/begin MEASUREMENT fmy_stat_pvs_ratio.err_info_stat.lv_ready "readiness status of the diagnosis instance PVS_RATIO" UWORD _CNV_S_2_RANGE______380_CM 1 0. 0. 1. DISPLAY_IDENTIFIER LV_READY_PVS_RATIO ECU_ADDRESS 0x7f996a BYTE_ORDER MSB_LAST BIT_MASK 0x40 /end MEASUREMENT
/begin MEASUREMENT fmy_stat_pvs_ratio.err_info_stat.lv_end_diag "end of diagnosis of the diagnosis instance PVS_RATIO" UWORD _CNV_S_2_RANGE______380_CM 1 0. 0. 1. DISPLAY_IDENTIFIER LV_END_DIAG_PVS_RATIO ECU_ADDRESS 0x7f996a BYTE_ORDER MSB_LAST BIT_MASK 0x20 /end MEASUREMENT
/begin MEASUREMENT fmy_stat_pvs_ratio.err_info_stat.lv_cdn_diag "diagnosis condition of the diagnosis instance PVS_RATIO" UWORD _CNV_S_2_RANGE______380_CM 1 0. 0. 1. DISPLAY_IDENTIFIER LV_CDN_DIAG_PVS_RATIO ECU_ADDRESS 0x7f996a BYTE_ORDER MSB_LAST BIT_MASK 0x10 /end MEASUREMENT
/begin MEASUREMENT fmy_stat_pvs_ratio.err_info_stat.err_sym "symptoms of the diagnosis instance PVS_RATIO" UWORD _CNV_S_6_CONV_ERRM__27_CM 1 0. 0. 15. DISPLAY_IDENTIFIER ERR_SYM_PVS_RATIO ECU_ADDRESS 0x7f996a BYTE_ORDER MSB_LAST BIT_MASK 0xF /end MEASUREMENT
/begin MEASUREMENT lv_err_pvs_move "Error flag of diagnosis instance PVS_MOVE" UBYTE _CNV_S_2_RANGE______28_CM 1 0. 0. 1. DISPLAY_IDENTIFIER LV_ERR_PVS_MOVE ECU_ADDRESS 0x7fb4e0 /end MEASUREMENT
/begin MEASUREMENT fmy_stat_pvs_move.ctr_abc "anti bounce counter for diagnosis instance PVS_MOVE" UBYTE _CNV_A_R_LINEAR_____1_CM 1 0. 0. 255. DISPLAY_IDENTIFIER CTR_ABC_PVS_MOVE ECU_ADDRESS 0x7f9971 FORMAT "%3.0" /end MEASUREMENT
/begin MEASUREMENT fmy_stat_pvs_move.ctr_end_diag "counter for end of diagnosis for diagnosis instance PVS_MOVE" UBYTE _CNV_A_R_LINEAR_____1_CM 1 0. 0. 255. DISPLAY_IDENTIFIER CTR_ABC_END_DIAG_PVS_MOVE ECU_ADDRESS 0x7f9970 FORMAT "%3.0" /end MEASUREMENT
/begin MEASUREMENT fmy_stat_pvs_move.err_info_stat.reserved "" UWORD _CNV_A_R_LINEAR_____0_CM 1 0. 0. 65535. DISPLAY_IDENTIFIER FMY_STAT_PVS_MOVE_ERR_INFO_STAT_ ECU_ADDRESS 0x7f996e BYTE_ORDER MSB_LAST BIT_MASK 0xF800 /end MEASUREMENT
/begin MEASUREMENT fmy_stat_pvs_move.err_info_stat.lv_cdn_diag_stc "Statistical flag for condition of diagnosis of the diagnosis instance PVS_MOVE" UWORD _CNV_S_2_RANGE______380_CM 1 0. 0. 1. DISPLAY_IDENTIFIER LV_CDN_DIAG_STC_PVS_MOVE ECU_ADDRESS 0x7f996e BYTE_ORDER MSB_LAST BIT_MASK 0x400 /end MEASUREMENT
/begin MEASUREMENT fmy_stat_pvs_move.err_info_stat.lv_lock_diag "lock flag (CPU load optimisation) of the diagnosis instance PVS_MOVE" UWORD _CNV_S_2_RANGE______380_CM 1 0. 0. 1. DISPLAY_IDENTIFIER LV_LOCK_DIAG_PVS_MOVE ECU_ADDRESS 0x7f996e BYTE_ORDER MSB_LAST BIT_MASK 0x200 /end MEASUREMENT
/begin MEASUREMENT fmy_stat_pvs_move.err_info_stat.lv_err_mem "storage in dynamic failure memory of the diagnosis instance PVS_MOVE" UWORD _CNV_S_2_RANGE______380_CM 1 0. 0. 1. DISPLAY_IDENTIFIER LV_ERR_MEM_PVS_MOVE ECU_ADDRESS 0x7f996e BYTE_ORDER MSB_LAST BIT_MASK 0x80 /end MEASUREMENT
/begin MEASUREMENT fmy_stat_pvs_move.err_info_stat.lv_ready "readiness status of the diagnosis instance PVS_MOVE" UWORD _CNV_S_2_RANGE______380_CM 1 0. 0. 1. DISPLAY_IDENTIFIER LV_READY_PVS_MOVE ECU_ADDRESS 0x7f996e BYTE_ORDER MSB_LAST BIT_MASK 0x40 /end MEASUREMENT
/begin MEASUREMENT fmy_stat_pvs_move.err_info_stat.lv_end_diag "end of diagnosis of the diagnosis instance PVS_MOVE" UWORD _CNV_S_2_RANGE______380_CM 1 0. 0. 1. DISPLAY_IDENTIFIER LV_END_DIAG_PVS_MOVE ECU_ADDRESS 0x7f996e BYTE_ORDER MSB_LAST BIT_MASK 0x20 /end MEASUREMENT
/begin MEASUREMENT fmy_stat_pvs_move.err_info_stat.lv_cdn_diag "diagnosis condition of the diagnosis instance PVS_MOVE" UWORD _CNV_S_2_RANGE______380_CM 1 0. 0. 1. DISPLAY_IDENTIFIER LV_CDN_DIAG_PVS_MOVE ECU_ADDRESS 0x7f996e BYTE_ORDER MSB_LAST BIT_MASK 0x10 /end MEASUREMENT
/begin MEASUREMENT fmy_stat_pvs_move.err_info_stat.err_sym "symptoms of the diagnosis instance PVS_MOVE" UWORD _CNV_S_6_CONV_ERRM__27_CM 1 0. 0. 15. DISPLAY_IDENTIFIER ERR_SYM_PVS_MOVE ECU_ADDRESS 0x7f996e BYTE_ORDER MSB_LAST BIT_MASK 0xF /end MEASUREMENT
/begin MEASUREMENT lv_err_pvs_bls_bts "Error flag of diagnosis instance PVS_BLS_BTS" UBYTE _CNV_S_2_RANGE______28_CM 1 0. 0. 1. DISPLAY_IDENTIFIER LV_ERR_PVS_BLS_BTS ECU_ADDRESS 0x7fb4e1 /end MEASUREMENT
/begin MEASUREMENT fmy_stat_pvs_bls_bts.ctr_abc "anti bounce counter for diagnosis instance PVS_BLS_BTS" UBYTE _CNV_A_R_LINEAR_____1_CM 1 0. 0. 255. DISPLAY_IDENTIFIER CTR_ABC_PVS_BLS_BTS ECU_ADDRESS 0x7f9975 FORMAT "%3.0" /end MEASUREMENT
/begin MEASUREMENT fmy_stat_pvs_bls_bts.ctr_end_diag "counter for end of diagnosis for diagnosis instance PVS_BLS_BTS" UBYTE _CNV_A_R_LINEAR_____1_CM 1 0. 0. 255. DISPLAY_IDENTIFIER CTR_ABC_END_DIAG_PVS_BLS_BTS ECU_ADDRESS 0x7f9974 FORMAT "%3.0" /end MEASUREMENT
/begin MEASUREMENT fmy_stat_pvs_bls_bts.err_info_stat.reserved "" UWORD _CNV_A_R_LINEAR_____0_CM 1 0. 0. 65535. DISPLAY_IDENTIFIER FMY_STAT_PVS_BLS_BTS_ERR_INFO_ST ECU_ADDRESS 0x7f9972 BYTE_ORDER MSB_LAST BIT_MASK 0xF800 /end MEASUREMENT
/begin MEASUREMENT fmy_stat_pvs_bls_bts.err_info_stat.lv_cdn_diag_stc "Statistical flag for condition of diagnosis of the diagnosis instance PVS_BLS_BTS" UWORD _CNV_S_2_RANGE______380_CM 1 0. 0. 1. DISPLAY_IDENTIFIER LV_CDN_DIAG_STC_PVS_BLS_BTS ECU_ADDRESS 0x7f9972 BYTE_ORDER MSB_LAST BIT_MASK 0x400 /end MEASUREMENT
/begin MEASUREMENT fmy_stat_pvs_bls_bts.err_info_stat.lv_lock_diag "lock flag (CPU load optimisation) of the diagnosis instance PVS_BLS_BTS" UWORD _CNV_S_2_RANGE______380_CM 1 0. 0. 1. DISPLAY_IDENTIFIER LV_LOCK_DIAG_PVS_BLS_BTS ECU_ADDRESS 0x7f9972 BYTE_ORDER MSB_LAST BIT_MASK 0x200 /end MEASUREMENT
/begin MEASUREMENT fmy_stat_pvs_bls_bts.err_info_stat.lv_err_mem "storage in dynamic failure memory of the diagnosis instance PVS_BLS_BTS" UWORD _CNV_S_2_RANGE______380_CM 1 0. 0. 1. DISPLAY_IDENTIFIER LV_ERR_MEM_PVS_BLS_BTS ECU_ADDRESS 0x7f9972 BYTE_ORDER MSB_LAST BIT_MASK 0x80 /end MEASUREMENT
/begin MEASUREMENT fmy_stat_pvs_bls_bts.err_info_stat.lv_ready "readiness status of the diagnosis instance PVS_BLS_BTS" UWORD _CNV_S_2_RANGE______380_CM 1 0. 0. 1. DISPLAY_IDENTIFIER LV_READY_PVS_BLS_BTS ECU_ADDRESS 0x7f9972 BYTE_ORDER MSB_LAST BIT_MASK 0x40 /end MEASUREMENT
/begin MEASUREMENT fmy_stat_pvs_bls_bts.err_info_stat.lv_end_diag "end of diagnosis of the diagnosis instance PVS_BLS_BTS" UWORD _CNV_S_2_RANGE______380_CM 1 0. 0. 1. DISPLAY_IDENTIFIER LV_END_DIAG_PVS_BLS_BTS ECU_ADDRESS 0x7f9972 BYTE_ORDER MSB_LAST BIT_MASK 0x20 /end MEASUREMENT
/begin MEASUREMENT fmy_stat_pvs_bls_bts.err_info_stat.lv_cdn_diag "diagnosis condition of the diagnosis instance PVS_BLS_BTS" UWORD _CNV_S_2_RANGE______380_CM 1 0. 0. 1. DISPLAY_IDENTIFIER LV_CDN_DIAG_PVS_BLS_BTS ECU_ADDRESS 0x7f9972 BYTE_ORDER MSB_LAST BIT_MASK 0x10 /end MEASUREMENT
/begin MEASUREMENT fmy_stat_pvs_bls_bts.err_info_stat.err_sym "symptoms of the diagnosis instance PVS_BLS_BTS" UWORD _CNV_S_6_CONV_ERRM__27_CM 1 0. 0. 15. DISPLAY_IDENTIFIER ERR_SYM_PVS_BLS_BTS ECU_ADDRESS 0x7f9972 BYTE_ORDER MSB_LAST BIT_MASK 0xF /end MEASUREMENT
/begin MEASUREMENT lv_err_vcc_1 "Error flag of diagnosis instance VCC_1" UBYTE _CNV_S_2_RANGE______28_CM 1 0. 0. 1. DISPLAY_IDENTIFIER LV_ERR_VCC_1 ECU_ADDRESS 0x7fb4e2 /end MEASUREMENT
/begin MEASUREMENT fmy_stat_vcc_1.ctr_abc "anti bounce counter for diagnosis instance VCC_1" UBYTE _CNV_A_R_LINEAR_____1_CM 1 0. 0. 255. DISPLAY_IDENTIFIER CTR_ABC_VCC_1 ECU_ADDRESS 0x7f9979 FORMAT "%3.0" /end MEASUREMENT
/begin MEASUREMENT fmy_stat_vcc_1.ctr_end_diag "counter for end of diagnosis for diagnosis instance VCC_1" UBYTE _CNV_A_R_LINEAR_____1_CM 1 0. 0. 255. DISPLAY_IDENTIFIER CTR_ABC_END_DIAG_VCC_1 ECU_ADDRESS 0x7f9978 FORMAT "%3.0" /end MEASUREMENT
/begin MEASUREMENT fmy_stat_vcc_1.err_info_stat.reserved "" UWORD _CNV_A_R_LINEAR_____0_CM 1 0. 0. 65535. DISPLAY_IDENTIFIER FMY_STAT_VCC_1_ERR_INFO_STAT_RES ECU_ADDRESS 0x7f9976 BYTE_ORDER MSB_LAST BIT_MASK 0xF800 /end MEASUREMENT
/begin MEASUREMENT fmy_stat_vcc_1.err_info_stat.lv_cdn_diag_stc "Statistical flag for condition of diagnosis of the diagnosis instance VCC_1" UWORD _CNV_S_2_RANGE______380_CM 1 0. 0. 1. DISPLAY_IDENTIFIER LV_CDN_DIAG_STC_VCC_1 ECU_ADDRESS 0x7f9976 BYTE_ORDER MSB_LAST BIT_MASK 0x400 /end MEASUREMENT
/begin MEASUREMENT fmy_stat_vcc_1.err_info_stat.lv_lock_diag "lock flag (CPU load optimisation) of the diagnosis instance VCC_1" UWORD _CNV_S_2_RANGE______380_CM 1 0. 0. 1. DISPLAY_IDENTIFIER LV_LOCK_DIAG_VCC_1 ECU_ADDRESS 0x7f9976 BYTE_ORDER MSB_LAST BIT_MASK 0x200 /end MEASUREMENT
/begin MEASUREMENT fmy_stat_vcc_1.err_info_stat.lv_err_mem "storage in dynamic failure memory of the diagnosis instance VCC_1" UWORD _CNV_S_2_RANGE______380_CM 1 0. 0. 1. DISPLAY_IDENTIFIER LV_ERR_MEM_VCC_1 ECU_ADDRESS 0x7f9976 BYTE_ORDER MSB_LAST BIT_MASK 0x80 /end MEASUREMENT
/begin MEASUREMENT fmy_stat_vcc_1.err_info_stat.lv_ready "readiness status of the diagnosis instance VCC_1" UWORD _CNV_S_2_RANGE______380_CM 1 0. 0. 1. DISPLAY_IDENTIFIER LV_READY_VCC_1 ECU_ADDRESS 0x7f9976 BYTE_ORDER MSB_LAST BIT_MASK 0x40 /end MEASUREMENT
/begin MEASUREMENT fmy_stat_vcc_1.err_info_stat.lv_end_diag "end of diagnosis of the diagnosis instance VCC_1" UWORD _CNV_S_2_RANGE______380_CM 1 0. 0. 1. DISPLAY_IDENTIFIER LV_END_DIAG_VCC_1 ECU_ADDRESS 0x7f9976 BYTE_ORDER MSB_LAST BIT_MASK 0x20 /end MEASUREMENT
/begin MEASUREMENT fmy_stat_vcc_1.err_info_stat.lv_cdn_diag "diagnosis condition of the diagnosis instance VCC_1" UWORD _CNV_S_2_RANGE______380_CM 1 0. 0. 1. DISPLAY_IDENTIFIER LV_CDN_DIAG_VCC_1 ECU_ADDRESS 0x7f9976 BYTE_ORDER MSB_LAST BIT_MASK 0x10 /end MEASUREMENT
/begin MEASUREMENT fmy_stat_vcc_1.err_info_stat.err_sym "symptoms of the diagnosis instance VCC_1" UWORD _CNV_S_6_CONV_ERRM__27_CM 1 0. 0. 15. DISPLAY_IDENTIFIER ERR_SYM_VCC_1 ECU_ADDRESS 0x7f9976 BYTE_ORDER MSB_LAST BIT_MASK 0xF /end MEASUREMENT
/begin MEASUREMENT lv_err_vcc_2 "Error flag of diagnosis instance VCC_2" UBYTE _CNV_S_2_RANGE______28_CM 1 0. 0. 1. DISPLAY_IDENTIFIER LV_ERR_VCC_2 ECU_ADDRESS 0x7fb4e3 /end MEASUREMENT
/begin MEASUREMENT fmy_stat_vcc_2.ctr_abc "anti bounce counter for diagnosis instance VCC_2" UBYTE _CNV_A_R_LINEAR_____1_CM 1 0. 0. 255. DISPLAY_IDENTIFIER CTR_ABC_VCC_2 ECU_ADDRESS 0x7f997d FORMAT "%3.0" /end MEASUREMENT
/begin MEASUREMENT fmy_stat_vcc_2.ctr_end_diag "counter for end of diagnosis for diagnosis instance VCC_2" UBYTE _CNV_A_R_LINEAR_____1_CM 1 0. 0. 255. DISPLAY_IDENTIFIER CTR_ABC_END_DIAG_VCC_2 ECU_ADDRESS 0x7f997c FORMAT "%3.0" /end MEASUREMENT
/begin MEASUREMENT fmy_stat_vcc_2.err_info_stat.reserved "" UWORD _CNV_A_R_LINEAR_____0_CM 1 0. 0. 65535. DISPLAY_IDENTIFIER FMY_STAT_VCC_2_ERR_INFO_STAT_RES ECU_ADDRESS 0x7f997a BYTE_ORDER MSB_LAST BIT_MASK 0xF800 /end MEASUREMENT
/begin MEASUREMENT fmy_stat_vcc_2.err_info_stat.lv_cdn_diag_stc "Statistical flag for condition of diagnosis of the diagnosis instance VCC_2" UWORD _CNV_S_2_RANGE______380_CM 1 0. 0. 1. DISPLAY_IDENTIFIER LV_CDN_DIAG_STC_VCC_2 ECU_ADDRESS 0x7f997a BYTE_ORDER MSB_LAST BIT_MASK 0x400 /end MEASUREMENT
/begin MEASUREMENT fmy_stat_vcc_2.err_info_stat.lv_lock_diag "lock flag (CPU load optimisation) of the diagnosis instance VCC_2" UWORD _CNV_S_2_RANGE______380_CM 1 0. 0. 1. DISPLAY_IDENTIFIER LV_LOCK_DIAG_VCC_2 ECU_ADDRESS 0x7f997a BYTE_ORDER MSB_LAST BIT_MASK 0x200 /end MEASUREMENT
/begin MEASUREMENT fmy_stat_vcc_2.err_info_stat.lv_err_mem "storage in dynamic failure memory of the diagnosis instance VCC_2" UWORD _CNV_S_2_RANGE______380_CM 1 0. 0. 1. DISPLAY_IDENTIFIER LV_ERR_MEM_VCC_2 ECU_ADDRESS 0x7f997a BYTE_ORDER MSB_LAST BIT_MASK 0x80 /end MEASUREMENT
/begin MEASUREMENT fmy_stat_vcc_2.err_info_stat.lv_ready "readiness status of the diagnosis instance VCC_2" UWORD _CNV_S_2_RANGE______380_CM 1 0. 0. 1. DISPLAY_IDENTIFIER LV_READY_VCC_2 ECU_ADDRESS 0x7f997a BYTE_ORDER MSB_LAST BIT_MASK 0x40 /end MEASUREMENT
/begin MEASUREMENT fmy_stat_vcc_2.err_info_stat.lv_end_diag "end of diagnosis of the diagnosis instance VCC_2" UWORD _CNV_S_2_RANGE______380_CM 1 0. 0. 1. DISPLAY_IDENTIFIER LV_END_DIAG_VCC_2 ECU_ADDRESS 0x7f997a BYTE_ORDER MSB_LAST BIT_MASK 0x20 /end MEASUREMENT
/begin MEASUREMENT fmy_stat_vcc_2.err_info_stat.lv_cdn_diag "diagnosis condition of the diagnosis instance VCC_2" UWORD _CNV_S_2_RANGE______380_CM 1 0. 0. 1. DISPLAY_IDENTIFIER LV_CDN_DIAG_VCC_2 ECU_ADDRESS 0x7f997a BYTE_ORDER MSB_LAST BIT_MASK 0x10 /end MEASUREMENT
/begin MEASUREMENT fmy_stat_vcc_2.err_info_stat.err_sym "symptoms of the diagnosis instance VCC_2" UWORD _CNV_S_6_CONV_ERRM__27_CM 1 0. 0. 15. DISPLAY_IDENTIFIER ERR_SYM_VCC_2 ECU_ADDRESS 0x7f997a BYTE_ORDER MSB_LAST BIT_MASK 0xF /end MEASUREMENT
/begin MEASUREMENT lv_err_v_dip_pf_rng "Error flag of diagnosis instance V_DIP_PF_RNG" UBYTE _CNV_S_2_RANGE______28_CM 1 0. 0. 1. DISPLAY_IDENTIFIER LV_ERR_V_DIP_PF_RNG ECU_ADDRESS 0x7fb4e4 /end MEASUREMENT
/begin MEASUREMENT fmy_stat_v_dip_pf_rng.ctr_abc "anti bounce counter for diagnosis instance V_DIP_PF_RNG" UBYTE _CNV_A_R_LINEAR_____1_CM 1 0. 0. 255. DISPLAY_IDENTIFIER CTR_ABC_V_DIP_PF_RNG ECU_ADDRESS 0x7f9981 FORMAT "%3.0" /end MEASUREMENT
/begin MEASUREMENT fmy_stat_v_dip_pf_rng.ctr_end_diag "counter for end of diagnosis for diagnosis instance V_DIP_PF_RNG" UBYTE _CNV_A_R_LINEAR_____1_CM 1 0. 0. 255. DISPLAY_IDENTIFIER CTR_ABC_END_DIAG_V_DIP_PF_RNG ECU_ADDRESS 0x7f9980 FORMAT "%3.0" /end MEASUREMENT
/begin MEASUREMENT fmy_stat_v_dip_pf_rng.err_info_stat.reserved "" UWORD _CNV_A_R_LINEAR_____0_CM 1 0. 0. 65535. DISPLAY_IDENTIFIER FMY_STAT_V_DIP_PF_RNG_ERR_INFO_S ECU_ADDRESS 0x7f997e BYTE_ORDER MSB_LAST BIT_MASK 0xF800 /end MEASUREMENT
/begin MEASUREMENT fmy_stat_v_dip_pf_rng.err_info_stat.lv_cdn_diag_stc "Statistical flag for condition of diagnosis of the diagnosis instance V_DIP_PF_RNG" UWORD _CNV_S_2_RANGE______380_CM 1 0. 0. 1. DISPLAY_IDENTIFIER LV_CDN_DIAG_STC_V_DIP_PF_RNG ECU_ADDRESS 0x7f997e BYTE_ORDER MSB_LAST BIT_MASK 0x400 /end MEASUREMENT
/begin MEASUREMENT fmy_stat_v_dip_pf_rng.err_info_stat.lv_lock_diag "lock flag (CPU load optimisation) of the diagnosis instance V_DIP_PF_RNG" UWORD _CNV_S_2_RANGE______380_CM 1 0. 0. 1. DISPLAY_IDENTIFIER LV_LOCK_DIAG_V_DIP_PF_RNG ECU_ADDRESS 0x7f997e BYTE_ORDER MSB_LAST BIT_MASK 0x200 /end MEASUREMENT
/begin MEASUREMENT fmy_stat_v_dip_pf_rng.err_info_stat.lv_err_mem "storage in dynamic failure memory of the diagnosis instance V_DIP_PF_RNG" UWORD _CNV_S_2_RANGE______380_CM 1 0. 0. 1. DISPLAY_IDENTIFIER LV_ERR_MEM_V_DIP_PF_RNG ECU_ADDRESS 0x7f997e BYTE_ORDER MSB_LAST BIT_MASK 0x80 /end MEASUREMENT
/begin MEASUREMENT fmy_stat_v_dip_pf_rng.err_info_stat.lv_ready "readiness status of the diagnosis instance V_DIP_PF_RNG" UWORD _CNV_S_2_RANGE______380_CM 1 0. 0. 1. DISPLAY_IDENTIFIER LV_READY_V_DIP_PF_RNG ECU_ADDRESS 0x7f997e BYTE_ORDER MSB_LAST BIT_MASK 0x40 /end MEASUREMENT
/begin MEASUREMENT fmy_stat_v_dip_pf_rng.err_info_stat.lv_end_diag "end of diagnosis of the diagnosis instance V_DIP_PF_RNG" UWORD _CNV_S_2_RANGE______380_CM 1 0. 0. 1. DISPLAY_IDENTIFIER LV_END_DIAG_V_DIP_PF_RNG ECU_ADDRESS 0x7f997e BYTE_ORDER MSB_LAST BIT_MASK 0x20 /end MEASUREMENT
/begin MEASUREMENT fmy_stat_v_dip_pf_rng.err_info_stat.lv_cdn_diag "diagnosis condition of the diagnosis instance V_DIP_PF_RNG" UWORD _CNV_S_2_RANGE______380_CM 1 0. 0. 1. DISPLAY_IDENTIFIER LV_CDN_DIAG_V_DIP_PF_RNG ECU_ADDRESS 0x7f997e BYTE_ORDER MSB_LAST BIT_MASK 0x10 /end MEASUREMENT
/begin MEASUREMENT fmy_stat_v_dip_pf_rng.err_info_stat.err_sym "symptoms of the diagnosis instance V_DIP_PF_RNG" UWORD _CNV_S_6_CONV_ERRM__27_CM 1 0. 0. 15. DISPLAY_IDENTIFIER ERR_SYM_V_DIP_PF_RNG ECU_ADDRESS 0x7f997e BYTE_ORDER MSB_LAST BIT_MASK 0xF /end MEASUREMENT
/begin MEASUREMENT lv_err_dip_pf_mes_es "Error flag of diagnosis instance DIP_PF_MES_ES" UBYTE _CNV_S_2_RANGE______28_CM 1 0. 0. 1. DISPLAY_IDENTIFIER LV_ERR_DIP_PF_MES_ES ECU_ADDRESS 0x7fb4e5 /end MEASUREMENT
/begin MEASUREMENT fmy_stat_dip_pf_mes_es.ctr_abc "anti bounce counter for diagnosis instance DIP_PF_MES_ES" UBYTE _CNV_A_R_LINEAR_____1_CM 1 0. 0. 255. DISPLAY_IDENTIFIER CTR_ABC_DIP_PF_MES_ES ECU_ADDRESS 0x7f9985 FORMAT "%3.0" /end MEASUREMENT
/begin MEASUREMENT fmy_stat_dip_pf_mes_es.ctr_end_diag "counter for end of diagnosis for diagnosis instance DIP_PF_MES_ES" UBYTE _CNV_A_R_LINEAR_____1_CM 1 0. 0. 255. DISPLAY_IDENTIFIER CTR_ABC_END_DIAG_DIP_PF_MES_ES ECU_ADDRESS 0x7f9984 FORMAT "%3.0" /end MEASUREMENT
/begin MEASUREMENT fmy_stat_dip_pf_mes_es.err_info_stat.reserved "" UWORD _CNV_A_R_LINEAR_____0_CM 1 0. 0. 65535. DISPLAY_IDENTIFIER FMY_STAT_DIP_PF_MES_ES_ERR_INFO_ ECU_ADDRESS 0x7f9982 BYTE_ORDER MSB_LAST BIT_MASK 0xF800 /end MEASUREMENT
/begin MEASUREMENT fmy_stat_dip_pf_mes_es.err_info_stat.lv_cdn_diag_stc "Statistical flag for condition of diagnosis of the diagnosis instance DIP_PF_MES_ES" UWORD _CNV_S_2_RANGE______380_CM 1 0. 0. 1. DISPLAY_IDENTIFIER LV_CDN_DIAG_STC_DIP_PF_MES_ES ECU_ADDRESS 0x7f9982 BYTE_ORDER MSB_LAST BIT_MASK 0x400 /end MEASUREMENT
/begin MEASUREMENT fmy_stat_dip_pf_mes_es.err_info_stat.lv_lock_diag "lock flag (CPU load optimisation) of the diagnosis instance DIP_PF_MES_ES" UWORD _CNV_S_2_RANGE______380_CM 1 0. 0. 1. DISPLAY_IDENTIFIER LV_LOCK_DIAG_DIP_PF_MES_ES ECU_ADDRESS 0x7f9982 BYTE_ORDER MSB_LAST BIT_MASK 0x200 /end MEASUREMENT
/begin MEASUREMENT fmy_stat_dip_pf_mes_es.err_info_stat.lv_err_mem "storage in dynamic failure memory of the diagnosis instance DIP_PF_MES_ES" UWORD _CNV_S_2_RANGE______380_CM 1 0. 0. 1. DISPLAY_IDENTIFIER LV_ERR_MEM_DIP_PF_MES_ES ECU_ADDRESS 0x7f9982 BYTE_ORDER MSB_LAST BIT_MASK 0x80 /end MEASUREMENT
/begin MEASUREMENT fmy_stat_dip_pf_mes_es.err_info_stat.lv_ready "readiness status of the diagnosis instance DIP_PF_MES_ES" UWORD _CNV_S_2_RANGE______380_CM 1 0. 0. 1. DISPLAY_IDENTIFIER LV_READY_DIP_PF_MES_ES ECU_ADDRESS 0x7f9982 BYTE_ORDER MSB_LAST BIT_MASK 0x40 /end MEASUREMENT
/begin MEASUREMENT fmy_stat_dip_pf_mes_es.err_info_stat.lv_end_diag "end of diagnosis of the diagnosis instance DIP_PF_MES_ES" UWORD _CNV_S_2_RANGE______380_CM 1 0. 0. 1. DISPLAY_IDENTIFIER LV_END_DIAG_DIP_PF_MES_ES ECU_ADDRESS 0x7f9982 BYTE_ORDER MSB_LAST BIT_MASK 0x20 /end MEASUREMENT
/begin MEASUREMENT fmy_stat_dip_pf_mes_es.err_info_stat.lv_cdn_diag "diagnosis condition of the diagnosis instance DIP_PF_MES_ES" UWORD _CNV_S_2_RANGE______380_CM 1 0. 0. 1. DISPLAY_IDENTIFIER LV_CDN_DIAG_DIP_PF_MES_ES ECU_ADDRESS 0x7f9982 BYTE_ORDER MSB_LAST BIT_MASK 0x10 /end MEASUREMENT
/begin MEASUREMENT fmy_stat_dip_pf_mes_es.err_info_stat.err_sym "symptoms of the diagnosis instance DIP_PF_MES_ES" UWORD _CNV_S_6_CONV_ERRM__27_CM 1 0. 0. 15. DISPLAY_IDENTIFIER ERR_SYM_DIP_PF_MES_ES ECU_ADDRESS 0x7f9982 BYTE_ORDER MSB_LAST BIT_MASK 0xF /end MEASUREMENT
/begin MEASUREMENT lv_err_dip_pf_mes_eru "Error flag of diagnosis instance DIP_PF_MES_ERU" UBYTE _CNV_S_2_RANGE______28_CM 1 0. 0. 1. DISPLAY_IDENTIFIER LV_ERR_DIP_PF_MES_ERU ECU_ADDRESS 0x7fb4e6 /end MEASUREMENT
/begin MEASUREMENT fmy_stat_dip_pf_mes_eru.ctr_abc "anti bounce counter for diagnosis instance DIP_PF_MES_ERU" UBYTE _CNV_A_R_LINEAR_____1_CM 1 0. 0. 255. DISPLAY_IDENTIFIER CTR_ABC_DIP_PF_MES_ERU ECU_ADDRESS 0x7f9989 FORMAT "%3.0" /end MEASUREMENT
/begin MEASUREMENT fmy_stat_dip_pf_mes_eru.ctr_end_diag "counter for end of diagnosis for diagnosis instance DIP_PF_MES_ERU" UBYTE _CNV_A_R_LINEAR_____1_CM 1 0. 0. 255. DISPLAY_IDENTIFIER CTR_ABC_END_DIAG_DIP_PF_MES_ERU ECU_ADDRESS 0x7f9988 FORMAT "%3.0" /end MEASUREMENT
/begin MEASUREMENT fmy_stat_dip_pf_mes_eru.err_info_stat.reserved "" UWORD _CNV_A_R_LINEAR_____0_CM 1 0. 0. 65535. DISPLAY_IDENTIFIER FMY_STAT_DIP_PF_MES_ERU_ERR_INFO ECU_ADDRESS 0x7f9986 BYTE_ORDER MSB_LAST BIT_MASK 0xF800 /end MEASUREMENT
/begin MEASUREMENT fmy_stat_dip_pf_mes_eru.err_info_stat.lv_cdn_diag_stc "Statistical flag for condition of diagnosis of the diagnosis instance DIP_PF_MES_ERU" UWORD _CNV_S_2_RANGE______380_CM 1 0. 0. 1. DISPLAY_IDENTIFIER LV_CDN_DIAG_STC_DIP_PF_MES_ERU ECU_ADDRESS 0x7f9986 BYTE_ORDER MSB_LAST BIT_MASK 0x400 /end MEASUREMENT
/begin MEASUREMENT fmy_stat_dip_pf_mes_eru.err_info_stat.lv_lock_diag "lock flag (CPU load optimisation) of the diagnosis instance DIP_PF_MES_ERU" UWORD _CNV_S_2_RANGE______380_CM 1 0. 0. 1. DISPLAY_IDENTIFIER LV_LOCK_DIAG_DIP_PF_MES_ERU ECU_ADDRESS 0x7f9986 BYTE_ORDER MSB_LAST BIT_MASK 0x200 /end MEASUREMENT
/begin MEASUREMENT fmy_stat_dip_pf_mes_eru.err_info_stat.lv_err_mem "storage in dynamic failure memory of the diagnosis instance DIP_PF_MES_ERU" UWORD _CNV_S_2_RANGE______380_CM 1 0. 0. 1. DISPLAY_IDENTIFIER LV_ERR_MEM_DIP_PF_MES_ERU ECU_ADDRESS 0x7f9986 BYTE_ORDER MSB_LAST BIT_MASK 0x80 /end MEASUREMENT
/begin MEASUREMENT fmy_stat_dip_pf_mes_eru.err_info_stat.lv_ready "readiness status of the diagnosis instance DIP_PF_MES_ERU" UWORD _CNV_S_2_RANGE______380_CM 1 0. 0. 1. DISPLAY_IDENTIFIER LV_READY_DIP_PF_MES_ERU ECU_ADDRESS 0x7f9986 BYTE_ORDER MSB_LAST BIT_MASK 0x40 /end MEASUREMENT
/begin MEASUREMENT fmy_stat_dip_pf_mes_eru.err_info_stat.lv_end_diag "end of diagnosis of the diagnosis instance DIP_PF_MES_ERU" UWORD _CNV_S_2_RANGE______380_CM 1 0. 0. 1. DISPLAY_IDENTIFIER LV_END_DIAG_DIP_PF_MES_ERU ECU_ADDRESS 0x7f9986 BYTE_ORDER MSB_LAST BIT_MASK 0x20 /end MEASUREMENT
/begin MEASUREMENT fmy_stat_dip_pf_mes_eru.err_info_stat.lv_cdn_diag "diagnosis condition of the diagnosis instance DIP_PF_MES_ERU" UWORD _CNV_S_2_RANGE______380_CM 1 0. 0. 1. DISPLAY_IDENTIFIER LV_CDN_DIAG_DIP_PF_MES_ERU ECU_ADDRESS 0x7f9986 BYTE_ORDER MSB_LAST BIT_MASK 0x10 /end MEASUREMENT
/begin MEASUREMENT fmy_stat_dip_pf_mes_eru.err_info_stat.err_sym "symptoms of the diagnosis instance DIP_PF_MES_ERU" UWORD _CNV_S_6_CONV_ERRM__27_CM 1 0. 0. 15. DISPLAY_IDENTIFIER ERR_SYM_DIP_PF_MES_ERU ECU_ADDRESS 0x7f9986 BYTE_ORDER MSB_LAST BIT_MASK 0xF /end MEASUREMENT
/begin MEASUREMENT lv_err_egr_is_slow_obd "Error flag of diagnosis instance EGR_IS_SLOW_OBD" UBYTE _CNV_S_2_RANGE______28_CM 1 0. 0. 1. DISPLAY_IDENTIFIER LV_ERR_EGR_IS_SLOW_OBD ECU_ADDRESS 0x7fb50b /end MEASUREMENT
/begin MEASUREMENT fmy_stat_egr_is_slow_obd.ctr_abc "anti bounce counter for diagnosis instance EGR_IS_SLOW_OBD" UBYTE _CNV_A_R_LINEAR_____1_CM 1 0. 0. 255. DISPLAY_IDENTIFIER CTR_ABC_EGR_IS_SLOW_OBD ECU_ADDRESS 0x7f9a1d FORMAT "%3.0" /end MEASUREMENT
/begin MEASUREMENT fmy_stat_egr_is_slow_obd.ctr_end_diag "counter for end of diagnosis for diagnosis instance EGR_IS_SLOW_OBD" UBYTE _CNV_A_R_LINEAR_____1_CM 1 0. 0. 255. DISPLAY_IDENTIFIER CTR_ABC_END_DIAG_EGR_IS_SLOW_OBD ECU_ADDRESS 0x7f9a1c FORMAT "%3.0" /end MEASUREMENT
/begin MEASUREMENT fmy_stat_egr_is_slow_obd.err_info_stat.reserved "" UWORD _CNV_A_R_LINEAR_____0_CM 1 0. 0. 65535. DISPLAY_IDENTIFIER FMY_STAT_EGR_IS_SLOW_OBD_ERR_INF ECU_ADDRESS 0x7f9a1a BYTE_ORDER MSB_LAST BIT_MASK 0xF800 /end MEASUREMENT
/begin MEASUREMENT fmy_stat_egr_is_slow_obd.err_info_stat.lv_cdn_diag_stc "Statistical flag for condition of diagnosis of the diagnosis instance EGR_IS_SLOW_OBD" UWORD _CNV_S_2_RANGE______380_CM 1 0. 0. 1. DISPLAY_IDENTIFIER LV_CDN_DIAG_STC_EGR_IS_SLOW_OBD ECU_ADDRESS 0x7f9a1a BYTE_ORDER MSB_LAST BIT_MASK 0x400 /end MEASUREMENT
/begin MEASUREMENT fmy_stat_egr_is_slow_obd.err_info_stat.lv_lock_diag "lock flag (CPU load optimisation) of the diagnosis instance EGR_IS_SLOW_OBD" UWORD _CNV_S_2_RANGE______380_CM 1 0. 0. 1. DISPLAY_IDENTIFIER LV_LOCK_DIAG_EGR_IS_SLOW_OBD ECU_ADDRESS 0x7f9a1a BYTE_ORDER MSB_LAST BIT_MASK 0x200 /end MEASUREMENT
/begin MEASUREMENT fmy_stat_egr_is_slow_obd.err_info_stat.lv_err_mem "storage in dynamic failure memory of the diagnosis instance EGR_IS_SLOW_OBD" UWORD _CNV_S_2_RANGE______380_CM 1 0. 0. 1. DISPLAY_IDENTIFIER LV_ERR_MEM_EGR_IS_SLOW_OBD ECU_ADDRESS 0x7f9a1a BYTE_ORDER MSB_LAST BIT_MASK 0x80 /end MEASUREMENT
/begin MEASUREMENT fmy_stat_egr_is_slow_obd.err_info_stat.lv_ready "readiness status of the diagnosis instance EGR_IS_SLOW_OBD" UWORD _CNV_S_2_RANGE______380_CM 1 0. 0. 1. DISPLAY_IDENTIFIER LV_READY_EGR_IS_SLOW_OBD ECU_ADDRESS 0x7f9a1a BYTE_ORDER MSB_LAST BIT_MASK 0x40 /end MEASUREMENT
/begin MEASUREMENT fmy_stat_egr_is_slow_obd.err_info_stat.lv_end_diag "end of diagnosis of the diagnosis instance EGR_IS_SLOW_OBD" UWORD _CNV_S_2_RANGE______380_CM 1 0. 0. 1. DISPLAY_IDENTIFIER LV_END_DIAG_EGR_IS_SLOW_OBD ECU_ADDRESS 0x7f9a1a BYTE_ORDER MSB_LAST BIT_MASK 0x20 /end MEASUREMENT
/begin MEASUREMENT fmy_stat_egr_is_slow_obd.err_info_stat.lv_cdn_diag "diagnosis condition of the diagnosis instance EGR_IS_SLOW_OBD" UWORD _CNV_S_2_RANGE______380_CM 1 0. 0. 1. DISPLAY_IDENTIFIER LV_CDN_DIAG_EGR_IS_SLOW_OBD ECU_ADDRESS 0x7f9a1a BYTE_ORDER MSB_LAST BIT_MASK 0x10 /end MEASUREMENT
/begin MEASUREMENT fmy_stat_egr_is_slow_obd.err_info_stat.err_sym "symptoms of the diagnosis instance EGR_IS_SLOW_OBD" UWORD _CNV_S_6_CONV_ERRM__27_CM 1 0. 0. 15. DISPLAY_IDENTIFIER ERR_SYM_EGR_IS_SLOW_OBD ECU_ADDRESS 0x7f9a1a BYTE_ORDER MSB_LAST BIT_MASK 0xF /end MEASUREMENT
/begin MEASUREMENT lv_err_egrv "Error flag of diagnosis instance EGRV" UBYTE _CNV_S_2_RANGE______28_CM 1 0. 0. 1. DISPLAY_IDENTIFIER LV_ERR_EGRV ECU_ADDRESS 0x7fb546 /end MEASUREMENT
/begin MEASUREMENT fmy_stat_egrv.ctr_abc "anti bounce counter for diagnosis instance EGRV" UBYTE _CNV_A_R_LINEAR_____1_CM 1 0. 0. 255. DISPLAY_IDENTIFIER CTR_ABC_EGRV ECU_ADDRESS 0x7f9b09 FORMAT "%3.0" /end MEASUREMENT
/begin MEASUREMENT fmy_stat_egrv.ctr_end_diag "counter for end of diagnosis for diagnosis instance EGRV" UBYTE _CNV_A_R_LINEAR_____1_CM 1 0. 0. 255. DISPLAY_IDENTIFIER CTR_ABC_END_DIAG_EGRV ECU_ADDRESS 0x7f9b08 FORMAT "%3.0" /end MEASUREMENT
/begin MEASUREMENT fmy_stat_egrv.err_info_stat.reserved "" UWORD _CNV_A_R_LINEAR_____0_CM 1 0. 0. 65535. DISPLAY_IDENTIFIER FMY_STAT_EGRV_ERR_INFO_STAT_RESE ECU_ADDRESS 0x7f9b06 BYTE_ORDER MSB_LAST BIT_MASK 0xF800 /end MEASUREMENT
/begin MEASUREMENT fmy_stat_egrv.err_info_stat.lv_cdn_diag_stc "Statistical flag for condition of diagnosis of the diagnosis instance EGRV" UWORD _CNV_S_2_RANGE______380_CM 1 0. 0. 1. DISPLAY_IDENTIFIER LV_CDN_DIAG_STC_EGRV ECU_ADDRESS 0x7f9b06 BYTE_ORDER MSB_LAST BIT_MASK 0x400 /end MEASUREMENT
/begin MEASUREMENT fmy_stat_egrv.err_info_stat.lv_lock_diag "lock flag (CPU load optimisation) of the diagnosis instance EGRV" UWORD _CNV_S_2_RANGE______380_CM 1 0. 0. 1. DISPLAY_IDENTIFIER LV_LOCK_DIAG_EGRV ECU_ADDRESS 0x7f9b06 BYTE_ORDER MSB_LAST BIT_MASK 0x200 /end MEASUREMENT
/begin MEASUREMENT fmy_stat_egrv.err_info_stat.lv_err_mem "storage in dynamic failure memory of the diagnosis instance EGRV" UWORD _CNV_S_2_RANGE______380_CM 1 0. 0. 1. DISPLAY_IDENTIFIER LV_ERR_MEM_EGRV ECU_ADDRESS 0x7f9b06 BYTE_ORDER MSB_LAST BIT_MASK 0x80 /end MEASUREMENT
/begin MEASUREMENT fmy_stat_egrv.err_info_stat.lv_ready "readiness status of the diagnosis instance EGRV" UWORD _CNV_S_2_RANGE______380_CM 1 0. 0. 1. DISPLAY_IDENTIFIER LV_READY_EGRV ECU_ADDRESS 0x7f9b06 BYTE_ORDER MSB_LAST BIT_MASK 0x40 /end MEASUREMENT
/begin MEASUREMENT fmy_stat_egrv.err_info_stat.lv_end_diag "end of diagnosis of the diagnosis instance EGRV" UWORD _CNV_S_2_RANGE______380_CM 1 0. 0. 1. DISPLAY_IDENTIFIER LV_END_DIAG_EGRV ECU_ADDRESS 0x7f9b06 BYTE_ORDER MSB_LAST BIT_MASK 0x20 /end MEASUREMENT
/begin MEASUREMENT fmy_stat_egrv.err_info_stat.lv_cdn_diag "diagnosis condition of the diagnosis instance EGRV" UWORD _CNV_S_2_RANGE______380_CM 1 0. 0. 1. DISPLAY_IDENTIFIER LV_CDN_DIAG_EGRV ECU_ADDRESS 0x7f9b06 BYTE_ORDER MSB_LAST BIT_MASK 0x10 /end MEASUREMENT
/begin MEASUREMENT fmy_stat_egrv.err_info_stat.err_sym "symptoms of the diagnosis instance EGRV" UWORD _CNV_S_6_CONV_ERRM__27_CM 1 0. 0. 15. DISPLAY_IDENTIFIER ERR_SYM_EGRV ECU_ADDRESS 0x7f9b06 BYTE_ORDER MSB_LAST BIT_MASK 0xF /end MEASUREMENT
/begin MEASUREMENT lv_err_fsd_1 "Error flag of diagnosis instance FSD_1" UBYTE _CNV_S_2_RANGE______28_CM 1 0. 0. 1. DISPLAY_IDENTIFIER LV_ERR_FSD_1 ECU_ADDRESS 0x7fb547 /end MEASUREMENT
/begin MEASUREMENT fmy_stat_fsd_1.ctr_abc "anti bounce counter for diagnosis instance FSD_1" UBYTE _CNV_A_R_LINEAR_____1_CM 1 0. 0. 255. DISPLAY_IDENTIFIER CTR_ABC_FSD_1 ECU_ADDRESS 0x7f9b0d FORMAT "%3.0" /end MEASUREMENT
/begin MEASUREMENT fmy_stat_fsd_1.ctr_end_diag "counter for end of diagnosis for diagnosis instance FSD_1" UBYTE _CNV_A_R_LINEAR_____1_CM 1 0. 0. 255. DISPLAY_IDENTIFIER CTR_ABC_END_DIAG_FSD_1 ECU_ADDRESS 0x7f9b0c FORMAT "%3.0" /end MEASUREMENT
/begin MEASUREMENT fmy_stat_fsd_1.err_info_stat.reserved "" UWORD _CNV_A_R_LINEAR_____0_CM 1 0. 0. 65535. DISPLAY_IDENTIFIER FMY_STAT_FSD_1_ERR_INFO_STAT_RES ECU_ADDRESS 0x7f9b0a BYTE_ORDER MSB_LAST BIT_MASK 0xF800 /end MEASUREMENT
/begin MEASUREMENT fmy_stat_fsd_1.err_info_stat.lv_cdn_diag_stc "Statistical flag for condition of diagnosis of the diagnosis instance FSD_1" UWORD _CNV_S_2_RANGE______380_CM 1 0. 0. 1. DISPLAY_IDENTIFIER LV_CDN_DIAG_STC_FSD_1 ECU_ADDRESS 0x7f9b0a BYTE_ORDER MSB_LAST BIT_MASK 0x400 /end MEASUREMENT
/begin MEASUREMENT fmy_stat_fsd_1.err_info_stat.lv_lock_diag "lock flag (CPU load optimisation) of the diagnosis instance FSD_1" UWORD _CNV_S_2_RANGE______380_CM 1 0. 0. 1. DISPLAY_IDENTIFIER LV_LOCK_DIAG_FSD_1 ECU_ADDRESS 0x7f9b0a BYTE_ORDER MSB_LAST BIT_MASK 0x200 /end MEASUREMENT
/begin MEASUREMENT fmy_stat_fsd_1.err_info_stat.lv_err_mem "storage in dynamic failure memory of the diagnosis instance FSD_1" UWORD _CNV_S_2_RANGE______380_CM 1 0. 0. 1. DISPLAY_IDENTIFIER LV_ERR_MEM_FSD_1 ECU_ADDRESS 0x7f9b0a BYTE_ORDER MSB_LAST BIT_MASK 0x80 /end MEASUREMENT
/begin MEASUREMENT fmy_stat_fsd_1.err_info_stat.lv_ready "readiness status of the diagnosis instance FSD_1" UWORD _CNV_S_2_RANGE______380_CM 1 0. 0. 1. DISPLAY_IDENTIFIER LV_READY_FSD_1 ECU_ADDRESS 0x7f9b0a BYTE_ORDER MSB_LAST BIT_MASK 0x40 /end MEASUREMENT
/begin MEASUREMENT fmy_stat_fsd_1.err_info_stat.lv_end_diag "end of diagnosis of the diagnosis instance FSD_1" UWORD _CNV_S_2_RANGE______380_CM 1 0. 0. 1. DISPLAY_IDENTIFIER LV_END_DIAG_FSD_1 ECU_ADDRESS 0x7f9b0a BYTE_ORDER MSB_LAST BIT_MASK 0x20 /end MEASUREMENT
/begin MEASUREMENT fmy_stat_fsd_1.err_info_stat.lv_cdn_diag "diagnosis condition of the diagnosis instance FSD_1" UWORD _CNV_S_2_RANGE______380_CM 1 0. 0. 1. DISPLAY_IDENTIFIER LV_CDN_DIAG_FSD_1 ECU_ADDRESS 0x7f9b0a BYTE_ORDER MSB_LAST BIT_MASK 0x10 /end MEASUREMENT
/begin MEASUREMENT fmy_stat_fsd_1.err_info_stat.err_sym "symptoms of the diagnosis instance FSD_1" UWORD _CNV_S_6_CONV_ERRM__27_CM 1 0. 0. 15. DISPLAY_IDENTIFIER ERR_SYM_FSD_1 ECU_ADDRESS 0x7f9b0a BYTE_ORDER MSB_LAST BIT_MASK 0xF /end MEASUREMENT
/begin MEASUREMENT lv_err_mis_a "Error flag of diagnosis instance MIS_A" UBYTE _CNV_S_2_RANGE______28_CM 1 0. 0. 1. DISPLAY_IDENTIFIER LV_ERR_MIS_A ECU_ADDRESS 0x7fb549 /end MEASUREMENT
/begin MEASUREMENT fmy_stat_mis_a.ctr_abc "anti bounce counter for diagnosis instance MIS_A" UBYTE _CNV_A_R_LINEAR_____1_CM 1 0. 0. 255. DISPLAY_IDENTIFIER CTR_ABC_MIS_A ECU_ADDRESS 0x7f9b15 FORMAT "%3.0" /end MEASUREMENT
/begin MEASUREMENT fmy_stat_mis_a.ctr_end_diag "counter for end of diagnosis for diagnosis instance MIS_A" UBYTE _CNV_A_R_LINEAR_____1_CM 1 0. 0. 255. DISPLAY_IDENTIFIER CTR_ABC_END_DIAG_MIS_A ECU_ADDRESS 0x7f9b14 FORMAT "%3.0" /end MEASUREMENT
/begin MEASUREMENT fmy_stat_mis_a.err_info_stat.reserved "" UWORD _CNV_A_R_LINEAR_____0_CM 1 0. 0. 65535. DISPLAY_IDENTIFIER FMY_STAT_MIS_A_ERR_INFO_STAT_RES ECU_ADDRESS 0x7f9b12 BYTE_ORDER MSB_LAST BIT_MASK 0xF800 /end MEASUREMENT
/begin MEASUREMENT fmy_stat_mis_a.err_info_stat.lv_cdn_diag_stc "Statistical flag for condition of diagnosis of the diagnosis instance MIS_A" UWORD _CNV_S_2_RANGE______380_CM 1 0. 0. 1. DISPLAY_IDENTIFIER LV_CDN_DIAG_STC_MIS_A ECU_ADDRESS 0x7f9b12 BYTE_ORDER MSB_LAST BIT_MASK 0x400 /end MEASUREMENT
/begin MEASUREMENT fmy_stat_mis_a.err_info_stat.lv_lock_diag "lock flag (CPU load optimisation) of the diagnosis instance MIS_A" UWORD _CNV_S_2_RANGE______380_CM 1 0. 0. 1. DISPLAY_IDENTIFIER LV_LOCK_DIAG_MIS_A ECU_ADDRESS 0x7f9b12 BYTE_ORDER MSB_LAST BIT_MASK 0x200 /end MEASUREMENT
/begin MEASUREMENT fmy_stat_mis_a.err_info_stat.lv_err_mem "storage in dynamic failure memory of the diagnosis instance MIS_A" UWORD _CNV_S_2_RANGE______380_CM 1 0. 0. 1. DISPLAY_IDENTIFIER LV_ERR_MEM_MIS_A ECU_ADDRESS 0x7f9b12 BYTE_ORDER MSB_LAST BIT_MASK 0x80 /end MEASUREMENT
/begin MEASUREMENT fmy_stat_mis_a.err_info_stat.lv_ready "readiness status of the diagnosis instance MIS_A" UWORD _CNV_S_2_RANGE______380_CM 1 0. 0. 1. DISPLAY_IDENTIFIER LV_READY_MIS_A ECU_ADDRESS 0x7f9b12 BYTE_ORDER MSB_LAST BIT_MASK 0x40 /end MEASUREMENT
/begin MEASUREMENT fmy_stat_mis_a.err_info_stat.lv_end_diag "end of diagnosis of the diagnosis instance MIS_A" UWORD _CNV_S_2_RANGE______380_CM 1 0. 0. 1. DISPLAY_IDENTIFIER LV_END_DIAG_MIS_A ECU_ADDRESS 0x7f9b12 BYTE_ORDER MSB_LAST BIT_MASK 0x20 /end MEASUREMENT
/begin MEASUREMENT fmy_stat_mis_a.err_info_stat.lv_cdn_diag "diagnosis condition of the diagnosis instance MIS_A" UWORD _CNV_S_2_RANGE______380_CM 1 0. 0. 1. DISPLAY_IDENTIFIER LV_CDN_DIAG_MIS_A ECU_ADDRESS 0x7f9b12 BYTE_ORDER MSB_LAST BIT_MASK 0x10 /end MEASUREMENT
/begin MEASUREMENT fmy_stat_mis_a.err_info_stat.err_sym "symptoms of the diagnosis instance MIS_A" UWORD _CNV_S_6_CONV_ERRM__27_CM 1 0. 0. 15. DISPLAY_IDENTIFIER ERR_SYM_MIS_A ECU_ADDRESS 0x7f9b12 BYTE_ORDER MSB_LAST BIT_MASK 0xF /end MEASUREMENT
/begin MEASUREMENT lv_err_mis_b1 "Error flag of diagnosis instance MIS_B1" UBYTE _CNV_S_2_RANGE______28_CM 1 0. 0. 1. DISPLAY_IDENTIFIER LV_ERR_MIS_B1 ECU_ADDRESS 0x7fb54a /end MEASUREMENT
/begin MEASUREMENT fmy_stat_mis_b1.ctr_abc "anti bounce counter for diagnosis instance MIS_B1" UBYTE _CNV_A_R_LINEAR_____1_CM 1 0. 0. 255. DISPLAY_IDENTIFIER CTR_ABC_MIS_B1 ECU_ADDRESS 0x7f9b19 FORMAT "%3.0" /end MEASUREMENT
/begin MEASUREMENT fmy_stat_mis_b1.ctr_end_diag "counter for end of diagnosis for diagnosis instance MIS_B1" UBYTE _CNV_A_R_LINEAR_____1_CM 1 0. 0. 255. DISPLAY_IDENTIFIER CTR_ABC_END_DIAG_MIS_B1 ECU_ADDRESS 0x7f9b18 FORMAT "%3.0" /end MEASUREMENT
/begin MEASUREMENT fmy_stat_mis_b1.err_info_stat.reserved "" UWORD _CNV_A_R_LINEAR_____0_CM 1 0. 0. 65535. DISPLAY_IDENTIFIER FMY_STAT_MIS_B1_ERR_INFO_STAT_RE ECU_ADDRESS 0x7f9b16 BYTE_ORDER MSB_LAST BIT_MASK 0xF800 /end MEASUREMENT
/begin MEASUREMENT fmy_stat_mis_b1.err_info_stat.lv_cdn_diag_stc "Statistical flag for condition of diagnosis of the diagnosis instance MIS_B1" UWORD _CNV_S_2_RANGE______380_CM 1 0. 0. 1. DISPLAY_IDENTIFIER LV_CDN_DIAG_STC_MIS_B1 ECU_ADDRESS 0x7f9b16 BYTE_ORDER MSB_LAST BIT_MASK 0x400 /end MEASUREMENT
/begin MEASUREMENT fmy_stat_mis_b1.err_info_stat.lv_lock_diag "lock flag (CPU load optimisation) of the diagnosis instance MIS_B1" UWORD _CNV_S_2_RANGE______380_CM 1 0. 0. 1. DISPLAY_IDENTIFIER LV_LOCK_DIAG_MIS_B1 ECU_ADDRESS 0x7f9b16 BYTE_ORDER MSB_LAST BIT_MASK 0x200 /end MEASUREMENT
/begin MEASUREMENT fmy_stat_mis_b1.err_info_stat.lv_err_mem "storage in dynamic failure memory of the diagnosis instance MIS_B1" UWORD _CNV_S_2_RANGE______380_CM 1 0. 0. 1. DISPLAY_IDENTIFIER LV_ERR_MEM_MIS_B1 ECU_ADDRESS 0x7f9b16 BYTE_ORDER MSB_LAST BIT_MASK 0x80 /end MEASUREMENT
/begin MEASUREMENT fmy_stat_mis_b1.err_info_stat.lv_ready "readiness status of the diagnosis instance MIS_B1" UWORD _CNV_S_2_RANGE______380_CM 1 0. 0. 1. DISPLAY_IDENTIFIER LV_READY_MIS_B1 ECU_ADDRESS 0x7f9b16 BYTE_ORDER MSB_LAST BIT_MASK 0x40 /end MEASUREMENT
/begin MEASUREMENT fmy_stat_mis_b1.err_info_stat.lv_end_diag "end of diagnosis of the diagnosis instance MIS_B1" UWORD _CNV_S_2_RANGE______380_CM 1 0. 0. 1. DISPLAY_IDENTIFIER LV_END_DIAG_MIS_B1 ECU_ADDRESS 0x7f9b16 BYTE_ORDER MSB_LAST BIT_MASK 0x20 /end MEASUREMENT
/begin MEASUREMENT fmy_stat_mis_b1.err_info_stat.lv_cdn_diag "diagnosis condition of the diagnosis instance MIS_B1" UWORD _CNV_S_2_RANGE______380_CM 1 0. 0. 1. DISPLAY_IDENTIFIER LV_CDN_DIAG_MIS_B1 ECU_ADDRESS 0x7f9b16 BYTE_ORDER MSB_LAST BIT_MASK 0x10 /end MEASUREMENT
/begin MEASUREMENT fmy_stat_mis_b1.err_info_stat.err_sym "symptoms of the diagnosis instance MIS_B1" UWORD _CNV_S_6_CONV_ERRM__27_CM 1 0. 0. 15. DISPLAY_IDENTIFIER ERR_SYM_MIS_B1 ECU_ADDRESS 0x7f9b16 BYTE_ORDER MSB_LAST BIT_MASK 0xF /end MEASUREMENT
/begin MEASUREMENT lv_err_mis_b4 "Error flag of diagnosis instance MIS_B4" UBYTE _CNV_S_2_RANGE______28_CM 1 0. 0. 1. DISPLAY_IDENTIFIER LV_ERR_MIS_B4 ECU_ADDRESS 0x7fb54b /end MEASUREMENT
/begin MEASUREMENT fmy_stat_mis_b4.ctr_abc "anti bounce counter for diagnosis instance MIS_B4" UBYTE _CNV_A_R_LINEAR_____1_CM 1 0. 0. 255. DISPLAY_IDENTIFIER CTR_ABC_MIS_B4 ECU_ADDRESS 0x7f9b1d FORMAT "%3.0" /end MEASUREMENT
/begin MEASUREMENT fmy_stat_mis_b4.ctr_end_diag "counter for end of diagnosis for diagnosis instance MIS_B4" UBYTE _CNV_A_R_LINEAR_____1_CM 1 0. 0. 255. DISPLAY_IDENTIFIER CTR_ABC_END_DIAG_MIS_B4 ECU_ADDRESS 0x7f9b1c FORMAT "%3.0" /end MEASUREMENT
/begin MEASUREMENT fmy_stat_mis_b4.err_info_stat.reserved "" UWORD _CNV_A_R_LINEAR_____0_CM 1 0. 0. 65535. DISPLAY_IDENTIFIER FMY_STAT_MIS_B4_ERR_INFO_STAT_RE ECU_ADDRESS 0x7f9b1a BYTE_ORDER MSB_LAST BIT_MASK 0xF800 /end MEASUREMENT
/begin MEASUREMENT fmy_stat_mis_b4.err_info_stat.lv_cdn_diag_stc "Statistical flag for condition of diagnosis of the diagnosis instance MIS_B4" UWORD _CNV_S_2_RANGE______380_CM 1 0. 0. 1. DISPLAY_IDENTIFIER LV_CDN_DIAG_STC_MIS_B4 ECU_ADDRESS 0x7f9b1a BYTE_ORDER MSB_LAST BIT_MASK 0x400 /end MEASUREMENT
/begin MEASUREMENT fmy_stat_mis_b4.err_info_stat.lv_lock_diag "lock flag (CPU load optimisation) of the diagnosis instance MIS_B4" UWORD _CNV_S_2_RANGE______380_CM 1 0. 0. 1. DISPLAY_IDENTIFIER LV_LOCK_DIAG_MIS_B4 ECU_ADDRESS 0x7f9b1a BYTE_ORDER MSB_LAST BIT_MASK 0x200 /end MEASUREMENT
/begin MEASUREMENT fmy_stat_mis_b4.err_info_stat.lv_err_mem "storage in dynamic failure memory of the diagnosis instance MIS_B4" UWORD _CNV_S_2_RANGE______380_CM 1 0. 0. 1. DISPLAY_IDENTIFIER LV_ERR_MEM_MIS_B4 ECU_ADDRESS 0x7f9b1a BYTE_ORDER MSB_LAST BIT_MASK 0x80 /end MEASUREMENT
/begin MEASUREMENT fmy_stat_mis_b4.err_info_stat.lv_ready "readiness status of the diagnosis instance MIS_B4" UWORD _CNV_S_2_RANGE______380_CM 1 0. 0. 1. DISPLAY_IDENTIFIER LV_READY_MIS_B4 ECU_ADDRESS 0x7f9b1a BYTE_ORDER MSB_LAST BIT_MASK 0x40 /end MEASUREMENT
/begin MEASUREMENT fmy_stat_mis_b4.err_info_stat.lv_end_diag "end of diagnosis of the diagnosis instance MIS_B4" UWORD _CNV_S_2_RANGE______380_CM 1 0. 0. 1. DISPLAY_IDENTIFIER LV_END_DIAG_MIS_B4 ECU_ADDRESS 0x7f9b1a BYTE_ORDER MSB_LAST BIT_MASK 0x20 /end MEASUREMENT
/begin MEASUREMENT fmy_stat_mis_b4.err_info_stat.lv_cdn_diag "diagnosis condition of the diagnosis instance MIS_B4" UWORD _CNV_S_2_RANGE______380_CM 1 0. 0. 1. DISPLAY_IDENTIFIER LV_CDN_DIAG_MIS_B4 ECU_ADDRESS 0x7f9b1a BYTE_ORDER MSB_LAST BIT_MASK 0x10 /end MEASUREMENT
/begin MEASUREMENT fmy_stat_mis_b4.err_info_stat.err_sym "symptoms of the diagnosis instance MIS_B4" UWORD _CNV_S_6_CONV_ERRM__27_CM 1 0. 0. 15. DISPLAY_IDENTIFIER ERR_SYM_MIS_B4 ECU_ADDRESS 0x7f9b1a BYTE_ORDER MSB_LAST BIT_MASK 0xF /end MEASUREMENT
/begin MEASUREMENT lv_err_pcv_2 "Error flag of diagnosis instance PCV_2" UBYTE _CNV_S_2_RANGE______28_CM 1 0. 0. 1. DISPLAY_IDENTIFIER LV_ERR_PCV_2 ECU_ADDRESS 0x7fb54d /end MEASUREMENT
/begin MEASUREMENT fmy_stat_pcv_2.ctr_abc "anti bounce counter for diagnosis instance PCV_2" UBYTE _CNV_A_R_LINEAR_____1_CM 1 0. 0. 255. DISPLAY_IDENTIFIER CTR_ABC_PCV_2 ECU_ADDRESS 0x7f9b25 FORMAT "%3.0" /end MEASUREMENT
/begin MEASUREMENT fmy_stat_pcv_2.ctr_end_diag "counter for end of diagnosis for diagnosis instance PCV_2" UBYTE _CNV_A_R_LINEAR_____1_CM 1 0. 0. 255. DISPLAY_IDENTIFIER CTR_ABC_END_DIAG_PCV_2 ECU_ADDRESS 0x7f9b24 FORMAT "%3.0" /end MEASUREMENT
/begin MEASUREMENT fmy_stat_pcv_2.err_info_stat.reserved "" UWORD _CNV_A_R_LINEAR_____0_CM 1 0. 0. 65535. DISPLAY_IDENTIFIER FMY_STAT_PCV_2_ERR_INFO_STAT_RES ECU_ADDRESS 0x7f9b22 BYTE_ORDER MSB_LAST BIT_MASK 0xF800 /end MEASUREMENT
/begin MEASUREMENT fmy_stat_pcv_2.err_info_stat.lv_cdn_diag_stc "Statistical flag for condition of diagnosis of the diagnosis instance PCV_2" UWORD _CNV_S_2_RANGE______380_CM 1 0. 0. 1. DISPLAY_IDENTIFIER LV_CDN_DIAG_STC_PCV_2 ECU_ADDRESS 0x7f9b22 BYTE_ORDER MSB_LAST BIT_MASK 0x400 /end MEASUREMENT
/begin MEASUREMENT fmy_stat_pcv_2.err_info_stat.lv_lock_diag "lock flag (CPU load optimisation) of the diagnosis instance PCV_2" UWORD _CNV_S_2_RANGE______380_CM 1 0. 0. 1. DISPLAY_IDENTIFIER LV_LOCK_DIAG_PCV_2 ECU_ADDRESS 0x7f9b22 BYTE_ORDER MSB_LAST BIT_MASK 0x200 /end MEASUREMENT
/begin MEASUREMENT fmy_stat_pcv_2.err_info_stat.lv_err_mem "storage in dynamic failure memory of the diagnosis instance PCV_2" UWORD _CNV_S_2_RANGE______380_CM 1 0. 0. 1. DISPLAY_IDENTIFIER LV_ERR_MEM_PCV_2 ECU_ADDRESS 0x7f9b22 BYTE_ORDER MSB_LAST BIT_MASK 0x80 /end MEASUREMENT
/begin MEASUREMENT fmy_stat_pcv_2.err_info_stat.lv_ready "readiness status of the diagnosis instance PCV_2" UWORD _CNV_S_2_RANGE______380_CM 1 0. 0. 1. DISPLAY_IDENTIFIER LV_READY_PCV_2 ECU_ADDRESS 0x7f9b22 BYTE_ORDER MSB_LAST BIT_MASK 0x40 /end MEASUREMENT
/begin MEASUREMENT fmy_stat_pcv_2.err_info_stat.lv_end_diag "end of diagnosis of the diagnosis instance PCV_2" UWORD _CNV_S_2_RANGE______380_CM 1 0. 0. 1. DISPLAY_IDENTIFIER LV_END_DIAG_PCV_2 ECU_ADDRESS 0x7f9b22 BYTE_ORDER MSB_LAST BIT_MASK 0x20 /end MEASUREMENT
/begin MEASUREMENT fmy_stat_pcv_2.err_info_stat.lv_cdn_diag "diagnosis condition of the diagnosis instance PCV_2" UWORD _CNV_S_2_RANGE______380_CM 1 0. 0. 1. DISPLAY_IDENTIFIER LV_CDN_DIAG_PCV_2 ECU_ADDRESS 0x7f9b22 BYTE_ORDER MSB_LAST BIT_MASK 0x10 /end MEASUREMENT
/begin MEASUREMENT fmy_stat_pcv_2.err_info_stat.err_sym "symptoms of the diagnosis instance PCV_2" UWORD _CNV_S_6_CONV_ERRM__27_CM 1 0. 0. 15. DISPLAY_IDENTIFIER ERR_SYM_PCV_2 ECU_ADDRESS 0x7f9b22 BYTE_ORDER MSB_LAST BIT_MASK 0xF /end MEASUREMENT
/begin MEASUREMENT lv_err_thr "Error flag of diagnosis instance THR" UBYTE _CNV_S_2_RANGE______28_CM 1 0. 0. 1. DISPLAY_IDENTIFIER LV_ERR_THR ECU_ADDRESS 0x7fb551 /end MEASUREMENT
/begin MEASUREMENT fmy_stat_thr.ctr_abc "anti bounce counter for diagnosis instance THR" UBYTE _CNV_A_R_LINEAR_____1_CM 1 0. 0. 255. DISPLAY_IDENTIFIER CTR_ABC_THR ECU_ADDRESS 0x7f9b35 FORMAT "%3.0" /end MEASUREMENT
/begin MEASUREMENT fmy_stat_thr.ctr_end_diag "counter for end of diagnosis for diagnosis instance THR" UBYTE _CNV_A_R_LINEAR_____1_CM 1 0. 0. 255. DISPLAY_IDENTIFIER CTR_ABC_END_DIAG_THR ECU_ADDRESS 0x7f9b34 FORMAT "%3.0" /end MEASUREMENT
/begin MEASUREMENT fmy_stat_thr.err_info_stat.reserved "" UWORD _CNV_A_R_LINEAR_____0_CM 1 0. 0. 65535. DISPLAY_IDENTIFIER FMY_STAT_THR_ERR_INFO_STAT_RESER ECU_ADDRESS 0x7f9b32 BYTE_ORDER MSB_LAST BIT_MASK 0xF800 /end MEASUREMENT
/begin MEASUREMENT fmy_stat_thr.err_info_stat.lv_cdn_diag_stc "Statistical flag for condition of diagnosis of the diagnosis instance THR" UWORD _CNV_S_2_RANGE______380_CM 1 0. 0. 1. DISPLAY_IDENTIFIER LV_CDN_DIAG_STC_THR ECU_ADDRESS 0x7f9b32 BYTE_ORDER MSB_LAST BIT_MASK 0x400 /end MEASUREMENT
/begin MEASUREMENT fmy_stat_thr.err_info_stat.lv_lock_diag "lock flag (CPU load optimisation) of the diagnosis instance THR" UWORD _CNV_S_2_RANGE______380_CM 1 0. 0. 1. DISPLAY_IDENTIFIER LV_LOCK_DIAG_THR ECU_ADDRESS 0x7f9b32 BYTE_ORDER MSB_LAST BIT_MASK 0x200 /end MEASUREMENT
/begin MEASUREMENT fmy_stat_thr.err_info_stat.lv_err_mem "storage in dynamic failure memory of the diagnosis instance THR" UWORD _CNV_S_2_RANGE______380_CM 1 0. 0. 1. DISPLAY_IDENTIFIER LV_ERR_MEM_THR ECU_ADDRESS 0x7f9b32 BYTE_ORDER MSB_LAST BIT_MASK 0x80 /end MEASUREMENT
/begin MEASUREMENT fmy_stat_thr.err_info_stat.lv_ready "readiness status of the diagnosis instance THR" UWORD _CNV_S_2_RANGE______380_CM 1 0. 0. 1. DISPLAY_IDENTIFIER LV_READY_THR ECU_ADDRESS 0x7f9b32 BYTE_ORDER MSB_LAST BIT_MASK 0x40 /end MEASUREMENT
/begin MEASUREMENT fmy_stat_thr.err_info_stat.lv_end_diag "end of diagnosis of the diagnosis instance THR" UWORD _CNV_S_2_RANGE______380_CM 1 0. 0. 1. DISPLAY_IDENTIFIER LV_END_DIAG_THR ECU_ADDRESS 0x7f9b32 BYTE_ORDER MSB_LAST BIT_MASK 0x20 /end MEASUREMENT
/begin MEASUREMENT fmy_stat_thr.err_info_stat.lv_cdn_diag "diagnosis condition of the diagnosis instance THR" UWORD _CNV_S_2_RANGE______380_CM 1 0. 0. 1. DISPLAY_IDENTIFIER LV_CDN_DIAG_THR ECU_ADDRESS 0x7f9b32 BYTE_ORDER MSB_LAST BIT_MASK 0x10 /end MEASUREMENT
/begin MEASUREMENT fmy_stat_thr.err_info_stat.err_sym "symptoms of the diagnosis instance THR" UWORD _CNV_S_6_CONV_ERRM__27_CM 1 0. 0. 15. DISPLAY_IDENTIFIER ERR_SYM_THR ECU_ADDRESS 0x7f9b32 BYTE_ORDER MSB_LAST BIT_MASK 0xF /end MEASUREMENT
/begin MEASUREMENT lv_err_var_cod "Error flag of diagnosis instance VAR_COD" UBYTE _CNV_S_2_RANGE______28_CM 1 0. 0. 1. DISPLAY_IDENTIFIER LV_ERR_VAR_COD ECU_ADDRESS 0x7fb552 /end MEASUREMENT
/begin MEASUREMENT fmy_stat_var_cod.ctr_abc "anti bounce counter for diagnosis instance VAR_COD" UBYTE _CNV_A_R_LINEAR_____1_CM 1 0. 0. 255. DISPLAY_IDENTIFIER CTR_ABC_VAR_COD ECU_ADDRESS 0x7f9b39 FORMAT "%3.0" /end MEASUREMENT
/begin MEASUREMENT fmy_stat_var_cod.ctr_end_diag "counter for end of diagnosis for diagnosis instance VAR_COD" UBYTE _CNV_A_R_LINEAR_____1_CM 1 0. 0. 255. DISPLAY_IDENTIFIER CTR_ABC_END_DIAG_VAR_COD ECU_ADDRESS 0x7f9b38 FORMAT "%3.0" /end MEASUREMENT
/begin MEASUREMENT fmy_stat_var_cod.err_info_stat.reserved "" UWORD _CNV_A_R_LINEAR_____0_CM 1 0. 0. 65535. DISPLAY_IDENTIFIER FMY_STAT_VAR_COD_ERR_INFO_STAT_R ECU_ADDRESS 0x7f9b36 BYTE_ORDER MSB_LAST BIT_MASK 0xF800 /end MEASUREMENT
/begin MEASUREMENT fmy_stat_var_cod.err_info_stat.lv_cdn_diag_stc "Statistical flag for condition of diagnosis of the diagnosis instance VAR_COD" UWORD _CNV_S_2_RANGE______380_CM 1 0. 0. 1. DISPLAY_IDENTIFIER LV_CDN_DIAG_STC_VAR_COD ECU_ADDRESS 0x7f9b36 BYTE_ORDER MSB_LAST BIT_MASK 0x400 /end MEASUREMENT
/begin MEASUREMENT fmy_stat_var_cod.err_info_stat.lv_lock_diag "lock flag (CPU load optimisation) of the diagnosis instance VAR_COD" UWORD _CNV_S_2_RANGE______380_CM 1 0. 0. 1. DISPLAY_IDENTIFIER LV_LOCK_DIAG_VAR_COD ECU_ADDRESS 0x7f9b36 BYTE_ORDER MSB_LAST BIT_MASK 0x200 /end MEASUREMENT
/begin MEASUREMENT fmy_stat_var_cod.err_info_stat.lv_err_mem "storage in dynamic failure memory of the diagnosis instance VAR_COD" UWORD _CNV_S_2_RANGE______380_CM 1 0. 0. 1. DISPLAY_IDENTIFIER LV_ERR_MEM_VAR_COD ECU_ADDRESS 0x7f9b36 BYTE_ORDER MSB_LAST BIT_MASK 0x80 /end MEASUREMENT
/begin MEASUREMENT fmy_stat_var_cod.err_info_stat.lv_ready "readiness status of the diagnosis instance VAR_COD" UWORD _CNV_S_2_RANGE______380_CM 1 0. 0. 1. DISPLAY_IDENTIFIER LV_READY_VAR_COD ECU_ADDRESS 0x7f9b36 BYTE_ORDER MSB_LAST BIT_MASK 0x40 /end MEASUREMENT
/begin MEASUREMENT fmy_stat_var_cod.err_info_stat.lv_end_diag "end of diagnosis of the diagnosis instance VAR_COD" UWORD _CNV_S_2_RANGE______380_CM 1 0. 0. 1. DISPLAY_IDENTIFIER LV_END_DIAG_VAR_COD ECU_ADDRESS 0x7f9b36 BYTE_ORDER MSB_LAST BIT_MASK 0x20 /end MEASUREMENT
/begin MEASUREMENT fmy_stat_var_cod.err_info_stat.lv_cdn_diag "diagnosis condition of the diagnosis instance VAR_COD" UWORD _CNV_S_2_RANGE______380_CM 1 0. 0. 1. DISPLAY_IDENTIFIER LV_CDN_DIAG_VAR_COD ECU_ADDRESS 0x7f9b36 BYTE_ORDER MSB_LAST BIT_MASK 0x10 /end MEASUREMENT
/begin MEASUREMENT fmy_stat_var_cod.err_info_stat.err_sym "symptoms of the diagnosis instance VAR_COD" UWORD _CNV_S_6_CONV_ERRM__27_CM 1 0. 0. 15. DISPLAY_IDENTIFIER ERR_SYM_VAR_COD ECU_ADDRESS 0x7f9b36 BYTE_ORDER MSB_LAST BIT_MASK 0xF /end MEASUREMENT
/begin MEASUREMENT lv_err_vcv_2 "Error flag of diagnosis instance VCV_2" UBYTE _CNV_S_2_RANGE______28_CM 1 0. 0. 1. DISPLAY_IDENTIFIER LV_ERR_VCV_2 ECU_ADDRESS 0x7fb555 /end MEASUREMENT
/begin MEASUREMENT fmy_stat_vcv_2.ctr_abc "anti bounce counter for diagnosis instance VCV_2" UBYTE _CNV_A_R_LINEAR_____1_CM 1 0. 0. 255. DISPLAY_IDENTIFIER CTR_ABC_VCV_2 ECU_ADDRESS 0x7f9b45 FORMAT "%3.0" /end MEASUREMENT
/begin MEASUREMENT fmy_stat_vcv_2.ctr_end_diag "counter for end of diagnosis for diagnosis instance VCV_2" UBYTE _CNV_A_R_LINEAR_____1_CM 1 0. 0. 255. DISPLAY_IDENTIFIER CTR_ABC_END_DIAG_VCV_2 ECU_ADDRESS 0x7f9b44 FORMAT "%3.0" /end MEASUREMENT
/begin MEASUREMENT fmy_stat_vcv_2.err_info_stat.reserved "" UWORD _CNV_A_R_LINEAR_____0_CM 1 0. 0. 65535. DISPLAY_IDENTIFIER FMY_STAT_VCV_2_ERR_INFO_STAT_RES ECU_ADDRESS 0x7f9b42 BYTE_ORDER MSB_LAST BIT_MASK 0xF800 /end MEASUREMENT
/begin MEASUREMENT fmy_stat_vcv_2.err_info_stat.lv_cdn_diag_stc "Statistical flag for condition of diagnosis of the diagnosis instance VCV_2" UWORD _CNV_S_2_RANGE______380_CM 1 0. 0. 1. DISPLAY_IDENTIFIER LV_CDN_DIAG_STC_VCV_2 ECU_ADDRESS 0x7f9b42 BYTE_ORDER MSB_LAST BIT_MASK 0x400 /end MEASUREMENT
/begin MEASUREMENT fmy_stat_vcv_2.err_info_stat.lv_lock_diag "lock flag (CPU load optimisation) of the diagnosis instance VCV_2" UWORD _CNV_S_2_RANGE______380_CM 1 0. 0. 1. DISPLAY_IDENTIFIER LV_LOCK_DIAG_VCV_2 ECU_ADDRESS 0x7f9b42 BYTE_ORDER MSB_LAST BIT_MASK 0x200 /end MEASUREMENT
/begin MEASUREMENT fmy_stat_vcv_2.err_info_stat.lv_err_mem "storage in dynamic failure memory of the diagnosis instance VCV_2" UWORD _CNV_S_2_RANGE______380_CM 1 0. 0. 1. DISPLAY_IDENTIFIER LV_ERR_MEM_VCV_2 ECU_ADDRESS 0x7f9b42 BYTE_ORDER MSB_LAST BIT_MASK 0x80 /end MEASUREMENT
/begin MEASUREMENT fmy_stat_vcv_2.err_info_stat.lv_ready "readiness status of the diagnosis instance VCV_2" UWORD _CNV_S_2_RANGE______380_CM 1 0. 0. 1. DISPLAY_IDENTIFIER LV_READY_VCV_2 ECU_ADDRESS 0x7f9b42 BYTE_ORDER MSB_LAST BIT_MASK 0x40 /end MEASUREMENT
/begin MEASUREMENT fmy_stat_vcv_2.err_info_stat.lv_end_diag "end of diagnosis of the diagnosis instance VCV_2" UWORD _CNV_S_2_RANGE______380_CM 1 0. 0. 1. DISPLAY_IDENTIFIER LV_END_DIAG_VCV_2 ECU_ADDRESS 0x7f9b42 BYTE_ORDER MSB_LAST BIT_MASK 0x20 /end MEASUREMENT
/begin MEASUREMENT fmy_stat_vcv_2.err_info_stat.lv_cdn_diag "diagnosis condition of the diagnosis instance VCV_2" UWORD _CNV_S_2_RANGE______380_CM 1 0. 0. 1. DISPLAY_IDENTIFIER LV_CDN_DIAG_VCV_2 ECU_ADDRESS 0x7f9b42 BYTE_ORDER MSB_LAST BIT_MASK 0x10 /end MEASUREMENT
/begin MEASUREMENT fmy_stat_vcv_2.err_info_stat.err_sym "symptoms of the diagnosis instance VCV_2" UWORD _CNV_S_6_CONV_ERRM__27_CM 1 0. 0. 15. DISPLAY_IDENTIFIER ERR_SYM_VCV_2 ECU_ADDRESS 0x7f9b42 BYTE_ORDER MSB_LAST BIT_MASK 0xF /end MEASUREMENT
/begin COMPU_METHOD _CNV_A_R_LINEAR_____0_CM "" RAT_FUNC "%6.3" "[-]" COEFFS 0 1. 0. 0 0 1 /end COMPU_METHOD
/begin COMPU_METHOD _CNV_A_R_LINEAR_____1_CM "" RAT_FUNC "%6.3" "-" COEFFS 0 1. 0. 0 0 1 /end COMPU_METHOD
/begin COMPU_METHOD _CNV_A_R_LINEAR_____5_CM "" RAT_FUNC "%6.3" "[rpm]" COEFFS 0 1. 0. 0 0 1 /end COMPU_METHOD
/begin COMPU_METHOD _CNV_S_2_RANGE______11_CM "" TAB_VERB "%6.3" "[-]" COMPU_TAB_REF _CNV_S_2_RANGE______11 /end COMPU_METHOD
/begin COMPU_VTAB _CNV_S_2_RANGE______11 "" TAB_VERB 2 0 "0" 1 "1" /end COMPU_VTAB
/begin COMPU_METHOD _CNV_A_R_LINEAR_____15_CM "" RAT_FUNC "%6.3" "[-]" COEFFS 0 16384. 0. 0 0 1 /end COMPU_METHOD
/begin COMPU_METHOD _CNV_A_R_LINEAR_____18_CM "" RAT_FUNC "%6.3" "[°C]" COEFFS 0 1. 50. 0 0 1 /end COMPU_METHOD
/begin COMPU_METHOD _CNV_A_R_LINEAR_____19_CM "" RAT_FUNC "%6.3" "[s]" COEFFS 0 10. 0. 0 0 1 /end COMPU_METHOD
/begin COMPU_METHOD _CNV_A_R_LINEAR_____24_CM "" RAT_FUNC "%6.3" "[-]" COEFFS 0 128. 0. 0 0 1 /end COMPU_METHOD
/begin COMPU_METHOD _CNV_S_6_CONV_ERRM__27_CM "" TAB_VERB "%6.3" "[-]" COMPU_TAB_REF _CNV_S_6_CONV_ERRM__27 /end COMPU_METHOD
/begin COMPU_VTAB _CNV_S_6_CONV_ERRM__27 "" TAB_VERB 6 0 "NO_SYM" 1 "SYM_0" 2 "SYM_1" 4 "SYM_2" 8 "SYM_3" 15 "BENCH_MODE" /end COMPU_VTAB
/begin COMPU_METHOD _CNV_S_2_RANGE______28_CM "" TAB_VERB "%6.3" "[-]" COMPU_TAB_REF _CNV_S_2_RANGE______28 /end COMPU_METHOD
/begin COMPU_VTAB _CNV_S_2_RANGE______28 "" TAB_VERB 2 0 "passive" 1 "active" /end COMPU_VTAB
/begin COMPU_METHOD _CNV_A_R_LINEAR_____59_CM "" RAT_FUNC "%6.3" "[s]" COEFFS 0 100. 0. 0 0 1 /end COMPU_METHOD
/begin COMPU_METHOD _CNV_A_R_LINEAR_____62_CM "" RAT_FUNC "%6.3" "[Nm]" COEFFS 0 32. 0. 0 0 1 /end COMPU_METHOD
/begin COMPU_METHOD _CNV_A_R_LINEAR_____82_CM "" RAT_FUNC "%6.3" "[%]" COEFFS 0 2.56 0. 0 0 1 /end COMPU_METHOD
/begin COMPU_METHOD _CNV_A_R_LINEAR_____84_CM "" RAT_FUNC "%6.3" "rpm" COEFFS 0 3.125e-002 0. 0 0 1 /end COMPU_METHOD
/begin COMPU_METHOD _CNV_S_2_RANGE__0___88_CM "" TAB_VERB "%6.3" "-" COMPU_TAB_REF _CNV_S_2_RANGE__0___88 /end COMPU_METHOD
/begin COMPU_VTAB _CNV_S_2_RANGE__0___88 "" TAB_VERB 2 0 "0" 1 "1" /end COMPU_VTAB
/begin COMPU_METHOD _CNV_A_R_LINEAR_____99_CM "" RAT_FUNC "%6.3" "[%]" COEFFS 0 655.3599999999997 -1.455191522836685e-011 0 0 1 /end COMPU_METHOD
/begin COMPU_METHOD _CNV_A_R_LINEAR_____100_CM "" RAT_FUNC "%6.3" "[g]" COEFFS 0 35.99993408114611 0. 0 0 1 /end COMPU_METHOD
/begin COMPU_METHOD _CNV_A_R_LINEAR_____101_CM "" RAT_FUNC "%6.3" "[°C]" COEFFS 0 16. 0. 0 0 1 /end COMPU_METHOD
/begin COMPU_METHOD _CNV_A_R_LINEAR_____102_CM "" RAT_FUNC "%6.3" "[°C]" COEFFS 0 64.06158357771261 2114.032258064516 0 0 1 /end COMPU_METHOD
/begin COMPU_METHOD _CNV_A_R_LINEAR_____103_CM "" RAT_FUNC "%6.3" "[°C]" COEFFS 0 1.333333333333333 64. 0 0 1 /end COMPU_METHOD
/begin COMPU_METHOD _CNV_A_R_LINEAR_____104_CM "" RAT_FUNC "%6.3" "[-]" COEFFS 0 32767.99999999992 0. 0 0 1 /end COMPU_METHOD
/begin COMPU_METHOD _CNV_A_R_LINEAR_____105_CM "" RAT_FUNC "%6.3" "[°CRK]" COEFFS 0 0.1666666666666667 0. 0 0 1 /end COMPU_METHOD
/begin COMPU_METHOD _CNV_A_R_LINEAR_____106_CM "" RAT_FUNC "%6.3" "[-]" COEFFS 0 1024. 0. 0 0 1 /end COMPU_METHOD
/begin COMPU_METHOD _CNV_S_5_EGCP_RANGE_107_CM "" TAB_VERB "%6.3" "[-]" COMPU_TAB_REF _CNV_S_5_EGCP_RANGE_107 /end COMPU_METHOD
/begin COMPU_VTAB _CNV_S_5_EGCP_RANGE_107 "" TAB_VERB 5 0 "PASSIVE" 1 "WAIT" 2 "CYC_LEAN" 3 "CYC_RICH" 4 "END" /end COMPU_VTAB
/begin COMPU_METHOD _CNV_S_9_EGCP_RANGE_108_CM "" TAB_VERB "%6.3" "[-]" COMPU_TAB_REF _CNV_S_9_EGCP_RANGE_108 /end COMPU_METHOD
/begin COMPU_VTAB _CNV_S_9_EGCP_RANGE_108 "" TAB_VERB 9 0 "CP_NOT_ACT" 1 "NO_PURGE" 2 "RAMP_TO_NO_PURGE" 3 "WAIT_RAMP_OPEN" 4 "MIN_PURGE" 8 "RAMP_OPEN" 9 "RAMP_OPEN_FAST" 10 "MAX_PURGE" 11 "RAMP_CLOSE" /end COMPU_VTAB
/begin COMPU_METHOD _CNV_A_R_LINEAR_____109_CM "" RAT_FUNC "%6.3" "[V]" COEFFS 0 204.7999999487896 -2.556795379859977e-007 0 0 1 /end COMPU_METHOD
/begin COMPU_METHOD _CNV_A_R_LINEAR_____110_CM "" RAT_FUNC "%6.3" "[mg/stk]" COEFFS 0 0.183585313174946 0. 0 0 1 /end COMPU_METHOD
/begin COMPU_METHOD _CNV_A_R_LINEAR_____111_CM "" RAT_FUNC "%6.3" "[-]" COEFFS 0 1024.000004128252 0. 0 0 1 /end COMPU_METHOD
/begin COMPU_METHOD _CNV_A_R_LINEAR_____112_CM "" RAT_FUNC "%6.3" "[kg/h]" COEFFS 0 64. 0. 0 0 1 /end COMPU_METHOD
/begin COMPU_METHOD _CNV_A_R_LINEAR_____113_CM "" RAT_FUNC "%6.3" "[-]" COEFFS 0 100. 0. 0 0 1 /end COMPU_METHOD
/begin COMPU_METHOD _CNV_A_R_LINEAR_____223_CM "" RAT_FUNC "%6.3" "s" COEFFS 0 100. 0. 0 0 1 /end COMPU_METHOD
/begin COMPU_METHOD _CNV_A_R_LINEAR_____245_CM "" RAT_FUNC "%6.3" "-" COEFFS 0 16. 0. 0 0 1 /end COMPU_METHOD
/begin COMPU_METHOD _CNV_A_R_LINEAR_____248_CM "" RAT_FUNC "%6.3" "-" COEFFS 0 256. 0. 0 0 1 /end COMPU_METHOD
/begin COMPU_METHOD _CNV_A_R_LINEAR_____257_CM "" RAT_FUNC "%6.3" "rpm" COEFFS 0 1. 0. 0 0 1 /end COMPU_METHOD
/begin COMPU_METHOD _CNV_A_R_LINEAR_____260_CM "" RAT_FUNC "%6.3" "V" COEFFS 0 204.8 0. 0 0 1 /end COMPU_METHOD
/begin COMPU_METHOD _CNV_A_R_LINEAR_____271_CM "" RAT_FUNC "%6.3" "rpm/s" COEFFS 0 3.125e-002 0. 0 0 1 /end COMPU_METHOD
/begin COMPU_METHOD _CNV_A_R_ENSD_LINEA_272_CM "" RAT_FUNC "%6.3" "rpm/s" COEFFS 0 1. 0. 0 0 1 /end COMPU_METHOD
/begin COMPU_METHOD _CNV_A_R_LINEAR_____273_CM "" RAT_FUNC "%6.3" "°CRK" COEFFS 0 2.666666666666667 0. 0 0 1 /end COMPU_METHOD
/begin COMPU_METHOD _CNV_A_R_ENSD_LINEA_274_CM "" RAT_FUNC "%6.3" "°CRK" COEFFS 0 16. 0. 0 0 1 /end COMPU_METHOD
/begin COMPU_METHOD _CNV_A_R_LINEAR_____275_CM "" RAT_FUNC "%6.3" "s" COEFFS 0 250000. 0. 0 0 1 /end COMPU_METHOD
/begin COMPU_METHOD _CNV_A_R_ENSD_LINEA_276_CM "" RAT_FUNC "%6.3" "s" COEFFS 0 4201678.146825826 0. 0 0 1 /end COMPU_METHOD
/begin COMPU_METHOD _CNV_A_R_LINEAR_____277_CM "" RAT_FUNC "%6.3" "s" COEFFS 0 4201656.398697721 0. 0 0 1 /end COMPU_METHOD
/begin COMPU_METHOD _CNV_A_R_LINEAR_____278_CM "" RAT_FUNC "%6.3" "°CRK" COEFFS 0 2.666666666666667 128. 0 0 1 /end COMPU_METHOD
/begin COMPU_METHOD _CNV_A_R_LINEAR_____279_CM "" RAT_FUNC "%6.3" "°CRK" COEFFS 0 2.666666666666667 256. 0 0 1 /end COMPU_METHOD
/begin COMPU_METHOD _CNV_A_R_ENSD_LINEA_280_CM "" RAT_FUNC "%6.3" "°CRK" COEFFS 0 16. 2048. 0 0 1 /end COMPU_METHOD
/begin COMPU_METHOD _CNV_A_R_LINEAR_____281_CM "" RAT_FUNC "%6.3" "-" COEFFS 0 1. -1. 0 0 1 /end COMPU_METHOD
/begin COMPU_METHOD _CNV_A_R_ENSD_LINEA_282_CM "" RAT_FUNC "%6.3" "°C" COEFFS 0 1. 50. 0 0 1 /end COMPU_METHOD
/begin COMPU_METHOD _CNV_A_R_ENSD_LINEA_283_CM "" RAT_FUNC "%6.3" "V" COEFFS 0 8.854166666666666 0. 0 0 1 /end COMPU_METHOD
/begin COMPU_METHOD _CNV_S_14_TMO3_ERR_C_351_CM "" TAB_VERB "%6.3" "[-]" COMPU_TAB_REF _CNV_S_14_TMO3_ERR_C_351 /end COMPU_METHOD
/begin COMPU_VTAB _CNV_S_14_TMO3_ERR_C_351 "" TAB_VERB 14 0 "OK" 1 "COMM_CKS_ERR" 2 "COMM_HD_ERR" 3 "PRDR_CHK_ERR" 4 "SW_VERS_ERR" 5 "SW_VAR_ERR" 6 "ABC_MON2_MU_ERR" 7 "IDX_MON2_MU_ERR" 8 "SYN_PFM_MU_ERR" 9 "ROM_LVL2_ERR" 10 "RAM_LVL2_ERR" 11 "ROM_LVL1_ERR" 12 "RAM_LVL1_ERR" 13 "RST_LOOP_ERR" /end COMPU_VTAB
/begin COMPU_METHOD _CNV_S_21_TMO3_ERR_C_352_CM "" TAB_VERB "%6.3" "[-]" COMPU_TAB_REF _CNV_S_21_TMO3_ERR_C_352 /end COMPU_METHOD
/begin COMPU_VTAB _CNV_S_21_TMO3_ERR_C_352 "" TAB_VERB 21 0 "OK" 1 "COMM_HD_ERR" 2 "COMM_CKS_ERR" 3 "PIN_CONF_ERR" 4 "SW_VERS_ERR" 5 "COMM_TOUT_MAX_ERR" 6 "COMM_TOUT_MIN_ERR" 7 "RAM_CHK_MU_ERR" 8 "ROM_CHK_MU_ERR" 9 "RESP_MON2_MC_ERR" 10 "RED_SWI_OFF_PATH" 11 "PFM_1_MC_ERR" 12 "PFM_2_MC_ERR" 13 "PFM_3_MC_ERR" 14 "PFM_4_MC_ERR" 15 "PFM_5_MC_ERR" 16 "PFM_6_MC_ERR" 17 "PFM_7_MC_ERR" 18 "PFM_8_MC_ERR" 19 "WDG_MU_ERR" 20 "ENA_BYTE_ERR" /end COMPU_VTAB
/begin COMPU_METHOD _CNV_S_6_TMO3_STATE_353_CM "" TAB_VERB "%6.3" "[-]" COMPU_TAB_REF _CNV_S_6_TMO3_STATE_353 /end COMPU_METHOD
/begin COMPU_VTAB _CNV_S_6_TMO3_STATE_353 "" TAB_VERB 6 1 "PREDRIVE" 2 "TMP_DIS" 4 "DISABLE_REQ" 8 "DISABLE_MC" 16 "DISABLE_MU" 224 "ENABLE" /end COMPU_VTAB
/begin COMPU_METHOD _CNV_S_4_TMO3_MC_ST_354_CM "" TAB_VERB "%6.3" "[-]" COMPU_TAB_REF _CNV_S_4_TMO3_MC_ST_354 /end COMPU_METHOD
/begin COMPU_VTAB _CNV_S_4_TMO3_MC_ST_354 "" TAB_VERB 4 18 "INIT" 59 "DISABLE" 173 "NORMAL" 207 "PREDRIVE" /end COMPU_VTAB
/begin COMPU_METHOD _CNV_S_4_TMO3_MU_DI_355_CM "" TAB_VERB "%6.3" "[-]" COMPU_TAB_REF _CNV_S_4_TMO3_MU_DI_355 /end COMPU_METHOD
/begin COMPU_VTAB _CNV_S_4_TMO3_MU_DI_355 "" TAB_VERB 4 0 "MU_DI_NOT_REQ" 1 "MU_DI_BUSY" 2 "MU_DI_ERR" 3 "MU_DI_OK" /end COMPU_VTAB
/begin COMPU_METHOD _CNV_A_R_TMO3_LINEA_356_CM "" RAT_FUNC "%6.3" "µs" COEFFS 0 0.125 -3.625 0 0 1 /end COMPU_METHOD
/begin COMPU_METHOD _CNV_S_2_RANGE______380_CM "" TAB_VERB "%6.3" "-" COMPU_TAB_REF _CNV_S_2_RANGE______380 /end COMPU_METHOD
/begin COMPU_VTAB _CNV_S_2_RANGE______380 "" TAB_VERB 2 0 "passive" 1 "active" /end COMPU_VTAB
/begin RECORD_LAYOUT _REC_VAL_20_u1 FNC_VALUES 1 UBYTE COLUMN_DIR DIRECT /end RECORD_LAYOUT
/begin RECORD_LAYOUT _REC_VAL_20_u2 FNC_VALUES 1 UWORD COLUMN_DIR DIRECT /end RECORD_LAYOUT
/begin RECORD_LAYOUT _REC_VAL_20_s2 FNC_VALUES 1 SWORD COLUMN_DIR DIRECT /end RECORD_LAYOUT
/begin RECORD_LAYOUT _REC_AXS_20_u1 NO_AXIS_PTS_X 1 UBYTE AXIS_PTS_X 2 UBYTE INDEX_INCR DIRECT /end RECORD_LAYOUT
/begin RECORD_LAYOUT _REC_CUR_20_u2_u1 FNC_VALUES 1 UWORD COLUMN_DIR DIRECT /end RECORD_LAYOUT
/begin RECORD_LAYOUT _REC_CUR_20_u1_u1 FNC_VALUES 1 UBYTE COLUMN_DIR DIRECT /end RECORD_LAYOUT
/begin RECORD_LAYOUT _REC_VAL_20_u4 FNC_VALUES 1 ULONG COLUMN_DIR DIRECT /end RECORD_LAYOUT
/begin FUNCTION IS_AIS_CTL "" /begin DEF_CHARACTERISTIC ip_n_is_add_tco ldp_tco_ip_n_is_add id_n_add_dri /end DEF_CHARACTERISTIC /begin OUT_MEASUREMENT lv_req_is_ctl t_ais_req /end OUT_MEASUREMENT /end FUNCTION
/begin FUNCTION IS_ATQI_ST "" /begin OUT_MEASUREMENT tqi_st_add /end OUT_MEASUREMENT /end FUNCTION
/begin FUNCTION IS_AIS_LIM "" /begin DEF_CHARACTERISTIC c_tqi_is_max c_tqi_is_min /end DEF_CHARACTERISTIC /begin OUT_MEASUREMENT lv_tqi_is_min lv_tqi_is_max tqi_is_min tqi_is_max /end OUT_MEASUREMENT /end FUNCTION
/begin FUNCTION IS_AIS_PCTL "" /begin OUT_MEASUREMENT tqi_is_pre_ctl /end OUT_MEASUREMENT /end FUNCTION
/begin FUNCTION C_B_ERRM_extended "Error Management data for diagnosis B extended" /end FUNCTION
/begin FUNCTION C_S_AGGR "Transfer Modules for Aggregates" /begin SUB_FUNCTION AGGR_ATRANEGCP /end SUB_FUNCTION /end FUNCTION
/begin FUNCTION AGGR_ATRANEGCP "" /begin DEF_CHARACTERISTIC c_t_max_teg_min_thd c_temp_min_teg_min_thd /end DEF_CHARACTERISTIC
 /begin OUT_MEASUREMENT fac_lam_lim[0] lv_vb_cdn_obd_1 lv_vb_cdn_obd_2[0] lv_efp lv_err_cat_diag[0] lv_err_el_cps lv_err_fsd[0] state_err_iv lv_err_map lv_err_map_plaus lv_err_mec_open_cps lv_err_sa_sap lv_err_sa_sav lv_err_tco lv_err_tco_grd lv_err_tco_plaus lv_err_tco_stuck lv_err_tps lv_fl lv_lam_adj_i_act[0] lv_lam_adj_p_act[0] lv_lam_stop[0] lv_lam_lscl[0] lv_mis_state_a lv_mis_state_b1 lv_mis_state_b4 lv_err_ratio_chk lv_sap lv_sav lv_teg_cat_down_min_thd[0] lv_teg_min_thd[0] maf_int_puc maf_int_pue teg_cat_down_mdl[0] teg_cat_up_mdl[0] teg_dyn temp_cat tia_thr_st lv_cp_ramp_open_act eff_cat_diag[0] cl_mmv cppwm crk_cyl_lam[0] lamb_delta_lam_adj[0] lamb_delta_i_lam_adj[0] lamb_pls[0] lamb_sp_fil_hom[0] lamb_sp[0] state_cat_diag[0] state_cp lv_cat_purge_act[0] lv_cl_clc_avl lv_err_igc lv_scc[0] lv_cat_ldc[0] lv_lamb_ohp[0] fac_lam_mv[0] vls_dif_lam_adj[0] lv_fac_lam_lim_max[0] lv_fac_lam_lim_min[0] lv_lamb_pls_act[0] lv_ldc_lam_adj[0] lv_mff_cst_fup_act lv_err_mtc_dr lv_n_lim_etc_lih lv_n_lim_tps_ad lv_map_puc_lim_act_lsl_gain_ad lv_sawup maf_hb sp_lamb_de saf_kgh t_per_lamb_de lv_err_maf t_teg_min_thd /end OUT_MEASUREMENT
/end FUNCTION
/begin FUNCTION C_4_ENSD "C_4_ENSD" /begin DEF_CHARACTERISTIC ldpm_n_32_1_ensd ldpm_n_32_2_ensd /end DEF_CHARACTERISTIC
 /begin SUB_FUNCTION ENSD_Engine_position_control ENSD_Engine_pos_speed_calc ENSD_Camshaft_adaptation ENSD_Synchro_det_in_Cam_LH /end SUB_FUNCTION
/end FUNCTION
/begin FUNCTION ENSD_Engine_position_control "Engine_position_control" /begin DEF_CHARACTERISTIC lc_inh_lih_crk lc_inh_lih_cam c_nr_vld_cam_syn_crk /end DEF_CHARACTERISTIC
 /begin OUT_MEASUREMENT lv_stop_eng lv_run_eng lv_syn_eng lv_syn_vld lv_lih_err_crk lv_lih_err_cam lv_act_crk lv_err_cam lv_err_lih_crk_cam ctr_vld_cam_syn_crk lv_first_vld_tooth lv_timeout_cam_syn_crk idx_n_ctl_in[0].lv_act_cam idx_n_ctl_in[0].lv_act_lih_crk_cam idx_n_ctl_in[0].lv_act_syn_crk_cam /end OUT_MEASUREMENT
/end FUNCTION
/begin FUNCTION ENSD_Engine_pos_speed_calc "Engine_pos_speed_calc"
 /begin DEF_CHARACTERISTIC id_crk_pha_cor ldp_n_32_id_crk_pha_cor c_n_tooth_end c_n_fast_swi c_fac_n_fast /end DEF_CHARACTERISTIC
 /begin OUT_MEASUREMENT n_mmv n_grd n_grd_h_res seg_ctr psn_eng_syn_min psn_eng_syn_max n_32 n_tooth t_seg_half_av t_crk_win seg_nr n n_fast t_seg_av id_seg_nr[0] id_seg_nr[1] id_seg_nr[2] id_seg_nr[3] /end OUT_MEASUREMENT
/end FUNCTION
/begin FUNCTION ENSD_Camshaft_adaptation "Camshaft_adaptation"
 /begin DEF_CHARACTERISTIC c_grd_ad_max_cam_in c_grd_ad_ref_max_cam_in c_crlc_ad_cam_in c_crlc_ad_ref_cam_in c_nr_rev_ad_ref_cam_in /end DEF_CHARACTERISTIC
 /begin OUT_MEASUREMENT idx_cam_ad_in[0].psn_ad_cam idx_cam_ad_in[0].ctr_rev_ad_ref_cam idx_cam_ad_in[0].psn_cam idx_cam_ad_in[0].psn_dif_edge_cam idx_cam_ad_in[0].psn_edge_cam_old idx_cam_ad_in[0].ptr_psn_edge_cam idx_cam_ad_in[0].ptr_psn_edge_ad_cam idx_cam_ad_in[0].t_dif_edge_cam idx_cam_ad_in[0].lv_ad_end_cam idx_psn_edge_ad_cam_in_1[0] idx_psn_edge_ad_cam_in_1[1] idx_psn_edge_ad_cam_in_1[2] idx_psn_edge_ad_cam_in_1[3] idx_psn_edge_ad_cam_in_1[4] idx_psn_edge_ad_cam_in_1[5] idx_psn_edge_ad_cam_in_1[6] idx_psn_edge_ad_cam_in_1[7] idx_psn_edge_ad_cam_in_1[8] idx_psn_edge_ad_cam_in_1[9] idx_psn_edge_cam_in_1[0] idx_psn_edge_cam_in_1[1] idx_psn_edge_cam_in_1[2] idx_psn_edge_cam_in_1[3] idx_psn_edge_cam_in_1[4] idx_psn_edge_cam_in_1[5] idx_psn_edge_cam_in_1[6] idx_psn_edge_cam_in_1[7] idx_psn_edge_cam_in_1[8] idx_psn_edge_cam_in_1[9] /end OUT_MEASUREMENT
/end FUNCTION
/begin FUNCTION ENSD_Synchro_det_in_Cam_LH "" /begin OUT_MEASUREMENT lv_cam_lih_ext_ena lv_seg_nr_upd_req lv_syn_vld_cam_lih /end OUT_MEASUREMENT /end FUNCTION
/begin FUNCTION C_A_ENSD "C_A_ENSD"
 /begin SUB_FUNCTION ENSD_Eng_pos_speed_diag_manager ENSD_Camshaft_pos_diagnosis ENSD_Camshaft_sensor_diagnosis ENSD_Crank_sensor_diagnosis ENSD_Crank_sensor_plaus_diag ENSD_Crank_sensor_circuit_diag ENSD_Cam_sensor_diag_Appl_inc ENSD_Crank_sensor_diag_Appl_inc /end SUB_FUNCTION
/end FUNCTION
/begin FUNCTION ENSD_Eng_pos_speed_diag_manager "Eng_pos_speed_diag_manager" /begin DEF_CHARACTERISTIC c_n_not_rest c_t_dly_rest_igk c_t_dly_rest_stall /end DEF_CHARACTERISTIC
 /begin OUT_MEASUREMENT lv_err_cam_tot lv_err_crk lv_inh_diag_crk_syn lv_inh_diag_crk_tooth lv_inh_diag_crk_tooth_per lv_inh_diag_crk_plaus lv_inh_diag_crk_oc lv_inh_diag_ensd idx_diag_mng_in[0].lv_err_cam idx_diag_mng_in[0].lv_inh_diag_syn_cam idx_diag_mng_in[0].lv_inh_diag_per_cam idx_diag_mng_in[0].lv_inh_diag_plaus_cam idx_diag_mng_in[0].lv_inh_diag_ref_crk_cam /end OUT_MEASUREMENT
/end FUNCTION
/begin FUNCTION ENSD_Camshaft_pos_diagnosis "Camshaft_position_diagnosis"
 /begin DEF_CHARACTERISTIC c_abc_inc_diag_ref_crk_cam_in c_abc_max_diag_ref_crk_cam_in c_tol_ref_crk_cam_in /end DEF_CHARACTERISTIC
 /begin OUT_MEASUREMENT lv_err_ref_crk_cam_in_1 /end OUT_MEASUREMENT
/end FUNCTION
/begin FUNCTION ENSD_Camshaft_sensor_diagnosis "Camshaft_sensor_diagnosis"
 /begin DEF_CHARACTERISTIC c_abc_inc_diag_per_cam_in c_abc_max_diag_per_cam_in c_abc_inc_diag_syn_cam_in c_abc_max_diag_syn_cam_in /end DEF_CHARACTERISTIC
 /begin OUT_MEASUREMENT lv_err_per_cam_in_1 lv_err_syn_cam_in_1 /end OUT_MEASUREMENT
/end FUNCTION
/begin FUNCTION ENSD_Crank_sensor_diagnosis "Crankshaft_sensor_diagnosis"
 /begin DEF_CHARACTERISTIC c_abc_inc_diag_crk_tooth_per c_abc_inc_diag_crk_tooth c_abc_inc_diag_crk_syn c_abc_max_diag_crk_tooth c_abc_max_diag_crk_tooth_per c_abc_max_diag_crk_syn /end DEF_CHARACTERISTIC
 /begin OUT_MEASUREMENT lv_inh_mis_crk lv_err_crk_tooth lv_err_crk_tooth_per lv_err_crk_syn /end OUT_MEASUREMENT
/end FUNCTION
/begin FUNCTION ENSD_Crank_sensor_plaus_diag "Crank_sensor_plaus_diag"
 /begin DEF_CHARACTERISTIC c_nr_edge_cam_ex_syn_crk_max c_nr_edge_cam_in_syn_crk_max c_nr_cyc_eng_plaus_cam_max c_ctr_orng_cam_syn_crk_max /end DEF_CHARACTERISTIC
 /begin OUT_MEASUREMENT lv_err_crk_plaus lv_err_plaus_cam_in_1 ctr_cyc_eng_plaus_cam_in_1 lv_err_syn_crk_cam_in_1 ctr_orng_cam_syn_crk /end OUT_MEASUREMENT
/end FUNCTION
/begin FUNCTION ENSD_Crank_sensor_circuit_diag "Crank_sensor_circuit_diag"
 /begin DEF_CHARACTERISTIC c_abc_inc_diag_crk_oc c_abc_max_diag_crk_oc c_v_mcps_thd c_v_mcps_thd_min c_v_mcps_thd_max c_mcps_sample_count lc_rst_v_mcps_diag_dif_max /end DEF_CHARACTERISTIC
/end FUNCTION
/begin FUNCTION ENSD_Cam_sensor_diag_Appl_inc "Camshaft sensor diagnosis ( appl.inci )" /end FUNCTION
/begin FUNCTION ENSD_Crank_sensor_diag_Appl_inc "Crankshaft sensor diagnosis ( Appli.inc )" /end FUNCTION
/begin FUNCTION C_2_ENSD "C_2_ENSD" /begin DEF_CHARACTERISTIC lc_cam_swi_conf /end DEF_CHARACTERISTIC /begin SUB_FUNCTION ENSD_Acq_crankshaft_signal ENSD_Acq_camshaft_signal /end SUB_FUNCTION /end FUNCTION
/begin FUNCTION ENSD_Acq_crankshaft_signal "Acq_crankshaft_signal" /begin DEF_CHARACTERISTIC c_t_crk_dly id_fac_tol_crk_tooth /end DEF_CHARACTERISTIC
 /begin OUT_MEASUREMENT lv_orng_tooth_per_crk lv_orng_nr_tooth_crk lv_lost_syn_crk lv_crk_syn t_crk_win_ensd t_seg_er /end OUT_MEASUREMENT
/end FUNCTION
/begin FUNCTION ENSD_Acq_camshaft_signal "Acq_camshaft_signal"
 /begin DEF_CHARACTERISTIC id_fac_cam_in c_dyw_cam_crk_syn_rtd_in c_dyw_cam_syn_in c_nr_edge_min_vld_cam_in c_crk_ang_dly c_psn_max_ofs c_psn_min_ofs c_dyw_cam_crk_syn_adc_in /end DEF_CHARACTERISTIC
 /begin OUT_MEASUREMENT lv_cam_syn_crk idx_cam_acq_in[0].idx_edge_cam idx_cam_acq_in[0].ctr_edge_cam idx_cam_acq_in[0].lv_vld_psn_cam idx_cam_acq_in[0].lv_syn_cam idx_cam_acq_in[0].lv_orng_per_cam idx_cam_acq_in[0].lv_orng_ratio_cam idx_cam_acq_in[0].psn_eng_cam idx_cam_acq_in[0].t_seg_cam /end OUT_MEASUREMENT
/end FUNCTION
/begin FUNCTION C_1_ENSD "" /begin SUB_FUNCTION ENSD_Interface_adaptation /end SUB_FUNCTION /end FUNCTION
/begin FUNCTION ENSD_Interface_adaptation "" /begin OUT_MEASUREMENT tco_cmn vb_cmn /end OUT_MEASUREMENT /end FUNCTION
/begin FUNCTION C_E_MO3 "C_E_MO3"
 /begin SUB_FUNCTION MO3_Proc_Mon MO3_Fault_Reac_Proc_Mon MO3_Communication_MC_MU /end SUB_FUNCTION
/end FUNCTION
/begin FUNCTION MO3_Proc_Mon "Proc_Mon" /begin DEF_CHARACTERISTIC c_rom_cks_cal_l c_rom_cks_cal_h lc_swi_rom_cks_cal /end DEF_CHARACTERISTIC
 /begin OUT_MEASUREMENT rom_cks_cal_clc_l rom_cks_cal_clc_h abc_mon2_mu test_rec_idx_mon2 acq_mc_0_mon acq_mu_0_mon sw_comp_nr_mc sw_vers_mu[0] sw_vers_mu[1] mu_pin_conf lv_rom_crc_ready lv_dr_off_mu_mon /end OUT_MEASUREMENT
/end FUNCTION
/begin FUNCTION MO3_Fault_Reac_Proc_Mon "Fault_Reac_Proc_Mon"
 /begin OUT_MEASUREMENT lv_err_mc lv_err_mu lv_err_tmp_mc lv_err_tmp_mu lv_err_tmp_mu_mc lv_err_mu_mc err_cod_mc err_cod_mu rst_ctr_mc rst_ctr_mu rst_ctr_mc_save rst_ctr_mu_save err_cod_mc_save err_cod_mu_save state_dr_mu_mc /end OUT_MEASUREMENT
/end FUNCTION
/begin FUNCTION MO3_Communication_MC_MU "Communication_MC_MU"
 /begin OUT_MEASUREMENT mc_state mu_di_state t_dgo_pls_mu nr_dgo_pls_mu out_port_mu /end OUT_MEASUREMENT
/end FUNCTION
/begin FUNCTION C_A_ERRM ""
 /begin SUB_FUNCTION ERRM_AIMOB ERRM_ADCDCDGO ERRM_APVSDIAG ERRM_AVCCDIAG ERRM_ERRM_DIAG ERRM_ATCODIAG ERRM_AEGRCTLD ERRM_AAMPDIAG ERRM_ATFU ERRM_AMAPDIAG ERRM_AMAFPLAD ERRM_AMAFANAD ERRM_ATPCDIAG ERRM_ATACDIAG ERRM_AOBDFSD ERRM_ACYBDIAG ERRM_AEGRVCAD ERRM_ATHRCAD ERRM_ABPACAD ERRM_ABYPCAD ERRM_AMAPCTLD ERRM_AOBDEGR ERRM_AVSDIAG ERRM_ACSDIAG ERRM_ABRAKE_D ERRM_ACANDGO ERRM_AVARDIAG ERRM_AAC_DIAG ERRM_ATBADIAG ERRM_AALTDIAG ERRM_AVEGRVDG ERRM_ACAPDIAG ERRM_ATCOPLAD ERRM_AEFPDIAG ERRM_ASPIDIAG ERRM_AEGRBYPD ERRM_AEGRVDHB ERRM_AINJDIAG ERRM_ADGOSPI ERRM_ARLYDIAG ERRM_AVBDIAG ERRM_AERRMON ERRM_TMO3ERRM ERRM_ENSD_DIAG ERRM_EGCP_DIAG /end SUB_FUNCTION
/end FUNCTION
/begin FUNCTION ERRM_AIMOB "Error Management data for diagnosis AIMOB"
 /begin OUT_MEASUREMENT fmy_stat_imob.ctr_abc fmy_stat_imob.ctr_end_diag fmy_stat_imob.err_info_stat.reserved fmy_stat_imob.err_info_stat.lv_cdn_diag_stc fmy_stat_imob.err_info_stat.lv_lock_diag fmy_stat_imob.err_info_stat.lv_err_mem fmy_stat_imob.err_info_stat.lv_ready fmy_stat_imob.err_info_stat.lv_end_diag fmy_stat_imob.err_info_stat.lv_cdn_diag fmy_stat_imob.err_info_stat.err_sym lv_err_ecu_4 fmy_stat_ecu_4.ctr_abc fmy_stat_ecu_4.ctr_end_diag fmy_stat_ecu_4.err_info_stat.reserved fmy_stat_ecu_4.err_info_stat.lv_cdn_diag_stc fmy_stat_ecu_4.err_info_stat.lv_lock_diag fmy_stat_ecu_4.err_info_stat.lv_err_mem fmy_stat_ecu_4.err_info_stat.lv_ready fmy_stat_ecu_4.err_info_stat.lv_end_diag fmy_stat_ecu_4.err_info_stat.lv_cdn_diag fmy_stat_ecu_4.err_info_stat.err_sym lv_err_ecu_2 fmy_stat_ecu_2.ctr_abc fmy_stat_ecu_2.ctr_end_diag fmy_stat_ecu_2.err_info_stat.reserved fmy_stat_ecu_2.err_info_stat.lv_cdn_diag_stc fmy_stat_ecu_2.err_info_stat.lv_lock_diag fmy_stat_ecu_2.err_info_stat.lv_err_mem fmy_stat_ecu_2.err_info_stat.lv_ready fmy_stat_ecu_2.err_info_stat.lv_end_diag fmy_stat_ecu_2.err_info_stat.lv_cdn_diag fmy_stat_ecu_2.err_info_stat.err_sym /end OUT_MEASUREMENT
/end FUNCTION
/begin FUNCTION ERRM_ADCDCDGO "Error Management data for diagnosis ADCDCDGO"
 /begin OUT_MEASUREMENT lv_err_v_dcdc_rng fmy_stat_v_dcdc_rng.ctr_abc fmy_stat_v_dcdc_rng.ctr_end_diag fmy_stat_v_dcdc_rng.err_info_stat.reserved fmy_stat_v_dcdc_rng.err_info_stat.lv_cdn_diag_stc fmy_stat_v_dcdc_rng.err_info_stat.lv_lock_diag fmy_stat_v_dcdc_rng.err_info_stat.lv_err_mem fmy_stat_v_dcdc_rng.err_info_stat.lv_ready fmy_stat_v_dcdc_rng.err_info_stat.lv_end_diag fmy_stat_v_dcdc_rng.err_info_stat.lv_cdn_diag fmy_stat_v_dcdc_rng.err_info_stat.err_sym /end OUT_MEASUREMENT
/end FUNCTION
/begin FUNCTION ERRM_APVSDIAG "Error Management data for diagnosis APVSDIAG"
 /begin OUT_MEASUREMENT lv_err_pvs_l_1 fmy_stat_pvs_l_1.ctr_abc fmy_stat_pvs_l_1.ctr_end_diag fmy_stat_pvs_l_1.err_info_stat.reserved fmy_stat_pvs_l_1.err_info_stat.lv_cdn_diag_stc fmy_stat_pvs_l_1.err_info_stat.lv_lock_diag fmy_stat_pvs_l_1.err_info_stat.lv_err_mem fmy_stat_pvs_l_1.err_info_stat.lv_ready fmy_stat_pvs_l_1.err_info_stat.lv_end_diag fmy_stat_pvs_l_1.err_info_stat.lv_cdn_diag fmy_stat_pvs_l_1.err_info_stat.err_sym lv_err_pvs_l_2 fmy_stat_pvs_l_2.ctr_abc fmy_stat_pvs_l_2.ctr_end_diag fmy_stat_pvs_l_2.err_info_stat.reserved fmy_stat_pvs_l_2.err_info_stat.lv_cdn_diag_stc fmy_stat_pvs_l_2.err_info_stat.lv_lock_diag fmy_stat_pvs_l_2.err_info_stat.lv_err_mem fmy_stat_pvs_l_2.err_info_stat.lv_ready fmy_stat_pvs_l_2.err_info_stat.lv_end_diag fmy_stat_pvs_l_2.err_info_stat.lv_cdn_diag fmy_stat_pvs_l_2.err_info_stat.err_sym lv_err_pvs_h_1 fmy_stat_pvs_h_1.ctr_abc fmy_stat_pvs_h_1.ctr_end_diag fmy_stat_pvs_h_1.err_info_stat.reserved fmy_stat_pvs_h_1.err_info_stat.lv_cdn_diag_stc fmy_stat_pvs_h_1.err_info_stat.lv_lock_diag fmy_stat_pvs_h_1.err_info_stat.lv_err_mem fmy_stat_pvs_h_1.err_info_stat.lv_ready fmy_stat_pvs_h_1.err_info_stat.lv_end_diag fmy_stat_pvs_h_1.err_info_stat.lv_cdn_diag fmy_stat_pvs_h_1.err_info_stat.err_sym lv_err_pvs_h_2 fmy_stat_pvs_h_2.ctr_abc fmy_stat_pvs_h_2.ctr_end_diag fmy_stat_pvs_h_2.err_info_stat.reserved fmy_stat_pvs_h_2.err_info_stat.lv_cdn_diag_stc fmy_stat_pvs_h_2.err_info_stat.lv_lock_diag fmy_stat_pvs_h_2.err_info_stat.lv_err_mem fmy_stat_pvs_h_2.err_info_stat.lv_ready fmy_stat_pvs_h_2.err_info_stat.lv_end_diag fmy_stat_pvs_h_2.err_info_stat.lv_cdn_diag fmy_stat_pvs_h_2.err_info_stat.err_sym lv_err_pvs_ratio fmy_stat_pvs_ratio.ctr_abc fmy_stat_pvs_ratio.ctr_end_diag fmy_stat_pvs_ratio.err_info_stat.reserved fmy_stat_pvs_ratio.err_info_stat.lv_cdn_diag_stc fmy_stat_pvs_ratio.err_info_stat.lv_lock_diag fmy_stat_pvs_ratio.err_info_stat.lv_err_mem fmy_stat_pvs_ratio.err_info_stat.lv_ready fmy_stat_pvs_ratio.err_info_stat.lv_end_diag fmy_stat_pvs_ratio.err_info_stat.lv_cdn_diag fmy_stat_pvs_ratio.err_info_stat.err_sym lv_err_pvs_move fmy_stat_pvs_move.ctr_abc fmy_stat_pvs_move.ctr_end_diag fmy_stat_pvs_move.err_info_stat.reserved fmy_stat_pvs_move.err_info_stat.lv_cdn_diag_stc fmy_stat_pvs_move.err_info_stat.lv_lock_diag fmy_stat_pvs_move.err_info_stat.lv_err_mem fmy_stat_pvs_move.err_info_stat.lv_ready fmy_stat_pvs_move.err_info_stat.lv_end_diag fmy_stat_pvs_move.err_info_stat.lv_cdn_diag fmy_stat_pvs_move.err_info_stat.err_sym lv_err_pvs_bls_bts fmy_stat_pvs_bls_bts.ctr_abc fmy_stat_pvs_bls_bts.ctr_end_diag fmy_stat_pvs_bls_bts.err_info_stat.reserved fmy_stat_pvs_bls_bts.err_info_stat.lv_cdn_diag_stc fmy_stat_pvs_bls_bts.err_info_stat.lv_lock_diag fmy_stat_pvs_bls_bts.err_info_stat.lv_err_mem fmy_stat_pvs_bls_bts.err_info_stat.lv_ready fmy_stat_pvs_bls_bts.err_info_stat.lv_end_diag fmy_stat_pvs_bls_bts.err_info_stat.lv_cdn_diag fmy_stat_pvs_bls_bts.err_info_stat.err_sym /end OUT_MEASUREMENT
/end FUNCTION
/begin FUNCTION ERRM_AVCCDIAG "Error Management data for diagnosis AVCCDIAG"
 /begin OUT_MEASUREMENT lv_err_vcc_1 fmy_stat_vcc_1.ctr_abc fmy_stat_vcc_1.ctr_end_diag fmy_stat_vcc_1.err_info_stat.reserved fmy_stat_vcc_1.err_info_stat.lv_cdn_diag_stc fmy_stat_vcc_1.err_info_stat.lv_lock_diag fmy_stat_vcc_1.err_info_stat.lv_err_mem fmy_stat_vcc_1.err_info_stat.lv_ready fmy_stat_vcc_1.err_info_stat.lv_end_diag fmy_stat_vcc_1.err_info_stat.lv_cdn_diag fmy_stat_vcc_1.err_info_stat.err_sym lv_err_vcc_2 fmy_stat_vcc_2.ctr_abc fmy_stat_vcc_2.ctr_end_diag fmy_stat_vcc_2.err_info_stat.reserved fmy_stat_vcc_2.err_info_stat.lv_cdn_diag_stc fmy_stat_vcc_2.err_info_stat.lv_lock_diag fmy_stat_vcc_2.err_info_stat.lv_err_mem fmy_stat_vcc_2.err_info_stat.lv_ready fmy_stat_vcc_2.err_info_stat.lv_end_diag fmy_stat_vcc_2.err_info_stat.lv_cdn_diag fmy_stat_vcc_2.err_info_stat.err_sym /end OUT_MEASUREMENT
/end FUNCTION
/begin FUNCTION ERRM_ERRM_DIAG "Error Management data for diagnosis ERRM_DIAG"
 /begin OUT_MEASUREMENT lv_err_v_dip_pf_rng fmy_stat_v_dip_pf_rng.ctr_abc fmy_stat_v_dip_pf_rng.ctr_end_diag fmy_stat_v_dip_pf_rng.err_info_stat.reserved fmy_stat_v_dip_pf_rng.err_info_stat.lv_cdn_diag_stc fmy_stat_v_dip_pf_rng.err_info_stat.lv_lock_diag fmy_stat_v_dip_pf_rng.err_info_stat.lv_err_mem fmy_stat_v_dip_pf_rng.err_info_stat.lv_ready fmy_stat_v_dip_pf_rng.err_info_stat.lv_end_diag fmy_stat_v_dip_pf_rng.err_info_stat.lv_cdn_diag fmy_stat_v_dip_pf_rng.err_info_stat.err_sym lv_err_dip_pf_mes_es fmy_stat_dip_pf_mes_es.ctr_abc fmy_stat_dip_pf_mes_es.ctr_end_diag fmy_stat_dip_pf_mes_es.err_info_stat.reserved fmy_stat_dip_pf_mes_es.err_info_stat.lv_cdn_diag_stc fmy_stat_dip_pf_mes_es.err_info_stat.lv_lock_diag fmy_stat_dip_pf_mes_es.err_info_stat.lv_err_mem fmy_stat_dip_pf_mes_es.err_info_stat.lv_ready fmy_stat_dip_pf_mes_es.err_info_stat.lv_end_diag fmy_stat_dip_pf_mes_es.err_info_stat.lv_cdn_diag fmy_stat_dip_pf_mes_es.err_info_stat.err_sym lv_err_dip_pf_mes_eru fmy_stat_dip_pf_mes_eru.ctr_abc fmy_stat_dip_pf_mes_eru.ctr_end_diag fmy_stat_dip_pf_mes_eru.err_info_stat.reserved fmy_stat_dip_pf_mes_eru.err_info_stat.lv_cdn_diag_stc fmy_stat_dip_pf_mes_eru.err_info_stat.lv_lock_diag fmy_stat_dip_pf_mes_eru.err_info_stat.lv_err_mem fmy_stat_dip_pf_mes_eru.err_info_stat.lv_ready fmy_stat_dip_pf_mes_eru.err_info_stat.lv_end_diag fmy_stat_dip_pf_mes_eru.err_info_stat.lv_cdn_diag fmy_stat_dip_pf_mes_eru.err_info_stat.err_sym lv_err_egr_is_slow_obd fmy_stat_egr_is_slow_obd.ctr_abc fmy_stat_egr_is_slow_obd.ctr_end_diag fmy_stat_egr_is_slow_obd.err_info_stat.reserved fmy_stat_egr_is_slow_obd.err_info_stat.lv_cdn_diag_stc fmy_stat_egr_is_slow_obd.err_info_stat.lv_lock_diag fmy_stat_egr_is_slow_obd.err_info_stat.lv_err_mem fmy_stat_egr_is_slow_obd.err_info_stat.lv_ready fmy_stat_egr_is_slow_obd.err_info_stat.lv_end_diag fmy_stat_egr_is_slow_obd.err_info_stat.lv_cdn_diag fmy_stat_egr_is_slow_obd.err_info_stat.err_sym lv_err_egrv fmy_stat_egrv.ctr_abc fmy_stat_egrv.ctr_end_diag fmy_stat_egrv.err_info_stat.reserved fmy_stat_egrv.err_info_stat.lv_cdn_diag_stc fmy_stat_egrv.err_info_stat.lv_lock_diag fmy_stat_egrv.err_info_stat.lv_err_mem fmy_stat_egrv.err_info_stat.lv_ready fmy_stat_egrv.err_info_stat.lv_end_diag fmy_stat_egrv.err_info_stat.lv_cdn_diag fmy_stat_egrv.err_info_stat.err_sym lv_err_fsd_1 fmy_stat_fsd_1.ctr_abc fmy_stat_fsd_1.ctr_end_diag fmy_stat_fsd_1.err_info_stat.reserved fmy_stat_fsd_1.err_info_stat.lv_cdn_diag_stc fmy_stat_fsd_1.err_info_stat.lv_lock_diag fmy_stat_fsd_1.err_info_stat.lv_err_mem fmy_stat_fsd_1.err_info_stat.lv_ready fmy_stat_fsd_1.err_info_stat.lv_end_diag fmy_stat_fsd_1.err_info_stat.lv_cdn_diag fmy_stat_fsd_1.err_info_stat.err_sym lv_err_mis_a fmy_stat_mis_a.ctr_abc fmy_stat_mis_a.ctr_end_diag fmy_stat_mis_a.err_info_stat.reserved fmy_stat_mis_a.err_info_stat.lv_cdn_diag_stc fmy_stat_mis_a.err_info_stat.lv_lock_diag fmy_stat_mis_a.err_info_stat.lv_err_mem fmy_stat_mis_a.err_info_stat.lv_ready fmy_stat_mis_a.err_info_stat.lv_end_diag fmy_stat_mis_a.err_info_stat.lv_cdn_diag fmy_stat_mis_a.err_info_stat.err_sym lv_err_mis_b1 fmy_stat_mis_b1.ctr_abc fmy_stat_mis_b1.ctr_end_diag fmy_stat_mis_b1.err_info_stat.reserved fmy_stat_mis_b1.err_info_stat.lv_cdn_diag_stc fmy_stat_mis_b1.err_info_stat.lv_lock_diag fmy_stat_mis_b1.err_info_stat.lv_err_mem fmy_stat_mis_b1.err_info_stat.lv_ready fmy_stat_mis_b1.err_info_stat.lv_end_diag fmy_stat_mis_b1.err_info_stat.lv_cdn_diag fmy_stat_mis_b1.err_info_stat.err_sym lv_err_mis_b4 fmy_stat_mis_b4.ctr_abc fmy_stat_mis_b4.ctr_end_diag fmy_stat_mis_b4.err_info_stat.reserved fmy_stat_mis_b4.err_info_stat.lv_cdn_diag_stc fmy_stat_mis_b4.err_info_stat.lv_lock_diag fmy_stat_mis_b4.err_info_stat.lv_err_mem fmy_stat_mis_b4.err_info_stat.lv_ready fmy_stat_mis_b4.err_info_stat.lv_end_diag fmy_stat_mis_b4.err_info_stat.lv_cdn_diag fmy_stat_mis_b4.err_info_stat.err_sym lv_err_pcv_2 fmy_stat_pcv_2.ctr_abc fmy_stat_pcv_2.ctr_end_diag fmy_stat_pcv_2.err_info_stat.reserved fmy_stat_pcv_2.err_info_stat.lv_cdn_diag_stc fmy_stat_pcv_2.err_info_stat.lv_lock_diag fmy_stat_pcv_2.err_info_stat.lv_err_mem fmy_stat_pcv_2.err_info_stat.lv_ready fmy_stat_pcv_2.err_info_stat.lv_end_diag fmy_stat_pcv_2.err_info_stat.lv_cdn_diag fmy_stat_pcv_2.err_info_stat.err_sym lv_err_thr fmy_stat_thr.ctr_abc fmy_stat_thr.ctr_end_diag fmy_stat_thr.err_info_stat.reserved fmy_stat_thr.err_info_stat.lv_cdn_diag_stc fmy_stat_thr.err_info_stat.lv_lock_diag fmy_stat_thr.err_info_stat.lv_err_mem fmy_stat_thr.err_info_stat.lv_ready fmy_stat_thr.err_info_stat.lv_end_diag fmy_stat_thr.err_info_stat.lv_cdn_diag fmy_stat_thr.err_info_stat.err_sym lv_err_var_cod fmy_stat_var_cod.ctr_abc fmy_stat_var_cod.ctr_end_diag fmy_stat_var_cod.err_info_stat.reserved fmy_stat_var_cod.err_info_stat.lv_cdn_diag_stc fmy_stat_var_cod.err_info_stat.lv_lock_diag fmy_stat_var_cod.err_info_stat.lv_err_mem fmy_stat_var_cod.err_info_stat.lv_ready fmy_stat_var_cod.err_info_stat.lv_end_diag fmy_stat_var_cod.err_info_stat.lv_cdn_diag fmy_stat_var_cod.err_info_stat.err_sym lv_err_vcv_2 fmy_stat_vcv_2.ctr_abc fmy_stat_vcv_2.ctr_end_diag fmy_stat_vcv_2.err_info_stat.reserved fmy_stat_vcv_2.err_info_stat.lv_cdn_diag_stc fmy_stat_vcv_2.err_info_stat.lv_lock_diag fmy_stat_vcv_2.err_info_stat.lv_err_mem fmy_stat_vcv_2.err_info_stat.lv_ready fmy_stat_vcv_2.err_info_stat.lv_end_diag fmy_stat_vcv_2.err_info_stat.lv_cdn_diag fmy_stat_vcv_2.err_info_stat.err_sym /end OUT_MEASUREMENT
/end FUNCTION
/end MODULE
/end PROJECT
