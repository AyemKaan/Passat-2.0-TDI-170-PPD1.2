ASAP2_VERSION 1 41
/begin PROJECT SN0 "SIMOS PPD"
/begin HEADER "_default_HeaderComment" PROJECT_NO PRJ_NUM /end HEADER
/begin MODULE _default_ModuleName "_default_ModuleLongIdentifier"
/begin MOD_COMMON "_default_ModCommonComment" DEPOSIT ABSOLUTE BYTE_ORDER MSB_FIRST ALIGNMENT_BYTE 1 ALIGNMENT_WORD 2 ALIGNMENT_LONG 4 ALIGNMENT_FLOAT32_IEEE 4 ALIGNMENT_FLOAT64_IEEE 8 /end MOD_COMMON
/begin AXIS_PTS ldpm_n_ip_mf_pf "" 0x843bf8 n _REC_AXS_20_u2 6375. _CNV_A_R_LINEAR_____5_CM 24 0. 6375. FORMAT "%4.0" /end AXIS_PTS
/begin MEASUREMENT ar_pi_egr "output of the EGR- controller" SWORD _CNV_A_R_LINEAR_____154_CM 1 0. -78.08139 78.079008 DISPLAY_IDENTIFIER AR_PI_EGR ECU_ADDRESS 0x7fa6be BYTE_ORDER MSB_LAST FORMAT "%5.3" /end MEASUREMENT
/begin MEASUREMENT egr_mmv_ctl "actual EGR- ratio for backup solution" UWORD _CNV_A_R_LINEAR_____8_CM 1 0. 0. 99.99847412109381 DISPLAY_IDENTIFIER EGR_MMV_CTL ECU_ADDRESS 0x7fa6c0 BYTE_ORDER MSB_LAST FORMAT "%5.3" /end MEASUREMENT
/begin MEASUREMENT lv_egr_ctl_sub "back up solution active" UBYTE _CNV_S_2_RANGE______11_CM 1 0. 0. 1. DISPLAY_IDENTIFIER LV_EGR_CTL_SUB ECU_ADDRESS 0x7fb494 /end MEASUREMENT
/begin MEASUREMENT egr_sp_mmv_ctl "EGR- ratio setpoint for backup solution" UWORD _CNV_A_R_LINEAR_____8_CM 1 0. 0. 99.99847412109381 DISPLAY_IDENTIFIER EGR_SP_MMV_CTL ECU_ADDRESS 0x7fa6c2 BYTE_ORDER MSB_LAST FORMAT "%5.3" /end MEASUREMENT
/begin MEASUREMENT egr_sp_mmv_out "EGR- ratio setpoint behind intervention for backup solution" UWORD _CNV_A_R_LINEAR_____8_CM 1 0. 0. 99.99847412109381 DISPLAY_IDENTIFIER EGR_SP_MMV_OUT ECU_ADDRESS 0x7fa6c4 BYTE_ORDER MSB_LAST FORMAT "%5.3" /end MEASUREMENT
/begin MEASUREMENT egr_mmv_out "actual EGR- ratio behind intervention for backup solution" UWORD _CNV_A_R_LINEAR_____8_CM 1 0. 0. 99.99847412109381 DISPLAY_IDENTIFIER EGR_MMV_OUT ECU_ADDRESS 0x7fa6c6 BYTE_ORDER MSB_LAST FORMAT "%5.3" /end MEASUREMENT
/begin MEASUREMENT egr_dif "EGR ratio deviation" SWORD _CNV_A_R_LINEAR_____12_CM 1 0. -100. 99.996948242 DISPLAY_IDENTIFIER EGR_DIF ECU_ADDRESS 0x7f983c BYTE_ORDER MSB_LAST FORMAT "%5.3" /end MEASUREMENT
/begin MEASUREMENT mafpwm "controller output for backup solution" UWORD _CNV_A_R_LINEAR_____155_CM 1 0. 0. 99.9969482421875 DISPLAY_IDENTIFIER MAFPWM ECU_ADDRESS 0x7f983e BYTE_ORDER MSB_LAST FORMAT "%5.3" /end MEASUREMENT
/begin MEASUREMENT mafpwm_pi "output of the PI- controller (backup solution)" SWORD _CNV_A_R_LINEAR_____12_CM 1 0. -100. 99.996948242 DISPLAY_IDENTIFIER MAFPWM_PI ECU_ADDRESS 0x7f9840 BYTE_ORDER MSB_LAST FORMAT "%5.3" /end MEASUREMENT
/begin MEASUREMENT ar_byp_ctl_the "theor. cross section of the bypass throttle" UWORD _CNV_A_R_LINEAR_____7_CM 1 0. 0. 78.08 DISPLAY_IDENTIFIER AR_BYP_CTL_THE ECU_ADDRESS 0x7f9842 BYTE_ORDER MSB_LAST FORMAT "%5.3" /end MEASUREMENT
/begin MEASUREMENT ar_thr_ctl_the "theor. cross section of the EGR- throttle" UWORD _CNV_A_R_LINEAR_____7_CM 1 0. 0. 78.08 DISPLAY_IDENTIFIER AR_THR_CTL_THE ECU_ADDRESS 0x7f9844 BYTE_ORDER MSB_LAST FORMAT "%5.3" /end MEASUREMENT
/begin MEASUREMENT fac_ar_byp_egr_ctl "Factor to correct the cross section of the bypass- throttle" UWORD _CNV_A_R_LINEAR_____14_CM 1 0. 0. 0.9999847412109381 DISPLAY_IDENTIFIER FAC_AR_BYP_EGR_CTL ECU_ADDRESS 0x7f9846 BYTE_ORDER MSB_LAST FORMAT "%6.5" /end MEASUREMENT
/begin MEASUREMENT fac_ar_thr_egr_ctl "Factor to correct the cross section of the EGR- throttle" UWORD _CNV_A_R_LINEAR_____14_CM 1 0. 0. 0.9999847412109381 DISPLAY_IDENTIFIER FAC_AR_THR_EGR_CTL ECU_ADDRESS 0x7f9848 BYTE_ORDER MSB_LAST FORMAT "%6.5" /end MEASUREMENT
/begin MEASUREMENT ar_thr_ico_ctl_the "theor. cross section of the intercooler throttle" UWORD _CNV_A_R_LINEAR_____7_CM 1 0. 0. 78.08 DISPLAY_IDENTIFIER AR_THR_ICO_CTL_THE ECU_ADDRESS 0x7f984a BYTE_ORDER MSB_LAST FORMAT "%5.3" /end MEASUREMENT
/begin MEASUREMENT ar_egrv_ctl_the "theor. cross section of the EGR- valve" UWORD _CNV_A_R_LINEAR_____7_CM 1 0. 0. 78.08 DISPLAY_IDENTIFIER AR_EGRV_CTL_THE ECU_ADDRESS 0x7f984c BYTE_ORDER MSB_LAST FORMAT "%5.3" /end MEASUREMENT
/begin MEASUREMENT lv_egr_ctl_thr "flag for an active EGR control with the throttle" UBYTE _CNV_S_2_RANGE______11_CM 1 0. 0. 1. DISPLAY_IDENTIFIER LV_EGR_CTL_THR ECU_ADDRESS 0x7fba58 /end MEASUREMENT
/begin MEASUREMENT ar_pi_egr_max "upper limit for the EGR- controller" SWORD _CNV_A_R_LINEAR_____154_CM 1 0. -78.08139 78.079008 DISPLAY_IDENTIFIER AR_PI_EGR_MAX ECU_ADDRESS 0x7fa6c8 BYTE_ORDER MSB_LAST FORMAT "%5.3" /end MEASUREMENT
/begin MEASUREMENT ar_pi_egr_min "lower limit for the EGR- controller" SWORD _CNV_A_R_LINEAR_____154_CM 1 0. -78.08139 78.079008 DISPLAY_IDENTIFIER AR_PI_EGR_MIN ECU_ADDRESS 0x7fa6ca BYTE_ORDER MSB_LAST FORMAT "%5.3" /end MEASUREMENT
/begin MEASUREMENT ar_pi_egr_min_lim "lower limit for the EGR- controller, absolut" SWORD _CNV_A_R_LINEAR_____154_CM 1 0. -78.08139 78.079008 DISPLAY_IDENTIFIER AR_PI_EGR_MIN_LIM ECU_ADDRESS 0x7fa6cc BYTE_ORDER MSB_LAST FORMAT "%5.3" /end MEASUREMENT
/begin MEASUREMENT ar_pi_egr_min_dif "lower limit for the EGR- controller, gradient" SWORD _CNV_A_R_LINEAR_____154_CM 1 0. -78.08139 78.079008 DISPLAY_IDENTIFIER AR_PI_EGR_MIN_DIF ECU_ADDRESS 0x7fa6ce BYTE_ORDER MSB_LAST FORMAT "%5.3" /end MEASUREMENT
/begin MEASUREMENT ar_pi_egr_min_bas "lower limit for the EGR- controller" SWORD _CNV_A_R_LINEAR_____154_CM 1 0. -78.08139 78.079008 DISPLAY_IDENTIFIER AR_PI_EGR_MIN_BAS ECU_ADDRESS 0x7fa6d0 BYTE_ORDER MSB_LAST FORMAT "%5.3" /end MEASUREMENT
/begin MEASUREMENT ar_pi_egr_max_lim "upper limit for the EGR- controller, absolut" SWORD _CNV_A_R_LINEAR_____154_CM 1 0. -78.08139 78.079008 DISPLAY_IDENTIFIER AR_PI_EGR_MAX_LIM ECU_ADDRESS 0x7fa6d2 BYTE_ORDER MSB_LAST FORMAT "%5.3" /end MEASUREMENT
/begin MEASUREMENT ar_pi_egr_max_dif "upper limit for the EGR- controller, gradient" SWORD _CNV_A_R_LINEAR_____154_CM 1 0. -78.08139 78.079008 DISPLAY_IDENTIFIER AR_PI_EGR_MAX_DIF ECU_ADDRESS 0x7fa6d4 BYTE_ORDER MSB_LAST FORMAT "%5.3" /end MEASUREMENT
/begin MEASUREMENT ar_pi_egr_max_bas "upper limit for the EGR- controller" SWORD _CNV_A_R_LINEAR_____154_CM 1 0. -78.08139 78.079008 DISPLAY_IDENTIFIER AR_PI_EGR_MAX_BAS ECU_ADDRESS 0x7fa6d6 BYTE_ORDER MSB_LAST FORMAT "%5.3" /end MEASUREMENT
/begin MEASUREMENT mafpwm_pi_min "lower limit for the controller output" SWORD _CNV_A_R_LINEAR_____12_CM 1 0. -100. 99.996948242 DISPLAY_IDENTIFIER MAFPWM_PI_MIN ECU_ADDRESS 0x7fa6d8 BYTE_ORDER MSB_LAST FORMAT "%5.3" /end MEASUREMENT
/begin MEASUREMENT mafpwm_pi_max "upper limit for the controller output" SWORD _CNV_A_R_LINEAR_____12_CM 1 0. -100. 99.996948242 DISPLAY_IDENTIFIER MAFPWM_PI_MAX ECU_ADDRESS 0x7fa6da BYTE_ORDER MSB_LAST FORMAT "%5.3" /end MEASUREMENT
/begin MEASUREMENT fac_mafpwm_pi_dt1 "output of the DT1-function for dynamic MAF controller output limitation" SWORD _CNV_A_R_LINEAR_____12_CM 1 0. -100. 99.996948242 DISPLAY_IDENTIFIER FAC_MAFPWM_PI_DT1 ECU_ADDRESS 0x7fa6dc BYTE_ORDER MSB_LAST FORMAT "%5.3" /end MEASUREMENT
/begin MEASUREMENT lv_mafpwm_thd_thr "activ controller parameters for the EGR- throttle" UBYTE _CNV_S_2_RANGE______11_CM 1 0. 0. 1. DISPLAY_IDENTIFIER LV_MAFPWM_THD_THR ECU_ADDRESS 0x7fba59 /end MEASUREMENT
/begin MEASUREMENT kr_pi_egr "gain for the EGR- controller" UWORD _CNV_A_R_LINEAR_____156_CM 1 0. 0. 3.123208 DISPLAY_IDENTIFIER KR_PI_EGR ECU_ADDRESS 0x7fa6de BYTE_ORDER MSB_LAST FORMAT "%6.5" /end MEASUREMENT
/begin MEASUREMENT tn_pi_egr "integral action time for the EGR- controller" UWORD _CNV_A_R_LINEAR_____67_CM 1 0. 0. 4.19424 DISPLAY_IDENTIFIER TN_PI_EGR ECU_ADDRESS 0x7fa6e0 BYTE_ORDER MSB_LAST FORMAT "%6.5" /end MEASUREMENT
/begin CHARACTERISTIC lc_egr_ctl_sub "button for back up EGR strategy" VALUE 0x85c31b _REC_VAL_20_u1 1. _CNV_A_R_LINEAR_____0_CM 0. 1. DISPLAY_IDENTIFIER LC_EGR_CTL_SUB FORMAT "%1.0" /end CHARACTERISTIC
/begin CHARACTERISTIC c_maf_cyl_sub "air mass flow value used to define EGR_SUB" VALUE 0x85bef6 _REC_VAL_20_u2 1389. _CNV_A_R_LINEAR_____23_CM 0. 1389. DISPLAY_IDENTIFIER C_MAF_CYL_SUB FORMAT "%6.2" /end CHARACTERISTIC
/begin CHARACTERISTIC lc_thr_3 "number of throttles" VALUE 0x85c36c _REC_VAL_20_u1 1. _CNV_A_R_LINEAR_____0_CM 0. 1. DISPLAY_IDENTIFIER LC_THR_3 FORMAT "%1.0" /end CHARACTERISTIC
/begin CHARACTERISTIC c_t_ramp_fac_ar_thr_byp "time to change between the two throttles" VALUE 0x85c106 _REC_VAL_20_u2 65.535 _CNV_A_R_LINEAR_____76_CM 0. 65.535 DISPLAY_IDENTIFIER C_T_RAMP_FAC_AR_THR_BYP FORMAT "%5.3" /end CHARACTERISTIC
/begin CHARACTERISTIC c_ar_egrv_max_dif "max. PI-gradient for the EGR- valve" VALUE 0x85bcf0 _REC_VAL_20_u2 78.08 _CNV_A_R_LINEAR_____7_CM 0. 78.08 DISPLAY_IDENTIFIER C_AR_EGRV_MAX_DIF FORMAT "%5.3" /end CHARACTERISTIC
/begin CHARACTERISTIC c_ar_thr_max_dif "max. PI-gradient for the EGR- throttle" VALUE 0x85bcf8 _REC_VAL_20_u2 78.08 _CNV_A_R_LINEAR_____7_CM 0. 78.08 DISPLAY_IDENTIFIER C_AR_THR_MAX_DIF FORMAT "%5.3" /end CHARACTERISTIC
/begin CHARACTERISTIC c_ar_thr_max_the "theoretic max. cross section of the EGR- throttle" VALUE 0x85bcfa _REC_VAL_20_u2 78.08 _CNV_A_R_LINEAR_____7_CM 0. 78.08 DISPLAY_IDENTIFIER C_AR_THR_MAX_THE FORMAT "%5.3" /end CHARACTERISTIC
/begin CHARACTERISTIC c_ar_thr_min_the "theoretic min. cross section of the EGR- throttle" VALUE 0x85bcfc _REC_VAL_20_u2 78.08 _CNV_A_R_LINEAR_____7_CM 0. 78.08 DISPLAY_IDENTIFIER C_AR_THR_MIN_THE FORMAT "%5.3" /end CHARACTERISTIC
/begin CHARACTERISTIC c_mafpwm_pi_dif "limit for EGR-controller output" VALUE 0x85bf26 _REC_VAL_20_u2 99.9969482421875 _CNV_A_R_LINEAR_____155_CM 0. 99.9969482421875 DISPLAY_IDENTIFIER C_MAFPWM_PI_DIF FORMAT "%5.3" /end CHARACTERISTIC
/begin CHARACTERISTIC c_mafpwm_max "maximal limit for MAF-controller output" VALUE 0x85bf1e _REC_VAL_20_u2 99.9969482421875 _CNV_A_R_LINEAR_____155_CM 0. 99.9969482421875 DISPLAY_IDENTIFIER C_MAFPWM_MAX FORMAT "%5.3" /end CHARACTERISTIC
/begin CHARACTERISTIC c_mafpwm_min "lower limit for MAF-controller output" VALUE 0x85bf20 _REC_VAL_20_u2 99.9969482421875 _CNV_A_R_LINEAR_____155_CM 0. 99.9969482421875 DISPLAY_IDENTIFIER C_MAFPWM_MIN FORMAT "%5.3" /end CHARACTERISTIC
/begin CHARACTERISTIC lc_mafpwm_pi_dt1 "button to activate the dynamic MAF controller output limitation" VALUE 0x85c33e _REC_VAL_20_u1 1. _CNV_A_R_LINEAR_____0_CM 0. 1. DISPLAY_IDENTIFIER LC_MAFPWM_PI_DT1 FORMAT "%1.0" /end CHARACTERISTIC
/begin CHARACTERISTIC c_tn_mafpwm_pi_dt1 "time value for dynamic MAF controller output limitation" VALUE 0x85c1bc _REC_VAL_20_u2 4.19424 _CNV_A_R_LINEAR_____67_CM 0. 4.19424 DISPLAY_IDENTIFIER C_TN_MAFPWM_PI_DT1 FORMAT "%6.5" /end CHARACTERISTIC
/begin CHARACTERISTIC c_kr_mafpwm_pi_dt1_tqi "gain for dynamic MAF controller output limitation" VALUE 0x85beaa _REC_VAL_20_s2 1.99997 _CNV_A_R_LINEAR_____157_CM -1. 0.99997 DISPLAY_IDENTIFIER C_KR_MAFPWM_PI_DT1_TQI FORMAT "%6.5" /end CHARACTERISTIC
/begin CHARACTERISTIC c_mafpwm_thd_thr "threshold for usage of throttle parameters" VALUE 0x85bf28 _REC_VAL_20_u2 99.9969482421875 _CNV_A_R_LINEAR_____155_CM 0. 99.9969482421875 DISPLAY_IDENTIFIER C_MAFPWM_THD_THR FORMAT "%5.3" /end CHARACTERISTIC
/begin CHARACTERISTIC c_mafpwm_hys_thr "hysteresis for usage of throttle parameters" VALUE 0x85bf1c _REC_VAL_20_u2 99.9969482421875 _CNV_A_R_LINEAR_____155_CM 0. 99.9969482421875 DISPLAY_IDENTIFIER C_MAFPWM_HYS_THR FORMAT "%5.3" /end CHARACTERISTIC
/begin CHARACTERISTIC ip_fac_kr_pi_egr__egr_dif "GE_ECTL: factor for the gain-value of the PI-controller" CURVE 0x84bad4 _REC_CUR_20_u2_u2 3.99998471 _CNV_A_R_LINEAR_____63_CM 0. 3.99998471 DISPLAY_IDENTIFIER IP_FAC_KR_PI_EGR__EGR_DIF FORMAT "%6.5"
 /begin AXIS_DESCR COM_AXIS egr_dif _CNV_A_R_LINEAR_____158_CM 6 -100. 99.99694820000001 FORMAT "%5.3" AXIS_PTS_REF ldpm_egr_dif_ip_fac_pi_egr /end AXIS_DESCR
/end CHARACTERISTIC
/begin AXIS_PTS ldpm_egr_dif_ip_fac_pi_egr "" 0x84346c egr_dif _REC_AXS_20_u2 199.9969482 _CNV_A_R_LINEAR_____158_CM 6 -100. 99.99694820000001 FORMAT "%5.3" /end AXIS_PTS
/begin CHARACTERISTIC ip_fac_tn_pi_egr__egr_dif "GE_ECTL: factor for the time-value of the PI-controller" CURVE 0x84c284 _REC_CUR_20_u2_u2 3.99998471 _CNV_A_R_LINEAR_____63_CM 0. 3.99998471 DISPLAY_IDENTIFIER IP_FAC_TN_PI_EGR__EGR_DIF FORMAT "%6.5"
 /begin AXIS_DESCR COM_AXIS egr_dif _CNV_A_R_LINEAR_____158_CM 6 -100. 99.99694820000001 FORMAT "%5.3" AXIS_PTS_REF ldpm_egr_dif_ip_fac_pi_egr /end AXIS_DESCR
/end CHARACTERISTIC
/begin CHARACTERISTIC ip_mafpwm_pi_max_dt1__n__fac "GE_ECTL: maximum value for dynamic MAF controller output limitation" MAP 0x84eabc _REC_MAP_20_u2_u2_u2 199.9969482 _CNV_A_R_LINEAR_____158_CM -100. 99.99694820000001 DISPLAY_IDENTIFIER IP_MAFPWM_PI_MAX_DT1__N__FAC FORMAT "%5.3"
 /begin AXIS_DESCR COM_AXIS n _CNV_A_R_LINEAR_____5_CM 16 0. 6375. FORMAT "%4.0" AXIS_PTS_REF ldpm_n_ip_mafpwm_pi_dt1 /end AXIS_DESCR
 /begin AXIS_DESCR COM_AXIS egr_dif _CNV_A_R_LINEAR_____158_CM 10 -100. 99.99694820000001 FORMAT "%5.3" AXIS_PTS_REF ldpm_fac_ip_mafpwm_pi_dt1 /end AXIS_DESCR
/end CHARACTERISTIC
/begin AXIS_PTS ldpm_n_ip_mafpwm_pi_dt1 "" 0x843b38 n _REC_AXS_20_u2 6375. _CNV_A_R_LINEAR_____5_CM 16 0. 6375. FORMAT "%4.0" /end AXIS_PTS
/begin AXIS_PTS ldpm_fac_ip_mafpwm_pi_dt1 "" 0x84347a egr_dif _REC_AXS_20_u2 199.9969482 _CNV_A_R_LINEAR_____158_CM 10 -100. 99.99694820000001 FORMAT "%5.3" /end AXIS_PTS
/begin CHARACTERISTIC ip_mafpwm_pi_min_dt1__n__fac "GE_ECTL: minimum value for dynamic MAF controller output limitation" MAP 0x84edfc _REC_MAP_20_u2_u2_u2 199.9969482 _CNV_A_R_LINEAR_____158_CM -100. 99.99694820000001 DISPLAY_IDENTIFIER IP_MAFPWM_PI_MIN_DT1__N__FAC FORMAT "%5.3"
 /begin AXIS_DESCR COM_AXIS n _CNV_A_R_LINEAR_____5_CM 16 0. 6375. FORMAT "%4.0" AXIS_PTS_REF ldpm_n_ip_mafpwm_pi_dt1 /end AXIS_DESCR
 /begin AXIS_DESCR COM_AXIS egr_dif _CNV_A_R_LINEAR_____158_CM 10 -100. 99.99694820000001 FORMAT "%5.3" AXIS_PTS_REF ldpm_fac_ip_mafpwm_pi_dt1 /end AXIS_DESCR
/end CHARACTERISTIC
/begin CHARACTERISTIC ip_mafpwm_pi_min "GE_ECTL: minimum value for EGR controller output" MAP 0x84ebfc _REC_MAP_20_u2_u2_u2 199.9969482 _CNV_A_R_LINEAR_____158_CM -100. 99.99694820000001 DISPLAY_IDENTIFIER IP_MAFPWM_PI_MIN FORMAT "%5.3"
 /begin AXIS_DESCR COM_AXIS n _CNV_A_R_LINEAR_____5_CM 16 0. 6375. FORMAT "%4.0" AXIS_PTS_REF ldpm_n_ip_mafpwm_pi_lim /end AXIS_DESCR
 /begin AXIS_DESCR COM_AXIS tqi_egr _CNV_A_R_LINEAR_____62_CM 16 0. 1023.96875 FORMAT "%6.2" AXIS_PTS_REF ldpm_tqi_ip_mafpwm_pi_lim /end AXIS_DESCR
/end CHARACTERISTIC
/begin AXIS_PTS ldpm_n_ip_mafpwm_pi_lim "" 0x843b5a n _REC_AXS_20_u2 6375. _CNV_A_R_LINEAR_____5_CM 16 0. 6375. FORMAT "%4.0" /end AXIS_PTS
/begin AXIS_PTS ldpm_tqi_ip_mafpwm_pi_lim "" 0x84408a tqi_egr _REC_AXS_20_u2 1023.96875 _CNV_A_R_LINEAR_____62_CM 16 0. 1023.96875 FORMAT "%6.2" /end AXIS_PTS
/begin CHARACTERISTIC ip_mafpwm_pi_max "GE_ECTL: maximum value for EGR controller output" MAP 0x84e8bc _REC_MAP_20_u2_u2_u2 199.9969482 _CNV_A_R_LINEAR_____158_CM -100. 99.99694820000001 DISPLAY_IDENTIFIER IP_MAFPWM_PI_MAX FORMAT "%5.3"
 /begin AXIS_DESCR COM_AXIS n _CNV_A_R_LINEAR_____5_CM 16 0. 6375. FORMAT "%4.0" AXIS_PTS_REF ldpm_n_ip_mafpwm_pi_lim /end AXIS_DESCR
 /begin AXIS_DESCR COM_AXIS tqi_egr _CNV_A_R_LINEAR_____62_CM 16 0. 1023.96875 FORMAT "%6.2" AXIS_PTS_REF ldpm_tqi_ip_mafpwm_pi_lim /end AXIS_DESCR
/end CHARACTERISTIC
/begin CHARACTERISTIC ip_kr_pi_thr "GE_ECTL: gain value for EGR controlling with the EGR- throttle" MAP 0x84ceea _REC_MAP_20_u2_u2_u2 3.123208 _CNV_A_R_LINEAR_____156_CM 0. 3.123208 DISPLAY_IDENTIFIER IP_KR_PI_THR FORMAT "%6.5"
 /begin AXIS_DESCR COM_AXIS n _CNV_A_R_LINEAR_____5_CM 6 0. 6375. FORMAT "%4.0" AXIS_PTS_REF ldpm_n_ip_pi_egr /end AXIS_DESCR
 /begin AXIS_DESCR COM_AXIS tqi_egr _CNV_A_R_LINEAR_____62_CM 6 0. 1023.96875 FORMAT "%6.2" AXIS_PTS_REF ldpm_tqi_ip_kr_pi_egr /end AXIS_DESCR
/end CHARACTERISTIC
/begin AXIS_PTS ldpm_n_ip_pi_egr "" 0x843c52 n _REC_AXS_20_u2 6375. _CNV_A_R_LINEAR_____5_CM 6 0. 6375. FORMAT "%4.0" /end AXIS_PTS
/begin AXIS_PTS ldpm_tqi_ip_kr_pi_egr "" 0x843fec tqi_egr _REC_AXS_20_u2 1023.96875 _CNV_A_R_LINEAR_____62_CM 6 0. 1023.96875 FORMAT "%6.2" /end AXIS_PTS
/begin CHARACTERISTIC ip_kr_pi_egrv "GE_ECTL: gain value for EGR controlling with the EGR- valve" MAP 0x84cd02 _REC_MAP_20_u2_u2_u2 3.123208 _CNV_A_R_LINEAR_____156_CM 0. 3.123208 DISPLAY_IDENTIFIER IP_KR_PI_EGRV FORMAT "%6.5"
 /begin AXIS_DESCR COM_AXIS n _CNV_A_R_LINEAR_____5_CM 6 0. 6375. FORMAT "%4.0" AXIS_PTS_REF ldpm_n_ip_pi_egr /end AXIS_DESCR
 /begin AXIS_DESCR COM_AXIS tqi_egr _CNV_A_R_LINEAR_____62_CM 6 0. 1023.96875 FORMAT "%6.2" AXIS_PTS_REF ldpm_tqi_ip_kr_pi_egr /end AXIS_DESCR
/end CHARACTERISTIC
/begin CHARACTERISTIC ip_kr_pi_sub_thr "GE_ECTL: gain value for EGR controlling with the EGR- throttle_a" MAP 0x84cea2 _REC_MAP_20_u2_u2_u2 3.123208 _CNV_A_R_LINEAR_____156_CM 0. 3.123208 DISPLAY_IDENTIFIER IP_KR_PI_SUB_THR FORMAT "%6.5"
 /begin AXIS_DESCR COM_AXIS n _CNV_A_R_LINEAR_____5_CM 6 0. 6375. FORMAT "%4.0" AXIS_PTS_REF ldpm_n_ip_pi_egr /end AXIS_DESCR
 /begin AXIS_DESCR COM_AXIS tqi_egr _CNV_A_R_LINEAR_____62_CM 6 0. 1023.96875 FORMAT "%6.2" AXIS_PTS_REF ldpm_tqi_ip_kr_pi_egr /end AXIS_DESCR
/end CHARACTERISTIC
/begin CHARACTERISTIC ip_kr_pi_sub_egrv "GE_ECTL: gain value for EGR controlling with the EGR- valve_a" MAP 0x84ce5a _REC_MAP_20_u2_u2_u2 3.123208 _CNV_A_R_LINEAR_____156_CM 0. 3.123208 DISPLAY_IDENTIFIER IP_KR_PI_SUB_EGRV FORMAT "%6.5"
 /begin AXIS_DESCR COM_AXIS n _CNV_A_R_LINEAR_____5_CM 6 0. 6375. FORMAT "%4.0" AXIS_PTS_REF ldpm_n_ip_pi_egr /end AXIS_DESCR
 /begin AXIS_DESCR COM_AXIS tqi_egr _CNV_A_R_LINEAR_____62_CM 6 0. 1023.96875 FORMAT "%6.2" AXIS_PTS_REF ldpm_tqi_ip_kr_pi_egr /end AXIS_DESCR
/end CHARACTERISTIC
/begin CHARACTERISTIC ip_tn_pi_thr "GE_ECTL: integral action time for EGR controlling with the EGR- throttle" MAP 0x85b0a8 _REC_MAP_20_u2_u2_u2 4.19424 _CNV_A_R_LINEAR_____67_CM 0. 4.19424 DISPLAY_IDENTIFIER IP_TN_PI_THR FORMAT "%6.5"
 /begin AXIS_DESCR COM_AXIS n _CNV_A_R_LINEAR_____5_CM 6 0. 6375. FORMAT "%4.0" AXIS_PTS_REF ldpm_n_ip_pi_egr /end AXIS_DESCR
 /begin AXIS_DESCR COM_AXIS tqi_egr _CNV_A_R_LINEAR_____62_CM 6 0. 1023.96875 FORMAT "%6.2" AXIS_PTS_REF ldpm_tqi_ip_kr_pi_egr /end AXIS_DESCR
/end CHARACTERISTIC
/begin CHARACTERISTIC ip_tn_pi_egrv "GE_ECTL: integral action time for EGR controlling with the EGR- valve" MAP 0x85aec0 _REC_MAP_20_u2_u2_u2 4.19424 _CNV_A_R_LINEAR_____67_CM 0. 4.19424 DISPLAY_IDENTIFIER IP_TN_PI_EGRV FORMAT "%6.5"
 /begin AXIS_DESCR COM_AXIS n _CNV_A_R_LINEAR_____5_CM 6 0. 6375. FORMAT "%4.0" AXIS_PTS_REF ldpm_n_ip_pi_egr /end AXIS_DESCR
 /begin AXIS_DESCR COM_AXIS tqi_egr _CNV_A_R_LINEAR_____62_CM 6 0. 1023.96875 FORMAT "%6.2" AXIS_PTS_REF ldpm_tqi_ip_kr_pi_egr /end AXIS_DESCR
/end CHARACTERISTIC
/begin CHARACTERISTIC ip_tn_pi_sub_thr "GE_ECTL: integral action time for EGR controlling with the EGR- throttle_a" MAP 0x85b060 _REC_MAP_20_u2_u2_u2 4.19424 _CNV_A_R_LINEAR_____67_CM 0. 4.19424 DISPLAY_IDENTIFIER IP_TN_PI_SUB_THR FORMAT "%6.5"
 /begin AXIS_DESCR COM_AXIS n _CNV_A_R_LINEAR_____5_CM 6 0. 6375. FORMAT "%4.0" AXIS_PTS_REF ldpm_n_ip_pi_egr /end AXIS_DESCR
 /begin AXIS_DESCR COM_AXIS tqi_egr _CNV_A_R_LINEAR_____62_CM 6 0. 1023.96875 FORMAT "%6.2" AXIS_PTS_REF ldpm_tqi_ip_kr_pi_egr /end AXIS_DESCR
/end CHARACTERISTIC
/begin CHARACTERISTIC ip_tn_pi_sub_egrv "GE_ECTL: integral action time for EGR controlling with the EGR- valve_a" MAP 0x85b018 _REC_MAP_20_u2_u2_u2 4.19424 _CNV_A_R_LINEAR_____67_CM 0. 4.19424 DISPLAY_IDENTIFIER IP_TN_PI_SUB_EGRV FORMAT "%6.5"
 /begin AXIS_DESCR COM_AXIS n _CNV_A_R_LINEAR_____5_CM 6 0. 6375. FORMAT "%4.0" AXIS_PTS_REF ldpm_n_ip_pi_egr /end AXIS_DESCR
 /begin AXIS_DESCR COM_AXIS tqi_egr _CNV_A_R_LINEAR_____62_CM 6 0. 1023.96875 FORMAT "%6.2" AXIS_PTS_REF ldpm_tqi_ip_kr_pi_egr /end AXIS_DESCR
/end CHARACTERISTIC
/begin MEASUREMENT prs_ex "exhaust back pressure" UWORD _CNV_A_R_LINEAR_____21_CM 1 0. 0. 5434. DISPLAY_IDENTIFIER PRS_EX ECU_ADDRESS 0x7f984e BYTE_ORDER MSB_LAST FORMAT "%6.2" /end MEASUREMENT
/begin MEASUREMENT temp_ex "exhaust gas temperature" UWORD _CNV_A_R_LINEAR_____153_CM 1 0. 0. 1023.984375 DISPLAY_IDENTIFIER TEMP_EX ECU_ADDRESS 0x7f9850 BYTE_ORDER MSB_LAST FORMAT "%6.2" /end MEASUREMENT
/begin MEASUREMENT temp_ex_sp "estimated exhaust gas temperature" UWORD _CNV_A_R_LINEAR_____153_CM 1 0. 0. 1023.984375 DISPLAY_IDENTIFIER TEMP_EX_SP ECU_ADDRESS 0x7f9852 BYTE_ORDER MSB_LAST FORMAT "%6.2" /end MEASUREMENT
/begin MEASUREMENT prs_ex_sp "estimated exhaust back pressure" UWORD _CNV_A_R_LINEAR_____21_CM 1 0. 0. 5434. DISPLAY_IDENTIFIER PRS_EX_SP ECU_ADDRESS 0x7f9854 BYTE_ORDER MSB_LAST FORMAT "%6.2" /end MEASUREMENT
/begin MEASUREMENT w_ind "indicated work" UWORD _CNV_A_R_LINEAR_____160_CM 1 0. 0. 6553.5 DISPLAY_IDENTIFIER W_IND ECU_ADDRESS 0x7fa74c BYTE_ORDER MSB_LAST FORMAT "%5.1" /end MEASUREMENT
/begin MEASUREMENT temp_ex_gas_up_pf[0] "" UWORD _CNV_A_R_LINEAR_____153_CM 1 0. 0. 1023.984375 DISPLAY_IDENTIFIER TEMP_EX_GAS_UP_PF ECU_ADDRESS 0x7fa702 BYTE_ORDER MSB_LAST FORMAT "%6.2" /end MEASUREMENT
/begin MEASUREMENT temp_ex_gas_up_pf[1] "" UWORD _CNV_A_R_LINEAR_____153_CM 1 0. 0. 1023.984375 DISPLAY_IDENTIFIER TEMP_EX_GAS_UP_PF_SP ECU_ADDRESS 0x7fa704 BYTE_ORDER MSB_LAST FORMAT "%6.2" /end MEASUREMENT
/begin MEASUREMENT prs_ex_mdl[0] "" UWORD _CNV_A_R_LINEAR_____21_CM 1 0. 0. 5434. DISPLAY_IDENTIFIER PRS_EX_MDL ECU_ADDRESS 0x7fa74e BYTE_ORDER MSB_LAST FORMAT "%6.2" /end MEASUREMENT
/begin MEASUREMENT prs_ex_mdl[1] "" UWORD _CNV_A_R_LINEAR_____21_CM 1 0. 0. 5434. DISPLAY_IDENTIFIER PRS_EX_MDL_SP ECU_ADDRESS 0x7fa750 BYTE_ORDER MSB_LAST FORMAT "%6.2" /end MEASUREMENT
/begin MEASUREMENT maf_cmp_kgh[0] "" UWORD _CNV_A_R_LINEAR_____112_CM 1 0. 0. 1023.984375 DISPLAY_IDENTIFIER MAF_CMP_KGH ECU_ADDRESS 0x7f989e BYTE_ORDER MSB_LAST FORMAT "%6.2" /end MEASUREMENT
/begin MEASUREMENT maf_cmp_kgh[1] "" UWORD _CNV_A_R_LINEAR_____112_CM 1 0. 0. 1023.984375 DISPLAY_IDENTIFIER MAF_CMP_KGH_SP ECU_ADDRESS 0x7f98a0 BYTE_ORDER MSB_LAST FORMAT "%6.2" /end MEASUREMENT
/begin MEASUREMENT dip_ico[0] "" UWORD _CNV_A_R_LINEAR_____21_CM 1 0. 0. 5434. DISPLAY_IDENTIFIER DIP_ICO ECU_ADDRESS 0x7fa6f6 BYTE_ORDER MSB_LAST FORMAT "%6.2" /end MEASUREMENT
/begin MEASUREMENT dip_ico[1] "" UWORD _CNV_A_R_LINEAR_____21_CM 1 0. 0. 5434. DISPLAY_IDENTIFIER DIP_ICO_SP ECU_ADDRESS 0x7fa6f8 BYTE_ORDER MSB_LAST FORMAT "%6.2" /end MEASUREMENT
/begin MEASUREMENT prs_up_cmp[0] "" UWORD _CNV_A_R_LINEAR_____21_CM 1 0. 0. 5434. DISPLAY_IDENTIFIER PRS_UP_CMP ECU_ADDRESS 0x7fa798 BYTE_ORDER MSB_LAST FORMAT "%6.2" /end MEASUREMENT
/begin MEASUREMENT prs_up_cmp[1] "" UWORD _CNV_A_R_LINEAR_____21_CM 1 0. 0. 5434. DISPLAY_IDENTIFIER PRS_UP_CMP_SP ECU_ADDRESS 0x7fa79a BYTE_ORDER MSB_LAST FORMAT "%6.2" /end MEASUREMENT
/begin MEASUREMENT eff_tcha[0] "" UWORD _CNV_A_R_LINEAR_____136_CM 1 0. 0. 100. DISPLAY_IDENTIFIER EFF_TCHA ECU_ADDRESS 0x7fa6fe BYTE_ORDER MSB_LAST /end MEASUREMENT
/begin MEASUREMENT eff_tcha[1] "" UWORD _CNV_A_R_LINEAR_____136_CM 1 0. 0. 100. DISPLAY_IDENTIFIER EFF_TCHA_SP ECU_ADDRESS 0x7fa700 BYTE_ORDER MSB_LAST /end MEASUREMENT
/begin MEASUREMENT n_tcha[0] "" UWORD _CNV_A_R_LINEAR_____161_CM 1 0. 0. 255. DISPLAY_IDENTIFIER N_TCHA ECU_ADDRESS 0x7fa6fa BYTE_ORDER MSB_LAST /end MEASUREMENT
/begin MEASUREMENT n_tcha[1] "" UWORD _CNV_A_R_LINEAR_____161_CM 1 0. 0. 255. DISPLAY_IDENTIFIER N_TCHA_SP ECU_ADDRESS 0x7fa6fc BYTE_ORDER MSB_LAST /end MEASUREMENT
/begin MEASUREMENT eff_tur[0] "" UWORD _CNV_A_R_LINEAR_____136_CM 1 0. 0. 100. DISPLAY_IDENTIFIER EFF_TUR ECU_ADDRESS 0x7fa756 BYTE_ORDER MSB_LAST /end MEASUREMENT
/begin MEASUREMENT eff_tur[1] "" UWORD _CNV_A_R_LINEAR_____136_CM 1 0. 0. 100. DISPLAY_IDENTIFIER EFF_TUR_SP ECU_ADDRESS 0x7fa758 BYTE_ORDER MSB_LAST /end MEASUREMENT
/begin MEASUREMENT eff_mec_tcha[0] "" UWORD _CNV_A_R_LINEAR_____136_CM 1 0. 0. 100. DISPLAY_IDENTIFIER EFF_MEC_TCHA ECU_ADDRESS 0x7fa75a BYTE_ORDER MSB_LAST /end MEASUREMENT
/begin MEASUREMENT eff_mec_tcha[1] "" UWORD _CNV_A_R_LINEAR_____136_CM 1 0. 0. 100. DISPLAY_IDENTIFIER EFF_MEC_TCHA_SP ECU_ADDRESS 0x7fa75c BYTE_ORDER MSB_LAST /end MEASUREMENT
/begin MEASUREMENT eff_tur_cor[0] "" UWORD _CNV_A_R_LINEAR_____162_CM 1 0. 0. 655.35 DISPLAY_IDENTIFIER EFF_TUR_COR ECU_ADDRESS 0x7fa75e BYTE_ORDER MSB_LAST /end MEASUREMENT
/begin MEASUREMENT eff_tur_cor[1] "" UWORD _CNV_A_R_LINEAR_____162_CM 1 0. 0. 655.35 DISPLAY_IDENTIFIER EFF_TUR_COR_SP ECU_ADDRESS 0x7fa760 BYTE_ORDER MSB_LAST /end MEASUREMENT
/begin MEASUREMENT prs_down_cmp[0] "" UWORD _CNV_A_R_LINEAR_____21_CM 1 0. 0. 5434. DISPLAY_IDENTIFIER PRS_DOWN_CMP ECU_ADDRESS 0x7fa762 BYTE_ORDER MSB_LAST FORMAT "%6.2" /end MEASUREMENT
/begin MEASUREMENT prs_down_cmp[1] "" UWORD _CNV_A_R_LINEAR_____21_CM 1 0. 0. 5434. DISPLAY_IDENTIFIER PRS_DOWN_CMP_SP ECU_ADDRESS 0x7fa764 BYTE_ORDER MSB_LAST FORMAT "%6.2" /end MEASUREMENT
/begin MEASUREMENT eff_cmp[0] "" UWORD _CNV_A_R_LINEAR_____14_CM 1 0. 0. 0.9999847412109381 DISPLAY_IDENTIFIER EFF_CMP ECU_ADDRESS 0x7fa766 BYTE_ORDER MSB_LAST FORMAT "%6.2" /end MEASUREMENT
/begin MEASUREMENT eff_cmp[1] "" UWORD _CNV_A_R_LINEAR_____14_CM 1 0. 0. 0.9999847412109381 DISPLAY_IDENTIFIER EFF_CMP_SP ECU_ADDRESS 0x7fa768 BYTE_ORDER MSB_LAST FORMAT "%6.2" /end MEASUREMENT
/begin MEASUREMENT temp_down_cmp[0] "" UWORD _CNV_A_R_LINEAR_____101_CM 1 0. 0. 4095.9375 DISPLAY_IDENTIFIER TEMP_DOWN_CMP ECU_ADDRESS 0x7fa76a BYTE_ORDER MSB_LAST FORMAT "%6.2" /end MEASUREMENT
/begin MEASUREMENT temp_down_cmp[1] "" UWORD _CNV_A_R_LINEAR_____101_CM 1 0. 0. 4095.9375 DISPLAY_IDENTIFIER TEMP_DOWN_CMP_SP ECU_ADDRESS 0x7fa76c BYTE_ORDER MSB_LAST FORMAT "%6.2" /end MEASUREMENT
/begin MEASUREMENT pq_cmp[0] "" UWORD _CNV_A_R_LINEAR_____163_CM 1 0. 0. 6.5535 DISPLAY_IDENTIFIER PQ_CMP ECU_ADDRESS 0x7fa76e BYTE_ORDER MSB_LAST FORMAT "%5.4" /end MEASUREMENT
/begin MEASUREMENT pq_cmp[1] "" UWORD _CNV_A_R_LINEAR_____163_CM 1 0. 0. 6.5535 DISPLAY_IDENTIFIER PQ_CMP_SP ECU_ADDRESS 0x7fa770 BYTE_ORDER MSB_LAST FORMAT "%5.4" /end MEASUREMENT
/begin MEASUREMENT maf_kgh_stnd[0] "" UWORD _CNV_A_R_LINEAR_____112_CM 1 0. 0. 1023.984375 DISPLAY_IDENTIFIER MAF_KGH_STND ECU_ADDRESS 0x7fa772 BYTE_ORDER MSB_LAST FORMAT "%6.2" /end MEASUREMENT
/begin MEASUREMENT maf_kgh_stnd[1] "" UWORD _CNV_A_R_LINEAR_____112_CM 1 0. 0. 1023.984375 DISPLAY_IDENTIFIER MAF_KGH_STND_SP ECU_ADDRESS 0x7fa774 BYTE_ORDER MSB_LAST FORMAT "%6.2" /end MEASUREMENT
/begin MEASUREMENT m_tur_kgh[0] "" UWORD _CNV_A_R_LINEAR_____112_CM 1 0. 0. 1023.984375 DISPLAY_IDENTIFIER M_TUR_KGH ECU_ADDRESS 0x7f985a BYTE_ORDER MSB_LAST FORMAT "%6.2" /end MEASUREMENT
/begin MEASUREMENT m_tur_kgh[1] "" UWORD _CNV_A_R_LINEAR_____112_CM 1 0. 0. 1023.984375 DISPLAY_IDENTIFIER M_TUR_KGH_SP ECU_ADDRESS 0x7f985c BYTE_ORDER MSB_LAST FORMAT "%6.2" /end MEASUREMENT
/begin MEASUREMENT m_tur[0] "" UWORD _CNV_A_R_LINEAR_____112_CM 1 0. 0. 1023.984375 DISPLAY_IDENTIFIER M_TUR ECU_ADDRESS 0x7f985e BYTE_ORDER MSB_LAST FORMAT "%6.2" /end MEASUREMENT
/begin MEASUREMENT m_tur[1] "" UWORD _CNV_A_R_LINEAR_____112_CM 1 0. 0. 1023.984375 DISPLAY_IDENTIFIER M_TUR_SP ECU_ADDRESS 0x7f9860 BYTE_ORDER MSB_LAST FORMAT "%6.2" /end MEASUREMENT
/begin MEASUREMENT m_tur_kgh_stnd[0] "" UWORD _CNV_A_R_LINEAR_____112_CM 1 0. 0. 1023.984375 DISPLAY_IDENTIFIER M_TUR_KGH_STND ECU_ADDRESS 0x7fa776 BYTE_ORDER MSB_LAST FORMAT "%6.2" /end MEASUREMENT
/begin MEASUREMENT m_tur_kgh_stnd[1] "" UWORD _CNV_A_R_LINEAR_____112_CM 1 0. 0. 1023.984375 DISPLAY_IDENTIFIER M_TUR_KGH_STND_SP ECU_ADDRESS 0x7fa778 BYTE_ORDER MSB_LAST FORMAT "%6.2" /end MEASUREMENT
/begin MEASUREMENT inv_div_prs_tur[0] "" UWORD _CNV_A_R_LINEAR_____145_CM 1 0. 0. 6.5535 DISPLAY_IDENTIFIER INV_DIV_PRS_TUR ECU_ADDRESS 0x7fa77a BYTE_ORDER MSB_LAST FORMAT "%5.4" /end MEASUREMENT
/begin MEASUREMENT inv_div_prs_tur[1] "" UWORD _CNV_A_R_LINEAR_____145_CM 1 0. 0. 6.5535 DISPLAY_IDENTIFIER INV_DIV_PRS_TUR_SP ECU_ADDRESS 0x7fa77c BYTE_ORDER MSB_LAST FORMAT "%5.4" /end MEASUREMENT
/begin MEASUREMENT n_tcha_stnd[0] "" UWORD _CNV_A_R_LINEAR_____14_CM 1 0. 0. 0.9999847412109381 DISPLAY_IDENTIFIER N_TCHA_STND ECU_ADDRESS 0x7f989a BYTE_ORDER MSB_LAST FORMAT "%6.2" /end MEASUREMENT
/begin MEASUREMENT n_tcha_stnd[1] "" UWORD _CNV_A_R_LINEAR_____14_CM 1 0. 0. 0.9999847412109381 DISPLAY_IDENTIFIER N_TCHA_STND_SP ECU_ADDRESS 0x7f989c BYTE_ORDER MSB_LAST FORMAT "%6.2" /end MEASUREMENT
/begin MEASUREMENT div_capa_heat_prs[0] "" UWORD _CNV_A_R_LINEAR_____53_CM 1 0. 0. 1.9999696 DISPLAY_IDENTIFIER DIV_CAPA_HEAT_PRS ECU_ADDRESS 0x7f9862 BYTE_ORDER MSB_LAST FORMAT "%5.4" /end MEASUREMENT
/begin MEASUREMENT div_capa_heat_prs[1] "" UWORD _CNV_A_R_LINEAR_____53_CM 1 0. 0. 1.9999696 DISPLAY_IDENTIFIER DIV_CAPA_HEAT_PRS_SP ECU_ADDRESS 0x7f9864 BYTE_ORDER MSB_LAST FORMAT "%5.4" /end MEASUREMENT
/begin MEASUREMENT div_temp[0] "" UWORD _CNV_A_R_LINEAR_____145_CM 1 0. 0. 6.5535 DISPLAY_IDENTIFIER DIV_TEMP ECU_ADDRESS 0x7f9866 BYTE_ORDER MSB_LAST FORMAT "%5.4" /end MEASUREMENT
/begin MEASUREMENT div_temp[1] "" UWORD _CNV_A_R_LINEAR_____145_CM 1 0. 0. 6.5535 DISPLAY_IDENTIFIER DIV_TEMP_SP ECU_ADDRESS 0x7f9868 BYTE_ORDER MSB_LAST FORMAT "%5.4" /end MEASUREMENT
/begin MEASUREMENT tcha_fac1[0] "" UWORD _CNV_A_R_LINEAR_____53_CM 1 0. 0. 1.9999696 DISPLAY_IDENTIFIER TCHA_FAC1 ECU_ADDRESS 0x7f986a BYTE_ORDER MSB_LAST FORMAT "%6.2" /end MEASUREMENT
/begin MEASUREMENT tcha_fac1[1] "" UWORD _CNV_A_R_LINEAR_____53_CM 1 0. 0. 1.9999696 DISPLAY_IDENTIFIER TCHA_FAC1_SP ECU_ADDRESS 0x7f986c BYTE_ORDER MSB_LAST FORMAT "%6.2" /end MEASUREMENT
/begin MEASUREMENT tcha_fac2[0] "" UWORD _CNV_A_R_LINEAR_____14_CM 1 0. 0. 0.9999847412109381 DISPLAY_IDENTIFIER TCHA_FAC2 ECU_ADDRESS 0x7f986e BYTE_ORDER MSB_LAST FORMAT "%5.4" /end MEASUREMENT
/begin MEASUREMENT tcha_fac2[1] "" UWORD _CNV_A_R_LINEAR_____14_CM 1 0. 0. 0.9999847412109381 DISPLAY_IDENTIFIER TCHA_FAC2_SP ECU_ADDRESS 0x7f9870 BYTE_ORDER MSB_LAST FORMAT "%5.4" /end MEASUREMENT
/begin MEASUREMENT tcha_fac3[0] "" UWORD _CNV_A_R_LINEAR_____63_CM 1 0. 0. 3.99998471 DISPLAY_IDENTIFIER TCHA_FAC3 ECU_ADDRESS 0x7f9872 BYTE_ORDER MSB_LAST FORMAT "%6.5" /end MEASUREMENT
/begin MEASUREMENT tcha_fac3[1] "" UWORD _CNV_A_R_LINEAR_____63_CM 1 0. 0. 3.99998471 DISPLAY_IDENTIFIER TCHA_FAC3_SP ECU_ADDRESS 0x7f9874 BYTE_ORDER MSB_LAST FORMAT "%6.5" /end MEASUREMENT
/begin MEASUREMENT tcha_fac4[0] "" UWORD _CNV_A_R_LINEAR_____164_CM 1 0. 0. 199.9969482 DISPLAY_IDENTIFIER TCHA_FAC4 ECU_ADDRESS 0x7f9876 BYTE_ORDER MSB_LAST /end MEASUREMENT
/begin MEASUREMENT tcha_fac4[1] "" UWORD _CNV_A_R_LINEAR_____164_CM 1 0. 0. 199.9969482 DISPLAY_IDENTIFIER TCHA_FAC4_SP ECU_ADDRESS 0x7f9878 BYTE_ORDER MSB_LAST /end MEASUREMENT
/begin MEASUREMENT tcha_fac5[0] "" UWORD _CNV_A_R_LINEAR_____164_CM 1 0. 0. 199.9969482 DISPLAY_IDENTIFIER TCHA_FAC5 ECU_ADDRESS 0x7f987a BYTE_ORDER MSB_LAST /end MEASUREMENT
/begin MEASUREMENT tcha_fac5[1] "" UWORD _CNV_A_R_LINEAR_____164_CM 1 0. 0. 199.9969482 DISPLAY_IDENTIFIER TCHA_FAC5_SP ECU_ADDRESS 0x7f987c BYTE_ORDER MSB_LAST /end MEASUREMENT
/begin MEASUREMENT tcha_fac6[0] "" UWORD _CNV_A_R_LINEAR_____130_CM 1 0. 0. 100. DISPLAY_IDENTIFIER TCHA_FAC6 ECU_ADDRESS 0x7f987e BYTE_ORDER MSB_LAST /end MEASUREMENT
/begin MEASUREMENT tcha_fac6[1] "" UWORD _CNV_A_R_LINEAR_____130_CM 1 0. 0. 100. DISPLAY_IDENTIFIER TCHA_FAC6_SP ECU_ADDRESS 0x7f9880 BYTE_ORDER MSB_LAST /end MEASUREMENT
/begin MEASUREMENT div_mass[0] "" UWORD _CNV_A_R_LINEAR_____53_CM 1 0. 0. 1.9999696 DISPLAY_IDENTIFIER DIV_MASS ECU_ADDRESS 0x7f9882 BYTE_ORDER MSB_LAST FORMAT "%6.4" /end MEASUREMENT
/begin MEASUREMENT div_mass[1] "" UWORD _CNV_A_R_LINEAR_____53_CM 1 0. 0. 1.9999696 DISPLAY_IDENTIFIER DIV_MASS_SP ECU_ADDRESS 0x7f9884 BYTE_ORDER MSB_LAST FORMAT "%6.4" /end MEASUREMENT
/begin MEASUREMENT prs_ex_gas_up_tur[0] "" UWORD _CNV_A_R_LINEAR_____21_CM 1 0. 0. 5434. DISPLAY_IDENTIFIER PRS_EX_GAS_UP_TUR ECU_ADDRESS 0x7f9886 BYTE_ORDER MSB_LAST FORMAT "%6.2" /end MEASUREMENT
/begin MEASUREMENT prs_ex_gas_up_tur[1] "" UWORD _CNV_A_R_LINEAR_____21_CM 1 0. 0. 5434. DISPLAY_IDENTIFIER PRS_EX_GAS_UP_TUR_SP ECU_ADDRESS 0x7f9888 BYTE_ORDER MSB_LAST FORMAT "%6.2" /end MEASUREMENT
/begin MEASUREMENT capa_heat_prs_ex[0] "" UWORD _CNV_A_R_LINEAR_____165_CM 1 0. 0. 2550. DISPLAY_IDENTIFIER CAPA_HEAT_PRS_EX ECU_ADDRESS 0x7f988a BYTE_ORDER MSB_LAST FORMAT "%6.2" /end MEASUREMENT
/begin MEASUREMENT capa_heat_prs_ex[1] "" UWORD _CNV_A_R_LINEAR_____165_CM 1 0. 0. 2550. DISPLAY_IDENTIFIER CAPA_HEAT_PRS_EX_SP ECU_ADDRESS 0x7f988c BYTE_ORDER MSB_LAST FORMAT "%6.2" /end MEASUREMENT
/begin MEASUREMENT kapa_ex[0] "" UWORD _CNV_A_R_LINEAR_____53_CM 1 0. 0. 1.9999696 DISPLAY_IDENTIFIER KAPA_EX ECU_ADDRESS 0x7f98a2 BYTE_ORDER MSB_LAST FORMAT "%6.4" /end MEASUREMENT
/begin MEASUREMENT kapa_ex[1] "" UWORD _CNV_A_R_LINEAR_____53_CM 1 0. 0. 1.9999696 DISPLAY_IDENTIFIER KAPA_EX_SP ECU_ADDRESS 0x7f98a4 BYTE_ORDER MSB_LAST FORMAT "%6.4" /end MEASUREMENT
/begin MEASUREMENT capa_heat_vol_ex_mwm[0] "" UWORD _CNV_A_R_LINEAR_____165_CM 1 0. 0. 2550. DISPLAY_IDENTIFIER CAPA_HEAT_VOL_EX_MWM ECU_ADDRESS 0x7f988e BYTE_ORDER MSB_LAST FORMAT "%6.2" /end MEASUREMENT
/begin MEASUREMENT capa_heat_vol_ex_mwm[1] "" UWORD _CNV_A_R_LINEAR_____165_CM 1 0. 0. 2550. DISPLAY_IDENTIFIER CAPA_HEAT_VOL_EX_MWM_SP ECU_ADDRESS 0x7f9890 BYTE_ORDER MSB_LAST FORMAT "%6.2" /end MEASUREMENT
/begin MEASUREMENT div_t_tur[0] "" UWORD _CNV_A_R_LINEAR_____14_CM 1 0. 0. 0.9999847412109381 DISPLAY_IDENTIFIER DIV_T_TUR ECU_ADDRESS 0x7f9892 BYTE_ORDER MSB_LAST FORMAT "%6.4" /end MEASUREMENT
/begin MEASUREMENT div_t_tur[1] "" UWORD _CNV_A_R_LINEAR_____14_CM 1 0. 0. 0.9999847412109381 DISPLAY_IDENTIFIER DIV_T_TUR_SP ECU_ADDRESS 0x7f9894 BYTE_ORDER MSB_LAST FORMAT "%6.4" /end MEASUREMENT
/begin MEASUREMENT bpa_psn[0] "" UWORD _CNV_A_R_LINEAR_____8_CM 1 0. 0. 99.99847412109381 DISPLAY_IDENTIFIER BPA_PSN ECU_ADDRESS 0x7f9896 BYTE_ORDER MSB_LAST /end MEASUREMENT
/begin MEASUREMENT bpa_psn[1] "" UWORD _CNV_A_R_LINEAR_____8_CM 1 0. 0. 99.99847412109381 DISPLAY_IDENTIFIER BPA_PSN_SP ECU_ADDRESS 0x7f9898 BYTE_ORDER MSB_LAST /end MEASUREMENT
/begin MEASUREMENT prs_ex_gas_down_pf[0] "" UWORD _CNV_A_R_LINEAR_____21_CM 1 0. 0. 5434. DISPLAY_IDENTIFIER PRS_EX_GAS_DOWN_PF ECU_ADDRESS 0x7fa70a BYTE_ORDER MSB_LAST FORMAT "%6.2" /end MEASUREMENT
/begin MEASUREMENT prs_ex_gas_down_pf[1] "" UWORD _CNV_A_R_LINEAR_____21_CM 1 0. 0. 5434. DISPLAY_IDENTIFIER PRS_EX_GAS_DOWN_PF_SP ECU_ADDRESS 0x7fa70c BYTE_ORDER MSB_LAST FORMAT "%6.2" /end MEASUREMENT
/begin MEASUREMENT prs_ex_gas_up_pf[0] "" UWORD _CNV_A_R_LINEAR_____21_CM 1 0. 0. 5434. DISPLAY_IDENTIFIER PRS_EX_GAS_UP_PF ECU_ADDRESS 0x7fa706 BYTE_ORDER MSB_LAST FORMAT "%6.2" /end MEASUREMENT
/begin MEASUREMENT prs_ex_gas_up_pf[1] "" UWORD _CNV_A_R_LINEAR_____21_CM 1 0. 0. 5434. DISPLAY_IDENTIFIER PRS_EX_GAS_UP_PF_SP ECU_ADDRESS 0x7fa708 BYTE_ORDER MSB_LAST FORMAT "%6.2" /end MEASUREMENT
/begin MEASUREMENT dip_out[0] "" UWORD _CNV_A_R_LINEAR_____21_CM 1 0. 0. 5434. DISPLAY_IDENTIFIER DIP_OUT ECU_ADDRESS 0x7fa77e BYTE_ORDER MSB_LAST FORMAT "%6.2" /end MEASUREMENT
/begin MEASUREMENT dip_out[1] "" UWORD _CNV_A_R_LINEAR_____21_CM 1 0. 0. 5434. DISPLAY_IDENTIFIER DIP_OUT_SP ECU_ADDRESS 0x7fa780 BYTE_ORDER MSB_LAST FORMAT "%6.2" /end MEASUREMENT
/begin MEASUREMENT heat_cyl_in[0] "" UWORD _CNV_A_R_LINEAR_____160_CM 1 0. 0. 6553.5 DISPLAY_IDENTIFIER HEAT_CYL_IN ECU_ADDRESS 0x7fa70e BYTE_ORDER MSB_LAST FORMAT "%5.1" /end MEASUREMENT
/begin MEASUREMENT heat_cyl_in[1] "" UWORD _CNV_A_R_LINEAR_____160_CM 1 0. 0. 6553.5 DISPLAY_IDENTIFIER HEAT_CYL_IN_SP ECU_ADDRESS 0x7fa710 BYTE_ORDER MSB_LAST FORMAT "%5.1" /end MEASUREMENT
/begin MEASUREMENT heat_cyl_out[0] "" UWORD _CNV_A_R_LINEAR_____160_CM 1 0. 0. 6553.5 DISPLAY_IDENTIFIER HEAT_CYL_OUT ECU_ADDRESS 0x7fa716 BYTE_ORDER MSB_LAST FORMAT "%5.1" /end MEASUREMENT
/begin MEASUREMENT heat_cyl_out[1] "" UWORD _CNV_A_R_LINEAR_____160_CM 1 0. 0. 6553.5 DISPLAY_IDENTIFIER HEAT_CYL_OUT_SP ECU_ADDRESS 0x7fa718 BYTE_ORDER MSB_LAST FORMAT "%5.1" /end MEASUREMENT
/begin MEASUREMENT temp_cyl_gas_out[0] "" UWORD _CNV_A_R_LINEAR_____101_CM 1 0. 0. 4095.9375 DISPLAY_IDENTIFIER TEMP_CYL_GAS_OUT ECU_ADDRESS 0x7fa71a BYTE_ORDER MSB_LAST FORMAT "%6.2" /end MEASUREMENT
/begin MEASUREMENT temp_cyl_gas_out[1] "" UWORD _CNV_A_R_LINEAR_____101_CM 1 0. 0. 4095.9375 DISPLAY_IDENTIFIER TEMP_CYL_GAS_OUT_SP ECU_ADDRESS 0x7fa71c BYTE_ORDER MSB_LAST FORMAT "%6.2" /end MEASUREMENT
/begin MEASUREMENT heat_cyl_comb[0] "" UWORD _CNV_A_R_LINEAR_____160_CM 1 0. 0. 6553.5 DISPLAY_IDENTIFIER HEAT_CYL_COMB ECU_ADDRESS 0x7fa71e BYTE_ORDER MSB_LAST FORMAT "%5.1" /end MEASUREMENT
/begin MEASUREMENT heat_cyl_comb[1] "" UWORD _CNV_A_R_LINEAR_____160_CM 1 0. 0. 6553.5 DISPLAY_IDENTIFIER HEAT_CYL_COMB_SP ECU_ADDRESS 0x7fa720 BYTE_ORDER MSB_LAST FORMAT "%5.1" /end MEASUREMENT
/begin MEASUREMENT heat_cyl_wall[0] "" SWORD _CNV_A_R_LINEAR_____166_CM 1 0. -6553.6 6553.4 DISPLAY_IDENTIFIER HEAT_CYL_WALL ECU_ADDRESS 0x7fa712 BYTE_ORDER MSB_LAST FORMAT "%5.1" /end MEASUREMENT
/begin MEASUREMENT heat_cyl_wall[1] "" SWORD _CNV_A_R_LINEAR_____166_CM 1 0. -6553.6 6553.4 DISPLAY_IDENTIFIER HEAT_CYL_WALL_SP ECU_ADDRESS 0x7fa714 BYTE_ORDER MSB_LAST FORMAT "%5.1" /end MEASUREMENT
/begin MEASUREMENT temp_cyl_gas_cmp[0] "" UWORD _CNV_A_R_LINEAR_____101_CM 1 0. 0. 4095.9375 DISPLAY_IDENTIFIER TEMP_CYL_GAS_CMP ECU_ADDRESS 0x7fa722 BYTE_ORDER MSB_LAST FORMAT "%6.2" /end MEASUREMENT
/begin MEASUREMENT temp_cyl_gas_cmp[1] "" UWORD _CNV_A_R_LINEAR_____101_CM 1 0. 0. 4095.9375 DISPLAY_IDENTIFIER TEMP_CYL_GAS_CMP_SP ECU_ADDRESS 0x7fa724 BYTE_ORDER MSB_LAST FORMAT "%6.2" /end MEASUREMENT
/begin MEASUREMENT temp_cyl_gas_comb[0] "" UWORD _CNV_A_R_LINEAR_____101_CM 1 0. 0. 4095.9375 DISPLAY_IDENTIFIER TEMP_CYL_GAS_COMB ECU_ADDRESS 0x7fa726 BYTE_ORDER MSB_LAST FORMAT "%6.2" /end MEASUREMENT
/begin MEASUREMENT temp_cyl_gas_comb[1] "" UWORD _CNV_A_R_LINEAR_____101_CM 1 0. 0. 4095.9375 DISPLAY_IDENTIFIER TEMP_CYL_GAS_COMB_SP ECU_ADDRESS 0x7fa728 BYTE_ORDER MSB_LAST FORMAT "%6.2" /end MEASUREMENT
/begin MEASUREMENT temp_cyl_gas_mvm[0] "" UWORD _CNV_A_R_LINEAR_____101_CM 1 0. 0. 4095.9375 DISPLAY_IDENTIFIER TEMP_CYL_GAS_MVM ECU_ADDRESS 0x7fa72a BYTE_ORDER MSB_LAST FORMAT "%6.2" /end MEASUREMENT
/begin MEASUREMENT temp_cyl_gas_mvm[1] "" UWORD _CNV_A_R_LINEAR_____101_CM 1 0. 0. 4095.9375 DISPLAY_IDENTIFIER TEMP_CYL_GAS_MVM_SP ECU_ADDRESS 0x7fa72c BYTE_ORDER MSB_LAST FORMAT "%6.2" /end MEASUREMENT
/begin MEASUREMENT temp_cyl_gas_exp[0] "" UWORD _CNV_A_R_LINEAR_____101_CM 1 0. 0. 4095.9375 DISPLAY_IDENTIFIER TEMP_CYL_GAS_EXP ECU_ADDRESS 0x7fa72e BYTE_ORDER MSB_LAST FORMAT "%6.2" /end MEASUREMENT
/begin MEASUREMENT temp_cyl_gas_exp[1] "" UWORD _CNV_A_R_LINEAR_____101_CM 1 0. 0. 4095.9375 DISPLAY_IDENTIFIER TEMP_CYL_GAS_EXP_SP ECU_ADDRESS 0x7fa730 BYTE_ORDER MSB_LAST FORMAT "%6.2" /end MEASUREMENT
/begin MEASUREMENT vel_air_eb "air speed flow around exhaust gas manifold" UWORD _CNV_A_R_LINEAR_____167_CM 1 0. 0. 100. DISPLAY_IDENTIFIER VEL_AIR_EB ECU_ADDRESS 0x7fa732 BYTE_ORDER MSB_LAST /end MEASUREMENT
/begin MEASUREMENT temp_air_eb "air temperature around exhasut gas manifold" UWORD _CNV_A_R_LINEAR_____153_CM 1 0. 0. 1023.984375 DISPLAY_IDENTIFIER TEMP_AIR_EB ECU_ADDRESS 0x7fa734 BYTE_ORDER MSB_LAST FORMAT "%6.2" /end MEASUREMENT
/begin MEASUREMENT diam_ex_port "characteristic manifold diameter" UWORD _CNV_A_R_LINEAR_____168_CM 1 0. 0. 65.535 DISPLAY_IDENTIFIER DIAM_EX_PORT ECU_ADDRESS 0x7fa782 BYTE_ORDER MSB_LAST FORMAT "%5.3" /end MEASUREMENT
/begin MEASUREMENT div_diam_len_ex_port "characteristic manifold diameter/length ratio" UWORD _CNV_A_R_LINEAR_____53_CM 1 0. 0. 1.9999696 DISPLAY_IDENTIFIER DIV_DIAM_LEN_EX_PORT ECU_ADDRESS 0x7fa784 BYTE_ORDER MSB_LAST FORMAT "%6.5" /end MEASUREMENT
/begin MEASUREMENT mass_ex_port "manifold weight" UWORD _CNV_A_R_LINEAR_____169_CM 1 0. 0. 65.535 DISPLAY_IDENTIFIER MASS_EX_PORT ECU_ADDRESS 0x7fa786 BYTE_ORDER MSB_LAST FORMAT "%5.3" /end MEASUREMENT
/begin MEASUREMENT temp_wall_ex_port[0] "" UWORD _CNV_A_R_LINEAR_____153_CM 1 0. 0. 1023.984375 DISPLAY_IDENTIFIER TEMP_WALL_EX_PORT ECU_ADDRESS 0x7fa736 BYTE_ORDER MSB_LAST FORMAT "%6.2" /end MEASUREMENT
/begin MEASUREMENT temp_wall_ex_port[1] "" UWORD _CNV_A_R_LINEAR_____153_CM 1 0. 0. 1023.984375 DISPLAY_IDENTIFIER TEMP_WALL_EX_PORT_SP ECU_ADDRESS 0x7fa738 BYTE_ORDER MSB_LAST FORMAT "%6.2" /end MEASUREMENT
/begin MEASUREMENT temp_ex_gas_up_tur_stat[0] "" UWORD _CNV_A_R_LINEAR_____153_CM 1 0. 0. 1023.984375 DISPLAY_IDENTIFIER TEMP_EX_GAS_UP_TUR_STAT ECU_ADDRESS 0x7fa73a BYTE_ORDER MSB_LAST FORMAT "%6.2" /end MEASUREMENT
/begin MEASUREMENT temp_ex_gas_up_tur_stat[1] "" UWORD _CNV_A_R_LINEAR_____153_CM 1 0. 0. 1023.984375 DISPLAY_IDENTIFIER TEMP_EX_GAS_UP_TUR_STAT_SP ECU_ADDRESS 0x7fa73c BYTE_ORDER MSB_LAST FORMAT "%6.2" /end MEASUREMENT
/begin MEASUREMENT mass_ex_gas_ex_port[0] "" UWORD _CNV_A_R_LINEAR_____170_CM 1 0. 0. 65535. DISPLAY_IDENTIFIER MASS_EX_GAS_EX_PORT ECU_ADDRESS 0x7fa746 BYTE_ORDER MSB_LAST FORMAT "%5.0" /end MEASUREMENT
/begin MEASUREMENT mass_ex_gas_ex_port[1] "" UWORD _CNV_A_R_LINEAR_____170_CM 1 0. 0. 65535. DISPLAY_IDENTIFIER MASS_EX_GAS_EX_PORT_SP ECU_ADDRESS 0x7fa748 BYTE_ORDER MSB_LAST FORMAT "%5.0" /end MEASUREMENT
/begin MEASUREMENT stanton_it[0] "" UWORD _CNV_A_R_LINEAR_____171_CM 1 0. 0. 19.979695 DISPLAY_IDENTIFIER STANTON_IT ECU_ADDRESS 0x7fa788 BYTE_ORDER MSB_LAST FORMAT "%6.4" /end MEASUREMENT
/begin MEASUREMENT stanton_it[1] "" UWORD _CNV_A_R_LINEAR_____171_CM 1 0. 0. 19.979695 DISPLAY_IDENTIFIER STANTON_IT_SP ECU_ADDRESS 0x7fa78a BYTE_ORDER MSB_LAST FORMAT "%6.4" /end MEASUREMENT
/begin MEASUREMENT grd_temp_wall_ex_port[0] "" SWORD _CNV_A_R_LINEAR_____172_CM 1 0. -1024. 1023.96875 DISPLAY_IDENTIFIER GRD_TEMP_WALL_EX_PORT ECU_ADDRESS 0x7fa78c BYTE_ORDER MSB_LAST FORMAT "%6.2" /end MEASUREMENT
/begin MEASUREMENT grd_temp_wall_ex_port[1] "" SWORD _CNV_A_R_LINEAR_____172_CM 1 0. -1024. 1023.96875 DISPLAY_IDENTIFIER GRD_TEMP_WALL_EX_PORT_SP ECU_ADDRESS 0x7fa78e BYTE_ORDER MSB_LAST FORMAT "%6.2" /end MEASUREMENT
/begin MEASUREMENT temp_ex_mdl[0] "" UWORD _CNV_A_R_LINEAR_____153_CM 1 0. 0. 1023.984375 DISPLAY_IDENTIFIER TEMP_EX_MDL ECU_ADDRESS 0x7fa752 BYTE_ORDER MSB_LAST FORMAT "%6.2" /end MEASUREMENT
/begin MEASUREMENT temp_ex_mdl[1] "" UWORD _CNV_A_R_LINEAR_____153_CM 1 0. 0. 1023.984375 DISPLAY_IDENTIFIER TEMP_EX_MDL_SP ECU_ADDRESS 0x7fa754 BYTE_ORDER MSB_LAST FORMAT "%6.2" /end MEASUREMENT
/begin MEASUREMENT reynolds_it[0] "" UWORD _CNV_A_R_LINEAR_____173_CM 1 0. 0. 262.14 DISPLAY_IDENTIFIER REYNOLDS_IT ECU_ADDRESS 0x7fa790 BYTE_ORDER MSB_LAST /end MEASUREMENT
/begin MEASUREMENT reynolds_it[1] "" UWORD _CNV_A_R_LINEAR_____173_CM 1 0. 0. 262.14 DISPLAY_IDENTIFIER REYNOLDS_IT_SP ECU_ADDRESS 0x7fa792 BYTE_ORDER MSB_LAST /end MEASUREMENT
/begin MEASUREMENT fac_heat_tran_ex_port_it[0] "" UWORD _CNV_A_R_LINEAR_____174_CM 1 0. 0. 655.35 DISPLAY_IDENTIFIER FAC_HEAT_TRAN_EX_PORT_IT ECU_ADDRESS 0x7fa73e BYTE_ORDER MSB_LAST FORMAT "%5.2" /end MEASUREMENT
/begin MEASUREMENT fac_heat_tran_ex_port_it[1] "" UWORD _CNV_A_R_LINEAR_____174_CM 1 0. 0. 655.35 DISPLAY_IDENTIFIER FAC_HEAT_TRAN_EX_PORT_IT_SP ECU_ADDRESS 0x7fa740 BYTE_ORDER MSB_LAST FORMAT "%5.2" /end MEASUREMENT
/begin MEASUREMENT reynolds_ext[0] "" UWORD _CNV_A_R_LINEAR_____173_CM 1 0. 0. 262.14 DISPLAY_IDENTIFIER REYNOLDS_EXT ECU_ADDRESS 0x7fa794 BYTE_ORDER MSB_LAST /end MEASUREMENT
/begin MEASUREMENT reynolds_ext[1] "" UWORD _CNV_A_R_LINEAR_____173_CM 1 0. 0. 262.14 DISPLAY_IDENTIFIER REYNOLDS_EXT_SP ECU_ADDRESS 0x7fa796 BYTE_ORDER MSB_LAST /end MEASUREMENT
/begin MEASUREMENT fac_heat_tran_ex_port_ext[0] "" UWORD _CNV_A_R_LINEAR_____174_CM 1 0. 0. 655.35 DISPLAY_IDENTIFIER FAC_HEAT_TRAN_EX_PORT_EXT ECU_ADDRESS 0x7fa742 BYTE_ORDER MSB_LAST FORMAT "%5.2" /end MEASUREMENT
/begin MEASUREMENT fac_heat_tran_ex_port_ext[1] "" UWORD _CNV_A_R_LINEAR_____174_CM 1 0. 0. 655.35 DISPLAY_IDENTIFIER FAC_HEAT_TRAN_EX_PORT_EXT_SP ECU_ADDRESS 0x7fa744 BYTE_ORDER MSB_LAST FORMAT "%5.2" /end MEASUREMENT
/begin MEASUREMENT bpa_psn_mmv "filtered signal for turbocharger guide blades" UWORD _CNV_A_R_LINEAR_____136_CM 1 0. 0. 100. DISPLAY_IDENTIFIER BPA_PSN_MMV ECU_ADDRESS 0x7fa74a BYTE_ORDER MSB_LAST FORMAT "%5.3" /end MEASUREMENT
/begin MEASUREMENT bpa_psn_sp_mmv "filtered signal for turbocharger guide blades (setpoint)" UWORD _CNV_A_R_LINEAR_____136_CM 1 0. 0. 100. DISPLAY_IDENTIFIER BPA_PSN_SP_MMV ECU_ADDRESS 0x7f9856 BYTE_ORDER MSB_LAST FORMAT "%5.3" /end MEASUREMENT
/begin CHARACTERISTIC lc_act_ex_clc_mpg "activation button for map_based-exhaust gas states calculation" VALUE 0x85c2ed _REC_VAL_20_u1 1. _CNV_A_R_LINEAR_____0_CM 0. 1. DISPLAY_IDENTIFIER LC_ACT_EX_CLC_MPG FORMAT "%1.0" /end CHARACTERISTIC
/begin CHARACTERISTIC c_pow_ecf_sub "substitute power for ECF" VALUE 0x85bfec _REC_VAL_20_u2 65535. _CNV_A_R_LINEAR_____0_CM 0. 65535. DISPLAY_IDENTIFIER C_POW_ECF_SUB FORMAT "%5.0" /end CHARACTERISTIC
/begin CHARACTERISTIC c_fac_temp_ex_fil "filter factor for TEMP_EX" VALUE 0x85be7c _REC_VAL_20_u2 0.9999847412109381 _CNV_A_R_LINEAR_____14_CM 0. 0.9999847412109381 DISPLAY_IDENTIFIER C_FAC_TEMP_EX_FIL FORMAT "%6.5" /end CHARACTERISTIC
/begin CHARACTERISTIC c_fac_dip_ico "factor for intercooler pressure difference" VALUE 0x85be26 _REC_VAL_20_u2 6.5535 _CNV_A_R_LINEAR_____175_CM 0. 6.5535 DISPLAY_IDENTIFIER C_FAC_DIP_ICO FORMAT "%5.4" /end CHARACTERISTIC
/begin CHARACTERISTIC c_fac_rho_stnd_in "density factor of the intake air" VALUE 0x85be6d _REC_VAL_20_u1 0.99609375 _CNV_A_R_LINEAR_____176_CM 0. 0.99609375 DISPLAY_IDENTIFIER C_FAC_RHO_STND_IN FORMAT "%4.3" /end CHARACTERISTIC
/begin CHARACTERISTIC c_n_tcha_stnd "max. n_tcha" VALUE 0x85bfd0 _REC_VAL_20_u2 999.98474 _CNV_A_R_LINEAR_____177_CM 0. 999.98474 DISPLAY_IDENTIFIER C_N_TCHA_STND FORMAT "%5.2" /end CHARACTERISTIC
/begin CHARACTERISTIC c_fac_cmp_cor "correction for heat exchange through the compressor wall" VALUE 0x85be1a _REC_VAL_20_u2 6.5535 _CNV_A_R_LINEAR_____145_CM 0. 6.5535 DISPLAY_IDENTIFIER C_FAC_CMP_COR FORMAT "%5.4" /end CHARACTERISTIC
/begin CHARACTERISTIC c_fac_dip_out "factor for outlet pressure difference" VALUE 0x85be28 _REC_VAL_20_u2 6.5535 _CNV_A_R_LINEAR_____175_CM 0. 6.5535 DISPLAY_IDENTIFIER C_FAC_DIP_OUT FORMAT "%5.4" /end CHARACTERISTIC
/begin CHARACTERISTIC c_fac_rho_stnd_eg "density factor of the exhaust gas" VALUE 0x85be6c _REC_VAL_20_u1 0.99609375 _CNV_A_R_LINEAR_____176_CM 0. 0.99609375 DISPLAY_IDENTIFIER C_FAC_RHO_STND_EG FORMAT "%4.3" /end CHARACTERISTIC
/begin CHARACTERISTIC c_dee "spezif. Heizwert des Brennstoffes" VALUE 0x85bdca _REC_VAL_20_u2 100. _CNV_A_R_LINEAR_____178_CM 0. 100. DISPLAY_IDENTIFIER C_DEE /end CHARACTERISTIC
/begin CHARACTERISTIC c_ar_heat_tran_cyl "mean value for inner surface of the comustion chamber" VALUE 0x85bcf4 _REC_VAL_20_u2 1023.984375 _CNV_A_R_LINEAR_____179_CM 0. 1023.984375 DISPLAY_IDENTIFIER C_AR_HEAT_TRAN_CYL FORMAT "%6.2" /end CHARACTERISTIC
/begin CHARACTERISTIC c_cmp_ratio "compression ratio of the cylinder" VALUE 0x85bd34 _REC_VAL_20_u2 100. _CNV_A_R_LINEAR_____130_CM 0. 100. DISPLAY_IDENTIFIER C_CMP_RATIO /end CHARACTERISTIC
/begin CHARACTERISTIC c_diam_fan "fan diameter" VALUE 0x85bdcc _REC_VAL_20_u2 0.9999847412109381 _CNV_A_R_LINEAR_____180_CM 0. 0.9999847412109381 DISPLAY_IDENTIFIER C_DIAM_FAN FORMAT "%6.5" /end CHARACTERISTIC
/begin CHARACTERISTIC c_ar_heat_tran_ex_port "heat exchange area of exh. gas manifold" VALUE 0x85bcf6 _REC_VAL_20_u2 65535. _CNV_A_R_LINEAR_____181_CM 0. 65535. DISPLAY_IDENTIFIER C_AR_HEAT_TRAN_EX_PORT FORMAT "%5.0" /end CHARACTERISTIC
/begin CHARACTERISTIC c_vol_ex_port "exh. manifold volume" VALUE 0x85c2cc _REC_VAL_20_u2 6.5535 _CNV_A_R_LINEAR_____182_CM 0. 6.5535 DISPLAY_IDENTIFIER C_VOL_EX_PORT FORMAT "%5.4" /end CHARACTERISTIC
/begin CHARACTERISTIC c_thkn_wall_ex_port "thickness of exh. gas manifold wall" VALUE 0x85c19a _REC_VAL_20_u2 65.535 _CNV_A_R_LINEAR_____183_CM 0. 65.535 DISPLAY_IDENTIFIER C_THKN_WALL_EX_PORT FORMAT "%5.3" /end CHARACTERISTIC
/begin CHARACTERISTIC c_rho_ex_port "spec. weight of exh. manifold wall" VALUE 0x85c014 _REC_VAL_20_u2 16776.96 _CNV_A_R_LINEAR_____184_CM 0. 16776.96 DISPLAY_IDENTIFIER C_RHO_EX_PORT FORMAT "%6.1" /end CHARACTERISTIC
/begin CHARACTERISTIC c_capa_heat_ex_port "spec. heat capacity of exh. manifold wall" VALUE 0x85bd2a _REC_VAL_20_u2 5434. _CNV_A_R_LINEAR_____185_CM 0. 5434. DISPLAY_IDENTIFIER C_CAPA_HEAT_EX_PORT FORMAT "%6.2" /end CHARACTERISTIC
/begin CHARACTERISTIC c_fac_bpa_psn_fil "filter factor for turbocharger guide blades position" VALUE 0x85be0c _REC_VAL_20_u2 0.9999847412109381 _CNV_A_R_LINEAR_____14_CM 0. 0.9999847412109381 DISPLAY_IDENTIFIER C_FAC_BPA_PSN_FIL FORMAT "%6.5" /end CHARACTERISTIC
/begin CHARACTERISTIC ip_fac_temp_ex__tco "GE_EGPT: factor for exhaust temperature correction TCO" CURVE 0x84c27a _REC_CUR_20_u2_u1 1.9999696 _CNV_A_R_LINEAR_____53_CM 0. 1.9999696 DISPLAY_IDENTIFIER IP_FAC_TEMP_EX__TCO FORMAT "%6.5"
 /begin AXIS_DESCR COM_AXIS tco _CNV_A_R_LINEAR_____18_CM 5 -50. 205. FORMAT "%3.0" AXIS_PTS_REF ldp_tco_ip_fac_temp_ex /end AXIS_DESCR
/end CHARACTERISTIC
/begin AXIS_PTS ldp_tco_ip_fac_temp_ex "factor for exhaust temperature correction TCO" 0x842779 tco _REC_AXS_20_u1 255. _CNV_A_R_LINEAR_____18_CM 5 -50. 205. FORMAT "%3.0" /end AXIS_PTS
/begin CHARACTERISTIC ip_fac_temp_ex__dip_pf "GE_EGPT: TEMP_EX correction for dif. pressure on particulate filter" CURVE 0x84c222 _REC_CUR_20_u2_u2 3.99998471 _CNV_A_R_LINEAR_____63_CM 0. 3.99998471 DISPLAY_IDENTIFIER IP_FAC_TEMP_EX__DIP_PF FORMAT "%6.5"
 /begin AXIS_DESCR COM_AXIS dip_pf _CNV_A_R_LINEAR_____21_CM 8 0. 5434. FORMAT "%6.2" AXIS_PTS_REF ldp_dip_pf_ip_fac_temp_ex /end AXIS_DESCR
/end CHARACTERISTIC
/begin AXIS_PTS ldp_dip_pf_ip_fac_temp_ex "TEMP_EX correction for dif. pressure on particulate filter" 0x841564 dip_pf _REC_AXS_20_u2 5434. _CNV_A_R_LINEAR_____21_CM 8 0. 5434. FORMAT "%6.2" /end AXIS_PTS
/begin CHARACTERISTIC ip_fac_prs_ex__tco "GE_EGPT: influence of tco on the expresure" CURVE 0x84c01a _REC_CUR_20_u2_u1 1.9999696 _CNV_A_R_LINEAR_____53_CM 0. 1.9999696 DISPLAY_IDENTIFIER IP_FAC_PRS_EX__TCO FORMAT "%6.5"
 /begin AXIS_DESCR COM_AXIS tco _CNV_A_R_LINEAR_____18_CM 5 -50. 205. FORMAT "%3.0" AXIS_PTS_REF ldp_tco_ip_fac_prs_ex /end AXIS_DESCR
/end CHARACTERISTIC
/begin AXIS_PTS ldp_tco_ip_fac_prs_ex "influence of tco on the expresure" 0x842726 tco _REC_AXS_20_u1 255. _CNV_A_R_LINEAR_____18_CM 5 -50. 205. FORMAT "%3.0" /end AXIS_PTS
/begin CHARACTERISTIC ip_maf_max__n "GE_EGPT: max maf as function on n" CURVE 0x84cfa2 _REC_CUR_20_u2_u2 1389. _CNV_A_R_LINEAR_____23_CM 0. 1389. DISPLAY_IDENTIFIER IP_MAF_MAX__N FORMAT "%6.2"
 /begin AXIS_DESCR COM_AXIS n _CNV_A_R_LINEAR_____5_CM 9 0. 6375. FORMAT "%4.0" AXIS_PTS_REF ldp_n_ip_maf_max /end AXIS_DESCR
/end CHARACTERISTIC
/begin AXIS_PTS ldp_n_ip_maf_max "max maf as function on n" 0x841af0 n _REC_AXS_20_u2 6375. _CNV_A_R_LINEAR_____5_CM 9 0. 6375. FORMAT "%4.0" /end AXIS_PTS
/begin CHARACTERISTIC ip_tcha_fac1__pq_cmp "GE_EGPT: factor1 for turbocharger balance equation" CURVE 0x85ab18 _REC_CUR_20_u2_u2 1.9999696 _CNV_A_R_LINEAR_____53_CM 0. 1.9999696 DISPLAY_IDENTIFIER IP_TCHA_FAC1__PQ_CMP FORMAT "%6.5"
 /begin AXIS_DESCR COM_AXIS pq_cmp[1] _CNV_A_R_LINEAR_____145_CM 12 0. 6.5535 FORMAT "%5.4" AXIS_PTS_REF ldp_pq_cmp_ip_tcha_fac1 /end AXIS_DESCR
/end CHARACTERISTIC
/begin AXIS_PTS ldp_pq_cmp_ip_tcha_fac1 "" 0x842464 pq_cmp[1] _REC_AXS_20_u2 6.5535 _CNV_A_R_LINEAR_____145_CM 12 0. 6.5535 FORMAT "%5.4" /end AXIS_PTS
/begin CHARACTERISTIC ip_tcha_fac2__tcha_bal "GE_EGPT: factor2 for turbocharger balance equation" CURVE 0x85ab30 _REC_CUR_20_u2_u2 0.9999847412109381 _CNV_A_R_LINEAR_____14_CM 0. 0.9999847412109381 DISPLAY_IDENTIFIER IP_TCHA_FAC2__TCHA_BAL FORMAT "%6.5"
 /begin AXIS_DESCR COM_AXIS online_dummy _CNV_A_R_LINEAR_____63_CM 12 0. 3.99998471 FORMAT "%6.5" AXIS_PTS_REF ldp_tcha_bal_ip_tcha_fac2 /end AXIS_DESCR
/end CHARACTERISTIC
/begin AXIS_PTS ldp_tcha_bal_ip_tcha_fac2 "factor2 for turbocharger balance equation" 0x84267c online_dummy _REC_AXS_20_u2 3.99998471 _CNV_A_R_LINEAR_____63_CM 12 0. 3.99998471 FORMAT "%6.5" /end AXIS_PTS
/begin CHARACTERISTIC ip_fac1_cmp__pq_cmp "GE_EGPT: ip_fac1_cmp__pq_cmp" CURVE 0x84b8aa _REC_CUR_20_u2_u2 6.5535 _CNV_A_R_LINEAR_____145_CM 0. 6.5535 DISPLAY_IDENTIFIER IP_FAC1_CMP__PQ_CMP FORMAT "%5.4"
 /begin AXIS_DESCR COM_AXIS pq_cmp[1] _CNV_A_R_LINEAR_____145_CM 8 0. 6.5535 FORMAT "%5.4" AXIS_PTS_REF ldp_pq_cmp_ip_fac1_cmp /end AXIS_DESCR
/end CHARACTERISTIC
/begin AXIS_PTS ldp_pq_cmp_ip_fac1_cmp "PQ_CMP_SP" 0x842430 pq_cmp[1] _REC_AXS_20_u2 6.5535 _CNV_A_R_LINEAR_____145_CM 8 0. 6.5535 FORMAT "%5.4" /end AXIS_PTS
/begin CHARACTERISTIC ip_eff_tcha_mec__n_tcha_stnd "GE_EGPT: non isentopic efficiency factor EFF_LOSS_TCHA" CURVE 0x84a6ba _REC_CUR_20_u2_u2 0.9999847412109381 _CNV_A_R_LINEAR_____14_CM 0. 0.9999847412109381 DISPLAY_IDENTIFIER IP_EFF_TCHA_MEC__N_TCHA_STND FORMAT "%6.5"
 /begin AXIS_DESCR COM_AXIS online_dummy _CNV_A_R_LINEAR_____14_CM 10 0. 0.9999847412109381 FORMAT "%6.5" AXIS_PTS_REF ldp_n_tcha_stnd_ip_eff_tcha_mec /end AXIS_DESCR
/end CHARACTERISTIC
/begin AXIS_PTS ldp_n_tcha_stnd_ip_eff_tcha_mec "non isentopic efficiency factor EFF_LOSS_TCHA" 0x8423c8 online_dummy _REC_AXS_20_u2 0.9999847412109381 _CNV_A_R_LINEAR_____14_CM 10 0. 0.9999847412109381 FORMAT "%6.5" /end AXIS_PTS
/begin CHARACTERISTIC ip_fac_exp__kapa "GE_EGPT: ip_fac_exp__kapa" CURVE 0x84b9aa _REC_CUR_20_u2_u2 100. _CNV_A_R_LINEAR_____130_CM 0. 100. DISPLAY_IDENTIFIER IP_FAC_EXP__KAPA
 /begin AXIS_DESCR COM_AXIS online_dummy _CNV_A_R_LINEAR_____53_CM 5 0. 1.9999696 FORMAT "%6.5" AXIS_PTS_REF ldp_kapa_ip_fac_exp /end AXIS_DESCR
/end CHARACTERISTIC
/begin AXIS_PTS ldp_kapa_ip_fac_exp "&nbsp;" 0x8416f8 online_dummy _REC_AXS_20_u2 1.9999696 _CNV_A_R_LINEAR_____53_CM 5 0. 1.9999696 FORMAT "%6.5" /end AXIS_PTS
/begin CHARACTERISTIC ip_fac_temp_eb__vel_air_eb "GE_EGPT: air flow influence of engine box temperature" CURVE 0x84c1f6 _REC_CUR_20_u2_u2 100. _CNV_A_R_LINEAR_____130_CM 0. 100. DISPLAY_IDENTIFIER IP_FAC_TEMP_EB__VEL_AIR_EB
 /begin AXIS_DESCR COM_AXIS online_dummy _CNV_A_R_LINEAR_____130_CM 10 0. 100. AXIS_PTS_REF ldp_vel_air_eb_ip_fac_temp_eb /end AXIS_DESCR
/end CHARACTERISTIC
/begin AXIS_PTS ldp_vel_air_eb_ip_fac_temp_eb "air flow influence of engine box temperature" 0x8433a8 online_dummy _REC_AXS_20_u2 100. _CNV_A_R_LINEAR_____130_CM 10 0. 100. /end AXIS_PTS
/begin CHARACTERISTIC ip_vel_air_eb__vel_air_am "GE_EGPT: mean air flow velocity in engine bay" CURVE 0x85ba96 _REC_CUR_20_u2_u2 100. _CNV_A_R_LINEAR_____167_CM 0. 100. DISPLAY_IDENTIFIER IP_VEL_AIR_EB__VEL_AIR_AM
 /begin AXIS_DESCR COM_AXIS online_dummy _CNV_A_R_LINEAR_____167_CM 10 0. 100. AXIS_PTS_REF ldp_vel_air_am_ip_vel_air_eb /end AXIS_DESCR
/end CHARACTERISTIC
/begin AXIS_PTS ldp_vel_air_am_ip_vel_air_eb "mean air flow velocity in engine bay" 0x843392 online_dummy _REC_AXS_20_u2 100. _CNV_A_R_LINEAR_____167_CM 10 0. 100. /end AXIS_PTS
/begin CHARACTERISTIC ip_vel_fan__pow_fan "GE_EGPT: air velocity after fan" CURVE 0x85baaa _REC_CUR_20_u2_u2 100. _CNV_A_R_LINEAR_____167_CM 0. 100. DISPLAY_IDENTIFIER IP_VEL_FAN__POW_FAN
 /begin AXIS_DESCR COM_AXIS online_dummy _CNV_A_R_LINEAR_____186_CM 12 0. 65535. FORMAT "%5.0" AXIS_PTS_REF ldp_pow_fan_ip_vel_fan /end AXIS_DESCR
/end CHARACTERISTIC
/begin AXIS_PTS ldp_pow_fan_ip_vel_fan "" 0x8423f4 online_dummy _REC_AXS_20_u2 65535. _CNV_A_R_LINEAR_____186_CM 12 0. 65535. FORMAT "%5.0" /end AXIS_PTS
/begin CHARACTERISTIC ip_delta_temp_ex_port__fac "GE_EGPT: ratio of temperature differences (gas - wall, manifold entry/exit)" CURVE 0x84a472 _REC_CUR_20_u2_u2 0.9999847412109381 _CNV_A_R_LINEAR_____14_CM 0. 0.9999847412109381 DISPLAY_IDENTIFIER IP_DELTA_TEMP_EX_PORT__FAC FORMAT "%6.5"
 /begin AXIS_DESCR COM_AXIS stanton_it[1] _CNV_A_R_LINEAR_____171_CM 12 0. 19.979695 FORMAT "%6.4" AXIS_PTS_REF ldp_fac_ip_delta_temp_ex_port /end AXIS_DESCR
/end CHARACTERISTIC
/begin AXIS_PTS ldp_fac_ip_delta_temp_ex_port "" 0x841662 stanton_it[1] _REC_AXS_20_u2 19.979695 _CNV_A_R_LINEAR_____171_CM 12 0. 19.979695 FORMAT "%6.4" /end AXIS_PTS
/begin CHARACTERISTIC ip_fac1_nu_it__rey "GE_EGPT: reynolds factor for internal nusselt number calculation" CURVE 0x84b8ec _REC_CUR_20_u2_u2 500. _CNV_A_R_LINEAR_____187_CM 0. 500. DISPLAY_IDENTIFIER IP_FAC1_NU_IT__REY
 /begin AXIS_DESCR COM_AXIS reynolds_ext[1] _CNV_A_R_LINEAR_____173_CM 6 0. 262.14 AXIS_PTS_REF ldp_rey_fac1_nu_it /end AXIS_DESCR
/end CHARACTERISTIC
/begin AXIS_PTS ldp_rey_fac1_nu_it "" 0x84254c reynolds_ext[1] _REC_AXS_20_u2 262.14 _CNV_A_R_LINEAR_____173_CM 6 0. 262.14 /end AXIS_PTS
/begin CHARACTERISTIC ip_fac2_nu_it__div_diam_len "GE_EGPT: length ratio factor for internal nusselt number calculation" CURVE 0x84b8f8 _REC_CUR_20_u2_u2 2.88354 _CNV_A_R_LINEAR_____188_CM 0. 2.88354 DISPLAY_IDENTIFIER IP_FAC2_NU_IT__DIV_DIAM_LEN FORMAT "%6.5"
 /begin AXIS_DESCR COM_AXIS div_diam_len_ex_port _CNV_A_R_LINEAR_____53_CM 11 0. 1.9999696 FORMAT "%6.5" AXIS_PTS_REF ldp_div_diam_len_ip_fac2_nu_it /end AXIS_DESCR
/end CHARACTERISTIC
/begin AXIS_PTS ldp_div_diam_len_ip_fac2_nu_it "length ratio factor for internal nusselt number calculation" 0x841576 div_diam_len_ex_port _REC_AXS_20_u2 1.9999696 _CNV_A_R_LINEAR_____53_CM 11 0. 1.9999696 FORMAT "%6.5" /end AXIS_PTS
/begin CHARACTERISTIC ip_fac3_nu_it__div_visc "GE_EGPT: viscosity factor for internal nusselt number calculation" CURVE 0x84b90e _REC_CUR_20_u1_u2 1.9921875 _CNV_A_R_LINEAR_____24_CM 0. 1.9921875 DISPLAY_IDENTIFIER IP_FAC3_NU_IT__DIV_VISC FORMAT "%4.3"
 /begin AXIS_DESCR COM_AXIS online_dummy _CNV_A_R_LINEAR_____189_CM 4 0. 2.509804 FORMAT "%6.5" AXIS_PTS_REF ldp_div_visc_ip_fac3_nu_it /end AXIS_DESCR
/end CHARACTERISTIC
/begin AXIS_PTS ldp_div_visc_ip_fac3_nu_it "viscosity factor for internal nusselt number calculation" 0x8415b0 online_dummy _REC_AXS_20_u2 2.509804 _CNV_A_R_LINEAR_____189_CM 4 0. 2.509804 FORMAT "%6.5" /end AXIS_PTS
/begin CHARACTERISTIC ip_nu_ext__rey "GE_EGPT: factor for external nusselt number calculation" CURVE 0x855728 _REC_CUR_20_u2_u2 2000. _CNV_A_R_LINEAR_____190_CM 0. 2000. DISPLAY_IDENTIFIER IP_NU_EXT__REY FORMAT "%6.2"
 /begin AXIS_DESCR COM_AXIS reynolds_ext[1] _CNV_A_R_LINEAR_____173_CM 6 0. 262.14 AXIS_PTS_REF ldp_rey_fac1_nu_it /end AXIS_DESCR
/end CHARACTERISTIC
/begin CHARACTERISTIC ip_div_t_tur__div_prs_tur "GE_EGPT: DIV_T_TUR as f(DIV_PRS_TUR, EFF_TUR)" CURVE 0x84a48a _REC_CUR_20_u2_u2 0.9999847412109381 _CNV_A_R_LINEAR_____14_CM 0. 0.9999847412109381 DISPLAY_IDENTIFIER IP_DIV_T_TUR__DIV_PRS_TUR FORMAT "%6.5"
 /begin AXIS_DESCR COM_AXIS online_dummy _CNV_A_R_LINEAR_____145_CM 16 0. 6.5535 FORMAT "%5.4" AXIS_PTS_REF ldp_div_prs_tur_ip_div_t_tur /end AXIS_DESCR
/end CHARACTERISTIC
/begin AXIS_PTS ldp_div_prs_tur_ip_div_t_tur "DIV_T_TUR as f(DIV_PRS_TUR, EFF_TUR)" 0x84158e online_dummy _REC_AXS_20_u2 6.5535 _CNV_A_R_LINEAR_____145_CM 16 0. 6.5535 FORMAT "%5.4" /end AXIS_PTS
/begin CHARACTERISTIC ip_amp_dec__maf_kgh "GE_EGPT: AMP correction after air filter" CURVE 0x849038 _REC_CUR_20_u2_u2 5434. _CNV_A_R_LINEAR_____21_CM 0. 5434. DISPLAY_IDENTIFIER IP_AMP_DEC__MAF_KGH FORMAT "%6.2"
 /begin AXIS_DESCR COM_AXIS online_dummy _CNV_A_R_LINEAR_____112_CM 5 0. 1023.984375 FORMAT "%6.2" AXIS_PTS_REF ldp_maf_kgh_ip_map_dec /end AXIS_DESCR
/end CHARACTERISTIC
/begin CHARACTERISTIC ip_temp_ex_bas__n__mf "GE_EGPT: basic exhaust gas temperature" MAP 0x85ab9c _REC_MAP_20_u2_u2_u2 1023.984375 _CNV_A_R_LINEAR_____153_CM 0. 1023.984375 DISPLAY_IDENTIFIER IP_TEMP_EX_BAS__N__MF FORMAT "%6.2"
 /begin AXIS_DESCR COM_AXIS n _CNV_A_R_LINEAR_____5_CM 9 0. 6375. FORMAT "%4.0" AXIS_PTS_REF ldp_n_ip_temp_ex /end AXIS_DESCR
 /begin AXIS_DESCR COM_AXIS mf_bas _CNV_A_R_LINEAR_____43_CM 5 0. 262.14 AXIS_PTS_REF ldp_mf_ip_temp_ex /end AXIS_DESCR
/end CHARACTERISTIC
/begin AXIS_PTS ldp_n_ip_temp_ex "basic exhaust gas temperature" 0x842300 n _REC_AXS_20_u2 6375. _CNV_A_R_LINEAR_____5_CM 9 0. 6375. FORMAT "%4.0" /end AXIS_PTS
/begin AXIS_PTS ldp_mf_ip_temp_ex "basic exhaust gas temperature" 0x841898 mf_bas _REC_AXS_20_u2 262.14 _CNV_A_R_LINEAR_____43_CM 5 0. 262.14 /end AXIS_PTS
/begin CHARACTERISTIC ip_fac_temp_ex__maf_rel__egr "GE_EGPT: influence of MAF_REL and EGR on TEMP_EX" MAP 0x84c232 _REC_MAP_20_u2_u2_u2 1.9999696 _CNV_A_R_LINEAR_____53_CM 0. 1.9999696 DISPLAY_IDENTIFIER IP_FAC_TEMP_EX__MAF_REL__EGR FORMAT "%6.5"
 /begin AXIS_DESCR COM_AXIS maf_rel_sp _CNV_A_R_LINEAR_____136_CM 6 0. 100. FORMAT "%5.3" AXIS_PTS_REF ldp_maf_rel_ip_fac_temp_ex /end AXIS_DESCR
 /begin AXIS_DESCR COM_AXIS egr_sp _CNV_A_R_LINEAR_____136_CM 6 0. 100. FORMAT "%5.3" AXIS_PTS_REF ldp_egr_ip_fac_temp_ex /end AXIS_DESCR
/end CHARACTERISTIC
/begin AXIS_PTS ldp_maf_rel_ip_fac_temp_ex "influence of MAF_REL and EGR on TEMP_EX" 0x841774 maf_rel_sp _REC_AXS_20_u2 100. _CNV_A_R_LINEAR_____136_CM 6 0. 100. FORMAT "%5.3" /end AXIS_PTS
/begin AXIS_PTS ldp_egr_ip_fac_temp_ex "influence of MAF_REL and EGR on TEMP_EX" 0x841646 egr_sp _REC_AXS_20_u2 100. _CNV_A_R_LINEAR_____136_CM 6 0. 100. FORMAT "%5.3" /end AXIS_PTS
/begin AXIS_PTS ldp_n_ip_prs_ex "exhaust pressure" 0x841ef6 n _REC_AXS_20_u2 6375. _CNV_A_R_LINEAR_____5_CM 9 0. 6375. FORMAT "%4.0" /end AXIS_PTS
/begin AXIS_PTS ldp_mf_ip_prs_ex "exhaust pressure" 0x84187e mf_bas _REC_AXS_20_u2 262.14 _CNV_A_R_LINEAR_____43_CM 5 0. 262.14 /end AXIS_PTS
/begin CHARACTERISTIC ip_fac_prs_ex__maf_rel__egr "GE_EGPT: influence of mafrel and egr on the expressure" MAP 0x84bfd2 _REC_MAP_20_u2_u2_u2 1.9999696 _CNV_A_R_LINEAR_____53_CM 0. 1.9999696 DISPLAY_IDENTIFIER IP_FAC_PRS_EX__MAF_REL__EGR FORMAT "%6.5"
 /begin AXIS_DESCR COM_AXIS maf_rel_sp _CNV_A_R_LINEAR_____136_CM 6 0. 100. FORMAT "%5.3" AXIS_PTS_REF ldp_maf_rel_ip_fac_prs_ex /end AXIS_DESCR
 /begin AXIS_DESCR COM_AXIS egr_sp _CNV_A_R_LINEAR_____136_CM 6 0. 100. FORMAT "%5.3" AXIS_PTS_REF ldp_egr_ip_fac_prs_ex /end AXIS_DESCR
/end CHARACTERISTIC
/begin AXIS_PTS ldp_maf_rel_ip_fac_prs_ex "influence of mafrel and egr on the expressure" 0x841766 maf_rel_sp _REC_AXS_20_u2 100. _CNV_A_R_LINEAR_____136_CM 6 0. 100. FORMAT "%5.3" /end AXIS_PTS
/begin AXIS_PTS ldp_egr_ip_fac_prs_ex "influence of mafrel and egr on the expressure" 0x841638 egr_sp _REC_AXS_20_u2 100. _CNV_A_R_LINEAR_____136_CM 6 0. 100. FORMAT "%5.3" /end AXIS_PTS
/begin CHARACTERISTIC ip_fac_mfw_tur__temp_ex__prs_ex "GE_EGPT: standardization factor for turbine mass flow" MAP 0x84bfa0 _REC_MAP_20_u2_u2_u2 65.535 _CNV_A_R_LINEAR_____159_CM 0. 65.535 DISPLAY_IDENTIFIER IP_FAC_MFW_TUR__TEMP_EX__PRS_EX FORMAT "%5.3"
 /begin AXIS_DESCR COM_AXIS temp_ex_mdl[1] _CNV_A_R_LINEAR_____153_CM 5 0. 1023.984375 FORMAT "%6.2" AXIS_PTS_REF ldp_temp_ex_ip_fac_mfw_tur_stnd /end AXIS_DESCR
 /begin AXIS_DESCR COM_AXIS prs_ex_mdl[1] _CNV_A_R_LINEAR_____21_CM 5 0. 5434. FORMAT "%6.2" AXIS_PTS_REF ldp_prs_ex_ip_fac_mfw_tur_stnd /end AXIS_DESCR
/end CHARACTERISTIC
/begin AXIS_PTS ldp_temp_ex_ip_fac_mfw_tur_stnd "standardization factor for turbine mass flow" 0x842896 temp_ex_mdl[1] _REC_AXS_20_u2 1023.984375 _CNV_A_R_LINEAR_____153_CM 5 0. 1023.984375 FORMAT "%6.2" /end AXIS_PTS
/begin AXIS_PTS ldp_prs_ex_ip_fac_mfw_tur_stnd "" 0x8424d4 prs_ex_mdl[1] _REC_AXS_20_u2 5434. _CNV_A_R_LINEAR_____21_CM 5 0. 5434. FORMAT "%6.2" /end AXIS_PTS
/begin CHARACTERISTIC ip_fac1_maf_stnd__tia__amp "GE_EGPT: standardization factor for the air mass flow" MAP 0x84b8ba _REC_MAP_20_u2_u1_u2 65.535 _CNV_A_R_LINEAR_____159_CM 0. 65.535 DISPLAY_IDENTIFIER IP_FAC1_MAF_STND__TIA__AMP FORMAT "%5.3"
 /begin AXIS_DESCR COM_AXIS tia _CNV_A_R_LINEAR_____18_CM 5 -50. 205. FORMAT "%3.0" AXIS_PTS_REF ldp_tia_ip_fac1_maf_stnd /end AXIS_DESCR
 /begin AXIS_DESCR COM_AXIS prs_up_cmp[1] _CNV_A_R_LINEAR_____21_CM 5 0. 5434. FORMAT "%6.2" AXIS_PTS_REF ldp_amp_ip_fac1_maf_stnd /end AXIS_DESCR
/end CHARACTERISTIC
/begin AXIS_PTS ldp_tia_ip_fac1_maf_stnd "standardization factor for the air mass flow" 0x842a16 tia _REC_AXS_20_u1 255. _CNV_A_R_LINEAR_____18_CM 5 -50. 205. FORMAT "%3.0" /end AXIS_PTS
/begin AXIS_PTS ldp_amp_ip_fac1_maf_stnd "" 0x841098 prs_up_cmp[1] _REC_AXS_20_u2 5434. _CNV_A_R_LINEAR_____21_CM 5 0. 5434. FORMAT "%6.2" /end AXIS_PTS
/begin CHARACTERISTIC ip_eff_cmp__maf_stnd__pq_cmp "GE_EGPT: EFF_CMP" MAP 0x84a4ba _REC_MAP_20_u2_u2_u2 0.9999847412109381 _CNV_A_R_LINEAR_____14_CM 0. 0.9999847412109381 DISPLAY_IDENTIFIER IP_EFF_CMP__MAF_STND__PQ_CMP FORMAT "%6.5"
 /begin AXIS_DESCR COM_AXIS maf_kgh_stnd[1] _CNV_A_R_LINEAR_____112_CM 16 0. 1023.984375 FORMAT "%6.2" AXIS_PTS_REF ldp_maf_stnd_ip_eff_cmp /end AXIS_DESCR
 /begin AXIS_DESCR COM_AXIS pq_cmp[1] _CNV_A_R_LINEAR_____145_CM 16 0. 6.5535 FORMAT "%5.4" AXIS_PTS_REF ldp_pq_cmp_ip_eff_cmp /end AXIS_DESCR
/end CHARACTERISTIC
/begin AXIS_PTS ldp_maf_stnd_ip_eff_cmp "" 0x841782 maf_kgh_stnd[1] _REC_AXS_20_u2 1023.984375 _CNV_A_R_LINEAR_____112_CM 16 0. 1023.984375 FORMAT "%6.2" /end AXIS_PTS
/begin AXIS_PTS ldp_pq_cmp_ip_eff_cmp "PQ_CMP_SP" 0x84240e pq_cmp[1] _REC_AXS_20_u2 6.5535 _CNV_A_R_LINEAR_____145_CM 16 0. 6.5535 FORMAT "%5.4" /end AXIS_PTS
/begin CHARACTERISTIC ip_n_tcha_stnd__maf_stnd__pq "GE_EGPT: standarized speed of the turbo charger" MAP 0x855528 _REC_MAP_20_u2_u2_u2 0.9999847412109381 _CNV_A_R_LINEAR_____14_CM 0. 0.9999847412109381 DISPLAY_IDENTIFIER IP_N_TCHA_STND__MAF_STND__PQ FORMAT "%6.5"
 /begin AXIS_DESCR COM_AXIS maf_kgh_stnd[1] _CNV_A_R_LINEAR_____112_CM 16 0. 1023.984375 FORMAT "%6.2" AXIS_PTS_REF ldp_maf_stnd_ip_n_tcha_stnd /end AXIS_DESCR
 /begin AXIS_DESCR COM_AXIS pq_cmp[1] _CNV_A_R_LINEAR_____145_CM 16 0. 6.5535 FORMAT "%5.4" AXIS_PTS_REF ldp_pq_cmp_ip_n_tcha_stnd /end AXIS_DESCR
/end CHARACTERISTIC
/begin AXIS_PTS ldp_maf_stnd_ip_n_tcha_stnd "" 0x8417a4 maf_kgh_stnd[1] _REC_AXS_20_u2 1023.984375 _CNV_A_R_LINEAR_____112_CM 16 0. 1023.984375 FORMAT "%6.2" /end AXIS_PTS
/begin AXIS_PTS ldp_pq_cmp_ip_n_tcha_stnd "" 0x842442 pq_cmp[1] _REC_AXS_20_u2 6.5535 _CNV_A_R_LINEAR_____145_CM 16 0. 6.5535 FORMAT "%5.4" /end AXIS_PTS
/begin CHARACTERISTIC ip_eff_tur__bpa_psn__mfw_tur "GE_EGPT: isentropic efficiency of the turbine" MAP 0x84a6ce _REC_MAP_20_u2_u2_u2 0.9999847412109381 _CNV_A_R_LINEAR_____14_CM 0. 0.9999847412109381 DISPLAY_IDENTIFIER IP_EFF_TUR__BPA_PSN__MFW_TUR FORMAT "%6.5"
 /begin AXIS_DESCR COM_AXIS bpa_psn_sp_mmv _CNV_A_R_LINEAR_____136_CM 16 0. 100. FORMAT "%5.3" AXIS_PTS_REF ldp_bpa_psn_ip_eff_tur /end AXIS_DESCR
 /begin AXIS_DESCR COM_AXIS m_tur_kgh_stnd[1] _CNV_A_R_LINEAR_____112_CM 16 0. 1023.984375 FORMAT "%6.2" AXIS_PTS_REF ldp_mfw_tur_ip_eff_tur /end AXIS_DESCR
/end CHARACTERISTIC
/begin AXIS_PTS ldp_bpa_psn_ip_eff_tur "isentropic efficiency of the turbine" 0x841424 bpa_psn_sp_mmv _REC_AXS_20_u2 100. _CNV_A_R_LINEAR_____136_CM 16 0. 100. FORMAT "%5.3" /end AXIS_PTS
/begin AXIS_PTS ldp_mfw_tur_ip_eff_tur "" 0x8418b0 m_tur_kgh_stnd[1] _REC_AXS_20_u2 1023.984375 _CNV_A_R_LINEAR_____112_CM 16 0. 1023.984375 FORMAT "%6.2" /end AXIS_PTS
/begin CHARACTERISTIC ip_capa_heat_prs_ex__temp__lamb "GE_EGPT: spec. heat capacity exhaus gas (p=const.)" MAP 0x84a06a _REC_MAP_20_u2_u2_u2 2550. _CNV_A_R_LINEAR_____165_CM 0. 2550. DISPLAY_IDENTIFIER IP_CAPA_HEAT_PRS_EX__TEMP__LAMB FORMAT "%6.2"
 /begin AXIS_DESCR COM_AXIS temp_ex_mdl[1] _CNV_A_R_LINEAR_____153_CM 15 0. 1023.984375 FORMAT "%6.2" AXIS_PTS_REF ldpm_temp_ip_capa_heat_prs_ex /end AXIS_DESCR
 /begin AXIS_DESCR COM_AXIS online_dummy _CNV_A_R_LINEAR_____191_CM 15 0. 31.99951171875 FORMAT "%6.4" AXIS_PTS_REF ldpm_lamb_ip_capa_heat_prs_ex /end AXIS_DESCR
/end CHARACTERISTIC
/begin AXIS_PTS ldpm_temp_ip_capa_heat_prs_ex "" 0x843ec4 temp_ex_mdl[1] _REC_AXS_20_u2 1023.984375 _CNV_A_R_LINEAR_____153_CM 15 0. 1023.984375 FORMAT "%6.2" /end AXIS_PTS
/begin AXIS_PTS ldpm_lamb_ip_capa_heat_prs_ex "" 0x8434ac online_dummy _REC_AXS_20_u2 31.99951171875 _CNV_A_R_LINEAR_____191_CM 15 0. 31.99951171875 FORMAT "%6.4" /end AXIS_PTS
/begin CHARACTERISTIC ip_fac_heat_tran_cyl__n__mf "GE_EGPT: heat transmission coeff" MAP 0x84b9d4 _REC_MAP_20_u2_u2_u2 1023.984375 _CNV_A_R_LINEAR_____192_CM 0. 1023.984375 DISPLAY_IDENTIFIER IP_FAC_HEAT_TRAN_CYL__N__MF FORMAT "%6.2"
 /begin AXIS_DESCR COM_AXIS n _CNV_A_R_LINEAR_____5_CM 16 0. 6375. FORMAT "%4.0" AXIS_PTS_REF ldp_n_ip_fac_heat_tran_cyl /end AXIS_DESCR
 /begin AXIS_DESCR COM_AXIS mf_tot _CNV_A_R_LINEAR_____43_CM 8 0. 262.14 AXIS_PTS_REF ldp_mf_ip_fac_heat_tran_cyl /end AXIS_DESCR
/end CHARACTERISTIC
/begin AXIS_PTS ldp_n_ip_fac_heat_tran_cyl "heat transmission coeff" 0x841a00 n _REC_AXS_20_u2 6375. _CNV_A_R_LINEAR_____5_CM 16 0. 6375. FORMAT "%4.0" /end AXIS_PTS
/begin AXIS_PTS ldp_mf_ip_fac_heat_tran_cyl "heat transmission coeff" 0x841850 mf_tot _REC_AXS_20_u2 262.14 _CNV_A_R_LINEAR_____43_CM 8 0. 262.14 /end AXIS_PTS
/begin CHARACTERISTIC ip_fac_temp_cmp__kappa__cmp "GE_EGPT: factor for final compression temperature calculation" MAP 0x84c1ba _REC_MAP_20_u2_u2_u2 12.799805 _CNV_A_R_LINEAR_____193_CM 0. 12.799805 DISPLAY_IDENTIFIER IP_FAC_TEMP_CMP__KAPPA__CMP FORMAT "%6.4"
 /begin AXIS_DESCR COM_AXIS online_dummy _CNV_A_R_LINEAR_____53_CM 6 0. 1.9999696 FORMAT "%6.5" AXIS_PTS_REF ldp_kappa_ip_fac_temp_cmp /end AXIS_DESCR
 /begin AXIS_DESCR COM_AXIS online_dummy _CNV_A_R_LINEAR_____130_CM 5 0. 100. AXIS_PTS_REF ldp_cmp_ratio_ip_fac_temp_cmp /end AXIS_DESCR
/end CHARACTERISTIC
/begin AXIS_PTS ldp_kappa_ip_fac_temp_cmp "factor for final compression temperature calculation" 0x841704 online_dummy _REC_AXS_20_u2 1.9999696 _CNV_A_R_LINEAR_____53_CM 6 0. 1.9999696 FORMAT "%6.5" /end AXIS_PTS
/begin AXIS_PTS ldp_cmp_ratio_ip_fac_temp_cmp "factor for final compression temperature calculation" 0x841468 online_dummy _REC_AXS_20_u2 100. _CNV_A_R_LINEAR_____130_CM 5 0. 100. /end AXIS_PTS
/begin CHARACTERISTIC ip_visc_ex__temp__lamb "GE_EGPT: dynamic viscosity exhaust gas" MAP 0x85bac2 _REC_MAP_20_u2_u2_u2 262.14 _CNV_A_R_LINEAR_____194_CM 0. 262.14 DISPLAY_IDENTIFIER IP_VISC_EX__TEMP__LAMB
 /begin AXIS_DESCR COM_AXIS temp_ex_mdl[1] _CNV_A_R_LINEAR_____153_CM 15 0. 1023.984375 FORMAT "%6.2" AXIS_PTS_REF ldpm_temp_ip_capa_heat_prs_ex /end AXIS_DESCR
 /begin AXIS_DESCR COM_AXIS online_dummy _CNV_A_R_LINEAR_____191_CM 15 0. 31.99951171875 FORMAT "%6.4" AXIS_PTS_REF ldpm_lamb_ip_capa_heat_prs_ex /end AXIS_DESCR
/end CHARACTERISTIC
/begin CHARACTERISTIC ip_heat_cond_ex__temp__lamb "GE_EGPT: thermal conductivity coefficient exhaust gas" MAP 0x84c92e _REC_MAP_20_u2_u2_u2 262.14 _CNV_A_R_LINEAR_____195_CM 0. 262.14 DISPLAY_IDENTIFIER IP_HEAT_COND_EX__TEMP__LAMB
 /begin AXIS_DESCR COM_AXIS temp_ex_mdl[1] _CNV_A_R_LINEAR_____153_CM 15 0. 1023.984375 FORMAT "%6.2" AXIS_PTS_REF ldpm_temp_ip_capa_heat_prs_ex /end AXIS_DESCR
 /begin AXIS_DESCR COM_AXIS online_dummy _CNV_A_R_LINEAR_____191_CM 15 0. 31.99951171875 FORMAT "%6.4" AXIS_PTS_REF ldpm_lamb_ip_capa_heat_prs_ex /end AXIS_DESCR
/end CHARACTERISTIC
/begin CHARACTERISTIC ip_capa_heat_vol_ex__temp__lamb "GE_EGPT: spec. heat capacity exhaus gas (v=const.)" MAP 0x84a22c _REC_MAP_20_u2_u2_u2 2550. _CNV_A_R_LINEAR_____165_CM 0. 2550. DISPLAY_IDENTIFIER IP_CAPA_HEAT_VOL_EX__TEMP__LAMB FORMAT "%6.2"
 /begin AXIS_DESCR COM_AXIS temp_ex_mdl[1] _CNV_A_R_LINEAR_____153_CM 15 0. 1023.984375 FORMAT "%6.2" AXIS_PTS_REF ldpm_temp_ip_capa_heat_prs_ex /end AXIS_DESCR
 /begin AXIS_DESCR COM_AXIS online_dummy _CNV_A_R_LINEAR_____191_CM 15 0. 31.99951171875 FORMAT "%6.4" AXIS_PTS_REF ldpm_lamb_ip_capa_heat_prs_ex /end AXIS_DESCR
/end CHARACTERISTIC
/begin CHARACTERISTIC ip_bpa_psn__div_prs_tur__m_tur "GE_EGPT: Variable Nozzle Position" MAP 0x849046 _REC_MAP_20_u2_u2_u2 100. _CNV_A_R_LINEAR_____136_CM 0. 100. DISPLAY_IDENTIFIER IP_BPA_PSN__DIV_PRS_TUR__M_TUR FORMAT "%5.3"
 /begin AXIS_DESCR COM_AXIS inv_div_prs_tur[1] _CNV_A_R_LINEAR_____145_CM 16 0. 6.5535 FORMAT "%5.4" AXIS_PTS_REF ldp_pq_tur_ip_bpa_psn /end AXIS_DESCR
 /begin AXIS_DESCR COM_AXIS m_tur_kgh_stnd[1] _CNV_A_R_LINEAR_____112_CM 16 0. 1023.984375 FORMAT "%6.2" AXIS_PTS_REF ldpm_mfw_tur_ip_pq_tur /end AXIS_DESCR
/end CHARACTERISTIC
/begin AXIS_PTS ldp_pq_tur_ip_bpa_psn "" 0x8424b2 inv_div_prs_tur[1] _REC_AXS_20_u2 6.5535 _CNV_A_R_LINEAR_____145_CM 16 0. 6.5535 FORMAT "%5.4" /end AXIS_PTS
/begin AXIS_PTS ldpm_mfw_tur_ip_pq_tur "" 0x843584 m_tur_kgh_stnd[1] _REC_AXS_20_u2 1023.984375 _CNV_A_R_LINEAR_____112_CM 16 0. 1023.984375 FORMAT "%6.2" /end AXIS_PTS
/begin MEASUREMENT dip_air_fil "" UWORD _CNV_A_R_LINEAR_____21_CM 1 0. 0. 5434. DISPLAY_IDENTIFIER DIP_AIR_FIL ECU_ADDRESS 0x7fa6f4 BYTE_ORDER MSB_LAST FORMAT "%6.2" /end MEASUREMENT
/begin MEASUREMENT dip_air_fil_sp "" UWORD _CNV_A_R_LINEAR_____21_CM 1 0. 0. 5434. DISPLAY_IDENTIFIER DIP_AIR_FIL_SP ECU_ADDRESS 0x7f9858 BYTE_ORDER MSB_LAST FORMAT "%6.2" /end MEASUREMENT
/begin AXIS_PTS ldp_maf_kgh_ip_map_dec "" 0x841748 online_dummy _REC_AXS_20_u2 1023.984375 _CNV_A_R_LINEAR_____112_CM 5 0. 1023.984375 FORMAT "%6.2" /end AXIS_PTS
/begin CHARACTERISTIC ip_prs_ex_bas__n__mf "GE_EGPT: exhaust pressure" MAP 0x855804 _REC_MAP_20_u2_u2_u2 5434. _CNV_A_R_LINEAR_____21_CM 0. 5434. DISPLAY_IDENTIFIER IP_PRS_EX_BAS__N__MF FORMAT "%6.2"
 /begin AXIS_DESCR COM_AXIS n _CNV_A_R_LINEAR_____5_CM 9 0. 6375. FORMAT "%4.0" AXIS_PTS_REF ldp_n_ip_prs_ex /end AXIS_DESCR
 /begin AXIS_DESCR COM_AXIS mf_bas _CNV_A_R_LINEAR_____43_CM 5 0. 262.14 AXIS_PTS_REF ldp_mf_ip_prs_ex /end AXIS_DESCR
/end CHARACTERISTIC
/begin MEASUREMENT prs_cmp_up_sp "Pressure in front of the compressor" UWORD _CNV_A_R_LINEAR_____21_CM 1 0. 0. 5434. DISPLAY_IDENTIFIER PRS_CMP_UP_SP ECU_ADDRESS 0x7f97de BYTE_ORDER MSB_LAST FORMAT "%6.2" /end MEASUREMENT
/begin MEASUREMENT maf_cyl_mmv "filtered air mass flow through the engine" UWORD _CNV_A_R_LINEAR_____23_CM 1 0. 0. 1389. DISPLAY_IDENTIFIER MAF_CYL_MMV ECU_ADDRESS 0x7fa602 BYTE_ORDER MSB_LAST FORMAT "%6.2" /end MEASUREMENT
/begin MEASUREMENT maf_cyl "airmass flow through the engine" UWORD _CNV_A_R_LINEAR_____23_CM 1 0. 0. 1389. DISPLAY_IDENTIFIER MAF_CYL ECU_ADDRESS 0x7f97e0 BYTE_ORDER MSB_LAST FORMAT "%6.2" /end MEASUREMENT
/begin MEASUREMENT maf_cyl_kgh "filtered air mass flow through the engine" UWORD _CNV_A_R_LINEAR_____112_CM 1 0. 0. 1023.984375 DISPLAY_IDENTIFIER MAF_CYL_KGH ECU_ADDRESS 0x7f97e2 BYTE_ORDER MSB_LAST FORMAT "%6.2" /end MEASUREMENT
/begin MEASUREMENT pq_map_prs_ex "pressure quotient manifold pressure to exhaust back pressure" UWORD _CNV_A_R_LINEAR_____196_CM 1 0. 0. 3.99998471 DISPLAY_IDENTIFIER PQ_MAP_PRS_EX ECU_ADDRESS 0x7fa604 BYTE_ORDER MSB_LAST FORMAT "%6.5" /end MEASUREMENT
/begin MEASUREMENT fac_maf_cyl "factor for air mass flow through the engine" UWORD _CNV_A_R_LINEAR_____53_CM 1 0. 0. 1.9999696 DISPLAY_IDENTIFIER FAC_MAF_CYL ECU_ADDRESS 0x7f97e4 BYTE_ORDER MSB_LAST FORMAT "%6.5" /end MEASUREMENT
/begin MEASUREMENT egr "EGR- ratio" UWORD _CNV_A_R_LINEAR_____8_CM 1 0. 0. 99.99847412109381 DISPLAY_IDENTIFIER EGR ECU_ADDRESS 0x7fa606 BYTE_ORDER MSB_LAST FORMAT "%5.3" /end MEASUREMENT
/begin MEASUREMENT egr_mmv "filtered EGR ratio" UWORD _CNV_A_R_LINEAR_____8_CM 1 0. 0. 99.99847412109381 DISPLAY_IDENTIFIER EGR_MMV ECU_ADDRESS 0x7f97e6 BYTE_ORDER MSB_LAST FORMAT "%5.3" /end MEASUREMENT
/begin MEASUREMENT mfw_egr "EGR mass flow" UWORD _CNV_A_R_LINEAR_____23_CM 1 0. 0. 1389. DISPLAY_IDENTIFIER MFW_EGR ECU_ADDRESS 0x7f97e8 BYTE_ORDER MSB_LAST FORMAT "%6.2" /end MEASUREMENT
/begin MEASUREMENT maf_im "stored air mass flow inside the intake manifold" SWORD _CNV_A_R_LINEAR_____149_CM 1 0. -694.5 694.479 DISPLAY_IDENTIFIER MAF_IM ECU_ADDRESS 0x7f97ea BYTE_ORDER MSB_LAST FORMAT "%5.2" /end MEASUREMENT
/begin MEASUREMENT maf_cyl_sp "expected air mass flow through the engine" UWORD _CNV_A_R_LINEAR_____23_CM 1 0. 0. 1389. DISPLAY_IDENTIFIER MAF_CYL_SP ECU_ADDRESS 0x7fa600 BYTE_ORDER MSB_LAST FORMAT "%6.2" /end MEASUREMENT
/begin MEASUREMENT pq_map_prs_ex_sp "expected pressure quotient manifold pressure to exhaust back pressure" UWORD _CNV_A_R_LINEAR_____196_CM 1 0. 0. 3.99998471 DISPLAY_IDENTIFIER PQ_MAP_PRS_EX_SP ECU_ADDRESS 0x7fa608 BYTE_ORDER MSB_LAST FORMAT "%6.5" /end MEASUREMENT
/begin MEASUREMENT fac_maf_cyl_sp "volumetric efficiency" UWORD _CNV_A_R_LINEAR_____53_CM 1 0. 0. 1.9999696 DISPLAY_IDENTIFIER FAC_MAF_CYL_SP ECU_ADDRESS 0x7f97ec BYTE_ORDER MSB_LAST FORMAT "%6.5" /end MEASUREMENT
/begin MEASUREMENT mfw_egr_sp "expected EGR mass flow" UWORD _CNV_A_R_LINEAR_____23_CM 1 0. 0. 1389. DISPLAY_IDENTIFIER MFW_EGR_SP ECU_ADDRESS 0x7f97ee BYTE_ORDER MSB_LAST FORMAT "%6.2" /end MEASUREMENT
/begin MEASUREMENT mfw_ex_sp "exhaust gas mass flow" UWORD _CNV_A_R_LINEAR_____23_CM 1 0. 0. 1389. DISPLAY_IDENTIFIER MFW_EX_SP ECU_ADDRESS 0x7fa60a BYTE_ORDER MSB_LAST FORMAT "%6.2" /end MEASUREMENT
/begin MEASUREMENT mfw_tur_sp "turbine mass flow" UWORD _CNV_A_R_LINEAR_____23_CM 1 0. 0. 1389. DISPLAY_IDENTIFIER MFW_TUR_SP ECU_ADDRESS 0x7fa60c BYTE_ORDER MSB_LAST FORMAT "%6.2" /end MEASUREMENT
/begin MEASUREMENT maf_cyl_sp_clc "expected air mass flow through the engine" UWORD _CNV_A_R_LINEAR_____23_CM 1 0. 0. 1389. DISPLAY_IDENTIFIER MAF_CYL_SP_CLC ECU_ADDRESS 0x7fa60e BYTE_ORDER MSB_LAST FORMAT "%6.2" /end MEASUREMENT
/begin MEASUREMENT pq_map_prs_ex_sp_clc "expected pressure quotient manifold pressure to exhaust back pressure" UWORD _CNV_A_R_LINEAR_____196_CM 1 0. 0. 3.99998471 DISPLAY_IDENTIFIER PQ_MAP_PRS_EX_SP_CLC ECU_ADDRESS 0x7fa610 BYTE_ORDER MSB_LAST FORMAT "%6.5" /end MEASUREMENT
/begin MEASUREMENT fac_maf_cyl_sp_clc "factor for air mass flow through the engine" UWORD _CNV_A_R_LINEAR_____53_CM 1 0. 0. 1.9999696 DISPLAY_IDENTIFIER FAC_MAF_CYL_SP_CLC ECU_ADDRESS 0x7f97f0 BYTE_ORDER MSB_LAST FORMAT "%6.5" /end MEASUREMENT
/begin MEASUREMENT mfw_egr_sp_clc "expected EGR mass flow" UWORD _CNV_A_R_LINEAR_____23_CM 1 0. 0. 1389. DISPLAY_IDENTIFIER MFW_EGR_SP_CLC ECU_ADDRESS 0x7fa612 BYTE_ORDER MSB_LAST FORMAT "%6.2" /end MEASUREMENT
/begin MEASUREMENT map_sp_max_egr "Maximum manifold pressure to reach the needed EGR ratio with a totally opened EGR valve" UWORD _CNV_A_R_LINEAR_____21_CM 1 0. 0. 5434. DISPLAY_IDENTIFIER MAP_SP_MAX_EGR ECU_ADDRESS 0x7f97f2 BYTE_ORDER MSB_LAST FORMAT "%6.2" /end MEASUREMENT
/begin MEASUREMENT fac_mfw_egr "factor for MAP_SP_MAX_EGR calculation" UWORD _CNV_A_R_LINEAR_____21_CM 1 0. 0. 5434. DISPLAY_IDENTIFIER FAC_MFW_EGR ECU_ADDRESS 0x7fa614 BYTE_ORDER MSB_LAST FORMAT "%6.2" /end MEASUREMENT
/begin MEASUREMENT fac_mfw_the__temp_ex "factor depending on the temperature to calculate the mass flow through a valve" UWORD _CNV_A_R_LINEAR_____197_CM 1 0. 0. 1.99997e-002 DISPLAY_IDENTIFIER FAC_MFW_THE__TEMP_EX ECU_ADDRESS 0x7f97f4 BYTE_ORDER MSB_LAST FORMAT "%8.7" /end MEASUREMENT
/begin MEASUREMENT temp_up_cyl_sp "expected temperature in front of the engine" UWORD _CNV_A_R_LINEAR_____198_CM 1 0. -50. 973.984375 DISPLAY_IDENTIFIER TEMP_UP_CYL_SP ECU_ADDRESS 0x7f97f6 BYTE_ORDER MSB_LAST FORMAT "%5.2" /end MEASUREMENT
/begin MEASUREMENT temp_up_cyl "temperature in front of the engine" UWORD _CNV_A_R_LINEAR_____198_CM 1 0. -50. 973.984375 DISPLAY_IDENTIFIER TEMP_UP_CYL ECU_ADDRESS 0x7f97f8 BYTE_ORDER MSB_LAST FORMAT "%5.2" /end MEASUREMENT
/begin MEASUREMENT mf_lamb_clc "fuel mass for lambda calculation" UWORD _CNV_A_R_LINEAR_____43_CM 1 0. 0. 262.14 DISPLAY_IDENTIFIER MF_LAMB_CLC ECU_ADDRESS 0x7fa5fe BYTE_ORDER MSB_LAST /end MEASUREMENT
/begin MEASUREMENT lamb_ext_clc_fil "external air/fuel-ratio" UWORD _CNV_A_R_LINEAR_____191_CM 1 0. 0. 31.99951171875 DISPLAY_IDENTIFIER LAMB_EXT_CLC_FIL ECU_ADDRESS 0x7f97fa BYTE_ORDER MSB_LAST FORMAT "%6.4" /end MEASUREMENT
/begin MEASUREMENT lamb_it_clc_fil "internal air/fuel-ratio" UWORD _CNV_A_R_LINEAR_____191_CM 1 0. 0. 31.99951171875 DISPLAY_IDENTIFIER LAMB_IT_CLC_FIL ECU_ADDRESS 0x7f97fc BYTE_ORDER MSB_LAST FORMAT "%6.4" /end MEASUREMENT
/begin MEASUREMENT lamb_it_sp_clc_fil "internal air/fuel-ratio setpoint" UWORD _CNV_A_R_LINEAR_____191_CM 1 0. 0. 31.99951171875 DISPLAY_IDENTIFIER LAMB_IT_SP_CLC_FIL ECU_ADDRESS 0x7f97fe BYTE_ORDER MSB_LAST FORMAT "%6.4" /end MEASUREMENT
/begin MEASUREMENT lamb_ext_sp_clc_fil "external air/fuel-ratio" UWORD _CNV_A_R_LINEAR_____191_CM 1 0. 0. 31.99951171875 DISPLAY_IDENTIFIER LAMB_EXT_SP_CLC_FIL ECU_ADDRESS 0x7f9800 BYTE_ORDER MSB_LAST FORMAT "%6.4" /end MEASUREMENT
/begin CHARACTERISTIC c_vol_cyl "cylinder displacement" VALUE 0x85c2c8 _REC_VAL_20_u2 1343.4 _CNV_A_R_LINEAR_____199_CM 0. 1343.4 DISPLAY_IDENTIFIER C_VOL_CYL FORMAT "%6.2" /end CHARACTERISTIC
/begin CHARACTERISTIC c_fac_maf_cyl_fil "filter factor for MAF_CYL" VALUE 0x85be4a _REC_VAL_20_u2 0.9999847412109381 _CNV_A_R_LINEAR_____14_CM 0. 0.9999847412109381 DISPLAY_IDENTIFIER C_FAC_MAF_CYL_FIL FORMAT "%6.5" /end CHARACTERISTIC
/begin CHARACTERISTIC c_fac_egr_fil "filter factor for EGR_MMV" VALUE 0x85be2a _REC_VAL_20_u2 0.9999847412109381 _CNV_A_R_LINEAR_____14_CM 0. 0.9999847412109381 DISPLAY_IDENTIFIER C_FAC_EGR_FIL FORMAT "%6.5" /end CHARACTERISTIC
/begin CHARACTERISTIC c_vol_down_thr "volume down throttle" VALUE 0x85c2ca _REC_VAL_20_u2 1343.4 _CNV_A_R_LINEAR_____200_CM 0. 1343.4 DISPLAY_IDENTIFIER C_VOL_DOWN_THR FORMAT "%6.2" /end CHARACTERISTIC
/begin CHARACTERISTIC c_vol_up_thr "volume up throttle" VALUE 0x85c2ce _REC_VAL_20_u2 1343.4 _CNV_A_R_LINEAR_____200_CM 0. 1343.4 DISPLAY_IDENTIFIER C_VOL_UP_THR FORMAT "%6.2" /end CHARACTERISTIC
/begin CHARACTERISTIC c_fac_lamb_ext_clc_fil "filter-factor for external lambda" VALUE 0x85be46 _REC_VAL_20_u2 0.9999847412109381 _CNV_A_R_LINEAR_____14_CM 0. 0.9999847412109381 DISPLAY_IDENTIFIER C_FAC_LAMB_EXT_CLC_FIL FORMAT "%6.5" /end CHARACTERISTIC
/begin CHARACTERISTIC c_fac_lamb_it_clc_fil "filter-factor for internal lambda" VALUE 0x85be48 _REC_VAL_20_u2 0.9999847412109381 _CNV_A_R_LINEAR_____14_CM 0. 0.9999847412109381 DISPLAY_IDENTIFIER C_FAC_LAMB_IT_CLC_FIL FORMAT "%6.5" /end CHARACTERISTIC
/begin CHARACTERISTIC c_fac_mf_post_lamb_clc "factor for the influence of MAF_POST on MF_LAMB_CLC" VALUE 0x85be66 _REC_VAL_20_u1 1.9921875 _CNV_A_R_LINEAR_____24_CM 0. 1.9921875 DISPLAY_IDENTIFIER C_FAC_MF_POST_LAMB_CLC FORMAT "%4.3" /end CHARACTERISTIC
/begin CHARACTERISTIC c_afs_dsl "stoichiometric air fuel ratio for diesel = 14.6 kg air/kg fuel" VALUE 0x85bcbc _REC_VAL_20_u2 15.999755 _CNV_A_R_LINEAR_____13_CM 0. 15.999755 DISPLAY_IDENTIFIER C_AFS_DSL FORMAT "%6.4" /end CHARACTERISTIC
/begin CHARACTERISTIC ip_fac_mfw_the__temp_ex "GE_AIRV: factor depending on temperature to calculate the mass flow through a valve" CURVE 0x84bf70 _REC_CUR_20_u2_u2 1.99997e-002 _CNV_A_R_LINEAR_____197_CM 0. 1.99997e-002 DISPLAY_IDENTIFIER IP_FAC_MFW_THE__TEMP_EX FORMAT "%8.7"
 /begin AXIS_DESCR COM_AXIS tba _CNV_A_R_LINEAR_____153_CM 12 0. 1023.984375 FORMAT "%6.2" AXIS_PTS_REF ldp_temp_ex_ip_fac_mfw_the /end AXIS_DESCR
/end CHARACTERISTIC
/begin AXIS_PTS ldp_temp_ex_ip_fac_mfw_the "" 0x84287c tba _REC_AXS_20_u2 1023.984375 _CNV_A_R_LINEAR_____153_CM 12 0. 1023.984375 FORMAT "%6.2" /end AXIS_PTS
/begin CHARACTERISTIC ip_fac_maf_cyl__n__pq "GE_AIRV: factor for air mass flow through the engine" MAP 0x84baf2 _REC_MAP_20_u2_u2_u2 1.9999696 _CNV_A_R_LINEAR_____53_CM 0. 1.9999696 DISPLAY_IDENTIFIER IP_FAC_MAF_CYL__N__PQ FORMAT "%6.5"
 /begin AXIS_DESCR COM_AXIS n _CNV_A_R_LINEAR_____5_CM 12 0. 6375. FORMAT "%4.0" AXIS_PTS_REF ldp_n_ip_fac_maf_cyl /end AXIS_DESCR
 /begin AXIS_DESCR COM_AXIS online_dummy _CNV_A_R_LINEAR_____63_CM 12 0. 3.99998471 FORMAT "%6.5" AXIS_PTS_REF ldp_pq_ip_fac_maf_cyl /end AXIS_DESCR
/end CHARACTERISTIC
/begin AXIS_PTS ldp_n_ip_fac_maf_cyl "" 0x841a22 n _REC_AXS_20_u2 6375. _CNV_A_R_LINEAR_____5_CM 12 0. 6375. FORMAT "%4.0" /end AXIS_PTS
/begin AXIS_PTS ldp_pq_ip_fac_maf_cyl "" 0x84247e online_dummy _REC_AXS_20_u2 3.99998471 _CNV_A_R_LINEAR_____63_CM 12 0. 3.99998471 FORMAT "%6.5" /end AXIS_PTS
/begin CHARACTERISTIC ip_map_max__prs_ex__fac_mfw "GE_AIRV: maximum MAP_SP" MAP 0x84ef3c _REC_MAP_20_u2_u2_u2 5434. _CNV_A_R_LINEAR_____21_CM 0. 5434. DISPLAY_IDENTIFIER IP_MAP_MAX__PRS_EX__FAC_MFW FORMAT "%6.2"
 /begin AXIS_DESCR COM_AXIS prs_ex _CNV_A_R_LINEAR_____21_CM 12 0. 5434. FORMAT "%6.2" AXIS_PTS_REF ldp_prs_ex_ip_map_max /end AXIS_DESCR
 /begin AXIS_DESCR COM_AXIS prs_ex _CNV_A_R_LINEAR_____21_CM 12 0. 5434. FORMAT "%6.2" AXIS_PTS_REF ldp_fac_mfw_ip_map_max /end AXIS_DESCR
/end CHARACTERISTIC
/begin AXIS_PTS ldp_prs_ex_ip_map_max "" 0x8424e0 prs_ex _REC_AXS_20_u2 5434. _CNV_A_R_LINEAR_____21_CM 12 0. 5434. FORMAT "%6.2" /end AXIS_PTS
/begin AXIS_PTS ldp_fac_mfw_ip_map_max "" 0x841692 prs_ex _REC_AXS_20_u2 5434. _CNV_A_R_LINEAR_____21_CM 12 0. 5434. FORMAT "%6.2" /end AXIS_PTS
/begin CHARACTERISTIC c_ar_egrv_max_the "theoretic max. cross section of the EGR- valve" VALUE 0x85bcf2 _REC_VAL_20_u2 78.08 _CNV_A_R_LINEAR_____7_CM 0. 78.08 DISPLAY_IDENTIFIER C_AR_EGRV_MAX_THE FORMAT "%5.3" /end CHARACTERISTIC
/begin MEASUREMENT map_dif "MAP controller deviation" SWORD _CNV_A_R_LINEAR_____60_CM 1 0. -2717. 2716.91708 DISPLAY_IDENTIFIER MAP_DIF ECU_ADDRESS 0x7f9818 BYTE_ORDER MSB_LAST FORMAT "%6.2" /end MEASUREMENT
/begin MEASUREMENT bpapwm_eff "effective boost pressure adjustment output" UWORD _CNV_A_R_LINEAR_____201_CM 1 0. 0. 99.972117 DISPLAY_IDENTIFIER BPAPWM_EFF ECU_ADDRESS 0x7f981a BYTE_ORDER MSB_LAST FORMAT "%5.3" /end MEASUREMENT
/begin MEASUREMENT bpapwm_ctl "sum of the PI- and DT1-controller" SWORD _CNV_A_R_LINEAR_____12_CM 1 0. -100. 99.996948242 DISPLAY_IDENTIFIER BPAPWM_CTL ECU_ADDRESS 0x7fa644 BYTE_ORDER MSB_LAST FORMAT "%5.3" /end MEASUREMENT
/begin MEASUREMENT bpapwm_ctl_dt1 "DT1 for BPAPWM_CTL" SWORD _CNV_A_R_LINEAR_____12_CM 1 0. -100. 99.996948242 DISPLAY_IDENTIFIER BPAPWM_CTL_DT1 ECU_ADDRESS 0x7fa646 BYTE_ORDER MSB_LAST FORMAT "%5.3" /end MEASUREMENT
/begin MEASUREMENT bpapwm_ctl_pi_max "max. output for the PI-controller" SWORD _CNV_A_R_LINEAR_____12_CM 1 0. -100. 99.996948242 DISPLAY_IDENTIFIER BPAPWM_CTL_PI_MAX ECU_ADDRESS 0x7fa648 BYTE_ORDER MSB_LAST FORMAT "%5.3" /end MEASUREMENT
/begin MEASUREMENT bpapwm_ctl_pi_min "min. output for the PI-controller" SWORD _CNV_A_R_LINEAR_____12_CM 1 0. -100. 99.996948242 DISPLAY_IDENTIFIER BPAPWM_CTL_PI_MIN ECU_ADDRESS 0x7fa64a BYTE_ORDER MSB_LAST FORMAT "%5.3" /end MEASUREMENT
/begin MEASUREMENT kr_dt1_bpa "gain for dynamic BPAPWM, depending on N and MAP_DIF" UWORD _CNV_A_R_LINEAR_____202_CM 1 0. -2.46996 2.46988 DISPLAY_IDENTIFIER KR_DT1_BPA ECU_ADDRESS 0x7fa64c BYTE_ORDER MSB_LAST FORMAT "%6.5" /end MEASUREMENT
/begin MEASUREMENT lv_bpapwm_ctl_min "BPA controller at min. limit" UBYTE _CNV_S_2_RANGE______11_CM 1 0. 0. 1. DISPLAY_IDENTIFIER LV_BPAPWM_CTL_MIN ECU_ADDRESS 0x7fb48b /end MEASUREMENT
/begin MEASUREMENT kr_pi_map "gain factor for MAP controller" UWORD _CNV_A_R_LINEAR_____203_CM 1 0. 0. 2.355575 DISPLAY_IDENTIFIER KR_PI_MAP ECU_ADDRESS 0x7fa64e BYTE_ORDER MSB_LAST FORMAT "%6.5" /end MEASUREMENT
/begin MEASUREMENT tn_pi_map "integral action time for MAP controller" UWORD _CNV_A_R_LINEAR_____67_CM 1 0. 0. 4.19424 DISPLAY_IDENTIFIER TN_PI_MAP ECU_ADDRESS 0x7fa650 BYTE_ORDER MSB_LAST FORMAT "%6.5" /end MEASUREMENT
/begin MEASUREMENT bpapwm_ctl_pi "PI-conroller output for boost pressure adjustment" SWORD _CNV_A_R_LINEAR_____12_CM 1 0. -100. 99.996948242 DISPLAY_IDENTIFIER BPAPWM_CTL_PI ECU_ADDRESS 0x7f981c BYTE_ORDER MSB_LAST FORMAT "%5.3" /end MEASUREMENT
/begin CHARACTERISTIC c_bpapwm_dt1_max "C_BPAPWM_DT1_MAX" VALUE 0x85bd06 _REC_VAL_20_s2 199.996948242 _CNV_A_R_LINEAR_____12_CM -100. 99.996948242 DISPLAY_IDENTIFIER C_BPAPWM_DT1_MAX FORMAT "%5.3" /end CHARACTERISTIC
/begin CHARACTERISTIC c_bpapwm_dt1_min "C_BPAPWM_DT1_MIN" VALUE 0x85bd08 _REC_VAL_20_s2 199.996948242 _CNV_A_R_LINEAR_____12_CM -100. 99.996948242 DISPLAY_IDENTIFIER C_BPAPWM_DT1_MIN FORMAT "%5.3" /end CHARACTERISTIC
/begin CHARACTERISTIC lc_bpa_dt1_map_dif_on "DT1 Activation for MAP_DIF" VALUE 0x85c2f7 _REC_VAL_20_u1 1. _CNV_A_R_LINEAR_____0_CM 0. 1. DISPLAY_IDENTIFIER LC_BPA_DT1_MAP_DIF_ON FORMAT "%1.0" /end CHARACTERISTIC
/begin CHARACTERISTIC c_fac_bpapwm_ctl_off_fil "filter factor for BPAPWM_CTL" VALUE 0x85be10 _REC_VAL_20_u2 0.9999847412109381 _CNV_A_R_LINEAR_____14_CM 0. 0.9999847412109381 DISPLAY_IDENTIFIER C_FAC_BPAPWM_CTL_OFF_FIL FORMAT "%6.5" /end CHARACTERISTIC
/begin CHARACTERISTIC ip_tn_dt1_bpa__n "BPA_CTL: time value for DT1 function BPA" CURVE 0x85ae9e _REC_CUR_20_u2_u2 4.19424 _CNV_A_R_LINEAR_____67_CM 0. 4.19424 DISPLAY_IDENTIFIER IP_TN_DT1_BPA__N FORMAT "%6.5"
 /begin AXIS_DESCR COM_AXIS n _CNV_A_R_LINEAR_____5_CM 8 0. 6375. FORMAT "%4.0" AXIS_PTS_REF ldpm_n_ip_map_ctl /end AXIS_DESCR
/end CHARACTERISTIC
/begin AXIS_PTS ldpm_n_ip_map_ctl "time value for DT1 function BPA" 0x843b9e n _REC_AXS_20_u2 6375. _CNV_A_R_LINEAR_____5_CM 8 0. 6375. FORMAT "%4.0" /end AXIS_PTS
/begin CHARACTERISTIC ip_fac_kr_pi_map__map_dif "BPA_CTL: factor for the gain value" CURVE 0x84bae0 _REC_CUR_20_u2_u2 1.9999696 _CNV_A_R_LINEAR_____53_CM 0. 1.9999696 DISPLAY_IDENTIFIER IP_FAC_KR_PI_MAP__MAP_DIF FORMAT "%6.5"
 /begin AXIS_DESCR COM_AXIS map_dif _CNV_A_R_LINEAR_____147_CM 6 -2717.041459 2716.958541 FORMAT "%6.2" AXIS_PTS_REF ldpm_map_dif_ip_map /end AXIS_DESCR
/end CHARACTERISTIC
/begin AXIS_PTS ldpm_map_dif_ip_map "factor for the gain value" 0x843508 map_dif _REC_AXS_20_u2 5434. _CNV_A_R_LINEAR_____147_CM 6 -2717.041459 2716.958541 FORMAT "%6.2" /end AXIS_PTS
/begin CHARACTERISTIC ip_fac_tn_pi_map__map_dif "BPA_CTL: factor for the integral action time" CURVE 0x84c290 _REC_CUR_20_u2_u2 1.9999696 _CNV_A_R_LINEAR_____53_CM 0. 1.9999696 DISPLAY_IDENTIFIER IP_FAC_TN_PI_MAP__MAP_DIF FORMAT "%6.5"
 /begin AXIS_DESCR COM_AXIS map_dif _CNV_A_R_LINEAR_____147_CM 6 -2717.041459 2716.958541 FORMAT "%6.2" AXIS_PTS_REF ldpm_map_dif_ip_map /end AXIS_DESCR
/end CHARACTERISTIC
/begin CHARACTERISTIC ip_kr_dt1_bpa__n__map_dif "BPA_CTL: gain value for dynamic bpa on map_dif" MAP 0x84cb00 _REC_MAP_20_u2_u2_u2 4.93984 _CNV_A_R_LINEAR_____202_CM -2.46996 2.46988 DISPLAY_IDENTIFIER IP_KR_DT1_BPA__N__MAP_DIF FORMAT "%6.5"
 /begin AXIS_DESCR COM_AXIS n _CNV_A_R_LINEAR_____5_CM 8 0. 6375. FORMAT "%4.0" AXIS_PTS_REF ldpm_n_ip_map_ctl /end AXIS_DESCR
 /begin AXIS_DESCR COM_AXIS map_dif _CNV_A_R_LINEAR_____147_CM 10 -2717.041459 2716.958541 FORMAT "%6.2" AXIS_PTS_REF ldp_map_dif_ip_kr_dt1_bpa /end AXIS_DESCR
/end CHARACTERISTIC
/begin AXIS_PTS ldp_map_dif_ip_kr_dt1_bpa "gain value for dynamic bpa on map_dif" 0x84182c map_dif _REC_AXS_20_u2 5434. _CNV_A_R_LINEAR_____147_CM 10 -2717.041459 2716.958541 FORMAT "%6.2" /end AXIS_PTS
/begin CHARACTERISTIC ip_kr_pi_map "BPA_CTL: gain value for the PI-controller" MAP 0x84cdda _REC_MAP_20_u2_u2_u2 2.355575 _CNV_A_R_LINEAR_____203_CM 0. 2.355575 DISPLAY_IDENTIFIER IP_KR_PI_MAP FORMAT "%6.5"
 /begin AXIS_DESCR COM_AXIS n _CNV_A_R_LINEAR_____5_CM 8 0. 6375. FORMAT "%4.0" AXIS_PTS_REF ldpm_n_ip_ctl_pi_map /end AXIS_DESCR
 /begin AXIS_DESCR COM_AXIS tqi_bpa_ctl _CNV_A_R_LINEAR_____62_CM 8 0. 1023.96875 FORMAT "%6.2" AXIS_PTS_REF ldpm_tqi_ip_ctl_pi_map /end AXIS_DESCR
/end CHARACTERISTIC
/begin AXIS_PTS ldpm_n_ip_ctl_pi_map "gain value for the PI-controller" 0x843978 n _REC_AXS_20_u2 6375. _CNV_A_R_LINEAR_____5_CM 8 0. 6375. FORMAT "%4.0" /end AXIS_PTS
/begin AXIS_PTS ldpm_tqi_ip_ctl_pi_map "gain value for the PI-controller" 0x843f92 tqi_bpa_ctl _REC_AXS_20_u2 1023.96875 _CNV_A_R_LINEAR_____62_CM 8 0. 1023.96875 FORMAT "%6.2" /end AXIS_PTS
/begin CHARACTERISTIC ip_tn_pi_map "BPA_CTL: integral action time for the PI-controller" MAP 0x85af98 _REC_MAP_20_u2_u2_u2 4.19424 _CNV_A_R_LINEAR_____67_CM 0. 4.19424 DISPLAY_IDENTIFIER IP_TN_PI_MAP FORMAT "%6.5"
 /begin AXIS_DESCR COM_AXIS n _CNV_A_R_LINEAR_____5_CM 8 0. 6375. FORMAT "%4.0" AXIS_PTS_REF ldpm_n_ip_ctl_pi_map /end AXIS_DESCR
 /begin AXIS_DESCR COM_AXIS tqi_bpa_ctl _CNV_A_R_LINEAR_____62_CM 8 0. 1023.96875 FORMAT "%6.2" AXIS_PTS_REF ldpm_tqi_ip_ctl_pi_map /end AXIS_DESCR
/end CHARACTERISTIC
/begin MEASUREMENT ar_thr_pctl_the "precontroller cross section of EGR- throttle" UWORD _CNV_A_R_LINEAR_____7_CM 1 0. 0. 78.08 DISPLAY_IDENTIFIER AR_THR_PCTL_THE ECU_ADDRESS 0x7f98f8 BYTE_ORDER MSB_LAST FORMAT "%5.3" /end MEASUREMENT
/begin MEASUREMENT mafpwm_max "max. MAFPWM" UWORD _CNV_A_R_LINEAR_____155_CM 1 0. 0. 99.9969482421875 DISPLAY_IDENTIFIER MAFPWM_MAX ECU_ADDRESS 0x7f98fa BYTE_ORDER MSB_LAST FORMAT "%5.3" /end MEASUREMENT
/begin MEASUREMENT ar_thr_pctl_the_bas "theortic precontrol cross section of the EGR- throttle" UWORD _CNV_A_R_LINEAR_____7_CM 1 0. 0. 78.08 DISPLAY_IDENTIFIER AR_THR_PCTL_THE_BAS ECU_ADDRESS 0x7fa84c BYTE_ORDER MSB_LAST FORMAT "%5.3" /end MEASUREMENT
/begin MEASUREMENT pq_thr_sp "estimated pressure quotient via the throttle" UWORD _CNV_A_R_LINEAR_____63_CM 1 0. 0. 3.99998471 DISPLAY_IDENTIFIER PQ_THR_SP ECU_ADDRESS 0x7fa84e BYTE_ORDER MSB_LAST FORMAT "%6.5" /end MEASUREMENT
/begin MEASUREMENT map_sp_ref "ref. manifold pressure at opened throttle and BPA precontrolled" UWORD _CNV_A_R_LINEAR_____21_CM 1 0. 0. 5434. DISPLAY_IDENTIFIER MAP_SP_REF ECU_ADDRESS 0x7f98fc BYTE_ORDER MSB_LAST FORMAT "%6.2" /end MEASUREMENT
/begin CHARACTERISTIC c_fac_ar_thr_pctl_fil "filter factor for AR_THR_PCTL" VALUE 0x85be02 _REC_VAL_20_u2 0.9999847412109381 _CNV_A_R_LINEAR_____14_CM 0. 0.9999847412109381 DISPLAY_IDENTIFIER C_FAC_AR_THR_PCTL_FIL FORMAT "%6.5" /end CHARACTERISTIC
/begin CHARACTERISTIC lc_thr_pctl_on "button for throttle predrive activation" VALUE 0x85c36e _REC_VAL_20_u1 1. _CNV_A_R_LINEAR_____0_CM 0. 1. DISPLAY_IDENTIFIER LC_THR_PCTL_ON FORMAT "%1.0" /end CHARACTERISTIC
/begin CHARACTERISTIC ip_fac_mfw_the__temp_in "GE_TPRE: factor depending on temperature to calculate the mass flow through a valve" CURVE 0x84bf88 _REC_CUR_20_u2_u1 1.99997e-002 _CNV_A_R_LINEAR_____197_CM 0. 1.99997e-002 DISPLAY_IDENTIFIER IP_FAC_MFW_THE__TEMP_IN FORMAT "%8.7"
 /begin AXIS_DESCR COM_AXIS tba _CNV_A_R_LINEAR_____18_CM 12 -50. 205. FORMAT "%3.0" AXIS_PTS_REF ldp_temp_in_ip_fac_mfw_the /end AXIS_DESCR
/end CHARACTERISTIC
/begin AXIS_PTS ldp_temp_in_ip_fac_mfw_the "" 0x8428a2 tba _REC_AXS_20_u1 255. _CNV_A_R_LINEAR_____18_CM 12 -50. 205. FORMAT "%3.0" /end AXIS_PTS
/begin CHARACTERISTIC ip_fac_mfw_the__pq "GE_TPRE: factor depending on the pressure quotient to calculate the mass flow through a valve" CURVE 0x84bf58 _REC_CUR_20_u2_u2 1.9999696 _CNV_A_R_LINEAR_____53_CM 0. 1.9999696 DISPLAY_IDENTIFIER IP_FAC_MFW_THE__PQ FORMAT "%6.5"
 /begin AXIS_DESCR COM_AXIS pq_thr_sp _CNV_A_R_LINEAR_____63_CM 12 0. 3.99998471 FORMAT "%6.5" AXIS_PTS_REF ldp_pq_ip_fac_mfw_the /end AXIS_DESCR
/end CHARACTERISTIC
/begin AXIS_PTS ldp_pq_ip_fac_mfw_the "" 0x842498 pq_thr_sp _REC_AXS_20_u2 3.99998471 _CNV_A_R_LINEAR_____63_CM 12 0. 3.99998471 FORMAT "%6.5" /end AXIS_PTS
/begin CHARACTERISTIC ip_map_sp_ref_0 "GE_TPRE: pressure in front of the throttle, injetion state=0" MAP 0x84fc64 _REC_MAP_20_u2_u2_u2 5434. _CNV_A_R_LINEAR_____21_CM 0. 5434. DISPLAY_IDENTIFIER IP_MAP_SP_REF_0 FORMAT "%6.2"
 /begin AXIS_DESCR COM_AXIS n _CNV_A_R_LINEAR_____5_CM 24 0. 6375. FORMAT "%4.0" AXIS_PTS_REF ldpm_n_ip_mf_pf /end AXIS_DESCR
 /begin AXIS_DESCR COM_AXIS tqi_sp _CNV_A_R_LINEAR_____89_CM 20 -1024. 1023.96875 FORMAT "%6.2" AXIS_PTS_REF ldpm_tqi_sp_ip_mf_pf /end AXIS_DESCR
/end CHARACTERISTIC
/begin AXIS_PTS ldpm_tqi_sp_ip_mf_pf "" 0x84441c tqi_sp _REC_AXS_20_u2 2047.96875 _CNV_A_R_LINEAR_____89_CM 20 -1024. 1023.96875 FORMAT "%6.2" /end AXIS_PTS
/begin CHARACTERISTIC ip_map_sp_ref_1 "GE_TPRE: pressure in front of the throttle, injection state=1" MAP 0x850024 _REC_MAP_20_u2_u2_u2 5434. _CNV_A_R_LINEAR_____21_CM 0. 5434. DISPLAY_IDENTIFIER IP_MAP_SP_REF_1 FORMAT "%6.2"
 /begin AXIS_DESCR COM_AXIS n _CNV_A_R_LINEAR_____5_CM 24 0. 6375. FORMAT "%4.0" AXIS_PTS_REF ldpm_n_ip_mf_pf /end AXIS_DESCR
 /begin AXIS_DESCR COM_AXIS tqi_sp _CNV_A_R_LINEAR_____89_CM 20 -1024. 1023.96875 FORMAT "%6.2" AXIS_PTS_REF ldpm_tqi_sp_ip_mf_pf /end AXIS_DESCR
/end CHARACTERISTIC
/begin MEASUREMENT ang_sp_bpa[0] "verified angle signal from ECU" UWORD _CNV_A_R_LINEAR_____8_CM 1 0. 0. 99.99847412109381 DISPLAY_IDENTIFIER ANG_SP_BPA_0_ ECU_ADDRESS 0x7f980c BYTE_ORDER MSB_LAST FORMAT "%5.3" /end MEASUREMENT
/begin MEASUREMENT test_bpa[0] "test signal for closed-loop positon control" UWORD _CNV_A_R_LINEAR_____8_CM 1 0. 0. 99.99847412109381 DISPLAY_IDENTIFIER TEST_BPA_0_ ECU_ADDRESS 0x7fa628 BYTE_ORDER MSB_LAST FORMAT "%5.3" /end MEASUREMENT
/begin MEASUREMENT ctl_dif_bpa[0] "controller deviation" SWORD _CNV_A_R_LINEAR_____12_CM 1 0. -100. 99.996948242 DISPLAY_IDENTIFIER CTL_DIF_BPA_0_ ECU_ADDRESS 0x7f980e BYTE_ORDER MSB_LAST FORMAT "%5.3" /end MEASUREMENT
/begin MEASUREMENT ctl_bpa[0] "controller output with pre-controller" SWORD _CNV_A_R_LINEAR_____399_CM 1 0. -200. 199.99389 DISPLAY_IDENTIFIER CTL_BPA_0_ ECU_ADDRESS 0x7fa62a BYTE_ORDER MSB_LAST /end MEASUREMENT
/begin MEASUREMENT pi_dt1_bpa[0] "output PI controller and DT1 function" SWORD _CNV_A_R_LINEAR_____399_CM 1 0. -200. 199.99389 DISPLAY_IDENTIFIER PI_DT1_BPA_0_ ECU_ADDRESS 0x7fa62e BYTE_ORDER MSB_LAST /end MEASUREMENT
/begin MEASUREMENT dt1_bpa[0] "output DT1 function" SWORD _CNV_A_R_LINEAR_____399_CM 1 0. -200. 199.99389 DISPLAY_IDENTIFIER DT1_BPA_0_ ECU_ADDRESS 0x7fa62c BYTE_ORDER MSB_LAST /end MEASUREMENT
/begin MEASUREMENT pi_bpa[0] "output PI controller" SWORD _CNV_A_R_LINEAR_____399_CM 1 0. -200. 199.99389 DISPLAY_IDENTIFIER PI_BPA_0_ ECU_ADDRESS 0x7fa630 BYTE_ORDER MSB_LAST /end MEASUREMENT
/begin MEASUREMENT tq_mot_bpa[0] "torque of DC motor" UWORD _CNV_A_R_LINEAR_____400_CM 1 0. 0. 999.98474 DISPLAY_IDENTIFIER TQ_MOT_BPA_0_ ECU_ADDRESS 0x7fa632 BYTE_ORDER MSB_LAST FORMAT "%5.2" /end MEASUREMENT
/begin MEASUREMENT v_mot_bpa[0] "voltage DC motor of BPA_j" UWORD _CNV_A_R_LINEAR_____401_CM 1 0. 0. 99.99847412109381 DISPLAY_IDENTIFIER V_MOT_BPA_0_ ECU_ADDRESS 0x7fa634 BYTE_ORDER MSB_LAST FORMAT "%5.3" /end MEASUREMENT
/begin MEASUREMENT r_mot_cor_bpa[0] "corrected resistance of DC motor" UWORD _CNV_A_R_LINEAR_____402_CM 1 0. 0. 9.999874 DISPLAY_IDENTIFIER R_MOT_COR_BPA_0_ ECU_ADDRESS 0x7f9810 BYTE_ORDER MSB_LAST FORMAT "%5.4" /end MEASUREMENT
/begin MEASUREMENT pctl_bpa[0] "output of the pre-controller" SWORD _CNV_A_R_LINEAR_____399_CM 1 0. -200. 199.99389 DISPLAY_IDENTIFIER PCTL_BPA_0_ ECU_ADDRESS 0x7fa636 BYTE_ORDER MSB_LAST /end MEASUREMENT
/begin MEASUREMENT ctl_lim_bpa[0] "limited controller output" SWORD _CNV_A_R_LINEAR_____12_CM 1 0. -100. 99.996948242 DISPLAY_IDENTIFIER CTL_LIM_BPA_0_ ECU_ADDRESS 0x7f9812 BYTE_ORDER MSB_LAST FORMAT "%5.3" /end MEASUREMENT
/begin MEASUREMENT lim_dif_bpa[0] "difference between limited and unlimited controller output" SWORD _CNV_A_R_LINEAR_____12_CM 1 0. -100. 99.996948242 DISPLAY_IDENTIFIER LIM_DIF_BPA_0_ ECU_ADDRESS 0x7fa638 BYTE_ORDER MSB_LAST FORMAT "%5.3" /end MEASUREMENT
/begin MEASUREMENT ctl_lim_bas_bpa[0] "basic controller output" SWORD _CNV_A_R_LINEAR_____12_CM 1 0. -100. 99.996948242 DISPLAY_IDENTIFIER CTL_LIM_BAS_BPA_0_ ECU_ADDRESS 0x7fa63a BYTE_ORDER MSB_LAST FORMAT "%5.3" /end MEASUREMENT
/begin CHARACTERISTIC lc_test_bpa[0] "" VALUE 0x85c367 _REC_VAL_20_u1 1. _CNV_A_R_LINEAR_____0_CM 0. 1. DISPLAY_IDENTIFIER LC_TEST_BPA_0_ FORMAT "%1.0" /end CHARACTERISTIC
/begin CHARACTERISTIC c_test_fac_bpa[0] "" VALUE 0x85c186 _REC_VAL_20_u2 99.99847412109381 _CNV_A_R_LINEAR_____8_CM 0. 99.99847412109381 DISPLAY_IDENTIFIER C_TEST_FAC_BPA_0_ FORMAT "%5.3" /end CHARACTERISTIC
/begin CHARACTERISTIC c_test_add_bpa[0] "" VALUE 0x85c180 _REC_VAL_20_u2 99.99847412109381 _CNV_A_R_LINEAR_____8_CM 0. 99.99847412109381 DISPLAY_IDENTIFIER C_TEST_ADD_BPA_0_ FORMAT "%5.3" /end CHARACTERISTIC
/begin CHARACTERISTIC lc_dt1_bpa_on[0] "" VALUE 0x85c312 _REC_VAL_20_u1 1. _CNV_A_R_LINEAR_____0_CM 0. 1. DISPLAY_IDENTIFIER LC_DT1_BPA_ON_0_ FORMAT "%1.0" /end CHARACTERISTIC
/begin CHARACTERISTIC lc_pi_bpa_on[0] "" VALUE 0x85c353 _REC_VAL_20_u1 1. _CNV_A_R_LINEAR_____0_CM 0. 1. DISPLAY_IDENTIFIER LC_PI_BPA_ON_0_ FORMAT "%1.0" /end CHARACTERISTIC
/begin CHARACTERISTIC c_bpa_ini[0] "" VALUE 0x85bcfe _REC_VAL_20_s2 399.99389 _CNV_A_R_LINEAR_____399_CM -200. 199.99389 DISPLAY_IDENTIFIER C_BPA_INI_0_ /end CHARACTERISTIC
/begin CHARACTERISTIC c_gear_trans_ratio_bpa "gear transition ratio" VALUE 0x85bea0 _REC_VAL_20_u2 99.99847412109381 _CNV_A_R_LINEAR_____403_CM 0. 99.99847412109381 DISPLAY_IDENTIFIER C_GEAR_TRANS_RATIO_BPA FORMAT "%5.3" /end CHARACTERISTIC
/begin CHARACTERISTIC c_fac_temp_cu_el "electrical temperatur coefficient of copper" VALUE 0x85be7a _REC_VAL_20_u2 0.125 _CNV_A_R_LINEAR_____404_CM 0. 0.125 DISPLAY_IDENTIFIER C_FAC_TEMP_CU_EL FORMAT "%7.6" /end CHARACTERISTIC
/begin CHARACTERISTIC c_temp_mot_bpa_ref "reference temperature DC motor" VALUE 0x85c172 _REC_VAL_20_u1 255. _CNV_A_R_LINEAR_____18_CM -50. 205. DISPLAY_IDENTIFIER C_TEMP_MOT_BPA_REF FORMAT "%3.0" /end CHARACTERISTIC
/begin CHARACTERISTIC c_r_mot_bpa "resistance DC motor" VALUE 0x85c008 _REC_VAL_20_u2 9.999874 _CNV_A_R_LINEAR_____402_CM 0. 9.999874 DISPLAY_IDENTIFIER C_R_MOT_BPA FORMAT "%5.4" /end CHARACTERISTIC
/begin CHARACTERISTIC c_pctl_bpa_lih "precontrol value during LIH" VALUE 0x85bfe6 _REC_VAL_20_s2 399.99389 _CNV_A_R_LINEAR_____399_CM -200. 199.99389 DISPLAY_IDENTIFIER C_PCTL_BPA_LIH /end CHARACTERISTIC
/begin CHARACTERISTIC lc_pctl_bpa_lih "indicates the used precontrol value during LIH" VALUE 0x85c34d _REC_VAL_20_u1 1. _CNV_A_R_LINEAR_____0_CM 0. 1. DISPLAY_IDENTIFIER LC_PCTL_BPA_LIH FORMAT "%1.0" /end CHARACTERISTIC
/begin CHARACTERISTIC c_temp_mot_bpa[0] "" VALUE 0x85c171 _REC_VAL_20_u1 255. _CNV_A_R_LINEAR_____18_CM -50. 205. DISPLAY_IDENTIFIER C_TEMP_MOT_BPA_0_ FORMAT "%3.0" /end CHARACTERISTIC
/begin CHARACTERISTIC lc_pctl_phys_bpa_on[0] "" VALUE 0x85c34f _REC_VAL_20_u1 1. _CNV_A_R_LINEAR_____0_CM 0. 1. DISPLAY_IDENTIFIER LC_PCTL_PHYS_BPA_ON_0_ FORMAT "%1.0" /end CHARACTERISTIC
/begin CHARACTERISTIC c_ctl_lim_bpa_add "additive correction" VALUE 0x85bd88 _REC_VAL_20_s2 199.996948242 _CNV_A_R_LINEAR_____12_CM -100. 99.996948242 DISPLAY_IDENTIFIER C_CTL_LIM_BPA_ADD FORMAT "%5.3" /end CHARACTERISTIC
/begin CHARACTERISTIC c_fac_ctl_lim_bpa "correction factor" VALUE 0x85be1c _REC_VAL_20_s2 3.999939 _CNV_A_R_LINEAR_____405_CM -2. 1.999939 DISPLAY_IDENTIFIER C_FAC_CTL_LIM_BPA FORMAT "%6.5" /end CHARACTERISTIC
/begin CHARACTERISTIC lc_ctl_lim_bpa_man "activation of the manual output for the BPA- position controller" VALUE 0x85c305 _REC_VAL_20_u1 1. _CNV_A_R_LINEAR_____0_CM 0. 1. DISPLAY_IDENTIFIER LC_CTL_LIM_BPA_MAN FORMAT "%1.0" /end CHARACTERISTIC
/begin CHARACTERISTIC c_ctl_lim_bpa_man[0] "" VALUE 0x85bd8a _REC_VAL_20_s2 199.996948242 _CNV_A_R_LINEAR_____12_CM -100. 99.996948242 DISPLAY_IDENTIFIER C_CTL_LIM_BPA_MAN_0_ FORMAT "%5.3" /end CHARACTERISTIC
/begin CHARACTERISTIC ip_kr_dt1_bpa__ctl_dif "GE_BCLP: gain for DT1 function" CURVE 0x84caf0 _REC_CUR_20_u2_u2 8.047560000000001 _CNV_A_R_LINEAR_____406_CM -4.02378 4.02378 DISPLAY_IDENTIFIER IP_KR_DT1_BPA__CTL_DIF FORMAT "%6.5"
 /begin AXIS_DESCR COM_AXIS ctl_dif_bpa[0] _CNV_A_R_LINEAR_____158_CM 8 -100. 99.99694820000001 FORMAT "%5.3" AXIS_PTS_REF ldp_ctl_dif__ip_kr_dt1_bpa /end AXIS_DESCR
/end CHARACTERISTIC
/begin AXIS_PTS ldp_ctl_dif__ip_kr_dt1_bpa "" 0x841474 ctl_dif_bpa[0] _REC_AXS_20_u2 199.9969482 _CNV_A_R_LINEAR_____158_CM 8 -100. 99.99694820000001 FORMAT "%5.3" /end AXIS_PTS
/begin CHARACTERISTIC ip_t1_dt1_bpa__ctl_dif "GE_BCLP: time value for DT1 function" CURVE 0x85aa34 _REC_CUR_20_u2_u2 0.125 _CNV_A_R_LINEAR_____407_CM 0. 0.125 DISPLAY_IDENTIFIER IP_T1_DT1_BPA__CTL_DIF FORMAT "%7.6"
 /begin AXIS_DESCR COM_AXIS ctl_dif_bpa[0] _CNV_A_R_LINEAR_____158_CM 8 -100. 99.99694820000001 FORMAT "%5.3" AXIS_PTS_REF ldp_ctl_dif__ip_t1_dt1_bpa /end AXIS_DESCR
/end CHARACTERISTIC
/begin AXIS_PTS ldp_ctl_dif__ip_t1_dt1_bpa "" 0x8414ec ctl_dif_bpa[0] _REC_AXS_20_u2 199.9969482 _CNV_A_R_LINEAR_____158_CM 8 -100. 99.99694820000001 FORMAT "%5.3" /end AXIS_PTS
/begin CHARACTERISTIC ip_kr_pi_bpa__ctl_dif "GE_BCLP: proportional value for PI contoller" CURVE 0x84ccf0 _REC_CUR_20_u2_u2 15.999755 _CNV_A_R_LINEAR_____13_CM 0. 15.999755 DISPLAY_IDENTIFIER IP_KR_PI_BPA__CTL_DIF FORMAT "%6.4"
 /begin AXIS_DESCR COM_AXIS ctl_dif_bpa[0] _CNV_A_R_LINEAR_____158_CM 9 -100. 99.99694820000001 FORMAT "%5.3" AXIS_PTS_REF ldp_ctl_dif__ip_kr_pi_bpa /end AXIS_DESCR
/end CHARACTERISTIC
/begin AXIS_PTS ldp_ctl_dif__ip_kr_pi_bpa "" 0x8414aa ctl_dif_bpa[0] _REC_AXS_20_u2 199.9969482 _CNV_A_R_LINEAR_____158_CM 9 -100. 99.99694820000001 FORMAT "%5.3" /end AXIS_PTS
/begin CHARACTERISTIC ip_tn_pi_bpa__ctl_dif "GE_BCLP: integral value for PI contoller" CURVE 0x85aeae _REC_CUR_20_u2_u2 15.999755 _CNV_A_R_LINEAR_____408_CM 0. 15.999755 DISPLAY_IDENTIFIER IP_TN_PI_BPA__CTL_DIF FORMAT "%6.4"
 /begin AXIS_DESCR COM_AXIS ctl_dif_bpa[0] _CNV_A_R_LINEAR_____158_CM 9 -100. 99.99694820000001 FORMAT "%5.3" AXIS_PTS_REF ldp_ctl_dif__ip_tn_pi_bpa /end AXIS_DESCR
/end CHARACTERISTIC
/begin AXIS_PTS ldp_ctl_dif__ip_tn_pi_bpa "" 0x841522 ctl_dif_bpa[0] _REC_AXS_20_u2 199.9969482 _CNV_A_R_LINEAR_____158_CM 9 -100. 99.99694820000001 FORMAT "%5.3" /end AXIS_PTS
/begin CHARACTERISTIC ip_tq_spr_bpa__ang_sp_bpa "GE_BCLP: characteristic of spring" CURVE 0x85b326 _REC_CUR_20_u2_u2 999.98474 _CNV_A_R_LINEAR_____400_CM 0. 999.98474 DISPLAY_IDENTIFIER IP_TQ_SPR_BPA__ANG_SP_BPA FORMAT "%5.2"
 /begin AXIS_DESCR COM_AXIS ang_sp_bpa[0] _CNV_A_R_LINEAR_____8_CM 4 0. 99.99847412109381 FORMAT "%5.3" AXIS_PTS_REF ldp_ang_sp_bpa_ip_tq_spr_bpa /end AXIS_DESCR
/end CHARACTERISTIC
/begin AXIS_PTS ldp_ang_sp_bpa_ip_tq_spr_bpa "" 0x84135c ang_sp_bpa[0] _REC_AXS_20_u2 99.99847412109381 _CNV_A_R_LINEAR_____8_CM 4 0. 99.99847412109381 FORMAT "%5.3" /end AXIS_PTS
/begin CHARACTERISTIC ip_cur_mot_bpa__tq_mot "GE_BCLP: current of DC motor" CURVE 0x84a45a _REC_CUR_20_u2_u2 9.999874 _CNV_A_R_LINEAR_____409_CM 0. 9.999874 DISPLAY_IDENTIFIER IP_CUR_MOT_BPA__TQ_MOT FORMAT "%5.4"
 /begin AXIS_DESCR COM_AXIS tq_mot_bpa[0] _CNV_A_R_LINEAR_____400_CM 4 0. 999.98474 FORMAT "%5.2" AXIS_PTS_REF ldp_tq_mot_bpa__ip_cur_mot /end AXIS_DESCR
/end CHARACTERISTIC
/begin AXIS_PTS ldp_tq_mot_bpa__ip_cur_mot "" 0x842a3e tq_mot_bpa[0] _REC_AXS_20_u2 999.98474 _CNV_A_R_LINEAR_____400_CM 4 0. 999.98474 FORMAT "%5.2" /end AXIS_PTS
/begin CHARACTERISTIC ip_pctl_bpa__v_mot_bpa "GE_BCLP: characteristic of power inverter" CURVE 0x855744 _REC_CUR_20_u2_u2 399.993897 _CNV_A_R_LINEAR_____410_CM -200. 199.993897 DISPLAY_IDENTIFIER IP_PCTL_BPA__V_MOT_BPA
 /begin AXIS_DESCR COM_AXIS v_mot_bpa[0] _CNV_A_R_LINEAR_____401_CM 4 0. 99.99847412109381 FORMAT "%5.3" AXIS_PTS_REF ldp_v_mot_bpa__ip_pctl_bpa /end AXIS_DESCR
/end CHARACTERISTIC
/begin AXIS_PTS ldp_v_mot_bpa__ip_pctl_bpa "" 0x8432ce v_mot_bpa[0] _REC_AXS_20_u2 99.99847412109381 _CNV_A_R_LINEAR_____401_CM 4 0. 99.99847412109381 FORMAT "%5.3" /end AXIS_PTS
/begin CHARACTERISTIC ip_pctl_bpa__ang_sp_bpa "GE_BCLP: precontrol for BPA actuator" CURVE 0x855734 _REC_CUR_20_u2_u2 399.993897 _CNV_A_R_LINEAR_____410_CM -200. 199.993897 DISPLAY_IDENTIFIER IP_PCTL_BPA__ANG_SP_BPA
 /begin AXIS_DESCR COM_AXIS ang_sp_bpa[0] _CNV_A_R_LINEAR_____8_CM 8 0. 99.99847412109381 FORMAT "%5.3" AXIS_PTS_REF ldp_ang_sp_bpa_ip_pctl_bpa /end AXIS_DESCR
/end CHARACTERISTIC
/begin AXIS_PTS ldp_ang_sp_bpa_ip_pctl_bpa "" 0x84134a ang_sp_bpa[0] _REC_AXS_20_u2 99.99847412109381 _CNV_A_R_LINEAR_____8_CM 8 0. 99.99847412109381 FORMAT "%5.3" /end AXIS_PTS
/begin CHARACTERISTIC ip_ctl_max_bpa_0__temp "GE_BCLP: maximum limit of BPA_0 controller output" CURVE 0x84a412 _REC_CUR_20_u1_u1 199.21875 _CNV_A_R_LINEAR_____411_CM -100. 99.21875 DISPLAY_IDENTIFIER IP_CTL_MAX_BPA_0__TEMP FORMAT "%3.1"
 /begin AXIS_DESCR COM_AXIS tco _CNV_A_R_LINEAR_____18_CM 4 -50. 205. FORMAT "%3.0" AXIS_PTS_REF ldpm_temp__ip_ctl_bpa /end AXIS_DESCR
/end CHARACTERISTIC
/begin AXIS_PTS ldpm_temp__ip_ctl_bpa "" 0x843eb5 tco _REC_AXS_20_u1 255. _CNV_A_R_LINEAR_____18_CM 4 -50. 205. FORMAT "%3.0" /end AXIS_PTS
/begin CHARACTERISTIC ip_ctl_min_bpa_0__temp "GE_BCLP: minimum limit of BPA_0 controller output" CURVE 0x84a426 _REC_CUR_20_u1_u1 199.21875 _CNV_A_R_LINEAR_____411_CM -100. 99.21875 DISPLAY_IDENTIFIER IP_CTL_MIN_BPA_0__TEMP FORMAT "%3.1"
 /begin AXIS_DESCR COM_AXIS tco _CNV_A_R_LINEAR_____18_CM 4 -50. 205. FORMAT "%3.0" AXIS_PTS_REF ldpm_temp__ip_ctl_bpa /end AXIS_DESCR
/end CHARACTERISTIC
/begin MEASUREMENT fac_bpa_pwm_cor[0] "multipl. correction for the boost pressure actuator (j=0..NC_BPA_NR-1)" UWORD _CNV_A_R_LINEAR_____63_CM 1 0. 0. 3.99998471 DISPLAY_IDENTIFIER FAC_BPA_PWM_COR_0_ ECU_ADDRESS 0x7f9814 BYTE_ORDER MSB_LAST FORMAT "%6.5" /end MEASUREMENT
/begin MEASUREMENT bpa_pwm_cor[0] "additive correction for the boost pressure actuator (j=0..NC_BPA_NR-1)" SWORD _CNV_A_R_LINEAR_____12_CM 1 0. -100. 99.996948242 DISPLAY_IDENTIFIER BPA_PWM_COR_0_ ECU_ADDRESS 0x7f9816 BYTE_ORDER MSB_LAST FORMAT "%5.3" /end MEASUREMENT
/begin CHARACTERISTIC c_fac_bpa_pwm_cor_man[0] "" VALUE 0x85be0e _REC_VAL_20_u2 3.99998471 _CNV_A_R_LINEAR_____63_CM 0. 3.99998471 DISPLAY_IDENTIFIER C_FAC_BPA_PWM_COR_MAN_0_ FORMAT "%6.5" /end CHARACTERISTIC
/begin CHARACTERISTIC c_bpa_pwm_cor_man[0] "" VALUE 0x85bd00 _REC_VAL_20_s2 199.996948242 _CNV_A_R_LINEAR_____12_CM -100. 99.996948242 DISPLAY_IDENTIFIER C_BPA_PWM_COR_MAN_0_ FORMAT "%5.3" /end CHARACTERISTIC
/begin MEASUREMENT ctl_dif_egrv[0] "controller deviation" SWORD _CNV_A_R_LINEAR_____12_CM 1 0. -100. 99.996948242 DISPLAY_IDENTIFIER CTL_DIF_EGRV_0_ ECU_ADDRESS 0x7f9902 BYTE_ORDER MSB_LAST FORMAT "%5.3" /end MEASUREMENT
/begin MEASUREMENT ctl_egrv[0] "controller output with pre-controller" SWORD _CNV_A_R_LINEAR_____399_CM 1 0. -200. 199.99389 DISPLAY_IDENTIFIER CTL_EGRV_0_ ECU_ADDRESS 0x7fa868 BYTE_ORDER MSB_LAST /end MEASUREMENT
/begin MEASUREMENT pi_dt1_egrv[0] "output PI controller and DT1 function" SWORD _CNV_A_R_LINEAR_____399_CM 1 0. -200. 199.99389 DISPLAY_IDENTIFIER PI_DT1_EGRV_0_ ECU_ADDRESS 0x7fa86c BYTE_ORDER MSB_LAST /end MEASUREMENT
/begin MEASUREMENT lv_edge_ang_sp_egrv_intv[0] "edge detect of LV_ANG_SP_EGRV_INTV_j" UBYTE _CNV_S_2_RANGE______11_CM 1 0. 0. 1. DISPLAY_IDENTIFIER LV_EDGE_ANG_SP_EGRV_INTV_0_ ECU_ADDRESS 0x7fba63 /end MEASUREMENT
/begin MEASUREMENT pi_egrv[0] "output PI controller" SWORD _CNV_A_R_LINEAR_____399_CM 1 0. -200. 199.99389 DISPLAY_IDENTIFIER PI_EGRV_0_ ECU_ADDRESS 0x7fa86e BYTE_ORDER MSB_LAST /end MEASUREMENT
/begin MEASUREMENT dt1_egrv[0] "output DT1 function" SWORD _CNV_A_R_LINEAR_____399_CM 1 0. -200. 199.99389 DISPLAY_IDENTIFIER DT1_EGRV_0_ ECU_ADDRESS 0x7fa86a BYTE_ORDER MSB_LAST /end MEASUREMENT
/begin MEASUREMENT pctl_egrv[0] "output of the pre-controller" SWORD _CNV_A_R_LINEAR_____399_CM 1 0. -200. 199.99389 DISPLAY_IDENTIFIER PCTL_EGRV_0_ ECU_ADDRESS 0x7fa870 BYTE_ORDER MSB_LAST /end MEASUREMENT
/begin MEASUREMENT t_ang_sp_egrv_close[0] "time since active closing precontrol is active" UWORD _CNV_A_R_LINEAR_____76_CM 1 0. 0. 65.535 DISPLAY_IDENTIFIER T_ANG_SP_EGRV_CLOSE_0_ ECU_ADDRESS 0x7fa87a BYTE_ORDER MSB_LAST FORMAT "%5.3" /end MEASUREMENT
/begin MEASUREMENT tq_mot_egrv[0] "torque of DC motor" UWORD _CNV_A_R_LINEAR_____400_CM 1 0. 0. 999.98474 DISPLAY_IDENTIFIER TQ_MOT_EGRV_0_ ECU_ADDRESS 0x7fa854 BYTE_ORDER MSB_LAST FORMAT "%5.2" /end MEASUREMENT
/begin MEASUREMENT v_mot_egrv[0] "voltage DC motor of EGRV_j" UWORD _CNV_A_R_LINEAR_____401_CM 1 0. 0. 99.99847412109381 DISPLAY_IDENTIFIER V_MOT_EGRV_0_ ECU_ADDRESS 0x7fa856 BYTE_ORDER MSB_LAST FORMAT "%5.3" /end MEASUREMENT
/begin MEASUREMENT r_mot_cor_egrv[0] "corrected resistance of DC motor" UWORD _CNV_A_R_LINEAR_____402_CM 1 0. 0. 9.999874 DISPLAY_IDENTIFIER R_MOT_COR_EGRV_0_ ECU_ADDRESS 0x7f9904 BYTE_ORDER MSB_LAST FORMAT "%5.4" /end MEASUREMENT
/begin MEASUREMENT ctl_lim_bas_egrv[0] "limited controller output" SWORD _CNV_A_R_LINEAR_____12_CM 1 0. -100. 99.996948242 DISPLAY_IDENTIFIER CTL_LIM_BAS_EGRV_0_ ECU_ADDRESS 0x7fa860 BYTE_ORDER MSB_LAST FORMAT "%5.3" /end MEASUREMENT
/begin MEASUREMENT lim_dif_egrv[0] "difference between limited and unlimited controller output" SWORD _CNV_A_R_LINEAR_____12_CM 1 0. -100. 99.996948242 DISPLAY_IDENTIFIER LIM_DIF_EGRV_0_ ECU_ADDRESS 0x7fa872 BYTE_ORDER MSB_LAST FORMAT "%5.3" /end MEASUREMENT
/begin MEASUREMENT ctl_lim_egrv[0] "controller output" SWORD _CNV_A_R_LINEAR_____12_CM 1 0. -100. 99.996948242 DISPLAY_IDENTIFIER CTL_LIM_EGRV_0_ ECU_ADDRESS 0x7f9906 BYTE_ORDER MSB_LAST FORMAT "%5.3" /end MEASUREMENT
/begin MEASUREMENT ctl_egrv_pre_lim[0] "EGRV control output before limitation" SWORD _CNV_A_R_LINEAR_____399_CM 1 0. -200. 199.99389 DISPLAY_IDENTIFIER CTL_EGRV_PRE_LIM_0_ ECU_ADDRESS 0x7fa876 BYTE_ORDER MSB_LAST /end MEASUREMENT
/begin MEASUREMENT ctl_dyn_lim_egrv[0] "Dynamic EGRV output limitation" SWORD _CNV_A_R_LINEAR_____399_CM 1 0. -200. 199.99389 DISPLAY_IDENTIFIER CTL_DYN_LIM_EGRV_0_ ECU_ADDRESS 0x7fa878 BYTE_ORDER MSB_LAST /end MEASUREMENT
/begin MEASUREMENT ang_sp_egrv_bas[0] "basic setpoint of position controller" UWORD _CNV_A_R_LINEAR_____8_CM 1 0. 0. 99.99847412109381 DISPLAY_IDENTIFIER ANG_SP_EGRV_BAS_0_ ECU_ADDRESS 0x7fa874 BYTE_ORDER MSB_LAST FORMAT "%5.3" /end MEASUREMENT
/begin MEASUREMENT test_egrv[0] "test signal for closed-loop positon control" UWORD _CNV_A_R_LINEAR_____8_CM 1 0. 0. 99.99847412109381 DISPLAY_IDENTIFIER TEST_EGRV_0_ ECU_ADDRESS 0x7fa866 BYTE_ORDER MSB_LAST FORMAT "%5.3" /end MEASUREMENT
/begin MEASUREMENT lv_ang_sp_egrv_close[0] "EGRV setpoint is closed" UBYTE _CNV_S_2_RANGE______11_CM 1 0. 0. 1. DISPLAY_IDENTIFIER LV_ANG_SP_EGRV_CLOSE_0_ ECU_ADDRESS 0x7fb4a3 /end MEASUREMENT
/begin MEASUREMENT ang_sp_egrv[0] "setpoint of position controller" UWORD _CNV_A_R_LINEAR_____8_CM 1 0. 0. 99.99847412109381 DISPLAY_IDENTIFIER ANG_SP_EGRV_0_ ECU_ADDRESS 0x7f9908 BYTE_ORDER MSB_LAST FORMAT "%5.3" /end MEASUREMENT
/begin CHARACTERISTIC lc_pi_egrv_on[0] "" VALUE 0x85c354 _REC_VAL_20_u1 1. _CNV_A_R_LINEAR_____0_CM 0. 1. DISPLAY_IDENTIFIER LC_PI_EGRV_ON_0_ FORMAT "%1.0" /end CHARACTERISTIC
/begin CHARACTERISTIC c_egrv_ini[0] "" VALUE 0x85bdec _REC_VAL_20_s2 399.99389 _CNV_A_R_LINEAR_____399_CM -200. 199.99389 DISPLAY_IDENTIFIER C_EGRV_INI_0_ /end CHARACTERISTIC
/begin CHARACTERISTIC lc_dt1_egrv_on[0] "" VALUE 0x85c313 _REC_VAL_20_u1 1. _CNV_A_R_LINEAR_____0_CM 0. 1. DISPLAY_IDENTIFIER LC_DT1_EGRV_ON_0_ FORMAT "%1.0" /end CHARACTERISTIC
/begin CHARACTERISTIC lc_pctl_egrv_lih "indicates the used precontrol value during LIH" VALUE 0x85c34e _REC_VAL_20_u1 1. _CNV_A_R_LINEAR_____0_CM 0. 1. DISPLAY_IDENTIFIER LC_PCTL_EGRV_LIH FORMAT "%1.0" /end CHARACTERISTIC
/begin CHARACTERISTIC c_pctl_egrv_lih "precontrol value during LIH" VALUE 0x85bfe8 _REC_VAL_20_s2 399.99389 _CNV_A_R_LINEAR_____399_CM -200. 199.99389 DISPLAY_IDENTIFIER C_PCTL_EGRV_LIH /end CHARACTERISTIC
/begin CHARACTERISTIC c_fac_fil_ang_sp_close_egrv "filter factor for closed EGRV precontrol" VALUE 0x85be3c _REC_VAL_20_u2 0.9999847412109381 _CNV_A_R_LINEAR_____14_CM 0. 0.9999847412109381 DISPLAY_IDENTIFIER C_FAC_FIL_ANG_SP_CLOSE_EGRV FORMAT "%6.5" /end CHARACTERISTIC
/begin CHARACTERISTIC lc_pctl_phys_egrv_on[0] "" VALUE 0x85c350 _REC_VAL_20_u1 1. _CNV_A_R_LINEAR_____0_CM 0. 1. DISPLAY_IDENTIFIER LC_PCTL_PHYS_EGRV_ON_0_ FORMAT "%1.0" /end CHARACTERISTIC
/begin CHARACTERISTIC c_gear_trans_ratio_egrv "gear transition ratio" VALUE 0x85bea2 _REC_VAL_20_u2 99.99847412109381 _CNV_A_R_LINEAR_____403_CM 0. 99.99847412109381 DISPLAY_IDENTIFIER C_GEAR_TRANS_RATIO_EGRV FORMAT "%5.3" /end CHARACTERISTIC
/begin CHARACTERISTIC c_temp_mot_egrv_ref "reference temperature DC motor" VALUE 0x85c174 _REC_VAL_20_u1 255. _CNV_A_R_LINEAR_____18_CM -50. 205. DISPLAY_IDENTIFIER C_TEMP_MOT_EGRV_REF FORMAT "%3.0" /end CHARACTERISTIC
/begin CHARACTERISTIC c_r_mot_egrv "resistance DC motor" VALUE 0x85c00a _REC_VAL_20_u2 9.999874 _CNV_A_R_LINEAR_____402_CM 0. 9.999874 DISPLAY_IDENTIFIER C_R_MOT_EGRV FORMAT "%5.4" /end CHARACTERISTIC
/begin CHARACTERISTIC c_temp_mot_egrv[0] "" VALUE 0x85c173 _REC_VAL_20_u1 255. _CNV_A_R_LINEAR_____18_CM -50. 205. DISPLAY_IDENTIFIER C_TEMP_MOT_EGRV_0_ FORMAT "%3.0" /end CHARACTERISTIC
/begin CHARACTERISTIC lc_ctl_lim_egrv_man "activation of the manual output for the EGRV- position controller" VALUE 0x85c307 _REC_VAL_20_u1 1. _CNV_A_R_LINEAR_____0_CM 0. 1. DISPLAY_IDENTIFIER LC_CTL_LIM_EGRV_MAN FORMAT "%1.0" /end CHARACTERISTIC
/begin CHARACTERISTIC lc_ctl_lim_egrv_diag "enable of the limitation for diagnosis" VALUE 0x85c306 _REC_VAL_20_u1 1. _CNV_A_R_LINEAR_____0_CM 0. 1. DISPLAY_IDENTIFIER LC_CTL_LIM_EGRV_DIAG FORMAT "%1.0" /end CHARACTERISTIC
/begin CHARACTERISTIC c_fac_ctl_lim_egrv "correction factor" VALUE 0x85be1e _REC_VAL_20_s2 3.999939 _CNV_A_R_LINEAR_____405_CM -2. 1.999939 DISPLAY_IDENTIFIER C_FAC_CTL_LIM_EGRV FORMAT "%6.5" /end CHARACTERISTIC
/begin CHARACTERISTIC c_ctl_lim_egrv_add "additive correction" VALUE 0x85bd8c _REC_VAL_20_s2 199.996948242 _CNV_A_R_LINEAR_____12_CM -100. 99.996948242 DISPLAY_IDENTIFIER C_CTL_LIM_EGRV_ADD FORMAT "%5.3" /end CHARACTERISTIC
/begin CHARACTERISTIC c_ctl_lim_egrv_man[0] "" VALUE 0x85bd90 _REC_VAL_20_s2 199.996948242 _CNV_A_R_LINEAR_____12_CM -100. 99.996948242 DISPLAY_IDENTIFIER C_CTL_LIM_EGRV_MAN_0_ FORMAT "%5.3" /end CHARACTERISTIC
/begin CHARACTERISTIC c_lim_dyn_max_egr[0] "" VALUE 0x85bef3 _REC_VAL_20_u1 255. _CNV_A_R_LINEAR_____262_CM 0. 255. DISPLAY_IDENTIFIER C_LIM_DYN_MAX_EGR_0_ FORMAT "%3.0" /end CHARACTERISTIC
/begin CHARACTERISTIC c_t_lim_dyn_egr[0] "" VALUE 0x85c0e0 _REC_VAL_20_u2 65535. _CNV_A_R_LINEAR_____414_CM 0. 65535. DISPLAY_IDENTIFIER C_T_LIM_DYN_EGR_0_ FORMAT "%5.0" /end CHARACTERISTIC
/begin CHARACTERISTIC lc_test_egrv[0] "" VALUE 0x85c368 _REC_VAL_20_u1 1. _CNV_A_R_LINEAR_____0_CM 0. 1. DISPLAY_IDENTIFIER LC_TEST_EGRV_0_ FORMAT "%1.0" /end CHARACTERISTIC
/begin CHARACTERISTIC c_test_fac_egrv[0] "" VALUE 0x85c188 _REC_VAL_20_u2 99.99847412109381 _CNV_A_R_LINEAR_____8_CM 0. 99.99847412109381 DISPLAY_IDENTIFIER C_TEST_FAC_EGRV_0_ FORMAT "%5.3" /end CHARACTERISTIC
/begin CHARACTERISTIC c_test_add_egrv[0] "" VALUE 0x85c182 _REC_VAL_20_u2 99.99847412109381 _CNV_A_R_LINEAR_____8_CM 0. 99.99847412109381 DISPLAY_IDENTIFIER C_TEST_ADD_EGRV_0_ FORMAT "%5.3" /end CHARACTERISTIC
/begin CHARACTERISTIC c_ang_sp_egrv_close_tol[0] "" VALUE 0x85bce8 _REC_VAL_20_u2 99.99847412109381 _CNV_A_R_LINEAR_____8_CM 0. 99.99847412109381 DISPLAY_IDENTIFIER C_ANG_SP_EGRV_CLOSE_TOL_0_ FORMAT "%5.3" /end CHARACTERISTIC
/begin CHARACTERISTIC c_ang_sp_egrv_thd_bol_grd "lower threshold for gradient limitation" VALUE 0x85bcea _REC_VAL_20_u2 99.99847412109381 _CNV_A_R_LINEAR_____8_CM 0. 99.99847412109381 DISPLAY_IDENTIFIER C_ANG_SP_EGRV_THD_BOL_GRD FORMAT "%5.3" /end CHARACTERISTIC
/begin CHARACTERISTIC c_ang_sp_egrv_bol_grd "maximum gradient for ANG_SP_EGRV (BOL)" VALUE 0x85bce6 _REC_VAL_20_u2 99.99847412109381 _CNV_A_R_LINEAR_____415_CM 0. 99.99847412109381 DISPLAY_IDENTIFIER C_ANG_SP_EGRV_BOL_GRD FORMAT "%5.3" /end CHARACTERISTIC
/begin CHARACTERISTIC c_ang_sp_egrv_tol_grd "maximum gradient for ANG_SP_EGRV (TOL)" VALUE 0x85bcee _REC_VAL_20_u2 99.99847412109381 _CNV_A_R_LINEAR_____415_CM 0. 99.99847412109381 DISPLAY_IDENTIFIER C_ANG_SP_EGRV_TOL_GRD FORMAT "%5.3" /end CHARACTERISTIC
/begin CHARACTERISTIC c_fac_fil_ang_sp_egrv "filter factor (PT1) for EGR- valve position setpoint" VALUE 0x85be3e _REC_VAL_20_u2 0.9999847412109381 _CNV_A_R_LINEAR_____14_CM 0. 0.9999847412109381 DISPLAY_IDENTIFIER C_FAC_FIL_ANG_SP_EGRV FORMAT "%6.5" /end CHARACTERISTIC
/begin CHARACTERISTIC c_ang_sp_egrv_thd_tol_grd "upper threshold for gradient limitation" VALUE 0x85bcec _REC_VAL_20_u2 99.99847412109381 _CNV_A_R_LINEAR_____8_CM 0. 99.99847412109381 DISPLAY_IDENTIFIER C_ANG_SP_EGRV_THD_TOL_GRD FORMAT "%5.3" /end CHARACTERISTIC
/begin CHARACTERISTIC ip_kr_dt1_egrv__ctl_dif "GE_VCLP: gain for DT1 function" CURVE 0x84ccac _REC_CUR_20_u2_u2 4.19424 _CNV_A_R_LINEAR_____416_CM 0. 4.19424 DISPLAY_IDENTIFIER IP_KR_DT1_EGRV__CTL_DIF FORMAT "%6.5"
 /begin AXIS_DESCR COM_AXIS ctl_dif_egrv[0] _CNV_A_R_LINEAR_____158_CM 8 -100. 99.99694820000001 FORMAT "%5.3" AXIS_PTS_REF ldp_ctl_dif__ip_kr_dt1_egrv /end AXIS_DESCR
/end CHARACTERISTIC
/begin AXIS_PTS ldp_ctl_dif__ip_kr_dt1_egrv "" 0x841486 ctl_dif_egrv[0] _REC_AXS_20_u2 199.9969482 _CNV_A_R_LINEAR_____158_CM 8 -100. 99.99694820000001 FORMAT "%5.3" /end AXIS_PTS
/begin CHARACTERISTIC ip_t1_dt1_egrv__ctl_dif "GE_VCLP: time value for DT1 function" CURVE 0x85aa44 _REC_CUR_20_u2_u2 0.125 _CNV_A_R_LINEAR_____407_CM 0. 0.125 DISPLAY_IDENTIFIER IP_T1_DT1_EGRV__CTL_DIF FORMAT "%7.6"
 /begin AXIS_DESCR COM_AXIS ctl_dif_egrv[0] _CNV_A_R_LINEAR_____158_CM 8 -100. 99.99694820000001 FORMAT "%5.3" AXIS_PTS_REF ldp_ctl_dif__ip_t1_dt1_egrv /end AXIS_DESCR
/end CHARACTERISTIC
/begin AXIS_PTS ldp_ctl_dif__ip_t1_dt1_egrv "" 0x8414fe ctl_dif_egrv[0] _REC_AXS_20_u2 199.9969482 _CNV_A_R_LINEAR_____158_CM 8 -100. 99.99694820000001 FORMAT "%5.3" /end AXIS_PTS
/begin CHARACTERISTIC ip_air_foc_egrv__ang_egrv "GE_VCLP: influence of EGRV angle on pressure over valve" CURVE 0x849010 _REC_CUR_20_u2_u2 100. _CNV_A_R_LINEAR_____130_CM 0. 100. DISPLAY_IDENTIFIER IP_AIR_FOC_EGRV__ANG_EGRV FORMAT "%5.3"
 /begin AXIS_DESCR COM_AXIS ang_sp_egrv[0] _CNV_A_R_LINEAR_____8_CM 8 0. 99.99847412109381 FORMAT "%5.3" AXIS_PTS_REF ldp_ang_egrv__ip_air_foc_egrv /end AXIS_DESCR
/end CHARACTERISTIC
/begin AXIS_PTS ldp_ang_egrv__ip_air_foc_egrv "" 0x84131c ang_sp_egrv[0] _REC_AXS_20_u2 99.99847412109381 _CNV_A_R_LINEAR_____8_CM 8 0. 99.99847412109381 FORMAT "%5.3" /end AXIS_PTS
/begin CHARACTERISTIC id_pctl_egrv__t_ang_sp_close_0 "GE_VCLP: precontrol values during closed EGRV" CURVE 0x848db2 _REC_CUR_20_s2_u2 399.99389 _CNV_A_R_LINEAR_____399_CM -200. 199.99389 DISPLAY_IDENTIFIER ID_PCTL_EGRV__T_ANG_SP_CLOSE_0
 /begin AXIS_DESCR COM_AXIS t_ang_sp_egrv_close[0] _CNV_A_R_LINEAR_____76_CM 4 0. 65.535 FORMAT "%5.3" AXIS_PTS_REF ldp_t_ang_close__id_pctl_egrv /end AXIS_DESCR
/end CHARACTERISTIC
/begin AXIS_PTS ldp_t_ang_close__id_pctl_egrv "" 0x842608 t_ang_sp_egrv_close[0] _REC_AXS_20_u2 65.535 _CNV_A_R_LINEAR_____76_CM 4 0. 65.535 FORMAT "%5.3" /end AXIS_PTS
/begin CHARACTERISTIC ip_tq_spr_egrv__ang_sp_egrv "GE_VCLP: characteristic of spring" CURVE 0x85b32e _REC_CUR_20_u2_u2 999.98474 _CNV_A_R_LINEAR_____400_CM 0. 999.98474 DISPLAY_IDENTIFIER IP_TQ_SPR_EGRV__ANG_SP_EGRV FORMAT "%5.2"
 /begin AXIS_DESCR COM_AXIS ang_sp_egrv[0] _CNV_A_R_LINEAR_____8_CM 4 0. 99.99847412109381 FORMAT "%5.3" AXIS_PTS_REF ldp_ang_sp_egrv_ip_tq_spr_egrv /end AXIS_DESCR
/end CHARACTERISTIC
/begin AXIS_PTS ldp_ang_sp_egrv_ip_tq_spr_egrv "" 0x841378 ang_sp_egrv[0] _REC_AXS_20_u2 99.99847412109381 _CNV_A_R_LINEAR_____8_CM 4 0. 99.99847412109381 FORMAT "%5.3" /end AXIS_PTS
/begin CHARACTERISTIC ip_cur_mot_egrv__tq_mot "GE_VCLP: current of DC motor" CURVE 0x84a462 _REC_CUR_20_u2_u2 9.999874 _CNV_A_R_LINEAR_____409_CM 0. 9.999874 DISPLAY_IDENTIFIER IP_CUR_MOT_EGRV__TQ_MOT FORMAT "%5.4"
 /begin AXIS_DESCR COM_AXIS tq_mot_egrv[0] _CNV_A_R_LINEAR_____400_CM 4 0. 999.98474 FORMAT "%5.2" AXIS_PTS_REF ldp_tq_mot_egrv__ip_cur_mot /end AXIS_DESCR
/end CHARACTERISTIC
/begin AXIS_PTS ldp_tq_mot_egrv__ip_cur_mot "" 0x842a48 tq_mot_egrv[0] _REC_AXS_20_u2 999.98474 _CNV_A_R_LINEAR_____400_CM 4 0. 999.98474 FORMAT "%5.2" /end AXIS_PTS
/begin CHARACTERISTIC ip_pctl_egrv__v_mot_egrv "GE_VCLP: characteristic of power inverter" CURVE 0x8557ac _REC_CUR_20_u2_u2 399.993897 _CNV_A_R_LINEAR_____410_CM -200. 199.993897 DISPLAY_IDENTIFIER IP_PCTL_EGRV__V_MOT_EGRV
 /begin AXIS_DESCR COM_AXIS v_mot_egrv[0] _CNV_A_R_LINEAR_____401_CM 4 0. 99.99847412109381 FORMAT "%5.3" AXIS_PTS_REF ldp_v_mot_egrv__ip_pctl_egrv /end AXIS_DESCR
/end CHARACTERISTIC
/begin AXIS_PTS ldp_v_mot_egrv__ip_pctl_egrv "" 0x8432d8 v_mot_egrv[0] _REC_AXS_20_u2 99.99847412109381 _CNV_A_R_LINEAR_____401_CM 4 0. 99.99847412109381 FORMAT "%5.3" /end AXIS_PTS
/begin CHARACTERISTIC ip_ctl_max_egrv_0__temp "GE_VCLP: maximum limit of EGRV_0 controller output" CURVE 0x84a41a _REC_CUR_20_u1_u1 199.21875 _CNV_A_R_LINEAR_____411_CM -100. 99.21875 DISPLAY_IDENTIFIER IP_CTL_MAX_EGRV_0__TEMP FORMAT "%3.1"
 /begin AXIS_DESCR COM_AXIS tco _CNV_A_R_LINEAR_____18_CM 4 -50. 205. FORMAT "%3.0" AXIS_PTS_REF ldpm_temp__ip_ctl_egrv /end AXIS_DESCR
/end CHARACTERISTIC
/begin AXIS_PTS ldpm_temp__ip_ctl_egrv "" 0x843eba tco _REC_AXS_20_u1 255. _CNV_A_R_LINEAR_____18_CM 4 -50. 205. FORMAT "%3.0" /end AXIS_PTS
/begin CHARACTERISTIC ip_ctl_min_egrv_0__temp "GE_VCLP: minimum limit of EGRV_0 controller output" CURVE 0x84a42e _REC_CUR_20_u1_u1 199.21875 _CNV_A_R_LINEAR_____411_CM -100. 99.21875 DISPLAY_IDENTIFIER IP_CTL_MIN_EGRV_0__TEMP FORMAT "%3.1"
 /begin AXIS_DESCR COM_AXIS tco _CNV_A_R_LINEAR_____18_CM 4 -50. 205. FORMAT "%3.0" AXIS_PTS_REF ldpm_temp__ip_ctl_egrv /end AXIS_DESCR
/end CHARACTERISTIC
/begin CHARACTERISTIC ip_ctl_dyn_lim_egrv_0__temp "GE_VCLP: maximum limit of EGRV_0 controller output_a" CURVE 0x84a406 _REC_CUR_20_u1_u1 199.21875 _CNV_A_R_LINEAR_____411_CM -100. 99.21875 DISPLAY_IDENTIFIER IP_CTL_DYN_LIM_EGRV_0__TEMP FORMAT "%3.1"
 /begin AXIS_DESCR COM_AXIS tco _CNV_A_R_LINEAR_____18_CM 4 -50. 205. FORMAT "%3.0" AXIS_PTS_REF ldpm_temp__ip_ctl_egrv /end AXIS_DESCR
/end CHARACTERISTIC
/begin CHARACTERISTIC ip_kr_pi_egrv__ctl_dif__air_foc "GE_VCLP: proportional value for PI contoller" MAP 0x84cd4a _REC_MAP_20_u2_u2_u2 15.999755 _CNV_A_R_LINEAR_____13_CM 0. 15.999755 DISPLAY_IDENTIFIER IP_KR_PI_EGRV__CTL_DIF__AIR_FOC FORMAT "%6.4"
 /begin AXIS_DESCR COM_AXIS ctl_dif_egrv[0] _CNV_A_R_LINEAR_____158_CM 12 -100. 99.99694820000001 FORMAT "%5.3" AXIS_PTS_REF ldp_ctl_dif__ip_kr_pi_egrv /end AXIS_DESCR
 /begin AXIS_DESCR COM_AXIS online_dummy _CNV_A_R_LINEAR_____403_CM 6 0. 99.99847412109381 FORMAT "%5.3" AXIS_PTS_REF ldpm_air_foc__ip_pi_egrv /end AXIS_DESCR
/end CHARACTERISTIC
/begin AXIS_PTS ldp_ctl_dif__ip_kr_pi_egrv "" 0x8414be ctl_dif_egrv[0] _REC_AXS_20_u2 199.9969482 _CNV_A_R_LINEAR_____158_CM 12 -100. 99.99694820000001 FORMAT "%5.3" /end AXIS_PTS
/begin AXIS_PTS ldpm_air_foc__ip_pi_egrv "" 0x8433f6 online_dummy _REC_AXS_20_u2 99.99847412109381 _CNV_A_R_LINEAR_____403_CM 6 0. 99.99847412109381 FORMAT "%5.3" /end AXIS_PTS
/begin CHARACTERISTIC ip_tn_pi_egrv__ctl_dif__air_foc "GE_VCLP: integral value for PI contoller" MAP 0x85af08 _REC_MAP_20_u2_u2_u2 15.999755 _CNV_A_R_LINEAR_____408_CM 0. 15.999755 DISPLAY_IDENTIFIER IP_TN_PI_EGRV__CTL_DIF__AIR_FOC FORMAT "%6.4"
 /begin AXIS_DESCR COM_AXIS ctl_dif_egrv[0] _CNV_A_R_LINEAR_____158_CM 12 -100. 99.99694820000001 FORMAT "%5.3" AXIS_PTS_REF ldp_ctl_dif__ip_tn_pi_egrv /end AXIS_DESCR
 /begin AXIS_DESCR COM_AXIS online_dummy _CNV_A_R_LINEAR_____403_CM 6 0. 99.99847412109381 FORMAT "%5.3" AXIS_PTS_REF ldpm_air_foc__ip_pi_egrv /end AXIS_DESCR
/end CHARACTERISTIC
/begin AXIS_PTS ldp_ctl_dif__ip_tn_pi_egrv "" 0x841536 ctl_dif_egrv[0] _REC_AXS_20_u2 199.9969482 _CNV_A_R_LINEAR_____158_CM 12 -100. 99.99694820000001 FORMAT "%5.3" /end AXIS_PTS
/begin CHARACTERISTIC ip_pctl_egrv__ang_sp__air_foc "GE_VCLP: non-physical precontrol" MAP 0x85574c _REC_MAP_20_u2_u2_u2 399.993897 _CNV_A_R_LINEAR_____410_CM -200. 199.993897 DISPLAY_IDENTIFIER IP_PCTL_EGRV__ANG_SP__AIR_FOC
 /begin AXIS_DESCR COM_AXIS ang_sp_egrv[0] _CNV_A_R_LINEAR_____8_CM 8 0. 99.99847412109381 FORMAT "%5.3" AXIS_PTS_REF ldp_ang_sp_egrv_ip_pctl_egrv /end AXIS_DESCR
 /begin AXIS_DESCR COM_AXIS online_dummy _CNV_A_R_LINEAR_____403_CM 6 0. 99.99847412109381 FORMAT "%5.3" AXIS_PTS_REF ldpm_air_foc__ip_pi_egrv /end AXIS_DESCR
/end CHARACTERISTIC
/begin AXIS_PTS ldp_ang_sp_egrv_ip_pctl_egrv "" 0x841366 ang_sp_egrv[0] _REC_AXS_20_u2 99.99847412109381 _CNV_A_R_LINEAR_____8_CM 8 0. 99.99847412109381 FORMAT "%5.3" /end AXIS_PTS
/begin CHARACTERISTIC ip_air_foc__n__tqi_sp "GE_VCLP: indication of pressure over EGR valve" MAP 0x848f90 _REC_MAP_20_u2_u2_u2 1. _CNV_A_R_LINEAR_____372_CM 0. 1. DISPLAY_IDENTIFIER IP_AIR_FOC__N__TQI_SP FORMAT "%6.5"
 /begin AXIS_DESCR COM_AXIS n _CNV_A_R_LINEAR_____5_CM 8 0. 8160. FORMAT "%4.0" AXIS_PTS_REF ldp_n__ip_air_foc /end AXIS_DESCR
 /begin AXIS_DESCR COM_AXIS tqi_sp _CNV_A_R_LINEAR_____89_CM 8 -1024. 1023.96875 FORMAT "%6.2" AXIS_PTS_REF ldp_tqi_sp__ip_air_foc /end AXIS_DESCR
/end CHARACTERISTIC
/begin AXIS_PTS ldp_n__ip_air_foc "" 0x841918 n _REC_AXS_20_u2 8160. _CNV_A_R_LINEAR_____5_CM 8 0. 8160. FORMAT "%4.0" /end AXIS_PTS
/begin AXIS_PTS ldp_tqi_sp__ip_air_foc "" 0x842d90 tqi_sp _REC_AXS_20_u2 2047.96875 _CNV_A_R_LINEAR_____89_CM 8 -1024. 1023.96875 FORMAT "%6.2" /end AXIS_PTS
/begin MEASUREMENT ang_sp_egrv_clean[0] "setpoint for EGR-valve cleaning procedure" UWORD _CNV_A_R_LINEAR_____155_CM 1 0. 0. 99.9969482421875 DISPLAY_IDENTIFIER ANG_SP_EGRV_CLEAN_0_ ECU_ADDRESS 0x7f97ce BYTE_ORDER MSB_LAST FORMAT "%5.3" /end MEASUREMENT
/begin MEASUREMENT lv_req_egr_pwl[0] "enable EGR valve cleaning procedure" UBYTE _CNV_S_2_RANGE______11_CM 1 0. 0. 1. DISPLAY_IDENTIFIER LV_REQ_EGR_PWL_0_ ECU_ADDRESS 0x7fb47a /end MEASUREMENT
/begin MEASUREMENT lv_cdn_egr_on_ext "EGR control Enable ext. int." UBYTE _CNV_S_2_RANGE______11_CM 1 0. 0. 1. DISPLAY_IDENTIFIER LV_CDN_EGR_ON_EXT ECU_ADDRESS 0x7fba41 /end MEASUREMENT
/begin MEASUREMENT lv_cdn_egr_on_eng_state "EGR control Enable for engine states" UBYTE _CNV_S_2_RANGE______11_CM 1 0. 0. 1. DISPLAY_IDENTIFIER LV_CDN_EGR_ON_ENG_STATE ECU_ADDRESS 0x7fba37 /end MEASUREMENT
/begin MEASUREMENT lv_cdn_egr_on_tco "logical variable EGR-enable for TCO-limits" UBYTE _CNV_S_2_RANGE______11_CM 1 0. 0. 1. DISPLAY_IDENTIFIER LV_CDN_EGR_ON_TCO ECU_ADDRESS 0x7fba38 /end MEASUREMENT
/begin MEASUREMENT lv_cdn_egr_on_amp "EGR control enable for AMP-limits" UBYTE _CNV_S_2_RANGE______11_CM 1 0. 0. 1. DISPLAY_IDENTIFIER LV_CDN_EGR_ON_AMP ECU_ADDRESS 0x7fba39 /end MEASUREMENT
/begin MEASUREMENT lv_cdn_egr_on_tia "EGR control enable for TIA-limits" UBYTE _CNV_S_2_RANGE______11_CM 1 0. 0. 1. DISPLAY_IDENTIFIER LV_CDN_EGR_ON_TIA ECU_ADDRESS 0x7fba3a /end MEASUREMENT
/begin MEASUREMENT lv_cdn_egr_on_t_ast "EGR control enable for \"time after start\"" UBYTE _CNV_S_2_RANGE______11_CM 1 0. 0. 1. DISPLAY_IDENTIFIER LV_CDN_EGR_ON_T_AST ECU_ADDRESS 0x7fba3b /end MEASUREMENT
/begin MEASUREMENT lv_cdn_egr_on_tqi "EGR control enable for TQI limits" UBYTE _CNV_S_2_RANGE______11_CM 1 0. 0. 1. DISPLAY_IDENTIFIER LV_CDN_EGR_ON_TQI ECU_ADDRESS 0x7fba3c /end MEASUREMENT
/begin MEASUREMENT lv_cdn_egr_on_tqi_grd "EGR control enable for MF- gradient" UBYTE _CNV_S_2_RANGE______11_CM 1 0. 0. 1. DISPLAY_IDENTIFIER LV_CDN_EGR_ON_TQI_GRD ECU_ADDRESS 0x7fba3d /end MEASUREMENT
/begin MEASUREMENT lv_cdn_egr_on_req_0 "EGR control enable (inj. state GES = 0)" UBYTE _CNV_S_2_RANGE______11_CM 1 0. 0. 1. DISPLAY_IDENTIFIER LV_CDN_EGR_ON_REQ_0 ECU_ADDRESS 0x7fba3e /end MEASUREMENT
/begin MEASUREMENT lv_cdn_egr_on_req_1 "EGR control enable (inj. state GES = 1)" UBYTE _CNV_S_2_RANGE______11_CM 1 0. 0. 1. DISPLAY_IDENTIFIER LV_CDN_EGR_ON_REQ_1 ECU_ADDRESS 0x7fba3f /end MEASUREMENT
/begin MEASUREMENT lv_cdn_egr_on_req "EGR control enable" UBYTE _CNV_S_2_RANGE______11_CM 1 0. 0. 1. DISPLAY_IDENTIFIER LV_CDN_EGR_ON_REQ ECU_ADDRESS 0x7fba40 /end MEASUREMENT
/begin CHARACTERISTIC lc_egr_ctl_on "button for EGR-controller activation" VALUE 0x85c31a _REC_VAL_20_u1 1. _CNV_A_R_LINEAR_____0_CM 0. 1. DISPLAY_IDENTIFIER LC_EGR_CTL_ON FORMAT "%1.0" /end CHARACTERISTIC
/begin CHARACTERISTIC c_tco_egr_max "max. EGR-activation limit for coolant temperature" VALUE 0x85c144 _REC_VAL_20_u1 255. _CNV_A_R_LINEAR_____18_CM -50. 205. DISPLAY_IDENTIFIER C_TCO_EGR_MAX FORMAT "%3.0" /end CHARACTERISTIC
/begin CHARACTERISTIC c_tco_hys_egr "activation hysteresis for coolant temperature" VALUE 0x85c14a _REC_VAL_20_u1 255. _CNV_A_R_LINEAR_____20_CM 0. 255. DISPLAY_IDENTIFIER C_TCO_HYS_EGR FORMAT "%3.0" /end CHARACTERISTIC
/begin CHARACTERISTIC c_tco_egr_min "min. EGR-activation limit for coolant temperature" VALUE 0x85c145 _REC_VAL_20_u1 255. _CNV_A_R_LINEAR_____18_CM -50. 205. DISPLAY_IDENTIFIER C_TCO_EGR_MIN FORMAT "%3.0" /end CHARACTERISTIC
/begin CHARACTERISTIC c_amp_egr_min "min. EGR-activation limit for ambient pressure" VALUE 0x85bcc4 _REC_VAL_20_u2 5434. _CNV_A_R_LINEAR_____21_CM 0. 5434. DISPLAY_IDENTIFIER C_AMP_EGR_MIN FORMAT "%6.2" /end CHARACTERISTIC
/begin CHARACTERISTIC c_amp_hys_egr "activation hysteresis for ambient pressure" VALUE 0x85bcc6 _REC_VAL_20_u2 5434. _CNV_A_R_LINEAR_____21_CM 0. 5434. DISPLAY_IDENTIFIER C_AMP_HYS_EGR FORMAT "%6.2" /end CHARACTERISTIC
/begin CHARACTERISTIC c_tia_hys_egr "activation hysteresis for intake air temperature" VALUE 0x85c1b7 _REC_VAL_20_u1 255. _CNV_A_R_LINEAR_____20_CM 0. 255. DISPLAY_IDENTIFIER C_TIA_HYS_EGR FORMAT "%3.0" /end CHARACTERISTIC
/begin CHARACTERISTIC c_tia_egr_max "max. EGR-activation limit for intake air temperature" VALUE 0x85c1b4 _REC_VAL_20_u1 255. _CNV_A_R_LINEAR_____18_CM -50. 205. DISPLAY_IDENTIFIER C_TIA_EGR_MAX FORMAT "%3.0" /end CHARACTERISTIC
/begin CHARACTERISTIC c_t_dly_egr_di "delay time for EGR function reactivation" VALUE 0x85c0b0 _REC_VAL_20_u2 1310.7 _CNV_A_R_LINEAR_____417_CM 0. 1310.7 DISPLAY_IDENTIFIER C_T_DLY_EGR_DI FORMAT "%6.2" /end CHARACTERISTIC
/begin CHARACTERISTIC c_tqi_grd_thd_egr_di "threshold for TQI-gradient for EGR-disable" VALUE 0x85c1d0 _REC_VAL_20_s2 65535. _CNV_A_R_LINEAR_____97_CM -32768. 32767. DISPLAY_IDENTIFIER C_TQI_GRD_THD_EGR_DI FORMAT "%5.0" /end CHARACTERISTIC
/begin CHARACTERISTIC c_tqi_thd_egr_min "min. torque threshold for function activation" VALUE 0x85c1e2 _REC_VAL_20_u2 1023.96875 _CNV_A_R_LINEAR_____62_CM 0. 1023.96875 DISPLAY_IDENTIFIER C_TQI_THD_EGR_MIN FORMAT "%6.2" /end CHARACTERISTIC
/begin CHARACTERISTIC ip_t_dly_egr_ast__tco "AGE_EACT: delay time for EGR enable after start" CURVE 0x85aa7a _REC_CUR_20_u2_u1 6553.5 _CNV_A_R_LINEAR_____19_CM 0. 6553.5 DISPLAY_IDENTIFIER IP_T_DLY_EGR_AST__TCO FORMAT "%5.1"
 /begin AXIS_DESCR COM_AXIS tco _CNV_A_R_LINEAR_____18_CM 4 -50. 205. FORMAT "%3.0" AXIS_PTS_REF ldp_tco_ip_t_dly_egr_ast /end AXIS_DESCR
/end CHARACTERISTIC
/begin AXIS_PTS ldp_tco_ip_t_dly_egr_ast "delay time for EGR enable after start" 0x84282c tco _REC_AXS_20_u1 255. _CNV_A_R_LINEAR_____18_CM 4 -50. 205. FORMAT "%3.0" /end AXIS_PTS
/begin CHARACTERISTIC ip_tqi_egr_ena_1 "AGE_EACT: torque threshold for EGR enable (inj. state GES = 1)" CURVE 0x85b6de _REC_CUR_20_u2_u2 1023.96875 _CNV_A_R_LINEAR_____62_CM 0. 1023.96875 DISPLAY_IDENTIFIER IP_TQI_EGR_ENA_1 FORMAT "%6.2"
 /begin AXIS_DESCR COM_AXIS n _CNV_A_R_LINEAR_____5_CM 16 0. 6375. FORMAT "%4.0" AXIS_PTS_REF ldpm_n_ip_tqi_egr_act_1 /end AXIS_DESCR
/end CHARACTERISTIC
/begin AXIS_PTS ldpm_n_ip_tqi_egr_act_1 "torque threshold for EGR enable (inj. state GES = 1)" 0x843d94 n _REC_AXS_20_u2 6375. _CNV_A_R_LINEAR_____5_CM 16 0. 6375. FORMAT "%4.0" /end AXIS_PTS
/begin CHARACTERISTIC ip_tqi_egr_di_1 "AGE_EACT: torque threshold for EGR disable (inj. state GES = 1)" CURVE 0x85b69e _REC_CUR_20_u2_u2 1023.96875 _CNV_A_R_LINEAR_____62_CM 0. 1023.96875 DISPLAY_IDENTIFIER IP_TQI_EGR_DI_1 FORMAT "%6.2"
 /begin AXIS_DESCR COM_AXIS n _CNV_A_R_LINEAR_____5_CM 16 0. 6375. FORMAT "%4.0" AXIS_PTS_REF ldpm_n_ip_tqi_egr_act_1 /end AXIS_DESCR
/end CHARACTERISTIC
/begin CHARACTERISTIC ip_tqi_egr_ena_0 "AGE_EACT: torque threshold for EGR enable (inj. state GES = 0)" CURVE 0x85b6be _REC_CUR_20_u2_u2 1023.96875 _CNV_A_R_LINEAR_____62_CM 0. 1023.96875 DISPLAY_IDENTIFIER IP_TQI_EGR_ENA_0 FORMAT "%6.2"
 /begin AXIS_DESCR COM_AXIS n _CNV_A_R_LINEAR_____5_CM 16 0. 6375. FORMAT "%4.0" AXIS_PTS_REF ldpm_n_ip_tqi_egr_act_0 /end AXIS_DESCR
/end CHARACTERISTIC
/begin AXIS_PTS ldpm_n_ip_tqi_egr_act_0 "torque threshold for EGR enable (inj. state GES = 0)" 0x843d72 n _REC_AXS_20_u2 6375. _CNV_A_R_LINEAR_____5_CM 16 0. 6375. FORMAT "%4.0" /end AXIS_PTS
/begin CHARACTERISTIC ip_tqi_egr_di_0 "AGE_EACT: torque threshold for EGR disable (inj. state GES = 0)" CURVE 0x85b67e _REC_CUR_20_u2_u2 1023.96875 _CNV_A_R_LINEAR_____62_CM 0. 1023.96875 DISPLAY_IDENTIFIER IP_TQI_EGR_DI_0 FORMAT "%6.2"
 /begin AXIS_DESCR COM_AXIS n _CNV_A_R_LINEAR_____5_CM 16 0. 6375. FORMAT "%4.0" AXIS_PTS_REF ldpm_n_ip_tqi_egr_act_0 /end AXIS_DESCR
/end CHARACTERISTIC
/begin MEASUREMENT lv_cdn_egr_on "EGR control Enable" UBYTE _CNV_S_2_RANGE______11_CM 1 0. 0. 1. DISPLAY_IDENTIFIER LV_CDN_EGR_ON ECU_ADDRESS 0x7fb481 /end MEASUREMENT
/begin MEASUREMENT lv_cdn_thr_on "activation flag for closed loop throttle control" UBYTE _CNV_S_2_RANGE______11_CM 1 0. 0. 1. DISPLAY_IDENTIFIER LV_CDN_THR_ON ECU_ADDRESS 0x7fb482 /end MEASUREMENT
/begin MEASUREMENT mafpwm_pctl_bas_tco_0 "uncorrected basic precontrol value for air mass flow regulation (inj. state GES=0)" UWORD _CNV_A_R_LINEAR_____201_CM 1 0. 0. 99.972117 DISPLAY_IDENTIFIER MAFPWM_PCTL_BAS_TCO_0 ECU_ADDRESS 0x7fa5ea BYTE_ORDER MSB_LAST FORMAT "%5.3" /end MEASUREMENT
/begin MEASUREMENT mafpwm_pctl_bas_tco_1 "uncorrected basic precontrol value for air mass flow regulation (inj. state GES=1)" UWORD _CNV_A_R_LINEAR_____201_CM 1 0. 0. 99.972117 DISPLAY_IDENTIFIER MAFPWM_PCTL_BAS_TCO_1 ECU_ADDRESS 0x7fa5ec BYTE_ORDER MSB_LAST FORMAT "%5.3" /end MEASUREMENT
/begin MEASUREMENT mafpwm_pctl_bas "basic precontrol value for air mass flow regulation" UWORD _CNV_A_R_LINEAR_____201_CM 1 0. 0. 99.972117 DISPLAY_IDENTIFIER MAFPWM_PCTL_BAS ECU_ADDRESS 0x7fa5ee BYTE_ORDER MSB_LAST FORMAT "%5.3" /end MEASUREMENT
/begin MEASUREMENT mafpwm_pctl_bas_0 "basic precontrol value for air mass flow regulation (inj. state GES = 0)" UWORD _CNV_A_R_LINEAR_____201_CM 1 0. 0. 99.972117 DISPLAY_IDENTIFIER MAFPWM_PCTL_BAS_0 ECU_ADDRESS 0x7fa5f0 BYTE_ORDER MSB_LAST FORMAT "%5.3" /end MEASUREMENT
/begin MEASUREMENT mafpwm_pctl_bas_1 "basic precontrol value for air mass flow regulation (inj. state GES = 1)" UWORD _CNV_A_R_LINEAR_____201_CM 1 0. 0. 99.972117 DISPLAY_IDENTIFIER MAFPWM_PCTL_BAS_1 ECU_ADDRESS 0x7fa5f2 BYTE_ORDER MSB_LAST FORMAT "%5.3" /end MEASUREMENT
/begin MEASUREMENT mafpwm_pctl "MAF precontrol value before output filter" UWORD _CNV_A_R_LINEAR_____201_CM 1 0. 0. 99.972117 DISPLAY_IDENTIFIER MAFPWM_PCTL ECU_ADDRESS 0x7fa5f4 BYTE_ORDER MSB_LAST FORMAT "%5.3" /end MEASUREMENT
/begin MEASUREMENT mafpwm_pctl_clc "precontrol value for air mass flow regulation after intervention for idel speed" UWORD _CNV_A_R_LINEAR_____201_CM 1 0. 0. 99.972117 DISPLAY_IDENTIFIER MAFPWM_PCTL_CLC ECU_ADDRESS 0x7fa5f6 BYTE_ORDER MSB_LAST FORMAT "%5.3" /end MEASUREMENT
/begin MEASUREMENT mafpwm_pctl_mmv "filterd output of MAF precontroller" UWORD _CNV_A_R_LINEAR_____201_CM 1 0. 0. 99.972117 DISPLAY_IDENTIFIER MAFPWM_PCTL_MMV ECU_ADDRESS 0x7f97dc BYTE_ORDER MSB_LAST FORMAT "%5.3" /end MEASUREMENT
/begin CHARACTERISTIC c_mafpwm_pctl_man "manual value for the air mass flow prcontroller" VALUE 0x85bf22 _REC_VAL_20_u2 99.972117 _CNV_A_R_LINEAR_____201_CM 0. 99.972117 DISPLAY_IDENTIFIER C_MAFPWM_PCTL_MAN FORMAT "%5.3" /end CHARACTERISTIC
/begin CHARACTERISTIC lc_mafpwm_pctl_man "button for manual precontrol value for the air mass flow controller" VALUE 0x85c33c _REC_VAL_20_u1 1. _CNV_A_R_LINEAR_____0_CM 0. 1. DISPLAY_IDENTIFIER LC_MAFPWM_PCTL_MAN FORMAT "%1.0" /end CHARACTERISTIC
/begin CHARACTERISTIC c_fac_mafpwm_pctl_is_fil "filter factor for MAF_SP increasing in idle" VALUE 0x85be5a _REC_VAL_20_u2 0.9999847412109381 _CNV_A_R_LINEAR_____14_CM 0. 0.9999847412109381 DISPLAY_IDENTIFIER C_FAC_MAFPWM_PCTL_IS_FIL FORMAT "%6.5" /end CHARACTERISTIC
/begin CHARACTERISTIC c_mafpwm_pctl_off "value for the air mass flow precontroller during disabed EGR regulation" VALUE 0x85bf24 _REC_VAL_20_u2 99.972117 _CNV_A_R_LINEAR_____201_CM 0. 99.972117 DISPLAY_IDENTIFIER C_MAFPWM_PCTL_OFF FORMAT "%5.3" /end CHARACTERISTIC
/begin CHARACTERISTIC c_fac_mafpwm_pctl_ini_fil "initial filter factor for the precontroller" VALUE 0x85be58 _REC_VAL_20_u2 0.9999847412109381 _CNV_A_R_LINEAR_____14_CM 0. 0.9999847412109381 DISPLAY_IDENTIFIER C_FAC_MAFPWM_PCTL_INI_FIL FORMAT "%6.5" /end CHARACTERISTIC
/begin CHARACTERISTIC lc_mafpwm_pctl_on "button for precontrol value for the air mass flow controller" VALUE 0x85c33d _REC_VAL_20_u1 1. _CNV_A_R_LINEAR_____0_CM 0. 1. DISPLAY_IDENTIFIER LC_MAFPWM_PCTL_ON FORMAT "%1.0" /end CHARACTERISTIC
/begin CHARACTERISTIC ip_fac_mafpwm_pctl_cor_amp_0 "MAF_PRE: air mass flow precontrol correction factor for ambient pressure (inj. region GES = 0)" CURVE 0x84bcfe _REC_CUR_20_u2_u2 0.9999847412109381 _CNV_A_R_LINEAR_____14_CM 0. 0.9999847412109381 DISPLAY_IDENTIFIER IP_FAC_MAFPWM_PCTL_COR_AMP_0 FORMAT "%6.5"
 /begin AXIS_DESCR COM_AXIS amp _CNV_A_R_LINEAR_____21_CM 8 0. 5434. FORMAT "%6.2" AXIS_PTS_REF ldp_amp_ip_fac_mafpwm_pctl_0 /end AXIS_DESCR
/end CHARACTERISTIC
/begin AXIS_PTS ldp_amp_ip_fac_mafpwm_pctl_0 "" 0x841122 amp _REC_AXS_20_u2 5434. _CNV_A_R_LINEAR_____21_CM 8 0. 5434. FORMAT "%6.2" /end AXIS_PTS
/begin CHARACTERISTIC ip_fac_mafpwm_pctl_cor_tgas_0 "MAF_PRE: air mass flow precontrol correction factor for temperature of the intake gas (inj. region GES = 0)" CURVE 0x84bd1e _REC_CUR_20_u2_u1 0.9999847412109381 _CNV_A_R_LINEAR_____14_CM 0. 0.9999847412109381 DISPLAY_IDENTIFIER IP_FAC_MAFPWM_PCTL_COR_TGAS_0 FORMAT "%6.5"
 /begin AXIS_DESCR COM_AXIS tgas _CNV_A_R_LINEAR_____18_CM 8 -50. 205. FORMAT "%3.0" AXIS_PTS_REF ldp_tgas_ip_fac_mafpwm_pctl_0 /end AXIS_DESCR
/end CHARACTERISTIC
/begin AXIS_PTS ldp_tgas_ip_fac_mafpwm_pctl_0 "" 0x842932 tgas _REC_AXS_20_u1 255. _CNV_A_R_LINEAR_____18_CM 8 -50. 205. FORMAT "%3.0" /end AXIS_PTS
/begin CHARACTERISTIC ip_fac_tran_mafpwm_pctl_1 "MAF_PRE: transition factor for the basic air mass flow precontrol (inj. region 1)" CURVE 0x84c8fe _REC_CUR_20_u2_u1 1.9999696 _CNV_A_R_LINEAR_____53_CM 0. 1.9999696 DISPLAY_IDENTIFIER IP_FAC_TRAN_MAFPWM_PCTL_1 FORMAT "%6.5"
 /begin AXIS_DESCR COM_AXIS tco _CNV_A_R_LINEAR_____18_CM 8 -50. 205. FORMAT "%3.0" AXIS_PTS_REF ldp_tco_ip_fac_tran_mafpwm_1 /end AXIS_DESCR
/end CHARACTERISTIC
/begin AXIS_PTS ldp_tco_ip_fac_tran_mafpwm_1 "" 0x8427be tco _REC_AXS_20_u1 255. _CNV_A_R_LINEAR_____18_CM 8 -50. 205. FORMAT "%3.0" /end AXIS_PTS
/begin CHARACTERISTIC ip_fac_mafpwm_pctl_cor_amp_1 "MAF_PRE: air mass flow precontrol correction factor for ambient pressure (inj. region GES = 1)" CURVE 0x84bd0e _REC_CUR_20_u2_u2 0.9999847412109381 _CNV_A_R_LINEAR_____14_CM 0. 0.9999847412109381 DISPLAY_IDENTIFIER IP_FAC_MAFPWM_PCTL_COR_AMP_1 FORMAT "%6.5"
 /begin AXIS_DESCR COM_AXIS amp _CNV_A_R_LINEAR_____21_CM 8 0. 5434. FORMAT "%6.2" AXIS_PTS_REF ldp_amp_ip_fac_mafpwm_pctl_1 /end AXIS_DESCR
/end CHARACTERISTIC
/begin AXIS_PTS ldp_amp_ip_fac_mafpwm_pctl_1 "" 0x841134 amp _REC_AXS_20_u2 5434. _CNV_A_R_LINEAR_____21_CM 8 0. 5434. FORMAT "%6.2" /end AXIS_PTS
/begin CHARACTERISTIC ip_fac_mafpwm_pctl_cor_tgas_1 "MAF_PRE: air mass flow precontrol correction factor for temperature of the intake gas (inj. region GES = 1)" CURVE 0x84bd2e _REC_CUR_20_u2_u1 0.9999847412109381 _CNV_A_R_LINEAR_____14_CM 0. 0.9999847412109381 DISPLAY_IDENTIFIER IP_FAC_MAFPWM_PCTL_COR_TGAS_1 FORMAT "%6.5"
 /begin AXIS_DESCR COM_AXIS tgas _CNV_A_R_LINEAR_____18_CM 8 -50. 205. FORMAT "%3.0" AXIS_PTS_REF ldp_tgas_ip_fac_mafpwm_pctl_1 /end AXIS_DESCR
/end CHARACTERISTIC
/begin AXIS_PTS ldp_tgas_ip_fac_mafpwm_pctl_1 "" 0x84293b tgas _REC_AXS_20_u1 255. _CNV_A_R_LINEAR_____18_CM 8 -50. 205. FORMAT "%3.0" /end AXIS_PTS
/begin CHARACTERISTIC ip_mafpwm_pctl_bas_0_1 "MAF_PRE: basic air mass flow precontrol for warm engine (inj. region GES = 0)" MAP 0x84e038 _REC_MAP_20_u2_u2_u2 100. _CNV_A_R_LINEAR_____136_CM 0. 100. DISPLAY_IDENTIFIER IP_MAFPWM_PCTL_BAS_0_1 FORMAT "%5.3"
 /begin AXIS_DESCR COM_AXIS n _CNV_A_R_LINEAR_____5_CM 16 0. 6375. FORMAT "%4.0" AXIS_PTS_REF ldpm_n_ip_mafpwm_pctl_bas_0 /end AXIS_DESCR
 /begin AXIS_DESCR COM_AXIS tqi_egr _CNV_A_R_LINEAR_____62_CM 16 0. 1023.96875 FORMAT "%6.2" AXIS_PTS_REF ldpm_tqi_ip_mafpwm_pctl_bas_0 /end AXIS_DESCR
/end CHARACTERISTIC
/begin AXIS_PTS ldpm_n_ip_mafpwm_pctl_bas_0 "" 0x843af0 n _REC_AXS_20_u2 6375. _CNV_A_R_LINEAR_____5_CM 16 0. 6375. FORMAT "%4.0" /end AXIS_PTS
/begin AXIS_PTS ldpm_tqi_ip_mafpwm_pctl_bas_0 "" 0x844042 tqi_egr _REC_AXS_20_u2 1023.96875 _CNV_A_R_LINEAR_____62_CM 16 0. 1023.96875 FORMAT "%6.2" /end AXIS_PTS
/begin CHARACTERISTIC ip_mafpwm_pctl_bas_0_0 "MAF_PRE: basic air mass flow precontrol for hot engine (inj. region GES = 0)" MAP 0x84de38 _REC_MAP_20_u2_u2_u2 100. _CNV_A_R_LINEAR_____136_CM 0. 100. DISPLAY_IDENTIFIER IP_MAFPWM_PCTL_BAS_0_0 FORMAT "%5.3"
 /begin AXIS_DESCR COM_AXIS n _CNV_A_R_LINEAR_____5_CM 16 0. 6375. FORMAT "%4.0" AXIS_PTS_REF ldpm_n_ip_mafpwm_pctl_bas_0 /end AXIS_DESCR
 /begin AXIS_DESCR COM_AXIS tqi_egr _CNV_A_R_LINEAR_____62_CM 16 0. 1023.96875 FORMAT "%6.2" AXIS_PTS_REF ldpm_tqi_ip_mafpwm_pctl_bas_0 /end AXIS_DESCR
/end CHARACTERISTIC
/begin CHARACTERISTIC ip_mafpwm_pctl_bas_0_2 "MAF_PRE: basic air mass flow precontrol for cold engine (inj. region GES = 0)" MAP 0x84e238 _REC_MAP_20_u2_u2_u2 100. _CNV_A_R_LINEAR_____136_CM 0. 100. DISPLAY_IDENTIFIER IP_MAFPWM_PCTL_BAS_0_2 FORMAT "%5.3"
 /begin AXIS_DESCR COM_AXIS n _CNV_A_R_LINEAR_____5_CM 1 0. 6375. FORMAT "%4.0" AXIS_PTS_REF ldpm_n_ip_mafpwm_pctl_bas_short /end AXIS_DESCR
 /begin AXIS_DESCR COM_AXIS tqi_egr _CNV_A_R_LINEAR_____62_CM 1 0. 1023.96875 FORMAT "%6.2" AXIS_PTS_REF ldpm_tqi_ip_mafpwm_pctl_bas_short /end AXIS_DESCR
/end CHARACTERISTIC
/begin CHARACTERISTIC ip_mafpwm_pctl_cor_tgas_0 "MAF_PRE: basic air mass flow precontrol correction map for intake gas temperature (inj. region GES = 0)" MAP 0x84e73c _REC_MAP_20_u2_u2_u2 99.99847412 _CNV_A_R_LINEAR_____141_CM -50. 49.99847412 DISPLAY_IDENTIFIER IP_MAFPWM_PCTL_COR_TGAS_0 FORMAT "%5.3"
 /begin AXIS_DESCR COM_AXIS n _CNV_A_R_LINEAR_____5_CM 8 0. 6375. FORMAT "%4.0" AXIS_PTS_REF ldp_n_ip_mafpwm_pctl_tgas_0 /end AXIS_DESCR
 /begin AXIS_DESCR COM_AXIS tqi_egr _CNV_A_R_LINEAR_____62_CM 8 0. 1023.96875 FORMAT "%6.2" AXIS_PTS_REF ldp_tqi_ip_mafpwm_pctl_tgas_0 /end AXIS_DESCR
/end CHARACTERISTIC
/begin AXIS_PTS ldp_n_ip_mafpwm_pctl_tgas_0 "" 0x841b70 n _REC_AXS_20_u2 6375. _CNV_A_R_LINEAR_____5_CM 8 0. 6375. FORMAT "%4.0" /end AXIS_PTS
/begin AXIS_PTS ldp_tqi_ip_mafpwm_pctl_tgas_0 "" 0x842bb8 tqi_egr _REC_AXS_20_u2 1023.96875 _CNV_A_R_LINEAR_____62_CM 8 0. 1023.96875 FORMAT "%6.2" /end AXIS_PTS
/begin CHARACTERISTIC ip_mafpwm_pctl_cor_amp_0 "MAF_PRE: basic air mass flow precontrol correction map for ambient pressure (inj. region GES = 0)" MAP 0x84e63c _REC_MAP_20_u2_u2_u2 99.99847412 _CNV_A_R_LINEAR_____141_CM -50. 49.99847412 DISPLAY_IDENTIFIER IP_MAFPWM_PCTL_COR_AMP_0 FORMAT "%5.3"
 /begin AXIS_DESCR COM_AXIS n _CNV_A_R_LINEAR_____5_CM 8 0. 6375. FORMAT "%4.0" AXIS_PTS_REF ldp_n_ip_mafpwm_pctl_amp_0 /end AXIS_DESCR
 /begin AXIS_DESCR COM_AXIS tqi_egr _CNV_A_R_LINEAR_____62_CM 8 0. 1023.96875 FORMAT "%6.2" AXIS_PTS_REF ldp_tqi_ip_mafpwm_pctl_amp_0 /end AXIS_DESCR
/end CHARACTERISTIC
/begin AXIS_PTS ldp_n_ip_mafpwm_pctl_amp_0 "" 0x841b4c n _REC_AXS_20_u2 6375. _CNV_A_R_LINEAR_____5_CM 8 0. 6375. FORMAT "%4.0" /end AXIS_PTS
/begin AXIS_PTS ldp_tqi_ip_mafpwm_pctl_amp_0 "" 0x842b94 tqi_egr _REC_AXS_20_u2 1023.96875 _CNV_A_R_LINEAR_____62_CM 8 0. 1023.96875 FORMAT "%6.2" /end AXIS_PTS
/begin CHARACTERISTIC ip_mafpwm_pctl_bas_1_1 "MAF_PRE: basic air mass flow precontrol for warm engine (inj. region GES = 1)" MAP 0x84e43a _REC_MAP_20_u2_u2_u2 100. _CNV_A_R_LINEAR_____136_CM 0. 100. DISPLAY_IDENTIFIER IP_MAFPWM_PCTL_BAS_1_1 FORMAT "%5.3"
 /begin AXIS_DESCR COM_AXIS n _CNV_A_R_LINEAR_____5_CM 16 0. 6375. FORMAT "%4.0" AXIS_PTS_REF ldpm_n_ip_mafpwm_pctl_bas_1 /end AXIS_DESCR
 /begin AXIS_DESCR COM_AXIS tqi_egr _CNV_A_R_LINEAR_____62_CM 16 0. 1023.96875 FORMAT "%6.2" AXIS_PTS_REF ldpm_tqi_ip_mafpwm_pctl_bas_1 /end AXIS_DESCR
/end CHARACTERISTIC
/begin AXIS_PTS ldpm_n_ip_mafpwm_pctl_bas_1 "" 0x843b12 n _REC_AXS_20_u2 6375. _CNV_A_R_LINEAR_____5_CM 16 0. 6375. FORMAT "%4.0" /end AXIS_PTS
/begin AXIS_PTS ldpm_tqi_ip_mafpwm_pctl_bas_1 "" 0x844064 tqi_egr _REC_AXS_20_u2 1023.96875 _CNV_A_R_LINEAR_____62_CM 16 0. 1023.96875 FORMAT "%6.2" /end AXIS_PTS
/begin CHARACTERISTIC ip_mafpwm_pctl_bas_1_0 "MAF_PRE: basic air mass flow precontrol for hot engine (inj. region GES = 1)" MAP 0x84e23a _REC_MAP_20_u2_u2_u2 100. _CNV_A_R_LINEAR_____136_CM 0. 100. DISPLAY_IDENTIFIER IP_MAFPWM_PCTL_BAS_1_0 FORMAT "%5.3"
 /begin AXIS_DESCR COM_AXIS n _CNV_A_R_LINEAR_____5_CM 16 0. 6375. FORMAT "%4.0" AXIS_PTS_REF ldpm_n_ip_mafpwm_pctl_bas_1 /end AXIS_DESCR
 /begin AXIS_DESCR COM_AXIS tqi_egr _CNV_A_R_LINEAR_____62_CM 16 0. 1023.96875 FORMAT "%6.2" AXIS_PTS_REF ldpm_tqi_ip_mafpwm_pctl_bas_1 /end AXIS_DESCR
/end CHARACTERISTIC
/begin CHARACTERISTIC ip_mafpwm_pctl_bas_1_2 "MAF_PRE: basic air mass flow precontrol for cold engine (inj. region GES = 1)" MAP 0x84e63a _REC_MAP_20_u2_u2_u2 100. _CNV_A_R_LINEAR_____136_CM 0. 100. DISPLAY_IDENTIFIER IP_MAFPWM_PCTL_BAS_1_2 FORMAT "%5.3"
 /begin AXIS_DESCR COM_AXIS n _CNV_A_R_LINEAR_____5_CM 1 0. 6375. FORMAT "%4.0" AXIS_PTS_REF ldpm_n_ip_mafpwm_pctl_bas_short /end AXIS_DESCR
 /begin AXIS_DESCR COM_AXIS tqi_egr _CNV_A_R_LINEAR_____62_CM 1 0. 1023.96875 FORMAT "%6.2" AXIS_PTS_REF ldpm_tqi_ip_mafpwm_pctl_bas_short /end AXIS_DESCR
/end CHARACTERISTIC
/begin CHARACTERISTIC ip_mafpwm_pctl_cor_tgas_1 "MAF_PRE: basic air mass flow precontrol correction map for intake gas temperature (inj. region GES = 1)" MAP 0x84e7bc _REC_MAP_20_u2_u2_u2 99.99847412 _CNV_A_R_LINEAR_____141_CM -50. 49.99847412 DISPLAY_IDENTIFIER IP_MAFPWM_PCTL_COR_TGAS_1 FORMAT "%5.3"
 /begin AXIS_DESCR COM_AXIS n _CNV_A_R_LINEAR_____5_CM 8 0. 6375. FORMAT "%4.0" AXIS_PTS_REF ldp_n_ip_mafpwm_pctl_tgas_1 /end AXIS_DESCR
 /begin AXIS_DESCR COM_AXIS tqi_egr _CNV_A_R_LINEAR_____62_CM 8 0. 1023.96875 FORMAT "%6.2" AXIS_PTS_REF ldp_tqi_ip_mafpwm_pctl_tgas_1 /end AXIS_DESCR
/end CHARACTERISTIC
/begin AXIS_PTS ldp_n_ip_mafpwm_pctl_tgas_1 "" 0x841b82 n _REC_AXS_20_u2 6375. _CNV_A_R_LINEAR_____5_CM 8 0. 6375. FORMAT "%4.0" /end AXIS_PTS
/begin AXIS_PTS ldp_tqi_ip_mafpwm_pctl_tgas_1 "" 0x842bca tqi_egr _REC_AXS_20_u2 1023.96875 _CNV_A_R_LINEAR_____62_CM 8 0. 1023.96875 FORMAT "%6.2" /end AXIS_PTS
/begin CHARACTERISTIC ip_mafpwm_pctl_cor_amp_1 "MAF_PRE: basic air mass flow precontrol correction map for ambient pressure (inj. region GES = 1)" MAP 0x84e6bc _REC_MAP_20_u2_u2_u2 99.99847412 _CNV_A_R_LINEAR_____141_CM -50. 49.99847412 DISPLAY_IDENTIFIER IP_MAFPWM_PCTL_COR_AMP_1 FORMAT "%5.3"
 /begin AXIS_DESCR COM_AXIS n _CNV_A_R_LINEAR_____5_CM 8 0. 6375. FORMAT "%4.0" AXIS_PTS_REF ldp_n_ip_mafpwm_pctl_amp_1 /end AXIS_DESCR
 /begin AXIS_DESCR COM_AXIS tqi_egr _CNV_A_R_LINEAR_____62_CM 8 0. 1023.96875 FORMAT "%6.2" AXIS_PTS_REF ldp_tqi_ip_mafpwm_pctl_amp_1 /end AXIS_DESCR
/end CHARACTERISTIC
/begin AXIS_PTS ldp_n_ip_mafpwm_pctl_amp_1 "" 0x841b5e n _REC_AXS_20_u2 6375. _CNV_A_R_LINEAR_____5_CM 8 0. 6375. FORMAT "%4.0" /end AXIS_PTS
/begin AXIS_PTS ldp_tqi_ip_mafpwm_pctl_amp_1 "" 0x842ba6 tqi_egr _REC_AXS_20_u2 1023.96875 _CNV_A_R_LINEAR_____62_CM 8 0. 1023.96875 FORMAT "%6.2" /end AXIS_PTS
/begin CHARACTERISTIC ip_mafpwm_pctl_is "MAF_PRE: precontrol value for MAF controller during IS" MAP 0x84e83c _REC_MAP_20_u2_u2_u1 99.972117 _CNV_A_R_LINEAR_____201_CM 0. 99.972117 DISPLAY_IDENTIFIER IP_MAFPWM_PCTL_IS FORMAT "%5.3"
 /begin AXIS_DESCR COM_AXIS amp _CNV_A_R_LINEAR_____21_CM 8 0. 5434. FORMAT "%6.2" AXIS_PTS_REF ldp_amp_ip_mafpwm_pctl_is /end AXIS_DESCR
 /begin AXIS_DESCR COM_AXIS tgas _CNV_A_R_LINEAR_____18_CM 8 -50. 205. FORMAT "%3.0" AXIS_PTS_REF ldp_tgas_ip_mafpwm_pctl_is /end AXIS_DESCR
/end CHARACTERISTIC
/begin AXIS_PTS ldp_amp_ip_mafpwm_pctl_is "" 0x8412da amp _REC_AXS_20_u2 5434. _CNV_A_R_LINEAR_____21_CM 8 0. 5434. FORMAT "%6.2" /end AXIS_PTS
/begin AXIS_PTS ldp_tgas_ip_mafpwm_pctl_is "" 0x8429f9 tgas _REC_AXS_20_u1 255. _CNV_A_R_LINEAR_____18_CM 8 -50. 205. FORMAT "%3.0" /end AXIS_PTS
/begin CHARACTERISTIC ip_fac_tran_mafpwm_pctl_0 "MAF_PRE: transition factor for the basic air mass flow precontrol (inj. region 0)" CURVE 0x84c8ee _REC_CUR_20_u2_u1 1.9999696 _CNV_A_R_LINEAR_____53_CM 0. 1.9999696 DISPLAY_IDENTIFIER IP_FAC_TRAN_MAFPWM_PCTL_0 FORMAT "%6.5"
 /begin AXIS_DESCR COM_AXIS tco _CNV_A_R_LINEAR_____18_CM 8 -50. 205. FORMAT "%3.0" AXIS_PTS_REF ldp_tco_ip_fac_tran_mafpwm_0 /end AXIS_DESCR
/end CHARACTERISTIC
/begin AXIS_PTS ldp_tco_ip_fac_tran_mafpwm_0 "" 0x8427b5 tco _REC_AXS_20_u1 255. _CNV_A_R_LINEAR_____18_CM 8 -50. 205. FORMAT "%3.0" /end AXIS_PTS
/begin AXIS_PTS ldpm_n_ip_mafpwm_pctl_bas_short "" 0x843b34 n _REC_AXS_20_u2 6375. _CNV_A_R_LINEAR_____5_CM 1 0. 6375. FORMAT "%4.0" /end AXIS_PTS
/begin AXIS_PTS ldpm_tqi_ip_mafpwm_pctl_bas_short "" 0x844086 tqi_egr _REC_AXS_20_u2 1023.96875 _CNV_A_R_LINEAR_____62_CM 1 0. 1023.96875 FORMAT "%6.2" /end AXIS_PTS
/begin MEASUREMENT lv_cdn_bpa_ctl_on "activation condition for closed loop bpa" UBYTE _CNV_S_2_RANGE______11_CM 1 0. 0. 1. DISPLAY_IDENTIFIER LV_CDN_BPA_CTL_ON ECU_ADDRESS 0x7fb483 /end MEASUREMENT
/begin MEASUREMENT lv_cdn_bpa_ctl_on_req "activation condition N and TQI for closed loop BPA" UBYTE _CNV_S_2_RANGE______11_CM 1 0. 0. 1. DISPLAY_IDENTIFIER LV_CDN_BPA_CTL_ON_REQ ECU_ADDRESS 0x7fba42 /end MEASUREMENT
/begin MEASUREMENT lv_cdn_bpa_ctl_ena_0 "activation conditions for TQI (inj. state GES = 0)" UBYTE _CNV_S_2_RANGE______11_CM 1 0. 0. 1. DISPLAY_IDENTIFIER LV_CDN_BPA_CTL_ENA_0 ECU_ADDRESS 0x7fba43 /end MEASUREMENT
/begin MEASUREMENT lv_cdn_bpa_ctl_ena_1 "activation conditions for TQI (inj. state GES = 1)" UBYTE _CNV_S_2_RANGE______11_CM 1 0. 0. 1. DISPLAY_IDENTIFIER LV_CDN_BPA_CTL_ENA_1 ECU_ADDRESS 0x7fba44 /end MEASUREMENT
/begin MEASUREMENT lv_cdn_bpa_ctl_ena "activation conditions for TQI" UBYTE _CNV_S_2_RANGE______11_CM 1 0. 0. 1. DISPLAY_IDENTIFIER LV_CDN_BPA_CTL_ENA ECU_ADDRESS 0x7fba45 /end MEASUREMENT
/begin CHARACTERISTIC lc_bpa_ctl_on "button for BPA controller activation" VALUE 0x85c2f4 _REC_VAL_20_u1 1. _CNV_A_R_LINEAR_____0_CM 0. 1. DISPLAY_IDENTIFIER LC_BPA_CTL_ON FORMAT "%1.0" /end CHARACTERISTIC
/begin CHARACTERISTIC lc_bpa_ctl_on_dev "activation flag for boost pressure activation during development" VALUE 0x85c2f5 _REC_VAL_20_u1 1. _CNV_A_R_LINEAR_____0_CM 0. 1. DISPLAY_IDENTIFIER LC_BPA_CTL_ON_DEV FORMAT "%1.0" /end CHARACTERISTIC
/begin CHARACTERISTIC lc_cdn_bpa_ctl_on_dev "boost pressure activation during development" VALUE 0x85c302 _REC_VAL_20_u1 1. _CNV_A_R_LINEAR_____0_CM 0. 1. DISPLAY_IDENTIFIER LC_CDN_BPA_CTL_ON_DEV FORMAT "%1.0" /end CHARACTERISTIC
/begin CHARACTERISTIC ip_tqi_bpa_cll_ena_0 "AGE_BACT: torque threshold for closed loop BPA enable (inj. state GES = 0)" CURVE 0x85b5be _REC_CUR_20_u2_u2 1023.96875 _CNV_A_R_LINEAR_____62_CM 0. 1023.96875 DISPLAY_IDENTIFIER IP_TQI_BPA_CLL_ENA_0 FORMAT "%6.2"
 /begin AXIS_DESCR COM_AXIS n _CNV_A_R_LINEAR_____5_CM 16 0. 6375. FORMAT "%4.0" AXIS_PTS_REF ldpm_n_ip_tqi_bpa_act_0 /end AXIS_DESCR
/end CHARACTERISTIC
/begin AXIS_PTS ldpm_n_ip_tqi_bpa_act_0 "torque threshold for closed loop BPA enable (inj. state GES = 0)" 0x843d2e n _REC_AXS_20_u2 6375. _CNV_A_R_LINEAR_____5_CM 16 0. 6375. FORMAT "%4.0" /end AXIS_PTS
/begin CHARACTERISTIC ip_tqi_bpa_cll_di_0 "AGE_BACT: torque threshold for closed loop BPA disable (inj. state GES = 0)" CURVE 0x85b57e _REC_CUR_20_u2_u2 1023.96875 _CNV_A_R_LINEAR_____62_CM 0. 1023.96875 DISPLAY_IDENTIFIER IP_TQI_BPA_CLL_DI_0 FORMAT "%6.2"
 /begin AXIS_DESCR COM_AXIS n _CNV_A_R_LINEAR_____5_CM 16 0. 6375. FORMAT "%4.0" AXIS_PTS_REF ldpm_n_ip_tqi_bpa_act_0 /end AXIS_DESCR
/end CHARACTERISTIC
/begin CHARACTERISTIC ip_tqi_bpa_cll_ena_1 "AGE_BACT: torque threshold for closed loop BPA enable (inj. state GES = 1)" CURVE 0x85b5de _REC_CUR_20_u2_u2 1023.96875 _CNV_A_R_LINEAR_____62_CM 0. 1023.96875 DISPLAY_IDENTIFIER IP_TQI_BPA_CLL_ENA_1 FORMAT "%6.2"
 /begin AXIS_DESCR COM_AXIS n _CNV_A_R_LINEAR_____5_CM 16 0. 6375. FORMAT "%4.0" AXIS_PTS_REF ldpm_n_ip_tqi_bpa_act_1 /end AXIS_DESCR
/end CHARACTERISTIC
/begin AXIS_PTS ldpm_n_ip_tqi_bpa_act_1 "torque threshold for closed loop BPA enable (inj. state GES = 1)" 0x843d50 n _REC_AXS_20_u2 6375. _CNV_A_R_LINEAR_____5_CM 16 0. 6375. FORMAT "%4.0" /end AXIS_PTS
/begin CHARACTERISTIC ip_tqi_bpa_cll_di_1 "AGE_BACT: torque threshold for closed loop BPA disable (inj. state GES = 1)" CURVE 0x85b59e _REC_CUR_20_u2_u2 1023.96875 _CNV_A_R_LINEAR_____62_CM 0. 1023.96875 DISPLAY_IDENTIFIER IP_TQI_BPA_CLL_DI_1 FORMAT "%6.2"
 /begin AXIS_DESCR COM_AXIS n _CNV_A_R_LINEAR_____5_CM 16 0. 6375. FORMAT "%4.0" AXIS_PTS_REF ldpm_n_ip_tqi_bpa_act_1 /end AXIS_DESCR
/end CHARACTERISTIC
/begin COMPU_METHOD _CNV_A_R_LINEAR_____0_CM "" RAT_FUNC "%6.3" "[-]" COEFFS 0 1. 0. 0 0 1 /end COMPU_METHOD
/begin COMPU_METHOD _CNV_A_R_LINEAR_____5_CM "" RAT_FUNC "%6.3" "[rpm]" COEFFS 0 1. 0. 0 0 1 /end COMPU_METHOD
/begin COMPU_METHOD _CNV_A_R_LINEAR_____7_CM "" RAT_FUNC "%6.3" "[cm^2]" COEFFS 0 839.3314549180328 0. 0 0 1 /end COMPU_METHOD
/begin COMPU_METHOD _CNV_A_R_LINEAR_____8_CM "" RAT_FUNC "%6.3" "[%]" COEFFS 0 655.3599999999997 0. 0 0 1 /end COMPU_METHOD
/begin COMPU_METHOD _CNV_S_2_RANGE______11_CM "" TAB_VERB "%6.3" "[-]" COMPU_TAB_REF _CNV_S_2_RANGE______11 /end COMPU_METHOD
/begin COMPU_VTAB _CNV_S_2_RANGE______11 "" TAB_VERB 2 0 "0" 1 "1" /end COMPU_VTAB
/begin COMPU_METHOD _CNV_A_R_LINEAR_____12_CM "" RAT_FUNC "%6.3" "[%]" COEFFS 0 327.6800000003072 3.071909304708242e-008 0 0 1 /end COMPU_METHOD
/begin COMPU_METHOD _CNV_A_R_LINEAR_____13_CM "" RAT_FUNC "%6.3" "[-]" COEFFS 0 4096.000220003369 0. 0 0 1 /end COMPU_METHOD
/begin COMPU_METHOD _CNV_A_R_LINEAR_____14_CM "" RAT_FUNC "%6.3" "[-]" COEFFS 0 65535.99999999996 0. 0 0 1 /end COMPU_METHOD
/begin COMPU_METHOD _CNV_A_R_LINEAR_____18_CM "" RAT_FUNC "%6.3" "[°C]" COEFFS 0 1. 50. 0 0 1 /end COMPU_METHOD
/begin COMPU_METHOD _CNV_A_R_LINEAR_____19_CM "" RAT_FUNC "%6.3" "[s]" COEFFS 0 10. 0. 0 0 1 /end COMPU_METHOD
/begin COMPU_METHOD _CNV_A_R_LINEAR_____20_CM "" RAT_FUNC "%6.3" "[°C]" COEFFS 0 1. 0. 0 0 1 /end COMPU_METHOD
/begin COMPU_METHOD _CNV_A_R_LINEAR_____21_CM "" RAT_FUNC "%6.3" "[hPa]" COEFFS 0 12.06017666543982 0. 0 0 1 /end COMPU_METHOD
/begin COMPU_METHOD _CNV_A_R_LINEAR_____23_CM "" RAT_FUNC "%6.3" "[mg/stk]" COEFFS 0 47.18142548596112 0. 0 0 1 /end COMPU_METHOD
/begin COMPU_METHOD _CNV_A_R_LINEAR_____24_CM "" RAT_FUNC "%6.3" "[-]" COEFFS 0 128. 0. 0 0 1 /end COMPU_METHOD
/begin COMPU_METHOD _CNV_A_R_LINEAR_____43_CM "" RAT_FUNC "%6.3" "[mg/stk]" COEFFS 0 250. 0. 0 0 1 /end COMPU_METHOD
/begin COMPU_METHOD _CNV_A_R_LINEAR_____53_CM "" RAT_FUNC "%6.3" "[-]" COEFFS 0 32767.99807357072 0. 0 0 1 /end COMPU_METHOD
/begin COMPU_METHOD _CNV_A_R_LINEAR_____60_CM "" RAT_FUNC "%6.3" "[hPa]" COEFFS 0 12.06036070024094 2.255463186884299e-005 0 0 1 /end COMPU_METHOD
/begin COMPU_METHOD _CNV_A_R_LINEAR_____62_CM "" RAT_FUNC "%6.3" "[Nm]" COEFFS 0 32. 0. 0 0 1 /end COMPU_METHOD
/begin COMPU_METHOD _CNV_A_R_LINEAR_____63_CM "" RAT_FUNC "%6.3" "[-]" COEFFS 0 16383.81262712377 0. 0 0 1 /end COMPU_METHOD
/begin COMPU_METHOD _CNV_A_R_LINEAR_____67_CM "" RAT_FUNC "%6.3" "[s]" COEFFS 0 15625. 0. 0 0 1 /end COMPU_METHOD
/begin COMPU_METHOD _CNV_A_R_LINEAR_____76_CM "" RAT_FUNC "%6.3" "[s]" COEFFS 0 1000. 0. 0 0 1 /end COMPU_METHOD
/begin COMPU_METHOD _CNV_A_R_LINEAR_____89_CM "" RAT_FUNC "%6.3" "[Nm]" COEFFS 0 32. 32768. 0 0 1 /end COMPU_METHOD
/begin COMPU_METHOD _CNV_A_R_LINEAR_____97_CM "" RAT_FUNC "%6.3" "[Nm/s]" COEFFS 0 1. 0. 0 0 1 /end COMPU_METHOD
/begin COMPU_METHOD _CNV_A_R_LINEAR_____101_CM "" RAT_FUNC "%6.3" "[°C]" COEFFS 0 16. 0. 0 0 1 /end COMPU_METHOD
/begin COMPU_METHOD _CNV_A_R_LINEAR_____112_CM "" RAT_FUNC "%6.3" "[kg/h]" COEFFS 0 64. 0. 0 0 1 /end COMPU_METHOD
/begin COMPU_METHOD _CNV_A_R_LINEAR_____130_CM "" RAT_FUNC "%6.3" "[-]" COEFFS 0 655.35 0. 0 0 1 /end COMPU_METHOD
/begin COMPU_METHOD _CNV_A_R_LINEAR_____136_CM "" RAT_FUNC "%6.3" "[%]" COEFFS 0 655.35 0. 0 0 1 /end COMPU_METHOD
/begin COMPU_METHOD _CNV_A_R_LINEAR_____141_CM "" RAT_FUNC "%6.3" "[%]" COEFFS 0 655.3600000071681 32768.00000035841 0 0 1 /end COMPU_METHOD
/begin COMPU_METHOD _CNV_A_R_LINEAR_____145_CM "" RAT_FUNC "%6.3" "[-]" COEFFS 0 10000. 0. 0 0 1 /end COMPU_METHOD
/begin COMPU_METHOD _CNV_A_R_LINEAR_____147_CM "" RAT_FUNC "%6.3" "[hPa]" COEFFS 0 12.06017666543982 32768.00000286437 0 0 1 /end COMPU_METHOD
/begin COMPU_METHOD _CNV_A_R_LINEAR_____149_CM "" RAT_FUNC "%6.3" "[mg/stk]" COEFFS 0 47.18213882283317 -4.587542360241059e-003 0 0 1 /end COMPU_METHOD
/begin COMPU_METHOD _CNV_A_R_LINEAR_____153_CM "" RAT_FUNC "%6.3" "[°C]" COEFFS 0 64. 0. 0 0 1 /end COMPU_METHOD
/begin COMPU_METHOD _CNV_A_R_LINEAR_____154_CM "" RAT_FUNC "%6.3" "[cm^2]" COEFFS 0 419.6646578731184 -1.793924711819273e-004 0 0 1 /end COMPU_METHOD
/begin COMPU_METHOD _CNV_A_R_LINEAR_____155_CM "" RAT_FUNC "%6.3" "[%]" COEFFS 0 327.68 0. 0 0 1 /end COMPU_METHOD
/begin COMPU_METHOD _CNV_A_R_LINEAR_____156_CM "" RAT_FUNC "%6.3" "[cm^2/%]" COEFFS 0 20983.23262491643 0. 0 0 1 /end COMPU_METHOD
/begin COMPU_METHOD _CNV_A_R_LINEAR_____157_CM "" RAT_FUNC "%6.3" "[%*s/(N*m)]" COEFFS 0 32767.9915198728 -8.480127202346921e-003 0 0 1 /end COMPU_METHOD
/begin COMPU_METHOD _CNV_A_R_LINEAR_____158_CM "" RAT_FUNC "%6.3" "[%]" COEFFS 0 327.680000069121 32768.0000069121 0 0 1 /end COMPU_METHOD
/begin COMPU_METHOD _CNV_A_R_LINEAR_____159_CM "" RAT_FUNC "%6.3" "[-]" COEFFS 0 1000. 0. 0 0 1 /end COMPU_METHOD
/begin COMPU_METHOD _CNV_A_R_LINEAR_____160_CM "" RAT_FUNC "%6.3" "[J/stk]" COEFFS 0 10. 0. 0 0 1 /end COMPU_METHOD
/begin COMPU_METHOD _CNV_A_R_LINEAR_____161_CM "" RAT_FUNC "%6.3" "[1000 rpm]" COEFFS 0 257. 0. 0 0 1 /end COMPU_METHOD
/begin COMPU_METHOD _CNV_A_R_LINEAR_____162_CM "" RAT_FUNC "%6.3" "[%]" COEFFS 0 100. 0. 0 0 1 /end COMPU_METHOD
/begin COMPU_METHOD _CNV_A_R_LINEAR_____163_CM "" RAT_FUNC "%6.3" "[hPa]" COEFFS 0 10000. 0. 0 0 1 /end COMPU_METHOD
/begin COMPU_METHOD _CNV_A_R_LINEAR_____164_CM "" RAT_FUNC "%6.3" "[-]" COEFFS 0 327.6800000691211 0. 0 0 1 /end COMPU_METHOD
/begin COMPU_METHOD _CNV_A_R_LINEAR_____165_CM "" RAT_FUNC "%6.3" "[J/(kg*K)]" COEFFS 0 25.6 0. 0 0 1 /end COMPU_METHOD
/begin COMPU_METHOD _CNV_A_R_LINEAR_____166_CM "" RAT_FUNC "%6.3" "[J/stk]" COEFFS 0 5. 0. 0 0 1 /end COMPU_METHOD
/begin COMPU_METHOD _CNV_A_R_LINEAR_____167_CM "" RAT_FUNC "%6.3" "[m/s]" COEFFS 0 655.35 0. 0 0 1 /end COMPU_METHOD
/begin COMPU_METHOD _CNV_A_R_LINEAR_____168_CM "" RAT_FUNC "%6.3" "[m]" COEFFS 0 1000. 0. 0 0 1 /end COMPU_METHOD
/begin COMPU_METHOD _CNV_A_R_LINEAR_____169_CM "" RAT_FUNC "%6.3" "[kg]" COEFFS 0 1000. 0. 0 0 1 /end COMPU_METHOD
/begin COMPU_METHOD _CNV_A_R_LINEAR_____170_CM "" RAT_FUNC "%6.3" "[mg]" COEFFS 0 1. 0. 0 0 1 /end COMPU_METHOD
/begin COMPU_METHOD _CNV_A_R_LINEAR_____171_CM "" RAT_FUNC "%6.3" "[-]" COEFFS 0 3280.080101322868 0. 0 0 1 /end COMPU_METHOD
/begin COMPU_METHOD _CNV_A_R_LINEAR_____172_CM "" RAT_FUNC "%6.3" "[°C/s]" COEFFS 0 32. 0. 0 0 1 /end COMPU_METHOD
/begin COMPU_METHOD _CNV_A_R_LINEAR_____173_CM "" RAT_FUNC "%6.3" "[-]" COEFFS 0 250. 0. 0 0 1 /end COMPU_METHOD
/begin COMPU_METHOD _CNV_A_R_LINEAR_____174_CM "" RAT_FUNC "%6.3" "[W/(m^2*K)]" COEFFS 0 100. 0. 0 0 1 /end COMPU_METHOD
/begin COMPU_METHOD _CNV_A_R_LINEAR_____175_CM "" RAT_FUNC "%6.3" "[hPa*h^2/(kg*m^3)]" COEFFS 0 10000. 0. 0 0 1 /end COMPU_METHOD
/begin COMPU_METHOD _CNV_A_R_LINEAR_____176_CM "" RAT_FUNC "%6.3" "[kg*K/(m^3*hPa)]" COEFFS 0 256. 0. 0 0 1 /end COMPU_METHOD
/begin COMPU_METHOD _CNV_A_R_LINEAR_____177_CM "" RAT_FUNC "%6.3" "[rpm/1000]" COEFFS 0 65.53600007936122 0. 0 0 1 /end COMPU_METHOD
/begin COMPU_METHOD _CNV_A_R_LINEAR_____178_CM "" RAT_FUNC "%6.3" "[MJ/kg]" COEFFS 0 655.35 0. 0 0 1 /end COMPU_METHOD
/begin COMPU_METHOD _CNV_A_R_LINEAR_____179_CM "" RAT_FUNC "%6.3" "[cm^2]" COEFFS 0 64. 0. 0 0 1 /end COMPU_METHOD
/begin COMPU_METHOD _CNV_A_R_LINEAR_____180_CM "" RAT_FUNC "%6.3" "[m]" COEFFS 0 65535.99999999996 0. 0 0 1 /end COMPU_METHOD
/begin COMPU_METHOD _CNV_A_R_LINEAR_____181_CM "" RAT_FUNC "%6.3" "[cm^2]" COEFFS 0 1. 0. 0 0 1 /end COMPU_METHOD
/begin COMPU_METHOD _CNV_A_R_LINEAR_____182_CM "" RAT_FUNC "%6.3" "[dm^3]" COEFFS 0 10000. 0. 0 0 1 /end COMPU_METHOD
/begin COMPU_METHOD _CNV_A_R_LINEAR_____183_CM "" RAT_FUNC "%6.3" "[mm]" COEFFS 0 1000. 0. 0 0 1 /end COMPU_METHOD
/begin COMPU_METHOD _CNV_A_R_LINEAR_____184_CM "" RAT_FUNC "%6.3" "[kg/m^3]" COEFFS 0 3.90625 0. 0 0 1 /end COMPU_METHOD
/begin COMPU_METHOD _CNV_A_R_LINEAR_____185_CM "" RAT_FUNC "%6.3" "[J/(kg*K)]" COEFFS 0 12.06017666543982 0. 0 0 1 /end COMPU_METHOD
/begin COMPU_METHOD _CNV_A_R_LINEAR_____186_CM "" RAT_FUNC "%6.3" "[(m/s)^3]" COEFFS 0 1. 0. 0 0 1 /end COMPU_METHOD
/begin COMPU_METHOD _CNV_A_R_LINEAR_____187_CM "" RAT_FUNC "%6.3" "[-]" COEFFS 0 131.07 0. 0 0 1 /end COMPU_METHOD
/begin COMPU_METHOD _CNV_A_R_LINEAR_____188_CM "" RAT_FUNC "%6.3" "[-]" COEFFS 0 22727.27272727273 0. 0 0 1 /end COMPU_METHOD
/begin COMPU_METHOD _CNV_A_R_LINEAR_____189_CM "" RAT_FUNC "%6.3" "[-]" COEFFS 0 26111.60074651248 0. 0 0 1 /end COMPU_METHOD
/begin COMPU_METHOD _CNV_A_R_LINEAR_____190_CM "" RAT_FUNC "%6.3" "[-]" COEFFS 0 32.7675 0. 0 0 1 /end COMPU_METHOD
/begin COMPU_METHOD _CNV_A_R_LINEAR_____191_CM "" RAT_FUNC "%6.3" "[-]" COEFFS 0 2048. 0. 0 0 1 /end COMPU_METHOD
/begin COMPU_METHOD _CNV_A_R_LINEAR_____192_CM "" RAT_FUNC "%6.3" "[W/(m^2*K)]" COEFFS 0 64. 0. 0 0 1 /end COMPU_METHOD
/begin COMPU_METHOD _CNV_A_R_LINEAR_____193_CM "" RAT_FUNC "%6.3" "[-]" COEFFS 0 5119.999874998096 0. 0 0 1 /end COMPU_METHOD
/begin COMPU_METHOD _CNV_A_R_LINEAR_____194_CM "" RAT_FUNC "%6.3" "[1e-6 * kg/(m*s)]" COEFFS 0 250. 0. 0 0 1 /end COMPU_METHOD
/begin COMPU_METHOD _CNV_A_R_LINEAR_____195_CM "" RAT_FUNC "%6.3" "[1e-3 * W/(m*K)]" COEFFS 0 250. 0. 0 0 1 /end COMPU_METHOD
/begin COMPU_METHOD _CNV_A_R_LINEAR_____196_CM "" RAT_FUNC "%6.3" "[hPa]" COEFFS 0 16383.81262712377 0. 0 0 1 /end COMPU_METHOD
/begin COMPU_METHOD _CNV_A_R_LINEAR_____197_CM "" RAT_FUNC "%6.3" "[s/m]" COEFFS 0 3276799.15198728 0. 0 0 1 /end COMPU_METHOD
/begin COMPU_METHOD _CNV_A_R_LINEAR_____198_CM "" RAT_FUNC "%6.3" "[°C]" COEFFS 0 64. 3200. 0 0 1 /end COMPU_METHOD
/begin COMPU_METHOD _CNV_A_R_LINEAR_____199_CM "" RAT_FUNC "%6.3" "[cm^3]" COEFFS 0 48.78293881196963 0. 0 0 1 /end COMPU_METHOD
/begin COMPU_METHOD _CNV_A_R_LINEAR_____200_CM "" RAT_FUNC "%6.3" "[dm^3]" COEFFS 0 48.78293881196963 0. 0 0 1 /end COMPU_METHOD
/begin COMPU_METHOD _CNV_A_R_LINEAR_____201_CM "" RAT_FUNC "%6.3" "[%]" COEFFS 0 327.7613897082924 0. 0 0 1 /end COMPU_METHOD
/begin COMPU_METHOD _CNV_A_R_LINEAR_____202_CM "" RAT_FUNC "%6.3" "[%*s/hPa]" COEFFS 0 13266.62402021118 32768.0306649608 0 0 1 /end COMPU_METHOD
/begin COMPU_METHOD _CNV_A_R_LINEAR_____203_CM "" RAT_FUNC "%6.3" "[%/hPa]" COEFFS 0 27821.2326077497 0. 0 0 1 /end COMPU_METHOD
/begin COMPU_METHOD _CNV_A_R_LINEAR_____262_CM "" RAT_FUNC "%6.3" "[%]" COEFFS 0 1. 0. 0 0 1 /end COMPU_METHOD
/begin COMPU_METHOD _CNV_A_R_LINEAR_____372_CM "" RAT_FUNC "%6.3" "[-]" COEFFS 0 65535. 0. 0 0 1 /end COMPU_METHOD
/begin COMPU_METHOD _CNV_A_R_LINEAR_____399_CM "" RAT_FUNC "%6.3" "[%]" COEFFS 0 163.8400026560406 5.312081193551421e-004 0 0 1 /end COMPU_METHOD
/begin COMPU_METHOD _CNV_A_R_LINEAR_____400_CM "" RAT_FUNC "%6.3" "[mNm]" COEFFS 0 65.53600007936122 0. 0 0 1 /end COMPU_METHOD
/begin COMPU_METHOD _CNV_A_R_LINEAR_____401_CM "" RAT_FUNC "%6.3" "[V]" COEFFS 0 655.3599999999997 0. 0 0 1 /end COMPU_METHOD
/begin COMPU_METHOD _CNV_A_R_LINEAR_____402_CM "" RAT_FUNC "%6.3" "[ohm]" COEFFS 0 6553.582575140446 0. 0 0 1 /end COMPU_METHOD
/begin COMPU_METHOD _CNV_A_R_LINEAR_____403_CM "" RAT_FUNC "%6.3" "[-]" COEFFS 0 655.3599999999997 0. 0 0 1 /end COMPU_METHOD
/begin COMPU_METHOD _CNV_A_R_LINEAR_____404_CM "" RAT_FUNC "%6.3" "[1/K]" COEFFS 0 524280. 0. 0 0 1 /end COMPU_METHOD
/begin COMPU_METHOD _CNV_A_R_LINEAR_____405_CM "" RAT_FUNC "%6.3" "[-]" COEFFS 0 16383.99985599781 -2.880043903132901e-004 0 0 1 /end COMPU_METHOD
/begin COMPU_METHOD _CNV_A_R_LINEAR_____406_CM "" RAT_FUNC "%6.3" "[s]" COEFFS 0 8143.462117710212 32767.5 0 0 1 /end COMPU_METHOD
/begin COMPU_METHOD _CNV_A_R_LINEAR_____407_CM "" RAT_FUNC "%6.3" "[s]" COEFFS 0 524280. 0. 0 0 1 /end COMPU_METHOD
/begin COMPU_METHOD _CNV_A_R_LINEAR_____408_CM "" RAT_FUNC "%6.3" "[s]" COEFFS 0 4096.000220003369 0. 0 0 1 /end COMPU_METHOD
/begin COMPU_METHOD _CNV_A_R_LINEAR_____409_CM "" RAT_FUNC "%6.3" "[A]" COEFFS 0 6553.582575140446 0. 0 0 1 /end COMPU_METHOD
/begin COMPU_METHOD _CNV_A_R_LINEAR_____410_CM "" RAT_FUNC "%6.3" "[%]" COEFFS 0 163.8399997887968 32767.99995775936 0 0 1 /end COMPU_METHOD
/begin COMPU_METHOD _CNV_A_R_LINEAR_____411_CM "" RAT_FUNC "%6.3" "[%]" COEFFS 0 1.28 128. 0 0 1 /end COMPU_METHOD
/begin COMPU_METHOD _CNV_A_R_LINEAR_____414_CM "" RAT_FUNC "%6.3" "[ms]" COEFFS 0 1. 0. 0 0 1 /end COMPU_METHOD
/begin COMPU_METHOD _CNV_A_R_LINEAR_____415_CM "" RAT_FUNC "%6.3" "[%/5ms]" COEFFS 0 655.3599999999997 0. 0 0 1 /end COMPU_METHOD
/begin COMPU_METHOD _CNV_A_R_LINEAR_____416_CM "" RAT_FUNC "%6.3" "[-]" COEFFS 0 15625. 0. 0 0 1 /end COMPU_METHOD
/begin COMPU_METHOD _CNV_A_R_LINEAR_____417_CM "" RAT_FUNC "%6.3" "[s]" COEFFS 0 50. 0. 0 0 1 /end COMPU_METHOD
/begin RECORD_LAYOUT _REC_VAL_20_u1 FNC_VALUES 1 UBYTE COLUMN_DIR DIRECT /end RECORD_LAYOUT
/begin RECORD_LAYOUT _REC_AXS_20_u2 NO_AXIS_PTS_X 1 UWORD AXIS_PTS_X 2 UWORD INDEX_INCR DIRECT /end RECORD_LAYOUT
/begin RECORD_LAYOUT _REC_CUR_20_u1_u2 FNC_VALUES 1 UBYTE COLUMN_DIR DIRECT /end RECORD_LAYOUT
/begin RECORD_LAYOUT _REC_MAP_20_u2_u2_u2 FNC_VALUES 1 UWORD COLUMN_DIR DIRECT /end RECORD_LAYOUT
/begin RECORD_LAYOUT _REC_VAL_20_u2 FNC_VALUES 1 UWORD COLUMN_DIR DIRECT /end RECORD_LAYOUT
/begin RECORD_LAYOUT _REC_VAL_20_s2 FNC_VALUES 1 SWORD COLUMN_DIR DIRECT /end RECORD_LAYOUT
/begin RECORD_LAYOUT _REC_AXS_20_u1 NO_AXIS_PTS_X 1 UBYTE AXIS_PTS_X 2 UBYTE INDEX_INCR DIRECT /end RECORD_LAYOUT
/begin RECORD_LAYOUT _REC_CUR_20_u2_u2 FNC_VALUES 1 UWORD COLUMN_DIR DIRECT /end RECORD_LAYOUT
/begin RECORD_LAYOUT _REC_CUR_20_u2_u1 FNC_VALUES 1 UWORD COLUMN_DIR DIRECT /end RECORD_LAYOUT
/begin RECORD_LAYOUT _REC_MAP_20_u2_u2_u1 FNC_VALUES 1 UWORD COLUMN_DIR DIRECT /end RECORD_LAYOUT
/begin RECORD_LAYOUT _REC_CUR_20_u1_u1 FNC_VALUES 1 UBYTE COLUMN_DIR DIRECT /end RECORD_LAYOUT
/begin RECORD_LAYOUT _REC_MAP_20_u2_u1_u2 FNC_VALUES 1 UWORD COLUMN_DIR DIRECT /end RECORD_LAYOUT
/begin RECORD_LAYOUT _REC_CUR_20_s2_u2 FNC_VALUES 1 SWORD COLUMN_DIR DIRECT /end RECORD_LAYOUT
/begin FUNCTION GES_EGPT ""
 /begin DEF_CHARACTERISTIC lc_act_ex_clc_mpg c_pow_ecf_sub c_fac_temp_ex_fil c_fac_dip_ico c_fac_rho_stnd_in c_n_tcha_stnd c_fac_cmp_cor c_fac_dip_out c_fac_rho_stnd_eg c_dee c_ar_heat_tran_cyl c_cmp_ratio c_diam_fan c_ar_heat_tran_ex_port c_vol_ex_port c_thkn_wall_ex_port c_rho_ex_port c_capa_heat_ex_port c_fac_bpa_psn_fil ip_fac_temp_ex__tco ldp_tco_ip_fac_temp_ex ip_fac_temp_ex__dip_pf ldp_dip_pf_ip_fac_temp_ex ip_fac_prs_ex__tco ldp_tco_ip_fac_prs_ex ip_maf_max__n ldp_n_ip_maf_max ip_tcha_fac1__pq_cmp ldp_pq_cmp_ip_tcha_fac1 ip_tcha_fac2__tcha_bal ldp_tcha_bal_ip_tcha_fac2 ip_fac1_cmp__pq_cmp ldp_pq_cmp_ip_fac1_cmp ip_eff_tcha_mec__n_tcha_stnd ldp_n_tcha_stnd_ip_eff_tcha_mec ip_fac_exp__kapa ldp_kapa_ip_fac_exp ip_fac_temp_eb__vel_air_eb ldp_vel_air_eb_ip_fac_temp_eb ip_vel_air_eb__vel_air_am ldp_vel_air_am_ip_vel_air_eb ip_vel_fan__pow_fan ldp_pow_fan_ip_vel_fan ip_delta_temp_ex_port__fac ldp_fac_ip_delta_temp_ex_port ip_fac1_nu_it__rey ldp_rey_fac1_nu_it ip_fac2_nu_it__div_diam_len ldp_div_diam_len_ip_fac2_nu_it ip_fac3_nu_it__div_visc ldp_div_visc_ip_fac3_nu_it ip_nu_ext__rey ip_div_t_tur__div_prs_tur ldp_div_prs_tur_ip_div_t_tur ip_amp_dec__maf_kgh ip_temp_ex_bas__n__mf ldp_n_ip_temp_ex ldp_mf_ip_temp_ex ip_fac_temp_ex__maf_rel__egr ldp_maf_rel_ip_fac_temp_ex ldp_egr_ip_fac_temp_ex ldp_n_ip_prs_ex ldp_mf_ip_prs_ex ip_fac_prs_ex__maf_rel__egr ldp_maf_rel_ip_fac_prs_ex ldp_egr_ip_fac_prs_ex ip_fac_mfw_tur__temp_ex__prs_ex ldp_temp_ex_ip_fac_mfw_tur_stnd ldp_prs_ex_ip_fac_mfw_tur_stnd ip_fac1_maf_stnd__tia__amp ldp_tia_ip_fac1_maf_stnd ldp_amp_ip_fac1_maf_stnd ip_eff_cmp__maf_stnd__pq_cmp ldp_maf_stnd_ip_eff_cmp ldp_pq_cmp_ip_eff_cmp ip_n_tcha_stnd__maf_stnd__pq ldp_maf_stnd_ip_n_tcha_stnd ldp_pq_cmp_ip_n_tcha_stnd ip_eff_tur__bpa_psn__mfw_tur ldp_bpa_psn_ip_eff_tur ldp_mfw_tur_ip_eff_tur ip_capa_heat_prs_ex__temp__lamb ldpm_temp_ip_capa_heat_prs_ex ldpm_lamb_ip_capa_heat_prs_ex ip_fac_heat_tran_cyl__n__mf ldp_n_ip_fac_heat_tran_cyl ldp_mf_ip_fac_heat_tran_cyl ip_fac_temp_cmp__kappa__cmp ldp_kappa_ip_fac_temp_cmp ldp_cmp_ratio_ip_fac_temp_cmp ip_visc_ex__temp__lamb ip_heat_cond_ex__temp__lamb ip_capa_heat_vol_ex__temp__lamb ip_bpa_psn__div_prs_tur__m_tur ldp_pq_tur_ip_bpa_psn ldpm_mfw_tur_ip_pq_tur ldp_maf_kgh_ip_map_dec ip_prs_ex_bas__n__mf /end DEF_CHARACTERISTIC
 /begin OUT_MEASUREMENT prs_ex temp_ex temp_ex_sp prs_ex_sp w_ind temp_ex_gas_up_pf[0] temp_ex_gas_up_pf[1] prs_ex_mdl[0] prs_ex_mdl[1] maf_cmp_kgh[0] maf_cmp_kgh[1] dip_ico[0] dip_ico[1] prs_up_cmp[0] prs_up_cmp[1] eff_tcha[0] eff_tcha[1] n_tcha[0] n_tcha[1] eff_tur[0] eff_tur[1] eff_mec_tcha[0] eff_mec_tcha[1] eff_tur_cor[0] eff_tur_cor[1] prs_down_cmp[0] prs_down_cmp[1] eff_cmp[0] eff_cmp[1] temp_down_cmp[0] temp_down_cmp[1] pq_cmp[0] pq_cmp[1] maf_kgh_stnd[0] maf_kgh_stnd[1] m_tur_kgh[0] m_tur_kgh[1] m_tur[0] m_tur[1] m_tur_kgh_stnd[0] m_tur_kgh_stnd[1] inv_div_prs_tur[0] inv_div_prs_tur[1] n_tcha_stnd[0] n_tcha_stnd[1] div_capa_heat_prs[0] div_capa_heat_prs[1] div_temp[0] div_temp[1] tcha_fac1[0] tcha_fac1[1] tcha_fac2[0] tcha_fac2[1] tcha_fac3[0] tcha_fac3[1] tcha_fac4[0] tcha_fac4[1] tcha_fac5[0] tcha_fac5[1] tcha_fac6[0] tcha_fac6[1] div_mass[0] div_mass[1] prs_ex_gas_up_tur[0] prs_ex_gas_up_tur[1] capa_heat_prs_ex[0] capa_heat_prs_ex[1] kapa_ex[0] kapa_ex[1] capa_heat_vol_ex_mwm[0] capa_heat_vol_ex_mwm[1] div_t_tur[0] div_t_tur[1] bpa_psn[0] bpa_psn[1] prs_ex_gas_down_pf[0] prs_ex_gas_down_pf[1] prs_ex_gas_up_pf[0] prs_ex_gas_up_pf[1] dip_out[0] dip_out[1] heat_cyl_in[0] heat_cyl_in[1] heat_cyl_out[0] heat_cyl_out[1] temp_cyl_gas_out[0] temp_cyl_gas_out[1] heat_cyl_comb[0] heat_cyl_comb[1] heat_cyl_wall[0] heat_cyl_wall[1] temp_cyl_gas_cmp[0] temp_cyl_gas_cmp[1] temp_cyl_gas_comb[0] temp_cyl_gas_comb[1] temp_cyl_gas_mvm[0] temp_cyl_gas_mvm[1] temp_cyl_gas_exp[0] temp_cyl_gas_exp[1] vel_air_eb temp_air_eb diam_ex_port div_diam_len_ex_port mass_ex_port temp_wall_ex_port[0] temp_wall_ex_port[1] temp_ex_gas_up_tur_stat[0] temp_ex_gas_up_tur_stat[1] mass_ex_gas_ex_port[0] mass_ex_gas_ex_port[1] stanton_it[0] stanton_it[1] grd_temp_wall_ex_port[0] grd_temp_wall_ex_port[1] temp_ex_mdl[0] temp_ex_mdl[1] reynolds_it[0] reynolds_it[1] fac_heat_tran_ex_port_it[0] fac_heat_tran_ex_port_it[1] reynolds_ext[0] reynolds_ext[1] fac_heat_tran_ex_port_ext[0] fac_heat_tran_ex_port_ext[1] bpa_psn_mmv bpa_psn_sp_mmv dip_air_fil dip_air_fil_sp /end OUT_MEASUREMENT
/end FUNCTION
/begin FUNCTION GES_AGE_BACT ""
 /begin DEF_CHARACTERISTIC lc_bpa_ctl_on lc_bpa_ctl_on_dev lc_cdn_bpa_ctl_on_dev ip_tqi_bpa_cll_ena_0 ldpm_n_ip_tqi_bpa_act_0 ip_tqi_bpa_cll_di_0 ip_tqi_bpa_cll_ena_1 ldpm_n_ip_tqi_bpa_act_1 ip_tqi_bpa_cll_di_1 /end DEF_CHARACTERISTIC
 /begin OUT_MEASUREMENT lv_cdn_bpa_ctl_on lv_cdn_bpa_ctl_on_req lv_cdn_bpa_ctl_ena_0 lv_cdn_bpa_ctl_ena_1 lv_cdn_bpa_ctl_ena /end OUT_MEASUREMENT
/end FUNCTION
/begin FUNCTION GES_AGE_MPRE ""
 /begin DEF_CHARACTERISTIC c_mafpwm_pctl_man lc_mafpwm_pctl_man c_fac_mafpwm_pctl_is_fil c_mafpwm_pctl_off c_fac_mafpwm_pctl_ini_fil lc_mafpwm_pctl_on ip_fac_mafpwm_pctl_cor_amp_0 ldp_amp_ip_fac_mafpwm_pctl_0 ip_fac_mafpwm_pctl_cor_tgas_0 ldp_tgas_ip_fac_mafpwm_pctl_0 ip_fac_tran_mafpwm_pctl_1 ldp_tco_ip_fac_tran_mafpwm_1 ip_fac_mafpwm_pctl_cor_amp_1 ldp_amp_ip_fac_mafpwm_pctl_1 ip_fac_mafpwm_pctl_cor_tgas_1 ldp_tgas_ip_fac_mafpwm_pctl_1 ip_mafpwm_pctl_bas_0_1 ldpm_n_ip_mafpwm_pctl_bas_0 ldpm_tqi_ip_mafpwm_pctl_bas_0 ip_mafpwm_pctl_bas_0_0 ip_mafpwm_pctl_bas_0_2 ip_mafpwm_pctl_cor_tgas_0 ldp_n_ip_mafpwm_pctl_tgas_0 ldp_tqi_ip_mafpwm_pctl_tgas_0 ip_mafpwm_pctl_cor_amp_0 ldp_n_ip_mafpwm_pctl_amp_0 ldp_tqi_ip_mafpwm_pctl_amp_0 ip_mafpwm_pctl_bas_1_1 ldpm_n_ip_mafpwm_pctl_bas_1 ldpm_tqi_ip_mafpwm_pctl_bas_1 ip_mafpwm_pctl_bas_1_0 ip_mafpwm_pctl_bas_1_2 ip_mafpwm_pctl_cor_tgas_1 ldp_n_ip_mafpwm_pctl_tgas_1 ldp_tqi_ip_mafpwm_pctl_tgas_1 ip_mafpwm_pctl_cor_amp_1 ldp_n_ip_mafpwm_pctl_amp_1 ldp_tqi_ip_mafpwm_pctl_amp_1 ip_mafpwm_pctl_is ldp_amp_ip_mafpwm_pctl_is ldp_tgas_ip_mafpwm_pctl_is ip_fac_tran_mafpwm_pctl_0 ldp_tco_ip_fac_tran_mafpwm_0 ldpm_n_ip_mafpwm_pctl_bas_short ldpm_tqi_ip_mafpwm_pctl_bas_short /end DEF_CHARACTERISTIC
 /begin OUT_MEASUREMENT mafpwm_pctl_bas_tco_0 mafpwm_pctl_bas_tco_1 mafpwm_pctl_bas mafpwm_pctl_bas_0 mafpwm_pctl_bas_1 mafpwm_pctl mafpwm_pctl_clc mafpwm_pctl_mmv /end OUT_MEASUREMENT
/end FUNCTION
/begin FUNCTION GES_AGE_EACT ""
 /begin DEF_CHARACTERISTIC lc_egr_ctl_on c_tco_egr_max c_tco_hys_egr c_tco_egr_min c_amp_egr_min c_amp_hys_egr c_tia_hys_egr c_tia_egr_max c_t_dly_egr_di c_tqi_grd_thd_egr_di c_tqi_thd_egr_min ip_t_dly_egr_ast__tco ldp_tco_ip_t_dly_egr_ast ip_tqi_egr_ena_1 ldpm_n_ip_tqi_egr_act_1 ip_tqi_egr_di_1 ip_tqi_egr_ena_0 ldpm_n_ip_tqi_egr_act_0 ip_tqi_egr_di_0 /end DEF_CHARACTERISTIC
 /begin OUT_MEASUREMENT lv_cdn_egr_on_ext lv_cdn_egr_on_eng_state lv_cdn_egr_on_tco lv_cdn_egr_on_amp lv_cdn_egr_on_tia lv_cdn_egr_on_t_ast lv_cdn_egr_on_tqi lv_cdn_egr_on_tqi_grd lv_cdn_egr_on_req_0 lv_cdn_egr_on_req_1 lv_cdn_egr_on_req lv_cdn_egr_on lv_cdn_thr_on /end OUT_MEASUREMENT
/end FUNCTION
/begin FUNCTION GES_AGE_VCLN "" /begin OUT_MEASUREMENT ang_sp_egrv_clean[0] lv_req_egr_pwl[0] /end OUT_MEASUREMENT /end FUNCTION
/begin FUNCTION GES_AGE_VCLP ""
 /begin DEF_CHARACTERISTIC lc_pi_egrv_on[0] c_egrv_ini[0] lc_dt1_egrv_on[0] lc_pctl_egrv_lih c_pctl_egrv_lih c_fac_fil_ang_sp_close_egrv lc_pctl_phys_egrv_on[0] c_gear_trans_ratio_egrv c_temp_mot_egrv_ref c_r_mot_egrv c_temp_mot_egrv[0] lc_ctl_lim_egrv_man lc_ctl_lim_egrv_diag c_fac_ctl_lim_egrv c_ctl_lim_egrv_add c_ctl_lim_egrv_man[0] c_lim_dyn_max_egr[0] c_t_lim_dyn_egr[0] lc_test_egrv[0] c_test_fac_egrv[0] c_test_add_egrv[0] c_ang_sp_egrv_close_tol[0] c_ang_sp_egrv_thd_bol_grd c_ang_sp_egrv_bol_grd c_ang_sp_egrv_tol_grd c_fac_fil_ang_sp_egrv c_ang_sp_egrv_thd_tol_grd ip_kr_dt1_egrv__ctl_dif ldp_ctl_dif__ip_kr_dt1_egrv ip_t1_dt1_egrv__ctl_dif ldp_ctl_dif__ip_t1_dt1_egrv ip_air_foc_egrv__ang_egrv ldp_ang_egrv__ip_air_foc_egrv id_pctl_egrv__t_ang_sp_close_0 ldp_t_ang_close__id_pctl_egrv ip_tq_spr_egrv__ang_sp_egrv ldp_ang_sp_egrv_ip_tq_spr_egrv ip_cur_mot_egrv__tq_mot ldp_tq_mot_egrv__ip_cur_mot ip_pctl_egrv__v_mot_egrv ldp_v_mot_egrv__ip_pctl_egrv ip_ctl_max_egrv_0__temp ldpm_temp__ip_ctl_egrv ip_ctl_min_egrv_0__temp ip_ctl_dyn_lim_egrv_0__temp ip_kr_pi_egrv__ctl_dif__air_foc ldp_ctl_dif__ip_kr_pi_egrv ldpm_air_foc__ip_pi_egrv ip_tn_pi_egrv__ctl_dif__air_foc ldp_ctl_dif__ip_tn_pi_egrv ip_pctl_egrv__ang_sp__air_foc ldp_ang_sp_egrv_ip_pctl_egrv ip_air_foc__n__tqi_sp ldp_n__ip_air_foc ldp_tqi_sp__ip_air_foc /end DEF_CHARACTERISTIC
 /begin OUT_MEASUREMENT ctl_dif_egrv[0] ctl_egrv[0] pi_dt1_egrv[0] lv_edge_ang_sp_egrv_intv[0] pi_egrv[0] dt1_egrv[0] pctl_egrv[0] t_ang_sp_egrv_close[0] tq_mot_egrv[0] v_mot_egrv[0] r_mot_cor_egrv[0] ctl_lim_bas_egrv[0] lim_dif_egrv[0] ctl_lim_egrv[0] ctl_egrv_pre_lim[0] ctl_dyn_lim_egrv[0] ang_sp_egrv_bas[0] test_egrv[0] lv_ang_sp_egrv_close[0] ang_sp_egrv[0] /end OUT_MEASUREMENT
/end FUNCTION
/begin FUNCTION GES_AGE_BCOR "" /begin DEF_CHARACTERISTIC c_fac_bpa_pwm_cor_man[0] c_bpa_pwm_cor_man[0] /end DEF_CHARACTERISTIC /begin OUT_MEASUREMENT fac_bpa_pwm_cor[0] bpa_pwm_cor[0] /end OUT_MEASUREMENT /end FUNCTION
/begin FUNCTION GES_AGE_BCLP ""
 /begin DEF_CHARACTERISTIC lc_test_bpa[0] c_test_fac_bpa[0] c_test_add_bpa[0] lc_dt1_bpa_on[0] lc_pi_bpa_on[0] c_bpa_ini[0] c_gear_trans_ratio_bpa c_fac_temp_cu_el c_temp_mot_bpa_ref c_r_mot_bpa c_pctl_bpa_lih lc_pctl_bpa_lih c_temp_mot_bpa[0] lc_pctl_phys_bpa_on[0] c_ctl_lim_bpa_add c_fac_ctl_lim_bpa lc_ctl_lim_bpa_man c_ctl_lim_bpa_man[0] ip_kr_dt1_bpa__ctl_dif ldp_ctl_dif__ip_kr_dt1_bpa ip_t1_dt1_bpa__ctl_dif ldp_ctl_dif__ip_t1_dt1_bpa ip_kr_pi_bpa__ctl_dif ldp_ctl_dif__ip_kr_pi_bpa ip_tn_pi_bpa__ctl_dif ldp_ctl_dif__ip_tn_pi_bpa ip_tq_spr_bpa__ang_sp_bpa ldp_ang_sp_bpa_ip_tq_spr_bpa ip_cur_mot_bpa__tq_mot ldp_tq_mot_bpa__ip_cur_mot ip_pctl_bpa__v_mot_bpa ldp_v_mot_bpa__ip_pctl_bpa ip_pctl_bpa__ang_sp_bpa ldp_ang_sp_bpa_ip_pctl_bpa ip_ctl_max_bpa_0__temp ldpm_temp__ip_ctl_bpa ip_ctl_min_bpa_0__temp /end DEF_CHARACTERISTIC
 /begin OUT_MEASUREMENT ang_sp_bpa[0] test_bpa[0] ctl_dif_bpa[0] ctl_bpa[0] pi_dt1_bpa[0] dt1_bpa[0] pi_bpa[0] tq_mot_bpa[0] v_mot_bpa[0] r_mot_cor_bpa[0] pctl_bpa[0] ctl_lim_bpa[0] lim_dif_bpa[0] ctl_lim_bas_bpa[0] /end OUT_MEASUREMENT
/end FUNCTION
/begin FUNCTION GES_AGE_TPRE ""
 /begin DEF_CHARACTERISTIC c_fac_ar_thr_pctl_fil lc_thr_pctl_on ip_fac_mfw_the__temp_in ldp_temp_in_ip_fac_mfw_the ip_fac_mfw_the__pq ldp_pq_ip_fac_mfw_the ip_map_sp_ref_0 ldpm_tqi_sp_ip_mf_pf ip_map_sp_ref_1 /end DEF_CHARACTERISTIC
 /begin OUT_MEASUREMENT ar_thr_pctl_the mafpwm_max ar_thr_pctl_the_bas pq_thr_sp map_sp_ref /end OUT_MEASUREMENT
/end FUNCTION
/begin FUNCTION GES_AGE_BCTL ""
 /begin DEF_CHARACTERISTIC c_bpapwm_dt1_max c_bpapwm_dt1_min lc_bpa_dt1_map_dif_on c_fac_bpapwm_ctl_off_fil ip_tn_dt1_bpa__n ldpm_n_ip_map_ctl ip_fac_kr_pi_map__map_dif ldpm_map_dif_ip_map ip_fac_tn_pi_map__map_dif ip_kr_dt1_bpa__n__map_dif ldp_map_dif_ip_kr_dt1_bpa ip_kr_pi_map ldpm_n_ip_ctl_pi_map ldpm_tqi_ip_ctl_pi_map ip_tn_pi_map /end DEF_CHARACTERISTIC
 /begin OUT_MEASUREMENT map_dif bpapwm_eff bpapwm_ctl bpapwm_ctl_dt1 bpapwm_ctl_pi_max bpapwm_ctl_pi_min kr_dt1_bpa lv_bpapwm_ctl_min kr_pi_map tn_pi_map bpapwm_ctl_pi /end OUT_MEASUREMENT
/end FUNCTION
/begin FUNCTION GES_AGE_AIRV ""
 /begin DEF_CHARACTERISTIC c_vol_cyl c_fac_maf_cyl_fil c_fac_egr_fil c_vol_down_thr c_vol_up_thr c_fac_lamb_ext_clc_fil c_fac_lamb_it_clc_fil c_fac_mf_post_lamb_clc c_afs_dsl ip_fac_mfw_the__temp_ex ldp_temp_ex_ip_fac_mfw_the ip_fac_maf_cyl__n__pq ldp_n_ip_fac_maf_cyl ldp_pq_ip_fac_maf_cyl ip_map_max__prs_ex__fac_mfw ldp_prs_ex_ip_map_max ldp_fac_mfw_ip_map_max c_ar_egrv_max_the /end DEF_CHARACTERISTIC
 /begin OUT_MEASUREMENT prs_cmp_up_sp maf_cyl_mmv maf_cyl maf_cyl_kgh pq_map_prs_ex fac_maf_cyl egr egr_mmv mfw_egr maf_im maf_cyl_sp pq_map_prs_ex_sp fac_maf_cyl_sp mfw_egr_sp mfw_ex_sp mfw_tur_sp maf_cyl_sp_clc pq_map_prs_ex_sp_clc fac_maf_cyl_sp_clc mfw_egr_sp_clc map_sp_max_egr fac_mfw_egr fac_mfw_the__temp_ex temp_up_cyl_sp temp_up_cyl mf_lamb_clc lamb_ext_clc_fil lamb_it_clc_fil lamb_it_sp_clc_fil lamb_ext_sp_clc_fil /end OUT_MEASUREMENT
/end FUNCTION
/begin FUNCTION GES_AGE_ECTL ""
 /begin DEF_CHARACTERISTIC lc_egr_ctl_sub c_maf_cyl_sub lc_thr_3 c_t_ramp_fac_ar_thr_byp c_ar_egrv_max_dif c_ar_thr_max_dif c_ar_thr_max_the c_ar_thr_min_the c_mafpwm_pi_dif c_mafpwm_max c_mafpwm_min lc_mafpwm_pi_dt1 c_tn_mafpwm_pi_dt1 c_kr_mafpwm_pi_dt1_tqi c_mafpwm_thd_thr c_mafpwm_hys_thr ip_fac_kr_pi_egr__egr_dif ldpm_egr_dif_ip_fac_pi_egr ip_fac_tn_pi_egr__egr_dif ip_mafpwm_pi_max_dt1__n__fac ldpm_n_ip_mafpwm_pi_dt1 ldpm_fac_ip_mafpwm_pi_dt1 ip_mafpwm_pi_min_dt1__n__fac ip_mafpwm_pi_min ldpm_n_ip_mafpwm_pi_lim ldpm_tqi_ip_mafpwm_pi_lim ip_mafpwm_pi_max ip_kr_pi_thr ldpm_n_ip_pi_egr ldpm_tqi_ip_kr_pi_egr ip_kr_pi_egrv ip_kr_pi_sub_thr ip_kr_pi_sub_egrv ip_tn_pi_thr ip_tn_pi_egrv ip_tn_pi_sub_thr ip_tn_pi_sub_egrv /end DEF_CHARACTERISTIC
 /begin OUT_MEASUREMENT ar_pi_egr egr_mmv_ctl lv_egr_ctl_sub egr_sp_mmv_ctl egr_sp_mmv_out egr_mmv_out egr_dif mafpwm mafpwm_pi ar_byp_ctl_the ar_thr_ctl_the fac_ar_byp_egr_ctl fac_ar_thr_egr_ctl ar_thr_ico_ctl_the ar_egrv_ctl_the lv_egr_ctl_thr ar_pi_egr_max ar_pi_egr_min ar_pi_egr_min_lim ar_pi_egr_min_dif ar_pi_egr_min_bas ar_pi_egr_max_lim ar_pi_egr_max_dif ar_pi_egr_max_bas mafpwm_pi_min mafpwm_pi_max fac_mafpwm_pi_dt1 lv_mafpwm_thd_thr kr_pi_egr tn_pi_egr /end OUT_MEASUREMENT
/end FUNCTION
/end MODULE
/end PROJECT
