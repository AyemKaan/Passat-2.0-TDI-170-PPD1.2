ASAP2_VERSION 1 41
/begin PROJECT SN0 "SIMOS PPD"
/begin HEADER "_default_HeaderComment" PROJECT_NO PRJ_NUM /end HEADER
/begin MODULE _default_ModuleName "_default_ModuleLongIdentifier"
/begin MOD_COMMON "_default_ModCommonComment" DEPOSIT ABSOLUTE BYTE_ORDER MSB_FIRST ALIGNMENT_BYTE 1 ALIGNMENT_WORD 2 ALIGNMENT_LONG 4 ALIGNMENT_FLOAT32_IEEE 4 ALIGNMENT_FLOAT64_IEEE 8 /end MOD_COMMON
/begin AXIS_PTS ldpm_clas_a_id_clas_fmy "" 0x84342a online_dummy _REC_AXS_20_u2 65535. _CNV_A_R_LINEAR_____1_CM 16 0. 65535. FORMAT "%5.0" /end AXIS_PTS
/begin AXIS_PTS ldp_clas_b_id_clas_fmy "" 0x84145e online_dummy _REC_AXS_20_u2 65535. _CNV_A_R_LINEAR_____1_CM 4 0. 65535. FORMAT "%5.0" /end AXIS_PTS
/begin AXIS_PTS ldp_1_id_err_dtc_mis "" 0x84106c online_dummy _REC_AXS_20_u2 65535. _CNV_A_R_LINEAR_____1_CM 2 0. 65535. FORMAT "%5.0" /end AXIS_PTS
/begin AXIS_PTS ldp_2_id_err_dtc_mis "" 0x841072 online_dummy _REC_AXS_20_u2 65535. _CNV_A_R_LINEAR_____1_CM 7 0. 65535. FORMAT "%5.0" /end AXIS_PTS
/begin CHARACTERISTIC lc_test_hbr[0] "" VALUE 0x85c369 _REC_VAL_20_u1 1. _CNV_A_R_LINEAR_____0_CM 0. 1. DISPLAY_IDENTIFIER LC_TEST_HBR_0_ FORMAT "%1.0" /end CHARACTERISTIC
/begin CHARACTERISTIC lc_test_hbr[1] "" VALUE 0x85c36a _REC_VAL_20_u1 1. _CNV_A_R_LINEAR_____0_CM 0. 1. DISPLAY_IDENTIFIER LC_TEST_HBR_1_ FORMAT "%1.0" /end CHARACTERISTIC
/begin CHARACTERISTIC lc_dir_chg_hbr[0] "" VALUE 0x85c30e _REC_VAL_20_u1 1. _CNV_A_R_LINEAR_____0_CM 0. 1. DISPLAY_IDENTIFIER LC_DIR_CHG_HBR_0_ FORMAT "%1.0" /end CHARACTERISTIC
/begin CHARACTERISTIC lc_dir_chg_hbr[1] "" VALUE 0x85c30f _REC_VAL_20_u1 1. _CNV_A_R_LINEAR_____0_CM 0. 1. DISPLAY_IDENTIFIER LC_DIR_CHG_HBR_1_ FORMAT "%1.0" /end CHARACTERISTIC
/begin CHARACTERISTIC c_test_hbr[0] "" VALUE 0x85c18c _REC_VAL_20_s2 199.996948242 _CNV_A_R_LINEAR_____12_CM -100. 99.996948242 DISPLAY_IDENTIFIER C_TEST_HBR_0_ FORMAT "%7.3" /end CHARACTERISTIC
/begin CHARACTERISTIC c_test_hbr[1] "" VALUE 0x85c18e _REC_VAL_20_s2 199.996948242 _CNV_A_R_LINEAR_____12_CM -100. 99.996948242 DISPLAY_IDENTIFIER C_TEST_HBR_1_ FORMAT "%7.3" /end CHARACTERISTIC
/begin CHARACTERISTIC c_crlc_cor_hbr[0] "" VALUE 0x85bd48 _REC_VAL_20_u2 0.9999847412109381 _CNV_A_R_LINEAR_____14_CM 0. 0.9999847412109381 DISPLAY_IDENTIFIER C_CRLC_COR_HBR_0_ FORMAT "%6.5" /end CHARACTERISTIC
/begin CHARACTERISTIC c_crlc_cor_hbr[1] "" VALUE 0x85bd4a _REC_VAL_20_u2 0.9999847412109381 _CNV_A_R_LINEAR_____14_CM 0. 0.9999847412109381 DISPLAY_IDENTIFIER C_CRLC_COR_HBR_1_ FORMAT "%6.5" /end CHARACTERISTIC
/begin CHARACTERISTIC lc_err_det_upd "logical constant to manage some functionality as the visualisation of sporadic error" VALUE 0x8487a7 _REC_VAL_20_u1 1. _CNV_A_R_LINEAR_____0_CM 0. 1. DISPLAY_IDENTIFIER LC_ERR_DET_UPD FORMAT "%2.0" /end CHARACTERISTIC
/begin CHARACTERISTIC lc_clr_err_intm "" VALUE 0x84878f _REC_VAL_20_u1 1. _CNV_A_R_LINEAR_____0_CM 0. 1. DISPLAY_IDENTIFIER LC_CLR_ERR_INTM FORMAT "%2.0" /end CHARACTERISTIC
/begin AXIS_PTS ldp_v_tfu_ip_tfu_mes "" 0x843360 v_tfu _REC_AXS_20_u2 4.9951171875 _CNV_A_R_LINEAR_____33_CM 16 0. 4.9951171875 FORMAT "%3.2" /end AXIS_PTS
/begin AXIS_PTS ldp_dri_id_fac_pl_is "" 0x8415ea dri _REC_AXS_20_u1 15. _CNV_P_8_TABLE_______71_CM 7 0. 15. FORMAT "%2.0" /end AXIS_PTS
/begin AXIS_PTS ldp_tco_ip_fac_fil_pl_is "" 0x8426be tco _REC_AXS_20_u1 255. _CNV_A_R_LINEAR_____18_CM 8 -50. 205. FORMAT "%4.0" /end AXIS_PTS
/begin AXIS_PTS ldp_tco_ip_fac_fil_st_is "" 0x8426c7 tco _REC_AXS_20_u1 255. _CNV_A_R_LINEAR_____18_CM 8 -50. 205. FORMAT "%4.0" /end AXIS_PTS
/begin AXIS_PTS ldp_vs_n_id_dri "" 0x8433d2 vs_n _REC_AXS_20_u2 9.e-002 _CNV_A_R_LINEAR_____73_CM 13 0. 0.1 FORMAT "%7.6" /end AXIS_PTS
/begin AXIS_PTS ldpm_dri_aj "" 0x84344c dri _REC_AXS_20_u1 6. _CNV_A_R_LINEAR_____0_CM 7 0. 6. FORMAT "%1.0" /end AXIS_PTS
/begin AXIS_PTS ldpm_vb_fil_ip_n_inh "" 0x84448a vb_fil _REC_AXS_20_u1 28.8 _CNV_A_R_LINEAR_____48_CM 5 0. 28.8 FORMAT "%5.3" /end AXIS_PTS
/begin AXIS_PTS ldp_quo_mfw_ip_fac_temp_egr "" 0x842532 quo_mfw_down_egrv_sp _REC_AXS_20_u2 65.535 _CNV_A_R_LINEAR_____159_CM 12 0. 65.535 FORMAT "%6.5" /end AXIS_PTS
/begin CHARACTERISTIC ip_tco_warn "Coolant temperature for overheating protection" MAP 0x847d0a _REC_MAP_20_u1_u1_u2 190.5 _CNV_A_R_LINEAR_____235_CM -48. 142.5 DISPLAY_IDENTIFIER IP_TCO_WARN FORMAT "%5.1"
 /begin AXIS_DESCR COM_AXIS tco _CNV_A_R_LINEAR_____18_CM 6 -50. 205. AXIS_PTS_REF ldp_tco_ip_tco_warn /end AXIS_DESCR
 /begin AXIS_DESCR COM_AXIS fco_t _CNV_A_R_LINEAR_____249_CM 6 0. 16.38375 FORMAT "%7.2" AXIS_PTS_REF ldp_fco_t_ip_tco_warn /end AXIS_DESCR
/end CHARACTERISTIC
/begin AXIS_PTS ldp_tco_ip_tco_warn "" 0x8447fa tco _REC_AXS_20_u1 255. _CNV_A_R_LINEAR_____18_CM 6 -50. 205. /end AXIS_PTS
/begin AXIS_PTS ldp_fco_t_ip_tco_warn "" 0x84456a fco_t _REC_AXS_20_u2 16.38375 _CNV_A_R_LINEAR_____249_CM 6 0. 16.38375 FORMAT "%7.2" /end AXIS_PTS
/begin CHARACTERISTIC c_tqi_sp_max_toil_mdl "Upper Limit for Rev. Time" VALUE 0x848716 _REC_VAL_20_s2 2047.96875 _CNV_A_R_LINEAR_____62_CM -1024. 1023.96875 DISPLAY_IDENTIFIER C_TQI_SP_MAX_TOIL_MDL FORMAT "%8.4" /end CHARACTERISTIC
/begin CHARACTERISTIC c_tqi_sp_min_toil_mdl "Lower Limit for rev. Time" VALUE 0x848718 _REC_VAL_20_s2 2047.96875 _CNV_A_R_LINEAR_____62_CM -1024. 1023.96875 DISPLAY_IDENTIFIER C_TQI_SP_MIN_TOIL_MDL FORMAT "%8.4" /end CHARACTERISTIC
/begin CHARACTERISTIC c_n_max_toil_mdl "Maximal Zulassige Drehzahl fuer TOIL_MDL." VALUE 0x8484e5 _REC_VAL_20_u1 8160. _CNV_A_R_LINEAR_____84_CM 0. 8160. DISPLAY_IDENTIFIER C_N_MAX_TOIL_MDL FORMAT "%4.0" /end CHARACTERISTIC
/begin CHARACTERISTIC c_n_min_toil_mdl "Minimale Zulassige Drehzahl fuer TOIL_MDL." VALUE 0x8484e7 _REC_VAL_20_u1 8160. _CNV_A_R_LINEAR_____84_CM 0. 8160. DISPLAY_IDENTIFIER C_N_MIN_TOIL_MDL FORMAT "%4.0" /end CHARACTERISTIC
/begin CHARACTERISTIC ip_toil_mdl "Data Map For OIl Temperature Model" MAP 0x847eea _REC_MAP_20_u1_u2_u2 255. _CNV_A_R_LINEAR_____20_CM 0. 255. DISPLAY_IDENTIFIER IP_TOIL_MDL FORMAT "%3.0"
 /begin AXIS_DESCR COM_AXIS n _CNV_A_R_LINEAR_____257_CM 10 0. 8160. FORMAT "%4.0" AXIS_PTS_REF ldp_n_wiv_ip_toil_mdl /end AXIS_DESCR
 /begin AXIS_DESCR COM_AXIS tqi_sp _CNV_A_R_LINEAR_____83_CM 5 -1024. 1023.97875 FORMAT "%8.2" AXIS_PTS_REF ldp_tqi_sp /end AXIS_DESCR
/end CHARACTERISTIC
/begin AXIS_PTS ldp_n_wiv_ip_toil_mdl "X Axis LDP for IP_TOIL_MDL" 0x8423de n _REC_AXS_20_u2 8160. _CNV_A_R_LINEAR_____257_CM 10 0. 8160. FORMAT "%4.0" /end AXIS_PTS
/begin AXIS_PTS ldp_tqi_sp "Y Axis LDP for IP_TOIL_MDL" 0x842d6c tqi_sp _REC_AXS_20_u2 2047.97875 _CNV_A_R_LINEAR_____83_CM 5 -1024. 1023.97875 FORMAT "%8.2" /end AXIS_PTS
/begin CHARACTERISTIC c_fac_toil_mdl "Filter Factor for Oil Temperature" VALUE 0x848466 _REC_VAL_20_u2 0.9999847412109381 _CNV_A_R_LINEAR_____300_CM 0. 0.9999847412109381 DISPLAY_IDENTIFIER C_FAC_TOIL_MDL FORMAT "%7.5" /end CHARACTERISTIC
/begin CHARACTERISTIC c_toil_mdl_sub "Replacement Value for Oil Temperature" VALUE 0x8486f7 _REC_VAL_20_u1 255. _CNV_A_R_LINEAR_____295_CM -60. 195. DISPLAY_IDENTIFIER C_TOIL_MDL_SUB FORMAT "%3.0" /end CHARACTERISTIC
/begin AXIS_PTS ldpm_n_32__drv2_er "ER: weighting factor for engine roughness curvature component calculation (correction amount), MT vehicle" 0x8438c2 n_32 _REC_AXS_20_u1 8160. _CNV_A_R_LINEAR_____58_CM 4 0. 8160. FORMAT "%4.0" /end AXIS_PTS
/begin AXIS_PTS ldp_n_32_n_grd_thd "Engine speed gradient threshold for filtering of basic engine speed gradient" 0x841908 n_32 _REC_AXS_20_u1 8160. _CNV_A_R_LINEAR_____35_CM 6 0. 8160. FORMAT "%4.0" /end AXIS_PTS
/begin AXIS_PTS ldpm_gear "P-control parameter for N_MAX-controller automatic transmission" 0x8434a2 dri _REC_AXS_20_u1 255. _CNV_A_R_LINEAR_____0_CM 9 0. 255. FORMAT "%3.0" /end AXIS_PTS
/begin AXIS_PTS ldp_v_maf_id_maf_x "" 0x8432a6 v_maf_x _REC_AXS_20_u1 15. _CNV_A_R_LINEAR_____0_CM 16 0. 15. FORMAT "%2.0" /end AXIS_PTS
/begin AXIS_PTS ldp_v_maf_id_maf_y "" 0x8432b7 v_maf_y _REC_AXS_20_u1 15. _CNV_A_R_LINEAR_____0_CM 16 0. 15. FORMAT "%2.0" /end AXIS_PTS
/begin AXIS_PTS ldp_tco_2_inj_x "" 0x842696 tco _REC_AXS_20_u1 255. _CNV_A_R_LINEAR_____18_CM 1 -50. 205. FORMAT "%3.0" /end AXIS_PTS
/begin AXIS_PTS ldp_tco_3_inj_x "" 0x842698 tco _REC_AXS_20_u1 255. _CNV_A_R_LINEAR_____18_CM 1 -50. 205. FORMAT "%3.0" /end AXIS_PTS
/begin AXIS_PTS ldp_tco_ip_fac_mf_prev2_cor_rgn_1 "TCO interpolation of minor injection fuel mass PREV2 during regeneration" 0x84271b tco _REC_AXS_20_u1 255. _CNV_A_R_LINEAR_____18_CM 1 -50. 205. FORMAT "%3.0" /end AXIS_PTS
/begin CHARACTERISTIC ip_fac_mf_prev2_cor_tco_rgn_1 "MF_AMF_MINOR_RGN : TCO interpolation of minor injection fuel mass PREV2 during regeneration" CURVE 0x84bf4e _REC_CUR_20_u2_u1 1.9999696 _CNV_A_R_LINEAR_____53_CM 0. 1.9999696 DISPLAY_IDENTIFIER IP_FAC_MF_PREV2_COR_TCO_RGN_1 FORMAT "%6.5"
 /begin AXIS_DESCR COM_AXIS tco _CNV_A_R_LINEAR_____18_CM 1 -50. 205. FORMAT "%3.0" AXIS_PTS_REF ldp_tco_ip_fac_mf_prev2_cor_rgn_1 /end AXIS_DESCR
/end CHARACTERISTIC
/begin AXIS_PTS ldp_t_ad_bpa_tol__ip_ad_bpa "" 0x8425d6 t_ad_bpa_tol_av[0] _REC_AXS_20_u2 65.535 _CNV_A_R_LINEAR_____76_CM 4 0. 65.535 FORMAT "%5.3" /end AXIS_PTS
/begin AXIS_PTS ldp_t_ad_bpa_bol__ip_ad_bpa "" 0x8425cc t_ad_bpa_bol_av[0] _REC_AXS_20_u2 65.535 _CNV_A_R_LINEAR_____76_CM 4 0. 65.535 FORMAT "%5.3" /end AXIS_PTS
/begin AXIS_PTS ldp_t_ad_egrv_tol__ip_ad_egrv "" 0x8425ea t_ad_egrv_tol_av[0] _REC_AXS_20_u2 65.535 _CNV_A_R_LINEAR_____76_CM 4 0. 65.535 FORMAT "%5.3" /end AXIS_PTS
/begin AXIS_PTS ldp_t_ad_egrv_bol__ip_ad_egrv "" 0x8425e0 t_ad_egrv_bol_av[0] _REC_AXS_20_u2 65.535 _CNV_A_R_LINEAR_____76_CM 4 0. 65.535 FORMAT "%5.3" /end AXIS_PTS
/begin AXIS_PTS ldp_n_ip_egrvpwm "" 0x8419ea n _REC_AXS_20_u2 6375. _CNV_A_R_LINEAR_____5_CM 10 0. 6375. FORMAT "%4.0" /end AXIS_PTS
/begin AXIS_PTS ldp_mafpwm_ip_egrvpwm "" 0x8417c6 mafpwm _REC_AXS_20_u2 99.9969482421875 _CNV_A_R_LINEAR_____155_CM 16 0. 99.9969482421875 FORMAT "%4.2" /end AXIS_PTS
/begin AXIS_PTS ldp_ar_egrv_ip_egrvpwm "" 0x8413ce ar_egrv_ctl_the _REC_AXS_20_u2 78.08 _CNV_A_R_LINEAR_____7_CM 12 0. 78.08 FORMAT "%6.4" /end AXIS_PTS
/begin CHARACTERISTIC c_can_imob_data_req_max "" VALUE 0x848348 _REC_VAL_20_u1 255. _CNV_A_R_LINEAR_____1_CM 0. 255. DISPLAY_IDENTIFIER C_CAN_IMOB_DATA_REQ_MAX FORMAT "%3.0" /end CHARACTERISTIC
/begin CHARACTERISTIC c_imob4_max_req_time "" VALUE 0x848480 _REC_VAL_20_u2 254. _CNV_A_R_LINEAR_____234_CM 1. 255. DISPLAY_IDENTIFIER C_IMOB4_MAX_REQ_TIME FORMAT "%6.1" /end CHARACTERISTIC
/begin CHARACTERISTIC lc_ena_dwnld "" VALUE 0x8487a0 _REC_VAL_20_u1 1. _CNV_A_R_LINEAR_____1_CM 0. 1. DISPLAY_IDENTIFIER LC_ENA_DWNLD FORMAT "%1.0" /end CHARACTERISTIC
/begin CHARACTERISTIC c_marken_id "Fahrzeugmarke" VALUE 0x8484c6 _REC_VAL_20_u1 5. _CNV_S_6_STATE_C_MA_531_CM 1. 6. DISPLAY_IDENTIFIER C_MARKEN_ID /end CHARACTERISTIC
/begin CHARACTERISTIC c_p_klasse "" VALUE 0x84858f _REC_VAL_20_u1 255. _CNV_A_R_LINEAR_____1_CM 0. 255. DISPLAY_IDENTIFIER C_P_KLASSE FORMAT "%3.0" /end CHARACTERISTIC
/begin CHARACTERISTIC lc_ena_retrain_ecu "" VALUE 0x8487a3 _REC_VAL_20_u1 1. _CNV_A_R_LINEAR_____1_CM 0. 1. DISPLAY_IDENTIFIER LC_ENA_RETRAIN_ECU FORMAT "%1.0" /end CHARACTERISTIC
/begin CHARACTERISTIC lc_ena_retrain_ims "" VALUE 0x8487a4 _REC_VAL_20_u1 1. _CNV_A_R_LINEAR_____1_CM 0. 1. DISPLAY_IDENTIFIER LC_ENA_RETRAIN_IMS FORMAT "%1.0" /end CHARACTERISTIC
/begin CHARACTERISTIC c_mon_startstop "start / stop of PECO monitoring" VALUE 0x85bf79 _REC_VAL_20_u1 255. _CNV_A_R_LINEAR_____0_CM 0. 255. DISPLAY_IDENTIFIER C_MON_STARTSTOP FORMAT "%3.0" /end CHARACTERISTIC
/begin CHARACTERISTIC c_mon_sel "select data for PECO monitoring" VALUE 0x8484ca _REC_VAL_20_u1 255. _CNV_A_R_LINEAR_____0_CM 0. 255. DISPLAY_IDENTIFIER C_MON_SEL FORMAT "%3.0" /end CHARACTERISTIC
/begin CHARACTERISTIC c_num_stk_ast "limit value for number of strokes after start" VALUE 0x848580 _REC_VAL_20_u2 65535. _CNV_A_R_LINEAR_____0_CM 0. 65535. DISPLAY_IDENTIFIER C_NUM_STK_AST FORMAT "%5.0" /end CHARACTERISTIC
/begin CHARACTERISTIC c_t_eoi_burst_dly_max "upper limit for delay time for burst measurement on EOI" VALUE 0x84863a _REC_VAL_20_u2 32.767 _CNV_A_R_LINEAR_____208_CM 0. 32.767 DISPLAY_IDENTIFIER C_T_EOI_BURST_DLY_MAX FORMAT "%5.3" /end CHARACTERISTIC
/begin CHARACTERISTIC c_t_eoi_burst_dly_min "lower limit for delay time for burst measurement on EOI" VALUE 0x84863c _REC_VAL_20_u2 32.767 _CNV_A_R_LINEAR_____208_CM 0. 32.767 DISPLAY_IDENTIFIER C_T_EOI_BURST_DLY_MIN FORMAT "%5.3" /end CHARACTERISTIC
/begin CHARACTERISTIC c_t_soi_burst_dly_max "upper limit for delay time for burst measurement on SOI" VALUE 0x8486a4 _REC_VAL_20_u2 32.767 _CNV_A_R_LINEAR_____208_CM 0. 32.767 DISPLAY_IDENTIFIER C_T_SOI_BURST_DLY_MAX FORMAT "%5.3" /end CHARACTERISTIC
/begin CHARACTERISTIC c_t_soi_burst_dly_min "lower limit for delay time for burst measurement on SOI" VALUE 0x8486a6 _REC_VAL_20_u2 32.767 _CNV_A_R_LINEAR_____208_CM 0. 32.767 DISPLAY_IDENTIFIER C_T_SOI_BURST_DLY_MIN FORMAT "%5.3" /end CHARACTERISTIC
/begin CHARACTERISTIC c_nr_test_pls_cyc_hld "generate test pulse for specified number of test pulse cycles" VALUE 0x848528 _REC_VAL_20_u1 255. _CNV_A_R_LINEAR_____0_CM 0. 255. DISPLAY_IDENTIFIER C_NR_TEST_PLS_CYC_HLD FORMAT "%3.0" /end CHARACTERISTIC
/begin CHARACTERISTIC c_nr_test_pls_cyc_hld_st "generate test pulse for specified number of test pulse cycles during start" VALUE 0x848529 _REC_VAL_20_u1 255. _CNV_A_R_LINEAR_____0_CM 0. 255. DISPLAY_IDENTIFIER C_NR_TEST_PLS_CYC_HLD_ST FORMAT "%3.0" /end CHARACTERISTIC
/begin CHARACTERISTIC c_nr_seg_test_pls_wait "pause test pulse for specified number of segments" VALUE 0x848524 _REC_VAL_20_u1 255. _CNV_A_R_LINEAR_____0_CM 0. 255. DISPLAY_IDENTIFIER C_NR_SEG_TEST_PLS_WAIT FORMAT "%3.0" /end CHARACTERISTIC
/begin CHARACTERISTIC c_nr_seg_test_pls_wait_st "pause test pulse for specified number of segments during start" VALUE 0x848525 _REC_VAL_20_u1 255. _CNV_A_R_LINEAR_____0_CM 0. 255. DISPLAY_IDENTIFIER C_NR_SEG_TEST_PLS_WAIT_ST FORMAT "%3.0" /end CHARACTERISTIC
/begin CHARACTERISTIC c_n_test_pls_max "upper engine speed limit for test pulse generation" VALUE 0x848518 _REC_VAL_20_u2 6375. _CNV_A_R_LINEAR_____5_CM 0. 6375. DISPLAY_IDENTIFIER C_N_TEST_PLS_MAX FORMAT "%4.0" /end CHARACTERISTIC
/begin CHARACTERISTIC c_nr_seg_test_pls_gap "segment gap between two test pulses" VALUE 0x848522 _REC_VAL_20_u1 255. _CNV_A_R_LINEAR_____0_CM 0. 255. DISPLAY_IDENTIFIER C_NR_SEG_TEST_PLS_GAP FORMAT "%3.0" /end CHARACTERISTIC
/begin CHARACTERISTIC c_nr_seg_test_pls_gap_st "segment gap between two test pulses during start" VALUE 0x848523 _REC_VAL_20_u1 255. _CNV_A_R_LINEAR_____0_CM 0. 255. DISPLAY_IDENTIFIER C_NR_SEG_TEST_PLS_GAP_ST FORMAT "%3.0" /end CHARACTERISTIC
/begin CHARACTERISTIC c_t_ast_test_pls "time after start for which C_NR_CYC_TEST_PLS_HLD_ST and C_NR_CYC_TEST_PLS_WAIT_ST are valid" VALUE 0x8485f0 _REC_VAL_20_u2 6553.5 _CNV_A_R_LINEAR_____19_CM 0. 6553.5 DISPLAY_IDENTIFIER C_T_AST_TEST_PLS FORMAT "%5.1" /end CHARACTERISTIC
/begin CHARACTERISTIC c_t_cha_test_pls "Charging time of test pulse" VALUE 0x848608 _REC_VAL_20_u1 0.31 _CNV_A_R_LINEAR_____220_CM 0. 0.31 DISPLAY_IDENTIFIER C_T_CHA_TEST_PLS FORMAT "%3.2" /end CHARACTERISTIC
/begin CHARACTERISTIC c_t_dcha_test_pls "Discharging time of test pulse" VALUE 0x84861a _REC_VAL_20_u1 0.31 _CNV_A_R_LINEAR_____220_CM 0. 0.31 DISPLAY_IDENTIFIER C_T_DCHA_TEST_PLS FORMAT "%3.2" /end CHARACTERISTIC
/begin CHARACTERISTIC lc_test_pls_on "switch test pulse on (1) or off (0)" VALUE 0x8487de _REC_VAL_20_u1 1. _CNV_A_R_LINEAR_____0_CM 0. 1. DISPLAY_IDENTIFIER LC_TEST_PLS_ON FORMAT "%1.0" /end CHARACTERISTIC
/begin CHARACTERISTIC ip_t_eoi_burst_dly__n "PECO_TEPL: speed dependent burst measurement delay time on EOI" CURVE 0x84764c _REC_CUR_20_u2_u2 32.767 _CNV_A_R_LINEAR_____208_CM 0. 32.767 DISPLAY_IDENTIFIER IP_T_EOI_BURST_DLY__N FORMAT "%5.3"
 /begin AXIS_DESCR COM_AXIS n _CNV_A_R_LINEAR_____5_CM 5 0. 6375. FORMAT "%4.0" AXIS_PTS_REF ldpm_n_ip_t_burst_dly /end AXIS_DESCR
/end CHARACTERISTIC
/begin AXIS_PTS ldpm_n_ip_t_burst_dly "" 0x843c60 n _REC_AXS_20_u2 6375. _CNV_A_R_LINEAR_____5_CM 5 0. 6375. FORMAT "%4.0" /end AXIS_PTS
/begin CHARACTERISTIC ip_t_soi_burst_dly__n "PECO_TEPL: speed dependent burst measurement delay time on SOI" CURVE 0x847938 _REC_CUR_20_u2_u2 32.767 _CNV_A_R_LINEAR_____208_CM 0. 32.767 DISPLAY_IDENTIFIER IP_T_SOI_BURST_DLY__N FORMAT "%5.3"
 /begin AXIS_DESCR COM_AXIS n _CNV_A_R_LINEAR_____5_CM 5 0. 6375. FORMAT "%4.0" AXIS_PTS_REF ldpm_n_ip_t_burst_dly /end AXIS_DESCR
/end CHARACTERISTIC
/begin CHARACTERISTIC c_num_fil_value_stk_ma[0] "moving average T_IV_CLOSE_MV-FIR filter numerator coefficient vector" VALUE 0x848550 _REC_VAL_20_s2 2. _CNV_A_R_LINEAR_____15_CM -1. 1. DISPLAY_IDENTIFIER C_NUM_FIL_VALUE_STK_MA_0_ FORMAT "%6.5" /end CHARACTERISTIC
/begin CHARACTERISTIC c_num_fil_value_stk_ma[1] "moving average T_IV_CLOSE_MV-FIR filter numerator coefficient vector" VALUE 0x848552 _REC_VAL_20_s2 2. _CNV_A_R_LINEAR_____15_CM -1. 1. DISPLAY_IDENTIFIER C_NUM_FIL_VALUE_STK_MA_1_ FORMAT "%6.5" /end CHARACTERISTIC
/begin CHARACTERISTIC c_num_fil_value_stk_ma[2] "moving average T_IV_CLOSE_MV-FIR filter numerator coefficient vector" VALUE 0x848554 _REC_VAL_20_s2 2. _CNV_A_R_LINEAR_____15_CM -1. 1. DISPLAY_IDENTIFIER C_NUM_FIL_VALUE_STK_MA_2_ FORMAT "%6.5" /end CHARACTERISTIC
/begin CHARACTERISTIC c_num_fil_value_stk_ma[3] "moving average T_IV_CLOSE_MV-FIR filter numerator coefficient vector" VALUE 0x848556 _REC_VAL_20_s2 2. _CNV_A_R_LINEAR_____15_CM -1. 1. DISPLAY_IDENTIFIER C_NUM_FIL_VALUE_STK_MA_3_ FORMAT "%6.5" /end CHARACTERISTIC
/begin CHARACTERISTIC c_dnom_fil_value_stk_ma[0] "moving average T_IV_CLOSE_MV-FIR filter denominator coefficient vector" VALUE 0x848392 _REC_VAL_20_s2 2. _CNV_A_R_LINEAR_____15_CM -1. 1. DISPLAY_IDENTIFIER C_DNOM_FIL_VALUE_STK_MA_0_ FORMAT "%6.5" /end CHARACTERISTIC
/begin CHARACTERISTIC c_dnom_fil_value_stk_ma[1] "moving average T_IV_CLOSE_MV-FIR filter denominator coefficient vector" VALUE 0x848394 _REC_VAL_20_s2 2. _CNV_A_R_LINEAR_____15_CM -1. 1. DISPLAY_IDENTIFIER C_DNOM_FIL_VALUE_STK_MA_1_ FORMAT "%6.5" /end CHARACTERISTIC
/begin CHARACTERISTIC c_dnom_fil_value_stk_ma[2] "moving average T_IV_CLOSE_MV-FIR filter denominator coefficient vector" VALUE 0x848396 _REC_VAL_20_s2 2. _CNV_A_R_LINEAR_____15_CM -1. 1. DISPLAY_IDENTIFIER C_DNOM_FIL_VALUE_STK_MA_2_ FORMAT "%6.5" /end CHARACTERISTIC
/begin CHARACTERISTIC c_dnom_fil_value_stk_ma[3] "moving average T_IV_CLOSE_MV-FIR filter denominator coefficient vector" VALUE 0x848398 _REC_VAL_20_s2 2. _CNV_A_R_LINEAR_____15_CM -1. 1. DISPLAY_IDENTIFIER C_DNOM_FIL_VALUE_STK_MA_3_ FORMAT "%6.5" /end CHARACTERISTIC
/begin CHARACTERISTIC c_fac_pwm_dcha_man "manual value for PWM discharge factor" VALUE 0x84845a _REC_VAL_20_u2 3.99998471 _CNV_A_R_LINEAR_____63_CM 0. 3.99998471 DISPLAY_IDENTIFIER C_FAC_PWM_DCHA_MAN FORMAT "%6.5" /end CHARACTERISTIC
/begin CHARACTERISTIC c_fac_t_per_t_hld_frze "factor for calculating T_HLD_FRZE_MV from T_PER_STK_DCHA" VALUE 0x848462 _REC_VAL_20_u1 1.9921875 _CNV_A_R_LINEAR_____24_CM 0. 1.9921875 DISPLAY_IDENTIFIER C_FAC_T_PER_T_HLD_FRZE FORMAT "%4.3" /end CHARACTERISTIC
/begin CHARACTERISTIC c_fac_t_per_t_hld_toze "factor for calculating T_HLD_TOZE_MV from T_PER_STK_DCHA" VALUE 0x848463 _REC_VAL_20_u1 1.9921875 _CNV_A_R_LINEAR_____24_CM 0. 1.9921875 DISPLAY_IDENTIFIER C_FAC_T_PER_T_HLD_TOZE FORMAT "%4.3" /end CHARACTERISTIC
/begin CHARACTERISTIC c_step_nr_cha_frze_main1_man "manual value for number of charge steps for pulse FROM ZERO MAIN1" VALUE 0x8485d1 _REC_VAL_20_u1 30. _CNV_A_R_LINEAR_____0_CM 0. 30. DISPLAY_IDENTIFIER C_STEP_NR_CHA_FRZE_MAIN1_MAN FORMAT "%2.0" /end CHARACTERISTIC
/begin CHARACTERISTIC c_step_nr_cha_frze_post1_man "manual value for number of charge steps for pulse FROM ZERO POST1" VALUE 0x8485d2 _REC_VAL_20_u1 30. _CNV_A_R_LINEAR_____0_CM 0. 30. DISPLAY_IDENTIFIER C_STEP_NR_CHA_FRZE_POST1_MAN FORMAT "%2.0" /end CHARACTERISTIC
/begin CHARACTERISTIC c_step_nr_cha_frze_prev1_man "manual value for number of charge steps for pulse FROM ZERO PREV1" VALUE 0x8485d3 _REC_VAL_20_u1 30. _CNV_A_R_LINEAR_____0_CM 0. 30. DISPLAY_IDENTIFIER C_STEP_NR_CHA_FRZE_PREV1_MAN FORMAT "%2.0" /end CHARACTERISTIC
/begin CHARACTERISTIC c_step_nr_dcha_main1_man "manual value for number of discharge steps for pulse MAIN1" VALUE 0x8485d4 _REC_VAL_20_u1 30. _CNV_A_R_LINEAR_____0_CM 0. 30. DISPLAY_IDENTIFIER C_STEP_NR_DCHA_MAIN1_MAN FORMAT "%2.0" /end CHARACTERISTIC
/begin CHARACTERISTIC c_step_nr_dcha_post1_man "manual value for number of discharge steps for pulse POST1" VALUE 0x8485d5 _REC_VAL_20_u1 30. _CNV_A_R_LINEAR_____0_CM 0. 30. DISPLAY_IDENTIFIER C_STEP_NR_DCHA_POST1_MAN FORMAT "%2.0" /end CHARACTERISTIC
/begin CHARACTERISTIC c_step_nr_dcha_prev1_man "manual value for number of discharge steps for pulse PREV1" VALUE 0x8485d6 _REC_VAL_20_u1 30. _CNV_A_R_LINEAR_____0_CM 0. 30. DISPLAY_IDENTIFIER C_STEP_NR_DCHA_PREV1_MAN FORMAT "%2.0" /end CHARACTERISTIC
/begin CHARACTERISTIC c_stk_ma_fil_ini "initialisation value for T_IV_CLOSE_MV filter state variables" VALUE 0x8485da _REC_VAL_20_u2 0.512 _CNV_A_R_LINEAR_____533_CM 0. 0.512 DISPLAY_IDENTIFIER C_STK_MA_FIL_INI FORMAT "%4.3" /end CHARACTERISTIC
/begin CHARACTERISTIC c_t_hld_frze_main1_stk_man "manual value for hold time of pulse FROM ZERO MAIN1" VALUE 0x84864a _REC_VAL_20_u2 32.767 _CNV_A_R_LINEAR_____208_CM 0. 32.767 DISPLAY_IDENTIFIER C_T_HLD_FRZE_MAIN1_STK_MAN FORMAT "%5.3" /end CHARACTERISTIC
/begin CHARACTERISTIC c_t_hld_frze_post1_stk_man "manual value for hold time of pulse FROM ZERO POST1" VALUE 0x84864c _REC_VAL_20_u2 32.767 _CNV_A_R_LINEAR_____208_CM 0. 32.767 DISPLAY_IDENTIFIER C_T_HLD_FRZE_POST1_STK_MAN FORMAT "%5.3" /end CHARACTERISTIC
/begin CHARACTERISTIC c_t_hld_frze_prev1_stk_man "manual value for hold time of pulse FROM ZERO PREV1" VALUE 0x84864e _REC_VAL_20_u2 32.767 _CNV_A_R_LINEAR_____208_CM 0. 32.767 DISPLAY_IDENTIFIER C_T_HLD_FRZE_PREV1_STK_MAN FORMAT "%5.3" /end CHARACTERISTIC
/begin CHARACTERISTIC c_t_hld_toze_main1_stk_man "manual value for hold time of pulse TO ZERO MAIN1" VALUE 0x848656 _REC_VAL_20_u2 32.767 _CNV_A_R_LINEAR_____208_CM 0. 32.767 DISPLAY_IDENTIFIER C_T_HLD_TOZE_MAIN1_STK_MAN FORMAT "%5.3" /end CHARACTERISTIC
/begin CHARACTERISTIC c_t_hld_toze_post1_stk_man "manual value for hold time of pulse TO ZERO POST1" VALUE 0x84865a _REC_VAL_20_u2 32.767 _CNV_A_R_LINEAR_____208_CM 0. 32.767 DISPLAY_IDENTIFIER C_T_HLD_TOZE_POST1_STK_MAN FORMAT "%5.3" /end CHARACTERISTIC
/begin CHARACTERISTIC c_t_hld_toze_prev1_stk_man "manual value for hold time of pulse TO ZERO PREV1" VALUE 0x84865e _REC_VAL_20_u2 32.767 _CNV_A_R_LINEAR_____208_CM 0. 32.767 DISPLAY_IDENTIFIER C_T_HLD_TOZE_PREV1_STK_MAN FORMAT "%5.3" /end CHARACTERISTIC
/begin CHARACTERISTIC lc_tun_stk_ctl_man "button for setting manual values for all output variables of stroke control" VALUE 0x8487e1 _REC_VAL_20_u1 1. _CNV_A_R_LINEAR_____0_CM 0. 1. DISPLAY_IDENTIFIER LC_TUN_STK_CTL_MAN FORMAT "%1.0" /end CHARACTERISTIC
/begin CHARACTERISTIC ip_fac_t_iv_opg_min_cor__tfu "PECO_STCO: TFU correction factor for T_IV_OPG_MIN" CURVE 0x846cc0 _REC_CUR_20_u1_u1 1.9921875 _CNV_A_R_LINEAR_____24_CM 0. 1.9921875 DISPLAY_IDENTIFIER IP_FAC_T_IV_OPG_MIN_COR__TFU FORMAT "%4.3"
 /begin AXIS_DESCR COM_AXIS tfu _CNV_A_R_LINEAR_____18_CM 5 -50. 205. FORMAT "%3.0" AXIS_PTS_REF ldp_tfu_ip_fac_t_iv_opg_min_cor /end AXIS_DESCR
/end CHARACTERISTIC
/begin AXIS_PTS ldp_tfu_ip_fac_t_iv_opg_min_cor "" 0x8428d0 tfu _REC_AXS_20_u1 255. _CNV_A_R_LINEAR_____18_CM 5 -50. 205. FORMAT "%3.0" /end AXIS_PTS
/begin CHARACTERISTIC ip_fac_step_nr_cha_frze__n__tfu "PECO_STCO: factor for step number (FROM ZERO PREV/MAIN1/POST1) calculated by stroke control" MAP 0x846c78 _REC_MAP_20_u1_u2_u1 1.9921875 _CNV_A_R_LINEAR_____24_CM 0. 1.9921875 DISPLAY_IDENTIFIER IP_FAC_STEP_NR_CHA_FRZE__N__TFU FORMAT "%4.3"
 /begin AXIS_DESCR COM_AXIS n _CNV_A_R_LINEAR_____5_CM 8 0. 6375. FORMAT "%4.0" AXIS_PTS_REF ldp_n_ip_fac_step_nr_cha_frze /end AXIS_DESCR
 /begin AXIS_DESCR COM_AXIS tfu _CNV_A_R_LINEAR_____18_CM 5 -50. 205. FORMAT "%3.0" AXIS_PTS_REF ldp_tfu_ip_fac_step_nr_cha_frze /end AXIS_DESCR
/end CHARACTERISTIC
/begin AXIS_PTS ldp_n_ip_fac_step_nr_cha_frze "" 0x841a3c n _REC_AXS_20_u2 6375. _CNV_A_R_LINEAR_____5_CM 8 0. 6375. FORMAT "%4.0" /end AXIS_PTS
/begin AXIS_PTS ldp_tfu_ip_fac_step_nr_cha_frze "" 0x8428ca tfu _REC_AXS_20_u1 255. _CNV_A_R_LINEAR_____18_CM 5 -50. 205. FORMAT "%3.0" /end AXIS_PTS
/begin CHARACTERISTIC ip_t_iv_opg_min__n__soi "PECO_STCO: interpolation map for determining minimal injection valve opening time" MAP 0x847760 _REC_MAP_20_u2_u2_u2 0.512 _CNV_A_R_LINEAR_____533_CM 0. 0.512 DISPLAY_IDENTIFIER IP_T_IV_OPG_MIN__N__SOI FORMAT "%4.3"
 /begin AXIS_DESCR COM_AXIS n _CNV_A_R_LINEAR_____5_CM 8 0. 6375. FORMAT "%4.0" AXIS_PTS_REF ldp_n_ip_t_iv_opg_min /end AXIS_DESCR
 /begin AXIS_DESCR COM_AXIS soi_main1_pwr_on_tu _CNV_A_R_LINEAR_____120_CM 14 -120. 240. FORMAT "%5.2" AXIS_PTS_REF ldp_soi_ip_t_iv_opg_min /end AXIS_DESCR
/end CHARACTERISTIC
/begin AXIS_PTS ldp_n_ip_t_iv_opg_min "" 0x8422ee n _REC_AXS_20_u2 6375. _CNV_A_R_LINEAR_____5_CM 8 0. 6375. FORMAT "%4.0" /end AXIS_PTS
/begin AXIS_PTS ldp_soi_ip_t_iv_opg_min "" 0x8425a2 soi_main1_pwr_on_tu _REC_AXS_20_u2 360. _CNV_A_R_LINEAR_____120_CM 14 -120. 240. FORMAT "%5.2" /end AXIS_PTS
/begin CHARACTERISTIC c_n_stk_ctl_act_max "upper engine speed limit for stroke control" VALUE 0x848514 _REC_VAL_20_u2 6375. _CNV_A_R_LINEAR_____5_CM 0. 6375. DISPLAY_IDENTIFIER C_N_STK_CTL_ACT_MAX FORMAT "%4.0" /end CHARACTERISTIC
/begin CHARACTERISTIC ip_fac_t_iv_opg_min_cor__n "PECO_STCO: N correction factor for T_IV_OPG_MIN" CURVE 0x846cb0 _REC_CUR_20_u2_u2 3.99998471 _CNV_A_R_LINEAR_____63_CM 0. 3.99998471 DISPLAY_IDENTIFIER IP_FAC_T_IV_OPG_MIN_COR__N FORMAT "%5.3"
 /begin AXIS_DESCR COM_AXIS n _CNV_A_R_LINEAR_____5_CM 8 0. 6375. FORMAT "%4.0" AXIS_PTS_REF ldp_n_ip_fac_t_iv_opg_min_cor /end AXIS_DESCR
/end CHARACTERISTIC
/begin AXIS_PTS ldp_n_ip_fac_t_iv_opg_min_cor "" 0x841a4e n _REC_AXS_20_u2 6375. _CNV_A_R_LINEAR_____5_CM 8 0. 6375. FORMAT "%4.0" /end AXIS_PTS
/begin CHARACTERISTIC c_pv_av_stk_ctl_act_max "max pedal value to activate stroke controller" VALUE 0x844490 _REC_VAL_20_u2 99.90000000000001 _CNV_A_R_LINEAR_____261_CM 0. 99.90000000000001 DISPLAY_IDENTIFIER C_PV_AV_STK_CTL_ACT_MAX FORMAT "%4.2" /end CHARACTERISTIC
/begin CHARACTERISTIC c_egy_inj_sp_man_[0] "" VALUE 0x848412 _REC_VAL_20_u2 522.7750632 _CNV_A_R_LINEAR_____534_CM 0. 522.7750632 DISPLAY_IDENTIFIER C_EGY_INJ_SP_MAN__0_ /end CHARACTERISTIC
/begin CHARACTERISTIC c_egy_inj_sp_man_[1] "" VALUE 0x848414 _REC_VAL_20_u2 522.7750632 _CNV_A_R_LINEAR_____534_CM 0. 522.7750632 DISPLAY_IDENTIFIER C_EGY_INJ_SP_MAN__1_ /end CHARACTERISTIC
/begin CHARACTERISTIC c_egy_inj_sp_man_[2] "" VALUE 0x848416 _REC_VAL_20_u2 522.7750632 _CNV_A_R_LINEAR_____534_CM 0. 522.7750632 DISPLAY_IDENTIFIER C_EGY_INJ_SP_MAN__2_ /end CHARACTERISTIC
/begin CHARACTERISTIC c_egy_inj_sp_man_[3] "" VALUE 0x848418 _REC_VAL_20_u2 522.7750632 _CNV_A_R_LINEAR_____534_CM 0. 522.7750632 DISPLAY_IDENTIFIER C_EGY_INJ_SP_MAN__3_ /end CHARACTERISTIC
/begin CHARACTERISTIC c_egy_inj_sp_max "energy injection set point maximum" VALUE 0x84841a _REC_VAL_20_u2 522.7750632 _CNV_A_R_LINEAR_____534_CM 0. 522.7750632 DISPLAY_IDENTIFIER C_EGY_INJ_SP_MAX /end CHARACTERISTIC
/begin CHARACTERISTIC c_egy_inj_sp_min "energy injection set point minimum" VALUE 0x84841c _REC_VAL_20_u2 522.7750632 _CNV_A_R_LINEAR_____534_CM 0. 522.7750632 DISPLAY_IDENTIFIER C_EGY_INJ_SP_MIN /end CHARACTERISTIC
/begin CHARACTERISTIC c_fac_pwm_dcha_pwm_cha "amplification between PPS PWM_DCHA and PWM_CHA" VALUE 0x84845c _REC_VAL_20_s2 3.999939 _CNV_A_R_LINEAR_____405_CM -2. 1.999939 DISPLAY_IDENTIFIER C_FAC_PWM_DCHA_PWM_CHA FORMAT "%6.5" /end CHARACTERISTIC
/begin CHARACTERISTIC c_kr_pi_egy_ctl "PI energy controller amplification" VALUE 0x848490 _REC_VAL_20_s2 199.996948242 _CNV_A_R_LINEAR_____536_CM -100. 99.996948242 DISPLAY_IDENTIFIER C_KR_PI_EGY_CTL FORMAT "%5.3" /end CHARACTERISTIC
/begin CHARACTERISTIC c_lim_pi_egy_ctl_max "energy control error integrator max limit" VALUE 0x8484ae _REC_VAL_20_u2 49.99847400000001 _CNV_A_R_LINEAR_____537_CM 0. 49.998474 DISPLAY_IDENTIFIER C_LIM_PI_EGY_CTL_MAX FORMAT "%5.3" /end CHARACTERISTIC
/begin CHARACTERISTIC c_lim_pi_egy_ctl_min "energy control error integrator min limit" VALUE 0x8484b0 _REC_VAL_20_s2 50. _CNV_A_R_LINEAR_____538_CM -50. 0. DISPLAY_IDENTIFIER C_LIM_PI_EGY_CTL_MIN FORMAT "%4.3" /end CHARACTERISTIC
/begin CHARACTERISTIC c_lim_pwm_cha_err_ctl_max "energy control error output max limit" VALUE 0x8484ba _REC_VAL_20_u2 49.99847400000001 _CNV_A_R_LINEAR_____537_CM 0. 49.998474 DISPLAY_IDENTIFIER C_LIM_PWM_CHA_ERR_CTL_MAX FORMAT "%5.3" /end CHARACTERISTIC
/begin CHARACTERISTIC c_lim_pwm_cha_err_ctl_min "energy control error output min limit" VALUE 0x8484bc _REC_VAL_20_s2 50. _CNV_A_R_LINEAR_____538_CM -50. 0. DISPLAY_IDENTIFIER C_LIM_PWM_CHA_ERR_CTL_MIN FORMAT "%4.3" /end CHARACTERISTIC
/begin CHARACTERISTIC c_pwm_cha_ini_[0] "" VALUE 0x848594 _REC_VAL_20_u2 99.99847412109381 _CNV_A_R_LINEAR_____8_CM 0. 99.99847412109381 DISPLAY_IDENTIFIER C_PWM_CHA_INI__0_ FORMAT "%5.3" /end CHARACTERISTIC
/begin CHARACTERISTIC c_pwm_cha_ini_[1] "" VALUE 0x848596 _REC_VAL_20_u2 99.99847412109381 _CNV_A_R_LINEAR_____8_CM 0. 99.99847412109381 DISPLAY_IDENTIFIER C_PWM_CHA_INI__1_ FORMAT "%5.3" /end CHARACTERISTIC
/begin CHARACTERISTIC c_pwm_cha_ini_[2] "" VALUE 0x848598 _REC_VAL_20_u2 99.99847412109381 _CNV_A_R_LINEAR_____8_CM 0. 99.99847412109381 DISPLAY_IDENTIFIER C_PWM_CHA_INI__2_ FORMAT "%5.3" /end CHARACTERISTIC
/begin CHARACTERISTIC c_pwm_cha_ini_[3] "" VALUE 0x84859a _REC_VAL_20_u2 99.99847412109381 _CNV_A_R_LINEAR_____8_CM 0. 99.99847412109381 DISPLAY_IDENTIFIER C_PWM_CHA_INI__3_ FORMAT "%5.3" /end CHARACTERISTIC
/begin CHARACTERISTIC c_pwm_cha_max "PPS charging PWM output maximum" VALUE 0x84859c _REC_VAL_20_u2 99.99847412109381 _CNV_A_R_LINEAR_____8_CM 0. 99.99847412109381 DISPLAY_IDENTIFIER C_PWM_CHA_MAX FORMAT "%5.3" /end CHARACTERISTIC
/begin CHARACTERISTIC c_pwm_cha_min "PPS charging PWM output minimum" VALUE 0x84859e _REC_VAL_20_u2 99.99847412109381 _CNV_A_R_LINEAR_____8_CM 0. 99.99847412109381 DISPLAY_IDENTIFIER C_PWM_CHA_MIN FORMAT "%5.3" /end CHARACTERISTIC
/begin CHARACTERISTIC c_pwm_dcha_man_[0] "" VALUE 0x8485a0 _REC_VAL_20_u2 99.99847412109381 _CNV_A_R_LINEAR_____8_CM 0. 99.99847412109381 DISPLAY_IDENTIFIER C_PWM_DCHA_MAN__0_ FORMAT "%5.3" /end CHARACTERISTIC
/begin CHARACTERISTIC c_pwm_dcha_man_[1] "" VALUE 0x8485a2 _REC_VAL_20_u2 99.99847412109381 _CNV_A_R_LINEAR_____8_CM 0. 99.99847412109381 DISPLAY_IDENTIFIER C_PWM_DCHA_MAN__1_ FORMAT "%5.3" /end CHARACTERISTIC
/begin CHARACTERISTIC c_pwm_dcha_man_[2] "" VALUE 0x8485a4 _REC_VAL_20_u2 99.99847412109381 _CNV_A_R_LINEAR_____8_CM 0. 99.99847412109381 DISPLAY_IDENTIFIER C_PWM_DCHA_MAN__2_ FORMAT "%5.3" /end CHARACTERISTIC
/begin CHARACTERISTIC c_pwm_dcha_man_[3] "" VALUE 0x8485a6 _REC_VAL_20_u2 99.99847412109381 _CNV_A_R_LINEAR_____8_CM 0. 99.99847412109381 DISPLAY_IDENTIFIER C_PWM_DCHA_MAN__3_ FORMAT "%5.3" /end CHARACTERISTIC
/begin CHARACTERISTIC c_pwm_dcha_max "PPS discharging PWM output maximum" VALUE 0x8485a8 _REC_VAL_20_u2 99.99847412109381 _CNV_A_R_LINEAR_____8_CM 0. 99.99847412109381 DISPLAY_IDENTIFIER C_PWM_DCHA_MAX FORMAT "%5.3" /end CHARACTERISTIC
/begin CHARACTERISTIC c_pwm_dcha_min "PPS discharging PWM output minimum" VALUE 0x8485aa _REC_VAL_20_u2 99.99847412109381 _CNV_A_R_LINEAR_____8_CM 0. 99.99847412109381 DISPLAY_IDENTIFIER C_PWM_DCHA_MIN FORMAT "%5.3" /end CHARACTERISTIC
/begin CHARACTERISTIC c_pwm_dcha_ofs "offset between PPS PWM_DCHA and PWM_CHA" VALUE 0x8485ac _REC_VAL_20_s2 99.99847412 _CNV_A_R_LINEAR_____539_CM -50. 49.99847412 DISPLAY_IDENTIFIER C_PWM_DCHA_OFS FORMAT "%5.3" /end CHARACTERISTIC
/begin CHARACTERISTIC lc_dcha_ctl_on "switch PPS discharge control on" VALUE 0x848794 _REC_VAL_20_u1 1. _CNV_A_R_LINEAR_____0_CM 0. 1. DISPLAY_IDENTIFIER LC_DCHA_CTL_ON FORMAT "%1.0" /end CHARACTERISTIC
/begin CHARACTERISTIC lc_egy_ctl_on "switch PPS energy control on" VALUE 0x84879e _REC_VAL_20_u1 1. _CNV_A_R_LINEAR_____0_CM 0. 1. DISPLAY_IDENTIFIER LC_EGY_CTL_ON FORMAT "%1.0" /end CHARACTERISTIC
/begin CHARACTERISTIC lc_egy_inj_sp_man "force PPS energy control manual set point" VALUE 0x84879f _REC_VAL_20_u1 1. _CNV_A_R_LINEAR_____0_CM 0. 1. DISPLAY_IDENTIFIER LC_EGY_INJ_SP_MAN FORMAT "%1.0" /end CHARACTERISTIC
/begin CHARACTERISTIC id_fac_egy_inj_sp_cor__t_cha "PECO_ENCO: correction factor for energy setpoint" CURVE 0x844a3a _REC_CUR_20_u2_u2 1.9999696 _CNV_A_R_LINEAR_____53_CM 0. 1.9999696 DISPLAY_IDENTIFIER ID_FAC_EGY_INJ_SP_COR__T_CHA FORMAT "%6.5"
 /begin AXIS_DESCR COM_AXIS dummy_peco _CNV_A_R_LINEAR_____208_CM 28 0. 32.767 FORMAT "%5.3" AXIS_PTS_REF ldp_t_cha_id_fac_egy_inj_sp_cor /end AXIS_DESCR
/end CHARACTERISTIC
/begin AXIS_PTS ldp_t_cha_id_fac_egy_inj_sp_cor "" 0x84261c dummy_peco _REC_AXS_20_u2 32.767 _CNV_A_R_LINEAR_____208_CM 28 0. 32.767 FORMAT "%5.3" /end AXIS_PTS
/begin CHARACTERISTIC ip_pwm_cha_pctl__egy "PECO_ENCO: amplification between PPS PWM_CHA and energy set point" CURVE 0x8474ce _REC_CUR_20_u2_u2 99.99847412109381 _CNV_A_R_LINEAR_____8_CM 0. 99.99847412109381 DISPLAY_IDENTIFIER IP_PWM_CHA_PCTL__EGY FORMAT "%6.5"
 /begin AXIS_DESCR COM_AXIS dummy_peco _CNV_A_R_LINEAR_____534_CM 6 0. 522.7750632 AXIS_PTS_REF ldp_egy_ip_pwm_cha_pctl /end AXIS_DESCR
/end CHARACTERISTIC
/begin AXIS_PTS ldp_egy_ip_pwm_cha_pctl "" 0x841654 dummy_peco _REC_AXS_20_u2 522.7750632 _CNV_A_R_LINEAR_____534_CM 6 0. 522.7750632 /end AXIS_PTS
/begin CHARACTERISTIC ip_tn_pi_neg_egy_ctl__n "PECO_ENCO: negative TN of energy PI controller" CURVE 0x847e2e _REC_CUR_20_u2_u2 3276.7 _CNV_A_R_LINEAR_____540_CM 0. 3276.7 DISPLAY_IDENTIFIER IP_TN_PI_NEG_EGY_CTL__N FORMAT "%5.1"
 /begin AXIS_DESCR COM_AXIS n _CNV_A_R_LINEAR_____5_CM 10 0. 6375. FORMAT "%4.0" AXIS_PTS_REF ldpm_n_ip_tn_pi_egy_ctl /end AXIS_DESCR
/end CHARACTERISTIC
/begin AXIS_PTS ldpm_n_ip_tn_pi_egy_ctl "" 0x843c9a n _REC_AXS_20_u2 6375. _CNV_A_R_LINEAR_____5_CM 10 0. 6375. FORMAT "%4.0" /end AXIS_PTS
/begin CHARACTERISTIC ip_tn_pi_pos_egy_ctl__n "PECO_ENCO: positive TN of energy PI controller" CURVE 0x847e7e _REC_CUR_20_u2_u2 3276.7 _CNV_A_R_LINEAR_____540_CM 0. 3276.7 DISPLAY_IDENTIFIER IP_TN_PI_POS_EGY_CTL__N FORMAT "%5.1"
 /begin AXIS_DESCR COM_AXIS n _CNV_A_R_LINEAR_____5_CM 10 0. 6375. FORMAT "%4.0" AXIS_PTS_REF ldpm_n_ip_tn_pi_egy_ctl /end AXIS_DESCR
/end CHARACTERISTIC
/begin CHARACTERISTIC ip_t_eoi_ofs_ctl__pwm "PECO_ENCO: EOI correction depending on PWM_DCHA" CURVE 0x847656 _REC_CUR_20_u2_u2 65.535 _CNV_A_R_LINEAR_____541_CM -32.768 32.767 DISPLAY_IDENTIFIER IP_T_EOI_OFS_CTL__PWM FORMAT "%5.3"
 /begin AXIS_DESCR COM_AXIS dummy_peco _CNV_A_R_LINEAR_____8_CM 10 0. 99.99847412109381 FORMAT "%5.3" AXIS_PTS_REF ldp_pwm_ip_t_eoi_ofs_ctl /end AXIS_DESCR
/end CHARACTERISTIC
/begin AXIS_PTS ldp_pwm_ip_t_eoi_ofs_ctl "" 0x84251c dummy_peco _REC_AXS_20_u2 99.99847412109381 _CNV_A_R_LINEAR_____8_CM 10 0. 99.99847412109381 FORMAT "%5.3" /end AXIS_PTS
/begin CHARACTERISTIC c_dnom_fil_value_v_delta_mmv[0] "MMV of DELTA_V - FIR filter denominator coefficient vector" VALUE 0x8483ae _REC_VAL_20_s2 2. _CNV_A_R_LINEAR_____15_CM -1. 1. DISPLAY_IDENTIFIER C_DNOM_FIL_VALUE_V_DELTA_MMV_0_ FORMAT "%6.5" /end CHARACTERISTIC
/begin CHARACTERISTIC c_dnom_fil_value_v_delta_mmv[1] "MMV of DELTA_V - FIR filter denominator coefficient vector" VALUE 0x8483b0 _REC_VAL_20_s2 2. _CNV_A_R_LINEAR_____15_CM -1. 1. DISPLAY_IDENTIFIER C_DNOM_FIL_VALUE_V_DELTA_MMV_1_ FORMAT "%6.5" /end CHARACTERISTIC
/begin CHARACTERISTIC c_dnom_fil_value_v_delta_mmv[2] "MMV of DELTA_V - FIR filter denominator coefficient vector" VALUE 0x8483b2 _REC_VAL_20_s2 2. _CNV_A_R_LINEAR_____15_CM -1. 1. DISPLAY_IDENTIFIER C_DNOM_FIL_VALUE_V_DELTA_MMV_2_ FORMAT "%6.5" /end CHARACTERISTIC
/begin CHARACTERISTIC c_dnom_fil_value_v_delta_mmv[3] "MMV of DELTA_V - FIR filter denominator coefficient vector" VALUE 0x8483b4 _REC_VAL_20_s2 2. _CNV_A_R_LINEAR_____15_CM -1. 1. DISPLAY_IDENTIFIER C_DNOM_FIL_VALUE_V_DELTA_MMV_3_ FORMAT "%6.5" /end CHARACTERISTIC
/begin CHARACTERISTIC c_dnom_fil_value_v_delta_mmv[4] "MMV of DELTA_V - FIR filter denominator coefficient vector" VALUE 0x8483b6 _REC_VAL_20_s2 2. _CNV_A_R_LINEAR_____15_CM -1. 1. DISPLAY_IDENTIFIER C_DNOM_FIL_VALUE_V_DELTA_MMV_4_ FORMAT "%6.5" /end CHARACTERISTIC
/begin CHARACTERISTIC c_dnom_fil_value_v_delta_mmv[5] "MMV of DELTA_V - FIR filter denominator coefficient vector" VALUE 0x8483b8 _REC_VAL_20_s2 2. _CNV_A_R_LINEAR_____15_CM -1. 1. DISPLAY_IDENTIFIER C_DNOM_FIL_VALUE_V_DELTA_MMV_5_ FORMAT "%6.5" /end CHARACTERISTIC
/begin CHARACTERISTIC c_dnom_fil_value_v_delta_mmv[6] "MMV of DELTA_V - FIR filter denominator coefficient vector" VALUE 0x8483ba _REC_VAL_20_s2 2. _CNV_A_R_LINEAR_____15_CM -1. 1. DISPLAY_IDENTIFIER C_DNOM_FIL_VALUE_V_DELTA_MMV_6_ FORMAT "%6.5" /end CHARACTERISTIC
/begin CHARACTERISTIC c_dnom_fil_value_v_delta_mmv[7] "MMV of DELTA_V - FIR filter denominator coefficient vector" VALUE 0x8483bc _REC_VAL_20_s2 2. _CNV_A_R_LINEAR_____15_CM -1. 1. DISPLAY_IDENTIFIER C_DNOM_FIL_VALUE_V_DELTA_MMV_7_ FORMAT "%6.5" /end CHARACTERISTIC
/begin CHARACTERISTIC c_dnom_fil_value_v_delta_mmv[8] "MMV of DELTA_V - FIR filter denominator coefficient vector" VALUE 0x8483be _REC_VAL_20_s2 2. _CNV_A_R_LINEAR_____15_CM -1. 1. DISPLAY_IDENTIFIER C_DNOM_FIL_VALUE_V_DELTA_MMV_8_ FORMAT "%6.5" /end CHARACTERISTIC
/begin CHARACTERISTIC c_dnom_fil_value_v_delta_mmv[9] "MMV of DELTA_V - FIR filter denominator coefficient vector" VALUE 0x8483c0 _REC_VAL_20_s2 2. _CNV_A_R_LINEAR_____15_CM -1. 1. DISPLAY_IDENTIFIER C_DNOM_FIL_VALUE_V_DELTA_MMV_9_ FORMAT "%6.5" /end CHARACTERISTIC
/begin CHARACTERISTIC c_kr_pi_iv_foc_ctl "IV_FOC_CTL PI amplification" VALUE 0x848492 _REC_VAL_20_s2 199.996948242 _CNV_A_R_LINEAR_____543_CM -100. 99.996948242 DISPLAY_IDENTIFIER C_KR_PI_IV_FOC_CTL FORMAT "%5.3" /end CHARACTERISTIC
/begin CHARACTERISTIC c_lim_egy_sp_err_iv_foc_ctl_max "IV_FOC controller output maximum limit" VALUE 0x8484a6 _REC_VAL_20_u2 261.3875315 _CNV_A_R_LINEAR_____544_CM 0. 261.3875315 DISPLAY_IDENTIFIER C_LIM_EGY_SP_ERR_IV_FOC_CTL_MAX /end CHARACTERISTIC
/begin CHARACTERISTIC c_lim_egy_sp_err_iv_foc_ctl_min "IV_FOC controller output minimum limit" VALUE 0x8484a8 _REC_VAL_20_s2 261.3875315 _CNV_A_R_LINEAR_____545_CM -261.3875315 0. DISPLAY_IDENTIFIER C_LIM_EGY_SP_ERR_IV_FOC_CTL_MIN FORMAT "%4.3" /end CHARACTERISTIC
/begin CHARACTERISTIC c_lim_pi_iv_foc_ctl_max "IV_FOC controller integrator maximum limit" VALUE 0x8484b2 _REC_VAL_20_u2 261.3875315 _CNV_A_R_LINEAR_____544_CM 0. 261.3875315 DISPLAY_IDENTIFIER C_LIM_PI_IV_FOC_CTL_MAX /end CHARACTERISTIC
/begin CHARACTERISTIC c_lim_pi_iv_foc_ctl_min "IV_FOC controller integrator minimum limit" VALUE 0x8484b4 _REC_VAL_20_s2 261.3875315 _CNV_A_R_LINEAR_____545_CM -261.3875315 0. DISPLAY_IDENTIFIER C_LIM_PI_IV_FOC_CTL_MIN FORMAT "%4.3" /end CHARACTERISTIC
/begin CHARACTERISTIC c_num_fil_value_v_delta_mmv[0] "MMV of DELTA_V - FIR filter numerator coefficient vector" VALUE 0x84856c _REC_VAL_20_s2 2. _CNV_A_R_LINEAR_____15_CM -1. 1. DISPLAY_IDENTIFIER C_NUM_FIL_VALUE_V_DELTA_MMV_0_ FORMAT "%6.5" /end CHARACTERISTIC
/begin CHARACTERISTIC c_num_fil_value_v_delta_mmv[1] "MMV of DELTA_V - FIR filter numerator coefficient vector" VALUE 0x84856e _REC_VAL_20_s2 2. _CNV_A_R_LINEAR_____15_CM -1. 1. DISPLAY_IDENTIFIER C_NUM_FIL_VALUE_V_DELTA_MMV_1_ FORMAT "%6.5" /end CHARACTERISTIC
/begin CHARACTERISTIC c_num_fil_value_v_delta_mmv[2] "MMV of DELTA_V - FIR filter numerator coefficient vector" VALUE 0x848570 _REC_VAL_20_s2 2. _CNV_A_R_LINEAR_____15_CM -1. 1. DISPLAY_IDENTIFIER C_NUM_FIL_VALUE_V_DELTA_MMV_2_ FORMAT "%6.5" /end CHARACTERISTIC
/begin CHARACTERISTIC c_num_fil_value_v_delta_mmv[3] "MMV of DELTA_V - FIR filter numerator coefficient vector" VALUE 0x848572 _REC_VAL_20_s2 2. _CNV_A_R_LINEAR_____15_CM -1. 1. DISPLAY_IDENTIFIER C_NUM_FIL_VALUE_V_DELTA_MMV_3_ FORMAT "%6.5" /end CHARACTERISTIC
/begin CHARACTERISTIC c_num_fil_value_v_delta_mmv[4] "MMV of DELTA_V - FIR filter numerator coefficient vector" VALUE 0x848574 _REC_VAL_20_s2 2. _CNV_A_R_LINEAR_____15_CM -1. 1. DISPLAY_IDENTIFIER C_NUM_FIL_VALUE_V_DELTA_MMV_4_ FORMAT "%6.5" /end CHARACTERISTIC
/begin CHARACTERISTIC c_num_fil_value_v_delta_mmv[5] "MMV of DELTA_V - FIR filter numerator coefficient vector" VALUE 0x848576 _REC_VAL_20_s2 2. _CNV_A_R_LINEAR_____15_CM -1. 1. DISPLAY_IDENTIFIER C_NUM_FIL_VALUE_V_DELTA_MMV_5_ FORMAT "%6.5" /end CHARACTERISTIC
/begin CHARACTERISTIC c_num_fil_value_v_delta_mmv[6] "MMV of DELTA_V - FIR filter numerator coefficient vector" VALUE 0x848578 _REC_VAL_20_s2 2. _CNV_A_R_LINEAR_____15_CM -1. 1. DISPLAY_IDENTIFIER C_NUM_FIL_VALUE_V_DELTA_MMV_6_ FORMAT "%6.5" /end CHARACTERISTIC
/begin CHARACTERISTIC c_num_fil_value_v_delta_mmv[7] "MMV of DELTA_V - FIR filter numerator coefficient vector" VALUE 0x84857a _REC_VAL_20_s2 2. _CNV_A_R_LINEAR_____15_CM -1. 1. DISPLAY_IDENTIFIER C_NUM_FIL_VALUE_V_DELTA_MMV_7_ FORMAT "%6.5" /end CHARACTERISTIC
/begin CHARACTERISTIC c_num_fil_value_v_delta_mmv[8] "MMV of DELTA_V - FIR filter numerator coefficient vector" VALUE 0x84857c _REC_VAL_20_s2 2. _CNV_A_R_LINEAR_____15_CM -1. 1. DISPLAY_IDENTIFIER C_NUM_FIL_VALUE_V_DELTA_MMV_8_ FORMAT "%6.5" /end CHARACTERISTIC
/begin CHARACTERISTIC c_num_fil_value_v_delta_mmv[9] "MMV of DELTA_V - FIR filter numerator coefficient vector" VALUE 0x84857e _REC_VAL_20_s2 2. _CNV_A_R_LINEAR_____15_CM -1. 1. DISPLAY_IDENTIFIER C_NUM_FIL_VALUE_V_DELTA_MMV_9_ FORMAT "%6.5" /end CHARACTERISTIC
/begin CHARACTERISTIC c_v_delta_max "maximum value of acceptable DELTA_V" VALUE 0x84872a _REC_VAL_20_u2 255. _CNV_A_R_LINEAR_____532_CM 0. 255. DISPLAY_IDENTIFIER C_V_DELTA_MAX /end CHARACTERISTIC
/begin CHARACTERISTIC c_v_delta_min "minimum value of acceptable DELTA_V" VALUE 0x84872c _REC_VAL_20_u2 255. _CNV_A_R_LINEAR_____532_CM 0. 255. DISPLAY_IDENTIFIER C_V_DELTA_MIN /end CHARACTERISTIC
/begin CHARACTERISTIC c_v_delta_mmv_fil_ini "initialisation value for MMF state variables of DELTA_V" VALUE 0x84872e _REC_VAL_20_u2 255. _CNV_A_R_LINEAR_____532_CM 0. 255. DISPLAY_IDENTIFIER C_V_DELTA_MMV_FIL_INI /end CHARACTERISTIC
/begin CHARACTERISTIC c_v_delta_mmv_inp_max_lim "maximum input value for MMF of V_DELTA" VALUE 0x848730 _REC_VAL_20_u2 255. _CNV_A_R_LINEAR_____532_CM 0. 255. DISPLAY_IDENTIFIER C_V_DELTA_MMV_INP_MAX_LIM /end CHARACTERISTIC
/begin CHARACTERISTIC c_v_delta_mmv_inp_min_lim "minimum input value for MMF of V_DELTA" VALUE 0x848732 _REC_VAL_20_u2 255. _CNV_A_R_LINEAR_____532_CM 0. 255. DISPLAY_IDENTIFIER C_V_DELTA_MMV_INP_MIN_LIM /end CHARACTERISTIC
/begin CHARACTERISTIC c_v_delta_mmv_out_max_lim "maximum output value of MMF of V_DELTA" VALUE 0x848734 _REC_VAL_20_u2 255. _CNV_A_R_LINEAR_____532_CM 0. 255. DISPLAY_IDENTIFIER C_V_DELTA_MMV_OUT_MAX_LIM /end CHARACTERISTIC
/begin CHARACTERISTIC c_v_delta_mmv_out_min_lim "minimum output value of MMF of V_DELTA" VALUE 0x848736 _REC_VAL_20_u2 255. _CNV_A_R_LINEAR_____532_CM 0. 255. DISPLAY_IDENTIFIER C_V_DELTA_MMV_OUT_MIN_LIM /end CHARACTERISTIC
/begin CHARACTERISTIC lc_iv_foc_ctl_on "switch on IV_FOC control" VALUE 0x8487c7 _REC_VAL_20_u1 1. _CNV_A_R_LINEAR_____0_CM 0. 1. DISPLAY_IDENTIFIER LC_IV_FOC_CTL_ON FORMAT "%1.0" /end CHARACTERISTIC
/begin CHARACTERISTIC lc_v_delta_rel_iv_foc_ctl_on "switch to DELTA_V_REL_x input for IV_FOC_CTL" VALUE 0x8487e5 _REC_VAL_20_u1 1. _CNV_A_R_LINEAR_____0_CM 0. 1. DISPLAY_IDENTIFIER LC_V_DELTA_REL_IV_FOC_CTL_ON FORMAT "%1.0" /end CHARACTERISTIC
/begin CHARACTERISTIC ip_egy_sp_ofs_foc_ctl__tco "PECO_FOCO: IV_FOC_CTL energy set point offset depending on TCO" CURVE 0x846902 _REC_CUR_20_u2_u1 522.7750630000001 _CNV_A_R_LINEAR_____546_CM -261.3875315 261.3875315 DISPLAY_IDENTIFIER IP_EGY_SP_OFS_FOC_CTL__TCO
 /begin AXIS_DESCR COM_AXIS tco _CNV_A_R_LINEAR_____18_CM 5 -50. 205. FORMAT "%3.0" AXIS_PTS_REF ldpm_tco_ip_egy_sp_foc_ctl /end AXIS_DESCR
/end CHARACTERISTIC
/begin AXIS_PTS ldpm_tco_ip_egy_sp_foc_ctl "" 0x843e9f tco _REC_AXS_20_u1 255. _CNV_A_R_LINEAR_____18_CM 5 -50. 205. FORMAT "%3.0" /end AXIS_PTS
/begin CHARACTERISTIC ip_tn_pi_neg_iv_foc_ctl__n "PECO_FOCO: IV_FOC control error integral time at negative deviation" CURVE 0x847e42 _REC_CUR_20_u2_u2 3276.7 _CNV_A_R_LINEAR_____540_CM 0. 3276.7 DISPLAY_IDENTIFIER IP_TN_PI_NEG_IV_FOC_CTL__N FORMAT "%5.1"
 /begin AXIS_DESCR COM_AXIS n _CNV_A_R_LINEAR_____5_CM 10 0. 6375. FORMAT "%4.0" AXIS_PTS_REF ldpm_n_ip_tn_pi_iv_foc_ctl /end AXIS_DESCR
/end CHARACTERISTIC
/begin AXIS_PTS ldpm_n_ip_tn_pi_iv_foc_ctl "" 0x843cc6 n _REC_AXS_20_u2 6375. _CNV_A_R_LINEAR_____5_CM 10 0. 6375. FORMAT "%4.0" /end AXIS_PTS
/begin CHARACTERISTIC ip_tn_pi_pos_iv_foc_ctl__n "PECO_FOCO: IV_FOC control error integral time at positive deviation" CURVE 0x847e92 _REC_CUR_20_u2_u2 3276.7 _CNV_A_R_LINEAR_____540_CM 0. 3276.7 DISPLAY_IDENTIFIER IP_TN_PI_POS_IV_FOC_CTL__N FORMAT "%5.1"
 /begin AXIS_DESCR COM_AXIS n _CNV_A_R_LINEAR_____5_CM 10 0. 6375. FORMAT "%4.0" AXIS_PTS_REF ldpm_n_ip_tn_pi_iv_foc_ctl /end AXIS_DESCR
/end CHARACTERISTIC
/begin CHARACTERISTIC ip_egy_sp_foc_ctl__n__doi "PECO_FOCO: IV_FOC_CTL energy set point depending on N and DOI" MAP 0x84689e _REC_MAP_20_u2_u2_u2 522.7750632 _CNV_A_R_LINEAR_____534_CM 0. 522.7750632 DISPLAY_IDENTIFIER IP_EGY_SP_FOC_CTL__N__DOI
 /begin AXIS_DESCR COM_AXIS n _CNV_A_R_LINEAR_____5_CM 5 0. 6375. FORMAT "%4.0" AXIS_PTS_REF ldpm_n_ip_egy_sp_foc_ctl /end AXIS_DESCR
 /begin AXIS_DESCR COM_AXIS dummy_peco _CNV_A_R_LINEAR_____121_CM 5 0. 360. FORMAT "%5.2" AXIS_PTS_REF ldp_doi_ip_egy_sp_foc_ctl /end AXIS_DESCR
/end CHARACTERISTIC
/begin AXIS_PTS ldpm_n_ip_egy_sp_foc_ctl "" 0x843a34 n _REC_AXS_20_u2 6375. _CNV_A_R_LINEAR_____5_CM 5 0. 6375. FORMAT "%4.0" /end AXIS_PTS
/begin AXIS_PTS ldp_doi_ip_egy_sp_foc_ctl "" 0x8415c6 dummy_peco _REC_AXS_20_u2 360. _CNV_A_R_LINEAR_____121_CM 5 0. 360. FORMAT "%5.2" /end AXIS_PTS
/begin CHARACTERISTIC ip_egy_sp_foc_ctl__n__soi "PECO_FOCO: IV_FOC_CTL energy set point depending on N and SOI" MAP 0x8468d0 _REC_MAP_20_u2_u2_u2 522.7750632 _CNV_A_R_LINEAR_____534_CM 0. 522.7750632 DISPLAY_IDENTIFIER IP_EGY_SP_FOC_CTL__N__SOI
 /begin AXIS_DESCR COM_AXIS n _CNV_A_R_LINEAR_____5_CM 5 0. 6375. FORMAT "%4.0" AXIS_PTS_REF ldpm_n_ip_egy_sp_foc_ctl /end AXIS_DESCR
 /begin AXIS_DESCR COM_AXIS soi_main1_pwr_on_tu _CNV_A_R_LINEAR_____120_CM 5 -120. 240. FORMAT "%5.2" AXIS_PTS_REF ldp_soi_ip_egy_sp_foc_ctl /end AXIS_DESCR
/end CHARACTERISTIC
/begin AXIS_PTS ldp_soi_ip_egy_sp_foc_ctl "" 0x84258a soi_main1_pwr_on_tu _REC_AXS_20_u2 360. _CNV_A_R_LINEAR_____120_CM 5 -120. 240. FORMAT "%5.2" /end AXIS_PTS
/begin CHARACTERISTIC ip_fac_egy_sp_foc__tco__capa "PECO_FOCO: IV_FOC_CTL energy set point tuning depending on TCO and CAPA representing the piezo temperature" MAP 0x846aaa _REC_MAP_20_u2_u1_u1 1.9999696 _CNV_A_R_LINEAR_____53_CM 0. 1.9999696 DISPLAY_IDENTIFIER IP_FAC_EGY_SP_FOC__TCO__CAPA FORMAT "%6.5"
 /begin AXIS_DESCR COM_AXIS tco _CNV_A_R_LINEAR_____18_CM 5 -50. 205. FORMAT "%3.0" AXIS_PTS_REF ldpm_tco_ip_egy_sp_foc_ctl /end AXIS_DESCR
 /begin AXIS_DESCR COM_AXIS dummy_peco _CNV_A_R_LINEAR_____122_CM 5 0. 31.96875 FORMAT "%3.1" AXIS_PTS_REF ldp_capa_ip_egy_sp_foc_ctl /end AXIS_DESCR
/end CHARACTERISTIC
/begin AXIS_PTS ldp_capa_ip_egy_sp_foc_ctl "" 0x84144c dummy_peco _REC_AXS_20_u1 31.96875 _CNV_A_R_LINEAR_____122_CM 5 0. 31.96875 FORMAT "%3.1" /end AXIS_PTS
/begin CHARACTERISTIC ip_v_delta_sp__n__doi "PECO_FOCO: V_DELTA set point depending on N and DOI" MAP 0x84805a _REC_MAP_20_u2_u2_u2 255. _CNV_A_R_LINEAR_____532_CM 0. 255. DISPLAY_IDENTIFIER IP_V_DELTA_SP__N__DOI
 /begin AXIS_DESCR COM_AXIS n _CNV_A_R_LINEAR_____5_CM 5 0. 6375. FORMAT "%4.0" AXIS_PTS_REF ldpm_n_ip_v_delta_sp /end AXIS_DESCR
 /begin AXIS_DESCR COM_AXIS dummy_peco _CNV_A_R_LINEAR_____121_CM 5 0. 360. FORMAT "%5.2" AXIS_PTS_REF ldp_doi_ip_v_delta_sp /end AXIS_DESCR
/end CHARACTERISTIC
/begin AXIS_PTS ldpm_n_ip_v_delta_sp "" 0x843e08 n _REC_AXS_20_u2 6375. _CNV_A_R_LINEAR_____5_CM 5 0. 6375. FORMAT "%4.0" /end AXIS_PTS
/begin AXIS_PTS ldp_doi_ip_v_delta_sp "" 0x8415de dummy_peco _REC_AXS_20_u2 360. _CNV_A_R_LINEAR_____121_CM 5 0. 360. FORMAT "%5.2" /end AXIS_PTS
/begin CHARACTERISTIC ip_v_delta_sp__n__soi "PECO_FOCO: V_DELTA set point depending on N and SOI" MAP 0x84808c _REC_MAP_20_u2_u2_u2 255. _CNV_A_R_LINEAR_____532_CM 0. 255. DISPLAY_IDENTIFIER IP_V_DELTA_SP__N__SOI
 /begin AXIS_DESCR COM_AXIS n _CNV_A_R_LINEAR_____5_CM 5 0. 6375. FORMAT "%4.0" AXIS_PTS_REF ldpm_n_ip_v_delta_sp /end AXIS_DESCR
 /begin AXIS_DESCR COM_AXIS soi_main1_pwr_on_tu _CNV_A_R_LINEAR_____120_CM 5 -120. 240. FORMAT "%5.2" AXIS_PTS_REF ldp_soi_ip_v_delta_sp /end AXIS_DESCR
/end CHARACTERISTIC
/begin AXIS_PTS ldp_soi_ip_v_delta_sp "" 0x8425c0 soi_main1_pwr_on_tu _REC_AXS_20_u2 360. _CNV_A_R_LINEAR_____120_CM 5 -120. 240. FORMAT "%5.2" /end AXIS_PTS
/begin CHARACTERISTIC ip_v_delta_sp__tco__capa "PECO_FOCO: V_DELTA set point depending on TCO and CAPA_INJ representing piezo temperature" MAP 0x8480be _REC_MAP_20_u2_u1_u1 255. _CNV_A_R_LINEAR_____532_CM 0. 255. DISPLAY_IDENTIFIER IP_V_DELTA_SP__TCO__CAPA
 /begin AXIS_DESCR COM_AXIS tco _CNV_A_R_LINEAR_____18_CM 5 -50. 205. FORMAT "%3.0" AXIS_PTS_REF ldp_tco_ip_v_delta_sp /end AXIS_DESCR
 /begin AXIS_DESCR COM_AXIS dummy_peco _CNV_A_R_LINEAR_____122_CM 5 0. 31.96875 FORMAT "%3.1" AXIS_PTS_REF ldp_capa_ip_v_delta_sp /end AXIS_DESCR
/end CHARACTERISTIC
/begin AXIS_PTS ldp_tco_ip_v_delta_sp "" 0x842875 tco _REC_AXS_20_u1 255. _CNV_A_R_LINEAR_____18_CM 5 -50. 205. FORMAT "%3.0" /end AXIS_PTS
/begin AXIS_PTS ldp_capa_ip_v_delta_sp "" 0x841458 dummy_peco _REC_AXS_20_u1 31.96875 _CNV_A_R_LINEAR_____122_CM 5 0. 31.96875 FORMAT "%3.1" /end AXIS_PTS
/begin CHARACTERISTIC c_dnom_fil_value_t_iv_close_mmv[0] "MMV of T_IV_CLOSE - FIR filter denominator coefficient vector" VALUE 0x84839a _REC_VAL_20_s2 2. _CNV_A_R_LINEAR_____15_CM -1. 1. DISPLAY_IDENTIFIER C_DNOM_FIL_VALUE_T_IV_CLOSE_MMV_ FORMAT "%6.5" /end CHARACTERISTIC
/begin CHARACTERISTIC c_dnom_fil_value_t_iv_close_mmv[1] "MMV of T_IV_CLOSE - FIR filter denominator coefficient vector" VALUE 0x84839c _REC_VAL_20_s2 2. _CNV_A_R_LINEAR_____15_CM -1. 1. DISPLAY_IDENTIFIER C_DNOM_FIL_VALUE_T_IV_CLOSE_MMV_ FORMAT "%6.5" /end CHARACTERISTIC
/begin CHARACTERISTIC c_dnom_fil_value_t_iv_close_mmv[2] "MMV of T_IV_CLOSE - FIR filter denominator coefficient vector" VALUE 0x84839e _REC_VAL_20_s2 2. _CNV_A_R_LINEAR_____15_CM -1. 1. DISPLAY_IDENTIFIER C_DNOM_FIL_VALUE_T_IV_CLOSE_MMV_ FORMAT "%6.5" /end CHARACTERISTIC
/begin CHARACTERISTIC c_dnom_fil_value_t_iv_close_mmv[3] "MMV of T_IV_CLOSE - FIR filter denominator coefficient vector" VALUE 0x8483a0 _REC_VAL_20_s2 2. _CNV_A_R_LINEAR_____15_CM -1. 1. DISPLAY_IDENTIFIER C_DNOM_FIL_VALUE_T_IV_CLOSE_MMV_ FORMAT "%6.5" /end CHARACTERISTIC
/begin CHARACTERISTIC c_dnom_fil_value_t_iv_close_mmv[4] "MMV of T_IV_CLOSE - FIR filter denominator coefficient vector" VALUE 0x8483a2 _REC_VAL_20_s2 2. _CNV_A_R_LINEAR_____15_CM -1. 1. DISPLAY_IDENTIFIER C_DNOM_FIL_VALUE_T_IV_CLOSE_MMV_ FORMAT "%6.5" /end CHARACTERISTIC
/begin CHARACTERISTIC c_dnom_fil_value_t_iv_close_mmv[5] "MMV of T_IV_CLOSE - FIR filter denominator coefficient vector" VALUE 0x8483a4 _REC_VAL_20_s2 2. _CNV_A_R_LINEAR_____15_CM -1. 1. DISPLAY_IDENTIFIER C_DNOM_FIL_VALUE_T_IV_CLOSE_MMV_ FORMAT "%6.5" /end CHARACTERISTIC
/begin CHARACTERISTIC c_dnom_fil_value_t_iv_close_mmv[6] "MMV of T_IV_CLOSE - FIR filter denominator coefficient vector" VALUE 0x8483a6 _REC_VAL_20_s2 2. _CNV_A_R_LINEAR_____15_CM -1. 1. DISPLAY_IDENTIFIER C_DNOM_FIL_VALUE_T_IV_CLOSE_MMV_ FORMAT "%6.5" /end CHARACTERISTIC
/begin CHARACTERISTIC c_dnom_fil_value_t_iv_close_mmv[7] "MMV of T_IV_CLOSE - FIR filter denominator coefficient vector" VALUE 0x8483a8 _REC_VAL_20_s2 2. _CNV_A_R_LINEAR_____15_CM -1. 1. DISPLAY_IDENTIFIER C_DNOM_FIL_VALUE_T_IV_CLOSE_MMV_ FORMAT "%6.5" /end CHARACTERISTIC
/begin CHARACTERISTIC c_dnom_fil_value_t_iv_close_mmv[8] "MMV of T_IV_CLOSE - FIR filter denominator coefficient vector" VALUE 0x8483aa _REC_VAL_20_s2 2. _CNV_A_R_LINEAR_____15_CM -1. 1. DISPLAY_IDENTIFIER C_DNOM_FIL_VALUE_T_IV_CLOSE_MMV_ FORMAT "%6.5" /end CHARACTERISTIC
/begin CHARACTERISTIC c_dnom_fil_value_t_iv_close_mmv[9] "MMV of T_IV_CLOSE - FIR filter denominator coefficient vector" VALUE 0x8483ac _REC_VAL_20_s2 2. _CNV_A_R_LINEAR_____15_CM -1. 1. DISPLAY_IDENTIFIER C_DNOM_FIL_VALUE_T_IV_CLOSE_MMV_ FORMAT "%6.5" /end CHARACTERISTIC
/begin CHARACTERISTIC c_kr_pi_soi_ctl "SOI control PI amplification" VALUE 0x848494 _REC_VAL_20_s2 1999.96948 _CNV_A_R_LINEAR_____547_CM -1000. 999.96948 DISPLAY_IDENTIFIER C_KR_PI_SOI_CTL FORMAT "%5.2" /end CHARACTERISTIC
/begin CHARACTERISTIC c_kr_pi_t_iv_close_ctl "T_IV_CLOSE_CTL PI amplification" VALUE 0x848496 _REC_VAL_20_s2 1999.96948 _CNV_A_R_LINEAR_____548_CM -1000. 999.96948 DISPLAY_IDENTIFIER C_KR_PI_T_IV_CLOSE_CTL FORMAT "%5.2" /end CHARACTERISTIC
/begin CHARACTERISTIC c_lim_egy_sp_err_t_iv_ctl_max "T_IV_CLOSE_CTL error output maximum limit" VALUE 0x8484aa _REC_VAL_20_u2 261.3875315 _CNV_A_R_LINEAR_____544_CM 0. 261.3875315 DISPLAY_IDENTIFIER C_LIM_EGY_SP_ERR_T_IV_CTL_MAX /end CHARACTERISTIC
/begin CHARACTERISTIC c_lim_egy_sp_err_t_iv_ctl_min "T_IV_CLOSE_CTL error output minimum limit" VALUE 0x8484ac _REC_VAL_20_s2 261.3875315 _CNV_A_R_LINEAR_____545_CM -261.3875315 0. DISPLAY_IDENTIFIER C_LIM_EGY_SP_ERR_T_IV_CTL_MIN FORMAT "%4.3" /end CHARACTERISTIC
/begin CHARACTERISTIC c_lim_pi_t_iv_close_ctl_max "T_IV_CLOSE_CTL integrator maximum limit" VALUE 0x8484b6 _REC_VAL_20_u2 261.3875315 _CNV_A_R_LINEAR_____544_CM 0. 261.3875315 DISPLAY_IDENTIFIER C_LIM_PI_T_IV_CLOSE_CTL_MAX /end CHARACTERISTIC
/begin CHARACTERISTIC c_lim_pi_t_iv_close_ctl_min "T_IV_CLOSE_CTL integrator minimum limit" VALUE 0x8484b8 _REC_VAL_20_s2 261.3875315 _CNV_A_R_LINEAR_____545_CM -261.3875315 0. DISPLAY_IDENTIFIER C_LIM_PI_T_IV_CLOSE_CTL_MIN FORMAT "%4.3" /end CHARACTERISTIC
/begin CHARACTERISTIC c_lim_t_pi_soi_ctl_max "SOI controller integrator maximum time" VALUE 0x8484be _REC_VAL_20_s2 65.535 _CNV_A_R_LINEAR_____533_CM -32.768 32.767 DISPLAY_IDENTIFIER C_LIM_T_PI_SOI_CTL_MAX FORMAT "%5.3" /end CHARACTERISTIC
/begin CHARACTERISTIC c_lim_t_pi_soi_ctl_min "SOI controller integrator minimum time" VALUE 0x8484c0 _REC_VAL_20_s2 65.535 _CNV_A_R_LINEAR_____533_CM -32.768 32.767 DISPLAY_IDENTIFIER C_LIM_T_PI_SOI_CTL_MIN FORMAT "%5.3" /end CHARACTERISTIC
/begin CHARACTERISTIC c_lim_t_soi_ofs_soi_ctl_max "SOI controller output maximum time" VALUE 0x8484c2 _REC_VAL_20_s2 65.535 _CNV_A_R_LINEAR_____533_CM -32.768 32.767 DISPLAY_IDENTIFIER C_LIM_T_SOI_OFS_SOI_CTL_MAX FORMAT "%5.3" /end CHARACTERISTIC
/begin CHARACTERISTIC c_lim_t_soi_ofs_soi_ctl_min "SOI controller output minimum time" VALUE 0x8484c4 _REC_VAL_20_s2 65.535 _CNV_A_R_LINEAR_____533_CM -32.768 32.767 DISPLAY_IDENTIFIER C_LIM_T_SOI_OFS_SOI_CTL_MIN FORMAT "%5.3" /end CHARACTERISTIC
/begin CHARACTERISTIC c_num_fil_value_t_iv_close_mmv[0] "MMV of T_IV_CLOSE - FIR filter numerator coefficient vector" VALUE 0x848558 _REC_VAL_20_s2 2. _CNV_A_R_LINEAR_____15_CM -1. 1. DISPLAY_IDENTIFIER C_NUM_FIL_VALUE_T_IV_CLOSE_MMV_0 FORMAT "%6.5" /end CHARACTERISTIC
/begin CHARACTERISTIC c_num_fil_value_t_iv_close_mmv[1] "MMV of T_IV_CLOSE - FIR filter numerator coefficient vector" VALUE 0x84855a _REC_VAL_20_s2 2. _CNV_A_R_LINEAR_____15_CM -1. 1. DISPLAY_IDENTIFIER C_NUM_FIL_VALUE_T_IV_CLOSE_MMV_1 FORMAT "%6.5" /end CHARACTERISTIC
/begin CHARACTERISTIC c_num_fil_value_t_iv_close_mmv[2] "MMV of T_IV_CLOSE - FIR filter numerator coefficient vector" VALUE 0x84855c _REC_VAL_20_s2 2. _CNV_A_R_LINEAR_____15_CM -1. 1. DISPLAY_IDENTIFIER C_NUM_FIL_VALUE_T_IV_CLOSE_MMV_2 FORMAT "%6.5" /end CHARACTERISTIC
/begin CHARACTERISTIC c_num_fil_value_t_iv_close_mmv[3] "MMV of T_IV_CLOSE - FIR filter numerator coefficient vector" VALUE 0x84855e _REC_VAL_20_s2 2. _CNV_A_R_LINEAR_____15_CM -1. 1. DISPLAY_IDENTIFIER C_NUM_FIL_VALUE_T_IV_CLOSE_MMV_3 FORMAT "%6.5" /end CHARACTERISTIC
/begin CHARACTERISTIC c_num_fil_value_t_iv_close_mmv[4] "MMV of T_IV_CLOSE - FIR filter numerator coefficient vector" VALUE 0x848560 _REC_VAL_20_s2 2. _CNV_A_R_LINEAR_____15_CM -1. 1. DISPLAY_IDENTIFIER C_NUM_FIL_VALUE_T_IV_CLOSE_MMV_4 FORMAT "%6.5" /end CHARACTERISTIC
/begin CHARACTERISTIC c_num_fil_value_t_iv_close_mmv[5] "MMV of T_IV_CLOSE - FIR filter numerator coefficient vector" VALUE 0x848562 _REC_VAL_20_s2 2. _CNV_A_R_LINEAR_____15_CM -1. 1. DISPLAY_IDENTIFIER C_NUM_FIL_VALUE_T_IV_CLOSE_MMV_5 FORMAT "%6.5" /end CHARACTERISTIC
/begin CHARACTERISTIC c_num_fil_value_t_iv_close_mmv[6] "MMV of T_IV_CLOSE - FIR filter numerator coefficient vector" VALUE 0x848564 _REC_VAL_20_s2 2. _CNV_A_R_LINEAR_____15_CM -1. 1. DISPLAY_IDENTIFIER C_NUM_FIL_VALUE_T_IV_CLOSE_MMV_6 FORMAT "%6.5" /end CHARACTERISTIC
/begin CHARACTERISTIC c_num_fil_value_t_iv_close_mmv[7] "MMV of T_IV_CLOSE - FIR filter numerator coefficient vector" VALUE 0x848566 _REC_VAL_20_s2 2. _CNV_A_R_LINEAR_____15_CM -1. 1. DISPLAY_IDENTIFIER C_NUM_FIL_VALUE_T_IV_CLOSE_MMV_7 FORMAT "%6.5" /end CHARACTERISTIC
/begin CHARACTERISTIC c_num_fil_value_t_iv_close_mmv[8] "MMV of T_IV_CLOSE - FIR filter numerator coefficient vector" VALUE 0x848568 _REC_VAL_20_s2 2. _CNV_A_R_LINEAR_____15_CM -1. 1. DISPLAY_IDENTIFIER C_NUM_FIL_VALUE_T_IV_CLOSE_MMV_8 FORMAT "%6.5" /end CHARACTERISTIC
/begin CHARACTERISTIC c_num_fil_value_t_iv_close_mmv[9] "MMV of T_IV_CLOSE - FIR filter numerator coefficient vector" VALUE 0x84856a _REC_VAL_20_s2 2. _CNV_A_R_LINEAR_____15_CM -1. 1. DISPLAY_IDENTIFIER C_NUM_FIL_VALUE_T_IV_CLOSE_MMV_9 FORMAT "%6.5" /end CHARACTERISTIC
/begin CHARACTERISTIC c_t_iv_close_max "maximum value of acceptable injection valve closing time" VALUE 0x848664 _REC_VAL_20_u2 0.512 _CNV_A_R_LINEAR_____533_CM 0. 0.512 DISPLAY_IDENTIFIER C_T_IV_CLOSE_MAX FORMAT "%4.3" /end CHARACTERISTIC
/begin CHARACTERISTIC c_t_iv_close_min "minimum value of acceptable injection valve closing time" VALUE 0x848666 _REC_VAL_20_u2 0.512 _CNV_A_R_LINEAR_____533_CM 0. 0.512 DISPLAY_IDENTIFIER C_T_IV_CLOSE_MIN FORMAT "%4.3" /end CHARACTERISTIC
/begin CHARACTERISTIC c_t_iv_close_mmv_fil_ini "initialisation value for MMF state variables of T_IV_CLOSE" VALUE 0x848668 _REC_VAL_20_u2 0.512 _CNV_A_R_LINEAR_____533_CM 0. 0.512 DISPLAY_IDENTIFIER C_T_IV_CLOSE_MMV_FIL_INI FORMAT "%4.3" /end CHARACTERISTIC
/begin CHARACTERISTIC c_t_iv_close_mmv_inp_max_lim "maximum input value for MMF of T_IV_CLOSE" VALUE 0x84866a _REC_VAL_20_u2 0.512 _CNV_A_R_LINEAR_____533_CM 0. 0.512 DISPLAY_IDENTIFIER C_T_IV_CLOSE_MMV_INP_MAX_LIM FORMAT "%4.3" /end CHARACTERISTIC
/begin CHARACTERISTIC c_t_iv_close_mmv_inp_min_lim "minimum input value for MMF of T_IV_CLOSE" VALUE 0x84866c _REC_VAL_20_u2 0.512 _CNV_A_R_LINEAR_____533_CM 0. 0.512 DISPLAY_IDENTIFIER C_T_IV_CLOSE_MMV_INP_MIN_LIM FORMAT "%4.3" /end CHARACTERISTIC
/begin CHARACTERISTIC c_t_iv_close_mmv_out_max_lim "maximum output value of MMF of T_IV_CLOSE" VALUE 0x84866e _REC_VAL_20_u2 0.512 _CNV_A_R_LINEAR_____533_CM 0. 0.512 DISPLAY_IDENTIFIER C_T_IV_CLOSE_MMV_OUT_MAX_LIM FORMAT "%4.3" /end CHARACTERISTIC
/begin CHARACTERISTIC c_t_iv_close_mmv_out_min_lim "minimum output value of MMF of T_IV_CLOSE" VALUE 0x848670 _REC_VAL_20_u2 0.512 _CNV_A_R_LINEAR_____533_CM 0. 0.512 DISPLAY_IDENTIFIER C_T_IV_CLOSE_MMV_OUT_MIN_LIM FORMAT "%4.3" /end CHARACTERISTIC
/begin CHARACTERISTIC lc_iv_foc_iv_close_ctl_sel "select IV control (1: IV_FOC_CTL and SOI_CTL, 0: only IV_CLOSE_CTL)" VALUE 0x8487c8 _REC_VAL_20_u1 1. _CNV_A_R_LINEAR_____0_CM 0. 1. DISPLAY_IDENTIFIER LC_IV_FOC_IV_CLOSE_CTL_SEL FORMAT "%1.0" /end CHARACTERISTIC
/begin CHARACTERISTIC lc_soi_ctl_on "switch on SOI control" VALUE 0x8487d1 _REC_VAL_20_u1 1. _CNV_A_R_LINEAR_____0_CM 0. 1. DISPLAY_IDENTIFIER LC_SOI_CTL_ON FORMAT "%1.0" /end CHARACTERISTIC
/begin CHARACTERISTIC lc_t_iv_close_ctl_on "switch injection valve closing time controller on" VALUE 0x8487d6 _REC_VAL_20_u1 1. _CNV_A_R_LINEAR_____0_CM 0. 1. DISPLAY_IDENTIFIER LC_T_IV_CLOSE_CTL_ON FORMAT "%1.0" /end CHARACTERISTIC
/begin CHARACTERISTIC ip_egy_sp_ofs_t_ctl__tco "PECO_CLCO: T_IV_CLOSE_CTL energy set point offset depending on TCO" CURVE 0x84690c _REC_CUR_20_u2_u1 522.7750630000001 _CNV_A_R_LINEAR_____546_CM -261.3875315 261.3875315 DISPLAY_IDENTIFIER IP_EGY_SP_OFS_T_CTL__TCO
 /begin AXIS_DESCR COM_AXIS tco _CNV_A_R_LINEAR_____18_CM 5 -50. 205. FORMAT "%3.0" AXIS_PTS_REF ldpm_tco_ip_egy_sp_close_ctl /end AXIS_DESCR
/end CHARACTERISTIC
/begin AXIS_PTS ldpm_tco_ip_egy_sp_close_ctl "" 0x843e99 tco _REC_AXS_20_u1 255. _CNV_A_R_LINEAR_____18_CM 5 -50. 205. FORMAT "%3.0" /end AXIS_PTS
/begin CHARACTERISTIC ip_tn_pi_neg_soi_ctl__n "PECO_CLCO: SOI_CTL error integral time at negative deviation" CURVE 0x847e56 _REC_CUR_20_u2_u2 3276.7 _CNV_A_R_LINEAR_____540_CM 0. 3276.7 DISPLAY_IDENTIFIER IP_TN_PI_NEG_SOI_CTL__N FORMAT "%5.1"
 /begin AXIS_DESCR COM_AXIS n _CNV_A_R_LINEAR_____5_CM 10 0. 6375. FORMAT "%4.0" AXIS_PTS_REF ldpm_n_ip_tn_pi_iv_close_ctl /end AXIS_DESCR
/end CHARACTERISTIC
/begin AXIS_PTS ldpm_n_ip_tn_pi_iv_close_ctl "" 0x843cb0 n _REC_AXS_20_u2 6375. _CNV_A_R_LINEAR_____5_CM 10 0. 6375. FORMAT "%4.0" /end AXIS_PTS
/begin CHARACTERISTIC ip_tn_pi_neg_t_iv_close_ctl__n "PECO_CLCO: T_IV_CLOSE_CTL error integral time at negative deviation" CURVE 0x847e6a _REC_CUR_20_u2_u2 3276.7 _CNV_A_R_LINEAR_____540_CM 0. 3276.7 DISPLAY_IDENTIFIER IP_TN_PI_NEG_T_IV_CLOSE_CTL__N FORMAT "%5.1"
 /begin AXIS_DESCR COM_AXIS n _CNV_A_R_LINEAR_____5_CM 10 0. 6375. FORMAT "%4.0" AXIS_PTS_REF ldpm_n_ip_tn_pi_iv_close_ctl /end AXIS_DESCR
/end CHARACTERISTIC
/begin CHARACTERISTIC ip_tn_pi_pos_soi_ctl__n "PECO_CLCO: SOI_CTL error integral time at positive deviation" CURVE 0x847ea6 _REC_CUR_20_u2_u2 3276.7 _CNV_A_R_LINEAR_____540_CM 0. 3276.7 DISPLAY_IDENTIFIER IP_TN_PI_POS_SOI_CTL__N FORMAT "%5.1"
 /begin AXIS_DESCR COM_AXIS n _CNV_A_R_LINEAR_____5_CM 10 0. 6375. FORMAT "%4.0" AXIS_PTS_REF ldpm_n_ip_tn_pi_iv_close_ctl /end AXIS_DESCR
/end CHARACTERISTIC
/begin CHARACTERISTIC ip_tn_pi_pos_t_iv_close_ctl__n "PECO_CLCO: T_IV_CLOSE_CTL error integral time at positive deviation" CURVE 0x847eba _REC_CUR_20_u2_u2 3276.7 _CNV_A_R_LINEAR_____540_CM 0. 3276.7 DISPLAY_IDENTIFIER IP_TN_PI_POS_T_IV_CLOSE_CTL__N FORMAT "%5.1"
 /begin AXIS_DESCR COM_AXIS n _CNV_A_R_LINEAR_____5_CM 10 0. 6375. FORMAT "%4.0" AXIS_PTS_REF ldpm_n_ip_tn_pi_iv_close_ctl /end AXIS_DESCR
/end CHARACTERISTIC
/begin CHARACTERISTIC ip_egy_sp_t_close_ctl__n__doi "PECO_CLCO: T_IV_CLOSE_CTL energy set point depending on N and DOI" MAP 0x846916 _REC_MAP_20_u2_u2_u2 522.7750632 _CNV_A_R_LINEAR_____534_CM 0. 522.7750632 DISPLAY_IDENTIFIER IP_EGY_SP_T_CLOSE_CTL__N__DOI
 /begin AXIS_DESCR COM_AXIS n _CNV_A_R_LINEAR_____5_CM 5 0. 6375. FORMAT "%4.0" AXIS_PTS_REF ldpm_n_ip_egy_sp_close_ctl /end AXIS_DESCR
 /begin AXIS_DESCR COM_AXIS dummy_peco _CNV_A_R_LINEAR_____121_CM 5 0. 360. FORMAT "%5.2" AXIS_PTS_REF ldp_doi_ip_egy_sp_close_ctl /end AXIS_DESCR
/end CHARACTERISTIC
/begin AXIS_PTS ldpm_n_ip_egy_sp_close_ctl "" 0x843a28 n _REC_AXS_20_u2 6375. _CNV_A_R_LINEAR_____5_CM 5 0. 6375. FORMAT "%4.0" /end AXIS_PTS
/begin AXIS_PTS ldp_doi_ip_egy_sp_close_ctl "" 0x8415ba dummy_peco _REC_AXS_20_u2 360. _CNV_A_R_LINEAR_____121_CM 5 0. 360. FORMAT "%5.2" /end AXIS_PTS
/begin CHARACTERISTIC ip_egy_sp_t_close_ctl__n__soi "PECO_CLCO: T_IV_CLOSE_CTL energy set point depending on N and SOI" MAP 0x846948 _REC_MAP_20_u2_u2_u2 522.7750632 _CNV_A_R_LINEAR_____534_CM 0. 522.7750632 DISPLAY_IDENTIFIER IP_EGY_SP_T_CLOSE_CTL__N__SOI
 /begin AXIS_DESCR COM_AXIS n _CNV_A_R_LINEAR_____5_CM 5 0. 6375. FORMAT "%4.0" AXIS_PTS_REF ldpm_n_ip_egy_sp_close_ctl /end AXIS_DESCR
 /begin AXIS_DESCR COM_AXIS soi_main1_pwr_on_tu _CNV_A_R_LINEAR_____120_CM 5 -120. 240. FORMAT "%5.2" AXIS_PTS_REF ldp_soi_ip_egy_sp_close_ctl /end AXIS_DESCR
/end CHARACTERISTIC
/begin AXIS_PTS ldp_soi_ip_egy_sp_close_ctl "" 0x84257e soi_main1_pwr_on_tu _REC_AXS_20_u2 360. _CNV_A_R_LINEAR_____120_CM 5 -120. 240. FORMAT "%5.2" /end AXIS_PTS
/begin CHARACTERISTIC ip_fac_egy_sp_t_ctl__tco__capa "PECO_CLCO: T_IV_CLOSE_CTL energy set point tuning depending on TCO and CAPA representing the piezo temperature" MAP 0x846adc _REC_MAP_20_u2_u1_u1 1.9999696 _CNV_A_R_LINEAR_____53_CM 0. 1.9999696 DISPLAY_IDENTIFIER IP_FAC_EGY_SP_T_CTL__TCO__CAPA FORMAT "%6.5"
 /begin AXIS_DESCR COM_AXIS tco _CNV_A_R_LINEAR_____18_CM 5 -50. 205. FORMAT "%3.0" AXIS_PTS_REF ldpm_tco_ip_egy_sp_close_ctl /end AXIS_DESCR
 /begin AXIS_DESCR COM_AXIS dummy_peco _CNV_A_R_LINEAR_____122_CM 5 0. 31.96875 FORMAT "%3.1" AXIS_PTS_REF ldp_capa_ip_egy_sp_close_ctl /end AXIS_DESCR
/end CHARACTERISTIC
/begin AXIS_PTS ldp_capa_ip_egy_sp_close_ctl "" 0x841446 dummy_peco _REC_AXS_20_u1 31.96875 _CNV_A_R_LINEAR_____122_CM 5 0. 31.96875 FORMAT "%3.1" /end AXIS_PTS
/begin CHARACTERISTIC ip_t_iv_close_sp__n__doi "PECO_CLCO: valve needle closing time set point depending on N and DOI" MAP 0x8476ca _REC_MAP_20_u2_u2_u2 0.512 _CNV_A_R_LINEAR_____533_CM 0. 0.512 DISPLAY_IDENTIFIER IP_T_IV_CLOSE_SP__N__DOI FORMAT "%4.3"
 /begin AXIS_DESCR COM_AXIS n _CNV_A_R_LINEAR_____5_CM 5 0. 6375. FORMAT "%4.0" AXIS_PTS_REF ldpm_n_ip_t_iv_close_sp /end AXIS_DESCR
 /begin AXIS_DESCR COM_AXIS dummy_peco _CNV_A_R_LINEAR_____121_CM 5 0. 360. FORMAT "%5.2" AXIS_PTS_REF ldp_doi_ip_t_iv_close_sp /end AXIS_DESCR
/end CHARACTERISTIC
/begin AXIS_PTS ldpm_n_ip_t_iv_close_sp "" 0x843c6c n _REC_AXS_20_u2 6375. _CNV_A_R_LINEAR_____5_CM 5 0. 6375. FORMAT "%4.0" /end AXIS_PTS
/begin AXIS_PTS ldp_doi_ip_t_iv_close_sp "" 0x8415d2 dummy_peco _REC_AXS_20_u2 360. _CNV_A_R_LINEAR_____121_CM 5 0. 360. FORMAT "%5.2" /end AXIS_PTS
/begin CHARACTERISTIC ip_t_iv_close_sp__n__soi "PECO_CLCO: valve needle closing time set point depending on N and SOI" MAP 0x8476fc _REC_MAP_20_u2_u2_u2 0.512 _CNV_A_R_LINEAR_____533_CM 0. 0.512 DISPLAY_IDENTIFIER IP_T_IV_CLOSE_SP__N__SOI FORMAT "%4.3"
 /begin AXIS_DESCR COM_AXIS n _CNV_A_R_LINEAR_____5_CM 5 0. 6375. FORMAT "%4.0" AXIS_PTS_REF ldpm_n_ip_t_iv_close_sp /end AXIS_DESCR
 /begin AXIS_DESCR COM_AXIS soi_main1_pwr_on_tu _CNV_A_R_LINEAR_____120_CM 5 -120. 240. FORMAT "%5.2" AXIS_PTS_REF ldp_soi_ip_t_iv_close_sp /end AXIS_DESCR
/end CHARACTERISTIC
/begin AXIS_PTS ldp_soi_ip_t_iv_close_sp "" 0x842596 soi_main1_pwr_on_tu _REC_AXS_20_u2 360. _CNV_A_R_LINEAR_____120_CM 5 -120. 240. FORMAT "%5.2" /end AXIS_PTS
/begin CHARACTERISTIC ip_t_iv_close_sp__tco__capa "PECO_CLCO: valve needle closing time set point depending on TCO and CAPA_INJ representing piezo temperature" MAP 0x84772e _REC_MAP_20_u2_u1_u1 0.512 _CNV_A_R_LINEAR_____533_CM 0. 0.512 DISPLAY_IDENTIFIER IP_T_IV_CLOSE_SP__TCO__CAPA FORMAT "%4.3"
 /begin AXIS_DESCR COM_AXIS tco _CNV_A_R_LINEAR_____18_CM 5 -50. 205. FORMAT "%3.0" AXIS_PTS_REF ldp_tco_ip_t_iv_close_sp /end AXIS_DESCR
 /begin AXIS_DESCR COM_AXIS dummy_peco _CNV_A_R_LINEAR_____122_CM 5 0. 31.96875 FORMAT "%3.1" AXIS_PTS_REF ldp_capa_ip_t_iv_close_sp /end AXIS_DESCR
/end CHARACTERISTIC
/begin AXIS_PTS ldp_tco_ip_t_iv_close_sp "" 0x842841 tco _REC_AXS_20_u1 255. _CNV_A_R_LINEAR_____18_CM 5 -50. 205. FORMAT "%3.0" /end AXIS_PTS
/begin AXIS_PTS ldp_capa_ip_t_iv_close_sp "" 0x841452 dummy_peco _REC_AXS_20_u1 31.96875 _CNV_A_R_LINEAR_____122_CM 5 0. 31.96875 FORMAT "%3.1" /end AXIS_PTS
/begin CHARACTERISTIC lc_t_iv_close_sel "select t_iv_close (1: t_iv_close_stat_mean_, 0: t_iv_close_)" VALUE 0x8487d7 _REC_VAL_20_u1 1. _CNV_A_R_LINEAR_____0_CM 0. 1. DISPLAY_IDENTIFIER LC_T_IV_CLOSE_SEL FORMAT "%1.0" /end CHARACTERISTIC
/begin MEASUREMENT v_inj_burst_act_[73] "voltage burst signal (choosen for detection)" UWORD _CNV_A_R_LINEAR_____123_CM 1 0. 0. 255. DISPLAY_IDENTIFIER V_INJ_BURST_ACT__73_ ECU_ADDRESS 0x7fadd4 BYTE_ORDER MSB_LAST FORMAT "%4.1" /end MEASUREMENT
/begin MEASUREMENT v_inj_burst_act_[74] "voltage burst signal (choosen for detection)" UWORD _CNV_A_R_LINEAR_____123_CM 1 0. 0. 255. DISPLAY_IDENTIFIER V_INJ_BURST_ACT__74_ ECU_ADDRESS 0x7fadd6 BYTE_ORDER MSB_LAST FORMAT "%4.1" /end MEASUREMENT
/begin MEASUREMENT v_inj_burst_act_[75] "voltage burst signal (choosen for detection)" UWORD _CNV_A_R_LINEAR_____123_CM 1 0. 0. 255. DISPLAY_IDENTIFIER V_INJ_BURST_ACT__75_ ECU_ADDRESS 0x7fadd8 BYTE_ORDER MSB_LAST FORMAT "%4.1" /end MEASUREMENT
/begin MEASUREMENT v_inj_burst_act_[76] "voltage burst signal (choosen for detection)" UWORD _CNV_A_R_LINEAR_____123_CM 1 0. 0. 255. DISPLAY_IDENTIFIER V_INJ_BURST_ACT__76_ ECU_ADDRESS 0x7fadda BYTE_ORDER MSB_LAST FORMAT "%4.1" /end MEASUREMENT
/begin MEASUREMENT v_inj_burst_act_[77] "voltage burst signal (choosen for detection)" UWORD _CNV_A_R_LINEAR_____123_CM 1 0. 0. 255. DISPLAY_IDENTIFIER V_INJ_BURST_ACT__77_ ECU_ADDRESS 0x7faddc BYTE_ORDER MSB_LAST FORMAT "%4.1" /end MEASUREMENT
/begin MEASUREMENT v_inj_burst_act_[78] "voltage burst signal (choosen for detection)" UWORD _CNV_A_R_LINEAR_____123_CM 1 0. 0. 255. DISPLAY_IDENTIFIER V_INJ_BURST_ACT__78_ ECU_ADDRESS 0x7fadde BYTE_ORDER MSB_LAST FORMAT "%4.1" /end MEASUREMENT
/begin MEASUREMENT v_inj_burst_act_[79] "voltage burst signal (choosen for detection)" UWORD _CNV_A_R_LINEAR_____123_CM 1 0. 0. 255. DISPLAY_IDENTIFIER V_INJ_BURST_ACT__79_ ECU_ADDRESS 0x7fade0 BYTE_ORDER MSB_LAST FORMAT "%4.1" /end MEASUREMENT
/begin MEASUREMENT v_inj_burst_act_[80] "voltage burst signal (choosen for detection)" UWORD _CNV_A_R_LINEAR_____123_CM 1 0. 0. 255. DISPLAY_IDENTIFIER V_INJ_BURST_ACT__80_ ECU_ADDRESS 0x7fade2 BYTE_ORDER MSB_LAST FORMAT "%4.1" /end MEASUREMENT
/begin MEASUREMENT v_inj_burst_act_[81] "voltage burst signal (choosen for detection)" UWORD _CNV_A_R_LINEAR_____123_CM 1 0. 0. 255. DISPLAY_IDENTIFIER V_INJ_BURST_ACT__81_ ECU_ADDRESS 0x7fade4 BYTE_ORDER MSB_LAST FORMAT "%4.1" /end MEASUREMENT
/begin MEASUREMENT v_inj_burst_act_[82] "voltage burst signal (choosen for detection)" UWORD _CNV_A_R_LINEAR_____123_CM 1 0. 0. 255. DISPLAY_IDENTIFIER V_INJ_BURST_ACT__82_ ECU_ADDRESS 0x7fade6 BYTE_ORDER MSB_LAST FORMAT "%4.1" /end MEASUREMENT
/begin MEASUREMENT v_inj_burst_act_[83] "voltage burst signal (choosen for detection)" UWORD _CNV_A_R_LINEAR_____123_CM 1 0. 0. 255. DISPLAY_IDENTIFIER V_INJ_BURST_ACT__83_ ECU_ADDRESS 0x7fade8 BYTE_ORDER MSB_LAST FORMAT "%4.1" /end MEASUREMENT
/begin MEASUREMENT v_inj_burst_act_[84] "voltage burst signal (choosen for detection)" UWORD _CNV_A_R_LINEAR_____123_CM 1 0. 0. 255. DISPLAY_IDENTIFIER V_INJ_BURST_ACT__84_ ECU_ADDRESS 0x7fadea BYTE_ORDER MSB_LAST FORMAT "%4.1" /end MEASUREMENT
/begin MEASUREMENT v_inj_burst_act_[85] "voltage burst signal (choosen for detection)" UWORD _CNV_A_R_LINEAR_____123_CM 1 0. 0. 255. DISPLAY_IDENTIFIER V_INJ_BURST_ACT__85_ ECU_ADDRESS 0x7fadec BYTE_ORDER MSB_LAST FORMAT "%4.1" /end MEASUREMENT
/begin MEASUREMENT v_inj_burst_act_[86] "voltage burst signal (choosen for detection)" UWORD _CNV_A_R_LINEAR_____123_CM 1 0. 0. 255. DISPLAY_IDENTIFIER V_INJ_BURST_ACT__86_ ECU_ADDRESS 0x7fadee BYTE_ORDER MSB_LAST FORMAT "%4.1" /end MEASUREMENT
/begin MEASUREMENT v_inj_burst_act_[87] "voltage burst signal (choosen for detection)" UWORD _CNV_A_R_LINEAR_____123_CM 1 0. 0. 255. DISPLAY_IDENTIFIER V_INJ_BURST_ACT__87_ ECU_ADDRESS 0x7fadf0 BYTE_ORDER MSB_LAST FORMAT "%4.1" /end MEASUREMENT
/begin MEASUREMENT v_inj_burst_dif1_[0] "first order derivation of voltage burst signal" SWORD _CNV_A_R_LINEAR_____549_CM 1 0. -256. 255. DISPLAY_IDENTIFIER V_INJ_BURST_DIF1__0_ ECU_ADDRESS 0x7fadf2 BYTE_ORDER MSB_LAST FORMAT "%4.1" /end MEASUREMENT
/begin MEASUREMENT v_inj_burst_dif1_[1] "first order derivation of voltage burst signal" SWORD _CNV_A_R_LINEAR_____549_CM 1 0. -256. 255. DISPLAY_IDENTIFIER V_INJ_BURST_DIF1__1_ ECU_ADDRESS 0x7fadf4 BYTE_ORDER MSB_LAST FORMAT "%4.1" /end MEASUREMENT
/begin MEASUREMENT v_inj_burst_dif1_[2] "first order derivation of voltage burst signal" SWORD _CNV_A_R_LINEAR_____549_CM 1 0. -256. 255. DISPLAY_IDENTIFIER V_INJ_BURST_DIF1__2_ ECU_ADDRESS 0x7fadf6 BYTE_ORDER MSB_LAST FORMAT "%4.1" /end MEASUREMENT
/begin MEASUREMENT v_inj_burst_dif1_[3] "first order derivation of voltage burst signal" SWORD _CNV_A_R_LINEAR_____549_CM 1 0. -256. 255. DISPLAY_IDENTIFIER V_INJ_BURST_DIF1__3_ ECU_ADDRESS 0x7fadf8 BYTE_ORDER MSB_LAST FORMAT "%4.1" /end MEASUREMENT
/begin MEASUREMENT v_inj_burst_dif2_[0] "second order derivation of voltage burst signal" SWORD _CNV_A_R_LINEAR_____549_CM 1 0. -256. 255. DISPLAY_IDENTIFIER V_INJ_BURST_DIF2__0_ ECU_ADDRESS 0x7fadfa BYTE_ORDER MSB_LAST FORMAT "%4.1" /end MEASUREMENT
/begin MEASUREMENT v_inj_burst_dif2_[1] "second order derivation of voltage burst signal" SWORD _CNV_A_R_LINEAR_____549_CM 1 0. -256. 255. DISPLAY_IDENTIFIER V_INJ_BURST_DIF2__1_ ECU_ADDRESS 0x7fadfc BYTE_ORDER MSB_LAST FORMAT "%4.1" /end MEASUREMENT
/begin MEASUREMENT v_inj_burst_dif2_[2] "second order derivation of voltage burst signal" SWORD _CNV_A_R_LINEAR_____549_CM 1 0. -256. 255. DISPLAY_IDENTIFIER V_INJ_BURST_DIF2__2_ ECU_ADDRESS 0x7fadfe BYTE_ORDER MSB_LAST FORMAT "%4.1" /end MEASUREMENT
/begin MEASUREMENT v_inj_burst_dif2_[3] "second order derivation of voltage burst signal" SWORD _CNV_A_R_LINEAR_____549_CM 1 0. -256. 255. DISPLAY_IDENTIFIER V_INJ_BURST_DIF2__3_ ECU_ADDRESS 0x7fae00 BYTE_ORDER MSB_LAST FORMAT "%4.1" /end MEASUREMENT
/begin MEASUREMENT v_inj_burst_exp_[0] "voltage burst signal (expanded)" UWORD _CNV_A_R_LINEAR_____123_CM 1 0. 0. 255. DISPLAY_IDENTIFIER V_INJ_BURST_EXP__0_ ECU_ADDRESS 0x7fae02 BYTE_ORDER MSB_LAST FORMAT "%4.1" /end MEASUREMENT
/begin MEASUREMENT v_inj_burst_exp_[1] "voltage burst signal (expanded)" UWORD _CNV_A_R_LINEAR_____123_CM 1 0. 0. 255. DISPLAY_IDENTIFIER V_INJ_BURST_EXP__1_ ECU_ADDRESS 0x7fae04 BYTE_ORDER MSB_LAST FORMAT "%4.1" /end MEASUREMENT
/begin MEASUREMENT v_inj_burst_exp_[2] "voltage burst signal (expanded)" UWORD _CNV_A_R_LINEAR_____123_CM 1 0. 0. 255. DISPLAY_IDENTIFIER V_INJ_BURST_EXP__2_ ECU_ADDRESS 0x7fae06 BYTE_ORDER MSB_LAST FORMAT "%4.1" /end MEASUREMENT
/begin MEASUREMENT v_inj_burst_exp_[3] "voltage burst signal (expanded)" UWORD _CNV_A_R_LINEAR_____123_CM 1 0. 0. 255. DISPLAY_IDENTIFIER V_INJ_BURST_EXP__3_ ECU_ADDRESS 0x7fae08 BYTE_ORDER MSB_LAST FORMAT "%4.1" /end MEASUREMENT
/begin MEASUREMENT v_inj_burst_exp_[4] "voltage burst signal (expanded)" UWORD _CNV_A_R_LINEAR_____123_CM 1 0. 0. 255. DISPLAY_IDENTIFIER V_INJ_BURST_EXP__4_ ECU_ADDRESS 0x7fae0a BYTE_ORDER MSB_LAST FORMAT "%4.1" /end MEASUREMENT
/begin MEASUREMENT v_inj_burst_exp_[5] "voltage burst signal (expanded)" UWORD _CNV_A_R_LINEAR_____123_CM 1 0. 0. 255. DISPLAY_IDENTIFIER V_INJ_BURST_EXP__5_ ECU_ADDRESS 0x7fae0c BYTE_ORDER MSB_LAST FORMAT "%4.1" /end MEASUREMENT
/begin MEASUREMENT v_inj_burst_exp_[6] "voltage burst signal (expanded)" UWORD _CNV_A_R_LINEAR_____123_CM 1 0. 0. 255. DISPLAY_IDENTIFIER V_INJ_BURST_EXP__6_ ECU_ADDRESS 0x7fae0e BYTE_ORDER MSB_LAST FORMAT "%4.1" /end MEASUREMENT
/begin MEASUREMENT v_inj_burst_exp_[7] "voltage burst signal (expanded)" UWORD _CNV_A_R_LINEAR_____123_CM 1 0. 0. 255. DISPLAY_IDENTIFIER V_INJ_BURST_EXP__7_ ECU_ADDRESS 0x7fae10 BYTE_ORDER MSB_LAST FORMAT "%4.1" /end MEASUREMENT
/begin MEASUREMENT v_inj_burst_exp_[8] "voltage burst signal (expanded)" UWORD _CNV_A_R_LINEAR_____123_CM 1 0. 0. 255. DISPLAY_IDENTIFIER V_INJ_BURST_EXP__8_ ECU_ADDRESS 0x7fae12 BYTE_ORDER MSB_LAST FORMAT "%4.1" /end MEASUREMENT
/begin MEASUREMENT v_inj_burst_exp_[9] "voltage burst signal (expanded)" UWORD _CNV_A_R_LINEAR_____123_CM 1 0. 0. 255. DISPLAY_IDENTIFIER V_INJ_BURST_EXP__9_ ECU_ADDRESS 0x7fae14 BYTE_ORDER MSB_LAST FORMAT "%4.1" /end MEASUREMENT
/begin MEASUREMENT v_inj_burst_exp_[10] "voltage burst signal (expanded)" UWORD _CNV_A_R_LINEAR_____123_CM 1 0. 0. 255. DISPLAY_IDENTIFIER V_INJ_BURST_EXP__10_ ECU_ADDRESS 0x7fae16 BYTE_ORDER MSB_LAST FORMAT "%4.1" /end MEASUREMENT
/begin MEASUREMENT v_inj_burst_exp_[11] "voltage burst signal (expanded)" UWORD _CNV_A_R_LINEAR_____123_CM 1 0. 0. 255. DISPLAY_IDENTIFIER V_INJ_BURST_EXP__11_ ECU_ADDRESS 0x7fae18 BYTE_ORDER MSB_LAST FORMAT "%4.1" /end MEASUREMENT
/begin MEASUREMENT v_inj_burst_exp_[12] "voltage burst signal (expanded)" UWORD _CNV_A_R_LINEAR_____123_CM 1 0. 0. 255. DISPLAY_IDENTIFIER V_INJ_BURST_EXP__12_ ECU_ADDRESS 0x7fae1a BYTE_ORDER MSB_LAST FORMAT "%4.1" /end MEASUREMENT
/begin MEASUREMENT v_inj_burst_exp_[13] "voltage burst signal (expanded)" UWORD _CNV_A_R_LINEAR_____123_CM 1 0. 0. 255. DISPLAY_IDENTIFIER V_INJ_BURST_EXP__13_ ECU_ADDRESS 0x7fae1c BYTE_ORDER MSB_LAST FORMAT "%4.1" /end MEASUREMENT
/begin MEASUREMENT v_inj_burst_exp_[14] "voltage burst signal (expanded)" UWORD _CNV_A_R_LINEAR_____123_CM 1 0. 0. 255. DISPLAY_IDENTIFIER V_INJ_BURST_EXP__14_ ECU_ADDRESS 0x7fae1e BYTE_ORDER MSB_LAST FORMAT "%4.1" /end MEASUREMENT
/begin MEASUREMENT v_inj_burst_exp_[15] "voltage burst signal (expanded)" UWORD _CNV_A_R_LINEAR_____123_CM 1 0. 0. 255. DISPLAY_IDENTIFIER V_INJ_BURST_EXP__15_ ECU_ADDRESS 0x7fae20 BYTE_ORDER MSB_LAST FORMAT "%4.1" /end MEASUREMENT
/begin MEASUREMENT v_inj_burst_exp_[16] "voltage burst signal (expanded)" UWORD _CNV_A_R_LINEAR_____123_CM 1 0. 0. 255. DISPLAY_IDENTIFIER V_INJ_BURST_EXP__16_ ECU_ADDRESS 0x7fae22 BYTE_ORDER MSB_LAST FORMAT "%4.1" /end MEASUREMENT
/begin MEASUREMENT v_inj_burst_exp_[17] "voltage burst signal (expanded)" UWORD _CNV_A_R_LINEAR_____123_CM 1 0. 0. 255. DISPLAY_IDENTIFIER V_INJ_BURST_EXP__17_ ECU_ADDRESS 0x7fae24 BYTE_ORDER MSB_LAST FORMAT "%4.1" /end MEASUREMENT
/begin MEASUREMENT v_inj_burst_exp_[18] "voltage burst signal (expanded)" UWORD _CNV_A_R_LINEAR_____123_CM 1 0. 0. 255. DISPLAY_IDENTIFIER V_INJ_BURST_EXP__18_ ECU_ADDRESS 0x7fae26 BYTE_ORDER MSB_LAST FORMAT "%4.1" /end MEASUREMENT
/begin MEASUREMENT v_inj_burst_exp_[19] "voltage burst signal (expanded)" UWORD _CNV_A_R_LINEAR_____123_CM 1 0. 0. 255. DISPLAY_IDENTIFIER V_INJ_BURST_EXP__19_ ECU_ADDRESS 0x7fae28 BYTE_ORDER MSB_LAST FORMAT "%4.1" /end MEASUREMENT
/begin MEASUREMENT v_inj_burst_exp_[20] "voltage burst signal (expanded)" UWORD _CNV_A_R_LINEAR_____123_CM 1 0. 0. 255. DISPLAY_IDENTIFIER V_INJ_BURST_EXP__20_ ECU_ADDRESS 0x7fae2a BYTE_ORDER MSB_LAST FORMAT "%4.1" /end MEASUREMENT
/begin MEASUREMENT v_inj_burst_exp_[21] "voltage burst signal (expanded)" UWORD _CNV_A_R_LINEAR_____123_CM 1 0. 0. 255. DISPLAY_IDENTIFIER V_INJ_BURST_EXP__21_ ECU_ADDRESS 0x7fae2c BYTE_ORDER MSB_LAST FORMAT "%4.1" /end MEASUREMENT
/begin MEASUREMENT v_inj_burst_exp_[22] "voltage burst signal (expanded)" UWORD _CNV_A_R_LINEAR_____123_CM 1 0. 0. 255. DISPLAY_IDENTIFIER V_INJ_BURST_EXP__22_ ECU_ADDRESS 0x7fae2e BYTE_ORDER MSB_LAST FORMAT "%4.1" /end MEASUREMENT
/begin MEASUREMENT v_inj_burst_exp_[23] "voltage burst signal (expanded)" UWORD _CNV_A_R_LINEAR_____123_CM 1 0. 0. 255. DISPLAY_IDENTIFIER V_INJ_BURST_EXP__23_ ECU_ADDRESS 0x7fae30 BYTE_ORDER MSB_LAST FORMAT "%4.1" /end MEASUREMENT
/begin MEASUREMENT v_inj_burst_exp_[24] "voltage burst signal (expanded)" UWORD _CNV_A_R_LINEAR_____123_CM 1 0. 0. 255. DISPLAY_IDENTIFIER V_INJ_BURST_EXP__24_ ECU_ADDRESS 0x7fae32 BYTE_ORDER MSB_LAST FORMAT "%4.1" /end MEASUREMENT
/begin MEASUREMENT v_inj_burst_exp_[25] "voltage burst signal (expanded)" UWORD _CNV_A_R_LINEAR_____123_CM 1 0. 0. 255. DISPLAY_IDENTIFIER V_INJ_BURST_EXP__25_ ECU_ADDRESS 0x7fae34 BYTE_ORDER MSB_LAST FORMAT "%4.1" /end MEASUREMENT
/begin MEASUREMENT v_inj_burst_exp_[26] "voltage burst signal (expanded)" UWORD _CNV_A_R_LINEAR_____123_CM 1 0. 0. 255. DISPLAY_IDENTIFIER V_INJ_BURST_EXP__26_ ECU_ADDRESS 0x7fae36 BYTE_ORDER MSB_LAST FORMAT "%4.1" /end MEASUREMENT
/begin MEASUREMENT v_inj_burst_exp_[27] "voltage burst signal (expanded)" UWORD _CNV_A_R_LINEAR_____123_CM 1 0. 0. 255. DISPLAY_IDENTIFIER V_INJ_BURST_EXP__27_ ECU_ADDRESS 0x7fae38 BYTE_ORDER MSB_LAST FORMAT "%4.1" /end MEASUREMENT
/begin MEASUREMENT v_inj_burst_exp_[28] "voltage burst signal (expanded)" UWORD _CNV_A_R_LINEAR_____123_CM 1 0. 0. 255. DISPLAY_IDENTIFIER V_INJ_BURST_EXP__28_ ECU_ADDRESS 0x7fae3a BYTE_ORDER MSB_LAST FORMAT "%4.1" /end MEASUREMENT
/begin MEASUREMENT v_inj_burst_exp_[29] "voltage burst signal (expanded)" UWORD _CNV_A_R_LINEAR_____123_CM 1 0. 0. 255. DISPLAY_IDENTIFIER V_INJ_BURST_EXP__29_ ECU_ADDRESS 0x7fae3c BYTE_ORDER MSB_LAST FORMAT "%4.1" /end MEASUREMENT
/begin MEASUREMENT v_inj_burst_exp_[30] "voltage burst signal (expanded)" UWORD _CNV_A_R_LINEAR_____123_CM 1 0. 0. 255. DISPLAY_IDENTIFIER V_INJ_BURST_EXP__30_ ECU_ADDRESS 0x7fae3e BYTE_ORDER MSB_LAST FORMAT "%4.1" /end MEASUREMENT
/begin MEASUREMENT v_inj_burst_exp_[31] "voltage burst signal (expanded)" UWORD _CNV_A_R_LINEAR_____123_CM 1 0. 0. 255. DISPLAY_IDENTIFIER V_INJ_BURST_EXP__31_ ECU_ADDRESS 0x7fae40 BYTE_ORDER MSB_LAST FORMAT "%4.1" /end MEASUREMENT
/begin MEASUREMENT v_inj_burst_exp_[32] "voltage burst signal (expanded)" UWORD _CNV_A_R_LINEAR_____123_CM 1 0. 0. 255. DISPLAY_IDENTIFIER V_INJ_BURST_EXP__32_ ECU_ADDRESS 0x7fae42 BYTE_ORDER MSB_LAST FORMAT "%4.1" /end MEASUREMENT
/begin MEASUREMENT v_inj_burst_exp_[33] "voltage burst signal (expanded)" UWORD _CNV_A_R_LINEAR_____123_CM 1 0. 0. 255. DISPLAY_IDENTIFIER V_INJ_BURST_EXP__33_ ECU_ADDRESS 0x7fae44 BYTE_ORDER MSB_LAST FORMAT "%4.1" /end MEASUREMENT
/begin MEASUREMENT v_inj_burst_exp_[34] "voltage burst signal (expanded)" UWORD _CNV_A_R_LINEAR_____123_CM 1 0. 0. 255. DISPLAY_IDENTIFIER V_INJ_BURST_EXP__34_ ECU_ADDRESS 0x7fae46 BYTE_ORDER MSB_LAST FORMAT "%4.1" /end MEASUREMENT
/begin MEASUREMENT v_inj_burst_exp_[35] "voltage burst signal (expanded)" UWORD _CNV_A_R_LINEAR_____123_CM 1 0. 0. 255. DISPLAY_IDENTIFIER V_INJ_BURST_EXP__35_ ECU_ADDRESS 0x7fae48 BYTE_ORDER MSB_LAST FORMAT "%4.1" /end MEASUREMENT
/begin MEASUREMENT v_inj_burst_exp_[36] "voltage burst signal (expanded)" UWORD _CNV_A_R_LINEAR_____123_CM 1 0. 0. 255. DISPLAY_IDENTIFIER V_INJ_BURST_EXP__36_ ECU_ADDRESS 0x7fae4a BYTE_ORDER MSB_LAST FORMAT "%4.1" /end MEASUREMENT
/begin MEASUREMENT v_inj_burst_exp_[37] "voltage burst signal (expanded)" UWORD _CNV_A_R_LINEAR_____123_CM 1 0. 0. 255. DISPLAY_IDENTIFIER V_INJ_BURST_EXP__37_ ECU_ADDRESS 0x7fae4c BYTE_ORDER MSB_LAST FORMAT "%4.1" /end MEASUREMENT
/begin MEASUREMENT v_inj_burst_exp_[38] "voltage burst signal (expanded)" UWORD _CNV_A_R_LINEAR_____123_CM 1 0. 0. 255. DISPLAY_IDENTIFIER V_INJ_BURST_EXP__38_ ECU_ADDRESS 0x7fae4e BYTE_ORDER MSB_LAST FORMAT "%4.1" /end MEASUREMENT
/begin MEASUREMENT v_inj_burst_exp_[39] "voltage burst signal (expanded)" UWORD _CNV_A_R_LINEAR_____123_CM 1 0. 0. 255. DISPLAY_IDENTIFIER V_INJ_BURST_EXP__39_ ECU_ADDRESS 0x7fae50 BYTE_ORDER MSB_LAST FORMAT "%4.1" /end MEASUREMENT
/begin MEASUREMENT v_inj_burst_exp_[40] "voltage burst signal (expanded)" UWORD _CNV_A_R_LINEAR_____123_CM 1 0. 0. 255. DISPLAY_IDENTIFIER V_INJ_BURST_EXP__40_ ECU_ADDRESS 0x7fae52 BYTE_ORDER MSB_LAST FORMAT "%4.1" /end MEASUREMENT
/begin MEASUREMENT v_inj_burst_exp_[41] "voltage burst signal (expanded)" UWORD _CNV_A_R_LINEAR_____123_CM 1 0. 0. 255. DISPLAY_IDENTIFIER V_INJ_BURST_EXP__41_ ECU_ADDRESS 0x7fae54 BYTE_ORDER MSB_LAST FORMAT "%4.1" /end MEASUREMENT
/begin MEASUREMENT v_inj_burst_exp_[42] "voltage burst signal (expanded)" UWORD _CNV_A_R_LINEAR_____123_CM 1 0. 0. 255. DISPLAY_IDENTIFIER V_INJ_BURST_EXP__42_ ECU_ADDRESS 0x7fae56 BYTE_ORDER MSB_LAST FORMAT "%4.1" /end MEASUREMENT
/begin MEASUREMENT v_inj_burst_exp_[43] "voltage burst signal (expanded)" UWORD _CNV_A_R_LINEAR_____123_CM 1 0. 0. 255. DISPLAY_IDENTIFIER V_INJ_BURST_EXP__43_ ECU_ADDRESS 0x7fae58 BYTE_ORDER MSB_LAST FORMAT "%4.1" /end MEASUREMENT
/begin MEASUREMENT v_inj_burst_exp_[44] "voltage burst signal (expanded)" UWORD _CNV_A_R_LINEAR_____123_CM 1 0. 0. 255. DISPLAY_IDENTIFIER V_INJ_BURST_EXP__44_ ECU_ADDRESS 0x7fae5a BYTE_ORDER MSB_LAST FORMAT "%4.1" /end MEASUREMENT
/begin MEASUREMENT v_inj_burst_exp_[45] "voltage burst signal (expanded)" UWORD _CNV_A_R_LINEAR_____123_CM 1 0. 0. 255. DISPLAY_IDENTIFIER V_INJ_BURST_EXP__45_ ECU_ADDRESS 0x7fae5c BYTE_ORDER MSB_LAST FORMAT "%4.1" /end MEASUREMENT
/begin MEASUREMENT v_inj_burst_exp_[46] "voltage burst signal (expanded)" UWORD _CNV_A_R_LINEAR_____123_CM 1 0. 0. 255. DISPLAY_IDENTIFIER V_INJ_BURST_EXP__46_ ECU_ADDRESS 0x7fae5e BYTE_ORDER MSB_LAST FORMAT "%4.1" /end MEASUREMENT
/begin MEASUREMENT v_inj_burst_exp_[47] "voltage burst signal (expanded)" UWORD _CNV_A_R_LINEAR_____123_CM 1 0. 0. 255. DISPLAY_IDENTIFIER V_INJ_BURST_EXP__47_ ECU_ADDRESS 0x7fae60 BYTE_ORDER MSB_LAST FORMAT "%4.1" /end MEASUREMENT
/begin MEASUREMENT v_inj_burst_exp_[48] "voltage burst signal (expanded)" UWORD _CNV_A_R_LINEAR_____123_CM 1 0. 0. 255. DISPLAY_IDENTIFIER V_INJ_BURST_EXP__48_ ECU_ADDRESS 0x7fae62 BYTE_ORDER MSB_LAST FORMAT "%4.1" /end MEASUREMENT
/begin MEASUREMENT v_inj_burst_exp_[49] "voltage burst signal (expanded)" UWORD _CNV_A_R_LINEAR_____123_CM 1 0. 0. 255. DISPLAY_IDENTIFIER V_INJ_BURST_EXP__49_ ECU_ADDRESS 0x7fae64 BYTE_ORDER MSB_LAST FORMAT "%4.1" /end MEASUREMENT
/begin MEASUREMENT v_inj_burst_exp_[50] "voltage burst signal (expanded)" UWORD _CNV_A_R_LINEAR_____123_CM 1 0. 0. 255. DISPLAY_IDENTIFIER V_INJ_BURST_EXP__50_ ECU_ADDRESS 0x7fae66 BYTE_ORDER MSB_LAST FORMAT "%4.1" /end MEASUREMENT
/begin MEASUREMENT v_inj_burst_exp_[51] "voltage burst signal (expanded)" UWORD _CNV_A_R_LINEAR_____123_CM 1 0. 0. 255. DISPLAY_IDENTIFIER V_INJ_BURST_EXP__51_ ECU_ADDRESS 0x7fae68 BYTE_ORDER MSB_LAST FORMAT "%4.1" /end MEASUREMENT
/begin MEASUREMENT v_inj_burst_exp_[52] "voltage burst signal (expanded)" UWORD _CNV_A_R_LINEAR_____123_CM 1 0. 0. 255. DISPLAY_IDENTIFIER V_INJ_BURST_EXP__52_ ECU_ADDRESS 0x7fae6a BYTE_ORDER MSB_LAST FORMAT "%4.1" /end MEASUREMENT
/begin MEASUREMENT v_inj_burst_exp_[53] "voltage burst signal (expanded)" UWORD _CNV_A_R_LINEAR_____123_CM 1 0. 0. 255. DISPLAY_IDENTIFIER V_INJ_BURST_EXP__53_ ECU_ADDRESS 0x7fae6c BYTE_ORDER MSB_LAST FORMAT "%4.1" /end MEASUREMENT
/begin MEASUREMENT v_inj_burst_exp_[54] "voltage burst signal (expanded)" UWORD _CNV_A_R_LINEAR_____123_CM 1 0. 0. 255. DISPLAY_IDENTIFIER V_INJ_BURST_EXP__54_ ECU_ADDRESS 0x7fae6e BYTE_ORDER MSB_LAST FORMAT "%4.1" /end MEASUREMENT
/begin MEASUREMENT v_inj_burst_exp_[55] "voltage burst signal (expanded)" UWORD _CNV_A_R_LINEAR_____123_CM 1 0. 0. 255. DISPLAY_IDENTIFIER V_INJ_BURST_EXP__55_ ECU_ADDRESS 0x7fae70 BYTE_ORDER MSB_LAST FORMAT "%4.1" /end MEASUREMENT
/begin MEASUREMENT v_inj_burst_exp_[56] "voltage burst signal (expanded)" UWORD _CNV_A_R_LINEAR_____123_CM 1 0. 0. 255. DISPLAY_IDENTIFIER V_INJ_BURST_EXP__56_ ECU_ADDRESS 0x7fae72 BYTE_ORDER MSB_LAST FORMAT "%4.1" /end MEASUREMENT
/begin MEASUREMENT v_inj_burst_exp_[57] "voltage burst signal (expanded)" UWORD _CNV_A_R_LINEAR_____123_CM 1 0. 0. 255. DISPLAY_IDENTIFIER V_INJ_BURST_EXP__57_ ECU_ADDRESS 0x7fae74 BYTE_ORDER MSB_LAST FORMAT "%4.1" /end MEASUREMENT
/begin MEASUREMENT v_inj_burst_exp_[58] "voltage burst signal (expanded)" UWORD _CNV_A_R_LINEAR_____123_CM 1 0. 0. 255. DISPLAY_IDENTIFIER V_INJ_BURST_EXP__58_ ECU_ADDRESS 0x7fae76 BYTE_ORDER MSB_LAST FORMAT "%4.1" /end MEASUREMENT
/begin MEASUREMENT v_inj_burst_exp_[59] "voltage burst signal (expanded)" UWORD _CNV_A_R_LINEAR_____123_CM 1 0. 0. 255. DISPLAY_IDENTIFIER V_INJ_BURST_EXP__59_ ECU_ADDRESS 0x7fae78 BYTE_ORDER MSB_LAST FORMAT "%4.1" /end MEASUREMENT
/begin MEASUREMENT v_inj_burst_exp_[60] "voltage burst signal (expanded)" UWORD _CNV_A_R_LINEAR_____123_CM 1 0. 0. 255. DISPLAY_IDENTIFIER V_INJ_BURST_EXP__60_ ECU_ADDRESS 0x7fae7a BYTE_ORDER MSB_LAST FORMAT "%4.1" /end MEASUREMENT
/begin MEASUREMENT v_inj_burst_exp_[61] "voltage burst signal (expanded)" UWORD _CNV_A_R_LINEAR_____123_CM 1 0. 0. 255. DISPLAY_IDENTIFIER V_INJ_BURST_EXP__61_ ECU_ADDRESS 0x7fae7c BYTE_ORDER MSB_LAST FORMAT "%4.1" /end MEASUREMENT
/begin MEASUREMENT v_inj_burst_exp_[62] "voltage burst signal (expanded)" UWORD _CNV_A_R_LINEAR_____123_CM 1 0. 0. 255. DISPLAY_IDENTIFIER V_INJ_BURST_EXP__62_ ECU_ADDRESS 0x7fae7e BYTE_ORDER MSB_LAST FORMAT "%4.1" /end MEASUREMENT
/begin MEASUREMENT v_inj_burst_exp_[63] "voltage burst signal (expanded)" UWORD _CNV_A_R_LINEAR_____123_CM 1 0. 0. 255. DISPLAY_IDENTIFIER V_INJ_BURST_EXP__63_ ECU_ADDRESS 0x7fae80 BYTE_ORDER MSB_LAST FORMAT "%4.1" /end MEASUREMENT
/begin MEASUREMENT v_inj_burst_exp_[64] "voltage burst signal (expanded)" UWORD _CNV_A_R_LINEAR_____123_CM 1 0. 0. 255. DISPLAY_IDENTIFIER V_INJ_BURST_EXP__64_ ECU_ADDRESS 0x7fae82 BYTE_ORDER MSB_LAST FORMAT "%4.1" /end MEASUREMENT
/begin MEASUREMENT v_inj_burst_exp_[65] "voltage burst signal (expanded)" UWORD _CNV_A_R_LINEAR_____123_CM 1 0. 0. 255. DISPLAY_IDENTIFIER V_INJ_BURST_EXP__65_ ECU_ADDRESS 0x7fae84 BYTE_ORDER MSB_LAST FORMAT "%4.1" /end MEASUREMENT
/begin MEASUREMENT v_inj_burst_exp_[66] "voltage burst signal (expanded)" UWORD _CNV_A_R_LINEAR_____123_CM 1 0. 0. 255. DISPLAY_IDENTIFIER V_INJ_BURST_EXP__66_ ECU_ADDRESS 0x7fae86 BYTE_ORDER MSB_LAST FORMAT "%4.1" /end MEASUREMENT
/begin MEASUREMENT v_inj_burst_exp_[67] "voltage burst signal (expanded)" UWORD _CNV_A_R_LINEAR_____123_CM 1 0. 0. 255. DISPLAY_IDENTIFIER V_INJ_BURST_EXP__67_ ECU_ADDRESS 0x7fae88 BYTE_ORDER MSB_LAST FORMAT "%4.1" /end MEASUREMENT
/begin MEASUREMENT v_inj_burst_exp_[68] "voltage burst signal (expanded)" UWORD _CNV_A_R_LINEAR_____123_CM 1 0. 0. 255. DISPLAY_IDENTIFIER V_INJ_BURST_EXP__68_ ECU_ADDRESS 0x7fae8a BYTE_ORDER MSB_LAST FORMAT "%4.1" /end MEASUREMENT
/begin MEASUREMENT v_inj_burst_exp_[69] "voltage burst signal (expanded)" UWORD _CNV_A_R_LINEAR_____123_CM 1 0. 0. 255. DISPLAY_IDENTIFIER V_INJ_BURST_EXP__69_ ECU_ADDRESS 0x7fae8c BYTE_ORDER MSB_LAST FORMAT "%4.1" /end MEASUREMENT
/begin MEASUREMENT v_inj_burst_exp_[70] "voltage burst signal (expanded)" UWORD _CNV_A_R_LINEAR_____123_CM 1 0. 0. 255. DISPLAY_IDENTIFIER V_INJ_BURST_EXP__70_ ECU_ADDRESS 0x7fae8e BYTE_ORDER MSB_LAST FORMAT "%4.1" /end MEASUREMENT
/begin MEASUREMENT v_inj_burst_exp_[71] "voltage burst signal (expanded)" UWORD _CNV_A_R_LINEAR_____123_CM 1 0. 0. 255. DISPLAY_IDENTIFIER V_INJ_BURST_EXP__71_ ECU_ADDRESS 0x7fae90 BYTE_ORDER MSB_LAST FORMAT "%4.1" /end MEASUREMENT
/begin MEASUREMENT v_inj_burst_exp_[72] "voltage burst signal (expanded)" UWORD _CNV_A_R_LINEAR_____123_CM 1 0. 0. 255. DISPLAY_IDENTIFIER V_INJ_BURST_EXP__72_ ECU_ADDRESS 0x7fae92 BYTE_ORDER MSB_LAST FORMAT "%4.1" /end MEASUREMENT
/begin MEASUREMENT v_inj_burst_exp_[73] "voltage burst signal (expanded)" UWORD _CNV_A_R_LINEAR_____123_CM 1 0. 0. 255. DISPLAY_IDENTIFIER V_INJ_BURST_EXP__73_ ECU_ADDRESS 0x7fae94 BYTE_ORDER MSB_LAST FORMAT "%4.1" /end MEASUREMENT
/begin MEASUREMENT v_inj_burst_exp_[74] "voltage burst signal (expanded)" UWORD _CNV_A_R_LINEAR_____123_CM 1 0. 0. 255. DISPLAY_IDENTIFIER V_INJ_BURST_EXP__74_ ECU_ADDRESS 0x7fae96 BYTE_ORDER MSB_LAST FORMAT "%4.1" /end MEASUREMENT
/begin MEASUREMENT v_inj_burst_exp_[75] "voltage burst signal (expanded)" UWORD _CNV_A_R_LINEAR_____123_CM 1 0. 0. 255. DISPLAY_IDENTIFIER V_INJ_BURST_EXP__75_ ECU_ADDRESS 0x7fae98 BYTE_ORDER MSB_LAST FORMAT "%4.1" /end MEASUREMENT
/begin MEASUREMENT v_inj_burst_exp_[76] "voltage burst signal (expanded)" UWORD _CNV_A_R_LINEAR_____123_CM 1 0. 0. 255. DISPLAY_IDENTIFIER V_INJ_BURST_EXP__76_ ECU_ADDRESS 0x7fae9a BYTE_ORDER MSB_LAST FORMAT "%4.1" /end MEASUREMENT
/begin MEASUREMENT v_inj_burst_exp_[77] "voltage burst signal (expanded)" UWORD _CNV_A_R_LINEAR_____123_CM 1 0. 0. 255. DISPLAY_IDENTIFIER V_INJ_BURST_EXP__77_ ECU_ADDRESS 0x7fae9c BYTE_ORDER MSB_LAST FORMAT "%4.1" /end MEASUREMENT
/begin MEASUREMENT v_inj_burst_exp_[78] "voltage burst signal (expanded)" UWORD _CNV_A_R_LINEAR_____123_CM 1 0. 0. 255. DISPLAY_IDENTIFIER V_INJ_BURST_EXP__78_ ECU_ADDRESS 0x7fae9e BYTE_ORDER MSB_LAST FORMAT "%4.1" /end MEASUREMENT
/begin MEASUREMENT v_inj_burst_exp_[79] "voltage burst signal (expanded)" UWORD _CNV_A_R_LINEAR_____123_CM 1 0. 0. 255. DISPLAY_IDENTIFIER V_INJ_BURST_EXP__79_ ECU_ADDRESS 0x7faea0 BYTE_ORDER MSB_LAST FORMAT "%4.1" /end MEASUREMENT
/begin MEASUREMENT v_inj_burst_exp_[80] "voltage burst signal (expanded)" UWORD _CNV_A_R_LINEAR_____123_CM 1 0. 0. 255. DISPLAY_IDENTIFIER V_INJ_BURST_EXP__80_ ECU_ADDRESS 0x7faea2 BYTE_ORDER MSB_LAST FORMAT "%4.1" /end MEASUREMENT
/begin MEASUREMENT v_inj_burst_exp_[81] "voltage burst signal (expanded)" UWORD _CNV_A_R_LINEAR_____123_CM 1 0. 0. 255. DISPLAY_IDENTIFIER V_INJ_BURST_EXP__81_ ECU_ADDRESS 0x7faea4 BYTE_ORDER MSB_LAST FORMAT "%4.1" /end MEASUREMENT
/begin MEASUREMENT v_inj_burst_exp_[82] "voltage burst signal (expanded)" UWORD _CNV_A_R_LINEAR_____123_CM 1 0. 0. 255. DISPLAY_IDENTIFIER V_INJ_BURST_EXP__82_ ECU_ADDRESS 0x7faea6 BYTE_ORDER MSB_LAST FORMAT "%4.1" /end MEASUREMENT
/begin MEASUREMENT v_inj_burst_exp_[83] "voltage burst signal (expanded)" UWORD _CNV_A_R_LINEAR_____123_CM 1 0. 0. 255. DISPLAY_IDENTIFIER V_INJ_BURST_EXP__83_ ECU_ADDRESS 0x7faea8 BYTE_ORDER MSB_LAST FORMAT "%4.1" /end MEASUREMENT
/begin MEASUREMENT v_inj_burst_exp_[84] "voltage burst signal (expanded)" UWORD _CNV_A_R_LINEAR_____123_CM 1 0. 0. 255. DISPLAY_IDENTIFIER V_INJ_BURST_EXP__84_ ECU_ADDRESS 0x7faeaa BYTE_ORDER MSB_LAST FORMAT "%4.1" /end MEASUREMENT
/begin MEASUREMENT v_inj_burst_exp_[85] "voltage burst signal (expanded)" UWORD _CNV_A_R_LINEAR_____123_CM 1 0. 0. 255. DISPLAY_IDENTIFIER V_INJ_BURST_EXP__85_ ECU_ADDRESS 0x7faeac BYTE_ORDER MSB_LAST FORMAT "%4.1" /end MEASUREMENT
/begin MEASUREMENT v_inj_burst_exp_[86] "voltage burst signal (expanded)" UWORD _CNV_A_R_LINEAR_____123_CM 1 0. 0. 255. DISPLAY_IDENTIFIER V_INJ_BURST_EXP__86_ ECU_ADDRESS 0x7faeae BYTE_ORDER MSB_LAST FORMAT "%4.1" /end MEASUREMENT
/begin MEASUREMENT v_inj_burst_exp_[87] "voltage burst signal (expanded)" UWORD _CNV_A_R_LINEAR_____123_CM 1 0. 0. 255. DISPLAY_IDENTIFIER V_INJ_BURST_EXP__87_ ECU_ADDRESS 0x7faeb0 BYTE_ORDER MSB_LAST FORMAT "%4.1" /end MEASUREMENT
/begin MEASUREMENT v_inj_burst_fil_max_[0] "vector with maximal risings in voltage burst signal" SWORD _CNV_A_R_LINEAR_____549_CM 1 0. -256. 255. DISPLAY_IDENTIFIER V_INJ_BURST_FIL_MAX__0_ ECU_ADDRESS 0x7faeb2 BYTE_ORDER MSB_LAST FORMAT "%4.1" /end MEASUREMENT
/begin MEASUREMENT v_inj_burst_fil_max_[1] "vector with maximal risings in voltage burst signal" SWORD _CNV_A_R_LINEAR_____549_CM 1 0. -256. 255. DISPLAY_IDENTIFIER V_INJ_BURST_FIL_MAX__1_ ECU_ADDRESS 0x7faeb4 BYTE_ORDER MSB_LAST FORMAT "%4.1" /end MEASUREMENT
/begin MEASUREMENT v_inj_burst_fil_max_[2] "vector with maximal risings in voltage burst signal" SWORD _CNV_A_R_LINEAR_____549_CM 1 0. -256. 255. DISPLAY_IDENTIFIER V_INJ_BURST_FIL_MAX__2_ ECU_ADDRESS 0x7faeb6 BYTE_ORDER MSB_LAST FORMAT "%4.1" /end MEASUREMENT
/begin MEASUREMENT v_inj_burst_fil_max_[3] "vector with maximal risings in voltage burst signal" SWORD _CNV_A_R_LINEAR_____549_CM 1 0. -256. 255. DISPLAY_IDENTIFIER V_INJ_BURST_FIL_MAX__3_ ECU_ADDRESS 0x7faeb8 BYTE_ORDER MSB_LAST FORMAT "%4.1" /end MEASUREMENT
/begin MEASUREMENT v_inj_burst_fil_max_[4] "vector with maximal risings in voltage burst signal" SWORD _CNV_A_R_LINEAR_____549_CM 1 0. -256. 255. DISPLAY_IDENTIFIER V_INJ_BURST_FIL_MAX__4_ ECU_ADDRESS 0x7faeba BYTE_ORDER MSB_LAST FORMAT "%4.1" /end MEASUREMENT
/begin MEASUREMENT v_inj_burst_fil_max_[5] "vector with maximal risings in voltage burst signal" SWORD _CNV_A_R_LINEAR_____549_CM 1 0. -256. 255. DISPLAY_IDENTIFIER V_INJ_BURST_FIL_MAX__5_ ECU_ADDRESS 0x7faebc BYTE_ORDER MSB_LAST FORMAT "%4.1" /end MEASUREMENT
/begin MEASUREMENT v_inj_burst_intp_[0] "voltage burst signal (interpolated)" UWORD _CNV_A_R_LINEAR_____123_CM 1 0. 0. 255. DISPLAY_IDENTIFIER V_INJ_BURST_INTP__0_ ECU_ADDRESS 0x7faebe BYTE_ORDER MSB_LAST FORMAT "%4.1" /end MEASUREMENT
/begin MEASUREMENT v_inj_burst_intp_[1] "voltage burst signal (interpolated)" UWORD _CNV_A_R_LINEAR_____123_CM 1 0. 0. 255. DISPLAY_IDENTIFIER V_INJ_BURST_INTP__1_ ECU_ADDRESS 0x7faec0 BYTE_ORDER MSB_LAST FORMAT "%4.1" /end MEASUREMENT
/begin MEASUREMENT v_inj_burst_intp_[2] "voltage burst signal (interpolated)" UWORD _CNV_A_R_LINEAR_____123_CM 1 0. 0. 255. DISPLAY_IDENTIFIER V_INJ_BURST_INTP__2_ ECU_ADDRESS 0x7faec2 BYTE_ORDER MSB_LAST FORMAT "%4.1" /end MEASUREMENT
/begin MEASUREMENT v_inj_burst_intp_[3] "voltage burst signal (interpolated)" UWORD _CNV_A_R_LINEAR_____123_CM 1 0. 0. 255. DISPLAY_IDENTIFIER V_INJ_BURST_INTP__3_ ECU_ADDRESS 0x7faec4 BYTE_ORDER MSB_LAST FORMAT "%4.1" /end MEASUREMENT
/begin MEASUREMENT v_inj_burst_intp_[4] "voltage burst signal (interpolated)" UWORD _CNV_A_R_LINEAR_____123_CM 1 0. 0. 255. DISPLAY_IDENTIFIER V_INJ_BURST_INTP__4_ ECU_ADDRESS 0x7faec6 BYTE_ORDER MSB_LAST FORMAT "%4.1" /end MEASUREMENT
/begin MEASUREMENT v_inj_burst_intp_[5] "voltage burst signal (interpolated)" UWORD _CNV_A_R_LINEAR_____123_CM 1 0. 0. 255. DISPLAY_IDENTIFIER V_INJ_BURST_INTP__5_ ECU_ADDRESS 0x7faec8 BYTE_ORDER MSB_LAST FORMAT "%4.1" /end MEASUREMENT
/begin MEASUREMENT v_inj_burst_intp_[6] "voltage burst signal (interpolated)" UWORD _CNV_A_R_LINEAR_____123_CM 1 0. 0. 255. DISPLAY_IDENTIFIER V_INJ_BURST_INTP__6_ ECU_ADDRESS 0x7faeca BYTE_ORDER MSB_LAST FORMAT "%4.1" /end MEASUREMENT
/begin MEASUREMENT v_inj_burst_intp_[7] "voltage burst signal (interpolated)" UWORD _CNV_A_R_LINEAR_____123_CM 1 0. 0. 255. DISPLAY_IDENTIFIER V_INJ_BURST_INTP__7_ ECU_ADDRESS 0x7faecc BYTE_ORDER MSB_LAST FORMAT "%4.1" /end MEASUREMENT
/begin MEASUREMENT v_inj_burst_intp_[8] "voltage burst signal (interpolated)" UWORD _CNV_A_R_LINEAR_____123_CM 1 0. 0. 255. DISPLAY_IDENTIFIER V_INJ_BURST_INTP__8_ ECU_ADDRESS 0x7faece BYTE_ORDER MSB_LAST FORMAT "%4.1" /end MEASUREMENT
/begin MEASUREMENT v_inj_burst_intp_[9] "voltage burst signal (interpolated)" UWORD _CNV_A_R_LINEAR_____123_CM 1 0. 0. 255. DISPLAY_IDENTIFIER V_INJ_BURST_INTP__9_ ECU_ADDRESS 0x7faed0 BYTE_ORDER MSB_LAST FORMAT "%4.1" /end MEASUREMENT
/begin MEASUREMENT v_inj_burst_intp_[10] "voltage burst signal (interpolated)" UWORD _CNV_A_R_LINEAR_____123_CM 1 0. 0. 255. DISPLAY_IDENTIFIER V_INJ_BURST_INTP__10_ ECU_ADDRESS 0x7faed2 BYTE_ORDER MSB_LAST FORMAT "%4.1" /end MEASUREMENT
/begin MEASUREMENT v_inj_burst_intp_[11] "voltage burst signal (interpolated)" UWORD _CNV_A_R_LINEAR_____123_CM 1 0. 0. 255. DISPLAY_IDENTIFIER V_INJ_BURST_INTP__11_ ECU_ADDRESS 0x7faed4 BYTE_ORDER MSB_LAST FORMAT "%4.1" /end MEASUREMENT
/begin MEASUREMENT v_inj_burst_intp_[12] "voltage burst signal (interpolated)" UWORD _CNV_A_R_LINEAR_____123_CM 1 0. 0. 255. DISPLAY_IDENTIFIER V_INJ_BURST_INTP__12_ ECU_ADDRESS 0x7faed6 BYTE_ORDER MSB_LAST FORMAT "%4.1" /end MEASUREMENT
/begin MEASUREMENT v_inj_burst_intp_[13] "voltage burst signal (interpolated)" UWORD _CNV_A_R_LINEAR_____123_CM 1 0. 0. 255. DISPLAY_IDENTIFIER V_INJ_BURST_INTP__13_ ECU_ADDRESS 0x7faed8 BYTE_ORDER MSB_LAST FORMAT "%4.1" /end MEASUREMENT
/begin MEASUREMENT v_inj_burst_intp_[14] "voltage burst signal (interpolated)" UWORD _CNV_A_R_LINEAR_____123_CM 1 0. 0. 255. DISPLAY_IDENTIFIER V_INJ_BURST_INTP__14_ ECU_ADDRESS 0x7faeda BYTE_ORDER MSB_LAST FORMAT "%4.1" /end MEASUREMENT
/begin MEASUREMENT v_inj_burst_intp_[15] "voltage burst signal (interpolated)" UWORD _CNV_A_R_LINEAR_____123_CM 1 0. 0. 255. DISPLAY_IDENTIFIER V_INJ_BURST_INTP__15_ ECU_ADDRESS 0x7faedc BYTE_ORDER MSB_LAST FORMAT "%4.1" /end MEASUREMENT
/begin MEASUREMENT v_inj_burst_intp_[16] "voltage burst signal (interpolated)" UWORD _CNV_A_R_LINEAR_____123_CM 1 0. 0. 255. DISPLAY_IDENTIFIER V_INJ_BURST_INTP__16_ ECU_ADDRESS 0x7faede BYTE_ORDER MSB_LAST FORMAT "%4.1" /end MEASUREMENT
/begin MEASUREMENT v_inj_burst_intp_[17] "voltage burst signal (interpolated)" UWORD _CNV_A_R_LINEAR_____123_CM 1 0. 0. 255. DISPLAY_IDENTIFIER V_INJ_BURST_INTP__17_ ECU_ADDRESS 0x7faee0 BYTE_ORDER MSB_LAST FORMAT "%4.1" /end MEASUREMENT
/begin MEASUREMENT v_inj_burst_intp_[18] "voltage burst signal (interpolated)" UWORD _CNV_A_R_LINEAR_____123_CM 1 0. 0. 255. DISPLAY_IDENTIFIER V_INJ_BURST_INTP__18_ ECU_ADDRESS 0x7faee2 BYTE_ORDER MSB_LAST FORMAT "%4.1" /end MEASUREMENT
/begin MEASUREMENT v_inj_burst_intp_[19] "voltage burst signal (interpolated)" UWORD _CNV_A_R_LINEAR_____123_CM 1 0. 0. 255. DISPLAY_IDENTIFIER V_INJ_BURST_INTP__19_ ECU_ADDRESS 0x7faee4 BYTE_ORDER MSB_LAST FORMAT "%4.1" /end MEASUREMENT
/begin MEASUREMENT v_inj_burst_intp_[20] "voltage burst signal (interpolated)" UWORD _CNV_A_R_LINEAR_____123_CM 1 0. 0. 255. DISPLAY_IDENTIFIER V_INJ_BURST_INTP__20_ ECU_ADDRESS 0x7faee6 BYTE_ORDER MSB_LAST FORMAT "%4.1" /end MEASUREMENT
/begin MEASUREMENT v_inj_burst_intp_[21] "voltage burst signal (interpolated)" UWORD _CNV_A_R_LINEAR_____123_CM 1 0. 0. 255. DISPLAY_IDENTIFIER V_INJ_BURST_INTP__21_ ECU_ADDRESS 0x7faee8 BYTE_ORDER MSB_LAST FORMAT "%4.1" /end MEASUREMENT
/begin MEASUREMENT v_inj_burst_intp_[22] "voltage burst signal (interpolated)" UWORD _CNV_A_R_LINEAR_____123_CM 1 0. 0. 255. DISPLAY_IDENTIFIER V_INJ_BURST_INTP__22_ ECU_ADDRESS 0x7faeea BYTE_ORDER MSB_LAST FORMAT "%4.1" /end MEASUREMENT
/begin MEASUREMENT v_inj_burst_intp_[23] "voltage burst signal (interpolated)" UWORD _CNV_A_R_LINEAR_____123_CM 1 0. 0. 255. DISPLAY_IDENTIFIER V_INJ_BURST_INTP__23_ ECU_ADDRESS 0x7faeec BYTE_ORDER MSB_LAST FORMAT "%4.1" /end MEASUREMENT
/begin MEASUREMENT v_inj_burst_intp_[24] "voltage burst signal (interpolated)" UWORD _CNV_A_R_LINEAR_____123_CM 1 0. 0. 255. DISPLAY_IDENTIFIER V_INJ_BURST_INTP__24_ ECU_ADDRESS 0x7faeee BYTE_ORDER MSB_LAST FORMAT "%4.1" /end MEASUREMENT
/begin MEASUREMENT v_inj_burst_intp_[25] "voltage burst signal (interpolated)" UWORD _CNV_A_R_LINEAR_____123_CM 1 0. 0. 255. DISPLAY_IDENTIFIER V_INJ_BURST_INTP__25_ ECU_ADDRESS 0x7faef0 BYTE_ORDER MSB_LAST FORMAT "%4.1" /end MEASUREMENT
/begin MEASUREMENT v_inj_burst_intp_[26] "voltage burst signal (interpolated)" UWORD _CNV_A_R_LINEAR_____123_CM 1 0. 0. 255. DISPLAY_IDENTIFIER V_INJ_BURST_INTP__26_ ECU_ADDRESS 0x7faef2 BYTE_ORDER MSB_LAST FORMAT "%4.1" /end MEASUREMENT
/begin MEASUREMENT v_inj_burst_intp_[27] "voltage burst signal (interpolated)" UWORD _CNV_A_R_LINEAR_____123_CM 1 0. 0. 255. DISPLAY_IDENTIFIER V_INJ_BURST_INTP__27_ ECU_ADDRESS 0x7faef4 BYTE_ORDER MSB_LAST FORMAT "%4.1" /end MEASUREMENT
/begin MEASUREMENT v_inj_burst_intp_[28] "voltage burst signal (interpolated)" UWORD _CNV_A_R_LINEAR_____123_CM 1 0. 0. 255. DISPLAY_IDENTIFIER V_INJ_BURST_INTP__28_ ECU_ADDRESS 0x7faef6 BYTE_ORDER MSB_LAST FORMAT "%4.1" /end MEASUREMENT
/begin MEASUREMENT v_inj_burst_intp_[29] "voltage burst signal (interpolated)" UWORD _CNV_A_R_LINEAR_____123_CM 1 0. 0. 255. DISPLAY_IDENTIFIER V_INJ_BURST_INTP__29_ ECU_ADDRESS 0x7faef8 BYTE_ORDER MSB_LAST FORMAT "%4.1" /end MEASUREMENT
/begin MEASUREMENT v_inj_burst_intp_[30] "voltage burst signal (interpolated)" UWORD _CNV_A_R_LINEAR_____123_CM 1 0. 0. 255. DISPLAY_IDENTIFIER V_INJ_BURST_INTP__30_ ECU_ADDRESS 0x7faefa BYTE_ORDER MSB_LAST FORMAT "%4.1" /end MEASUREMENT
/begin MEASUREMENT v_inj_burst_intp_[31] "voltage burst signal (interpolated)" UWORD _CNV_A_R_LINEAR_____123_CM 1 0. 0. 255. DISPLAY_IDENTIFIER V_INJ_BURST_INTP__31_ ECU_ADDRESS 0x7faefc BYTE_ORDER MSB_LAST FORMAT "%4.1" /end MEASUREMENT
/begin MEASUREMENT v_inj_burst_intp_[32] "voltage burst signal (interpolated)" UWORD _CNV_A_R_LINEAR_____123_CM 1 0. 0. 255. DISPLAY_IDENTIFIER V_INJ_BURST_INTP__32_ ECU_ADDRESS 0x7faefe BYTE_ORDER MSB_LAST FORMAT "%4.1" /end MEASUREMENT
/begin MEASUREMENT v_inj_burst_intp_[33] "voltage burst signal (interpolated)" UWORD _CNV_A_R_LINEAR_____123_CM 1 0. 0. 255. DISPLAY_IDENTIFIER V_INJ_BURST_INTP__33_ ECU_ADDRESS 0x7faf00 BYTE_ORDER MSB_LAST FORMAT "%4.1" /end MEASUREMENT
/begin MEASUREMENT v_inj_burst_intp_[34] "voltage burst signal (interpolated)" UWORD _CNV_A_R_LINEAR_____123_CM 1 0. 0. 255. DISPLAY_IDENTIFIER V_INJ_BURST_INTP__34_ ECU_ADDRESS 0x7faf02 BYTE_ORDER MSB_LAST FORMAT "%4.1" /end MEASUREMENT
/begin MEASUREMENT v_inj_burst_intp_[35] "voltage burst signal (interpolated)" UWORD _CNV_A_R_LINEAR_____123_CM 1 0. 0. 255. DISPLAY_IDENTIFIER V_INJ_BURST_INTP__35_ ECU_ADDRESS 0x7faf04 BYTE_ORDER MSB_LAST FORMAT "%4.1" /end MEASUREMENT
/begin MEASUREMENT v_inj_burst_intp_[36] "voltage burst signal (interpolated)" UWORD _CNV_A_R_LINEAR_____123_CM 1 0. 0. 255. DISPLAY_IDENTIFIER V_INJ_BURST_INTP__36_ ECU_ADDRESS 0x7faf06 BYTE_ORDER MSB_LAST FORMAT "%4.1" /end MEASUREMENT
/begin MEASUREMENT v_inj_burst_intp_[37] "voltage burst signal (interpolated)" UWORD _CNV_A_R_LINEAR_____123_CM 1 0. 0. 255. DISPLAY_IDENTIFIER V_INJ_BURST_INTP__37_ ECU_ADDRESS 0x7faf08 BYTE_ORDER MSB_LAST FORMAT "%4.1" /end MEASUREMENT
/begin MEASUREMENT v_inj_burst_intp_[38] "voltage burst signal (interpolated)" UWORD _CNV_A_R_LINEAR_____123_CM 1 0. 0. 255. DISPLAY_IDENTIFIER V_INJ_BURST_INTP__38_ ECU_ADDRESS 0x7faf0a BYTE_ORDER MSB_LAST FORMAT "%4.1" /end MEASUREMENT
/begin MEASUREMENT v_inj_burst_intp_[39] "voltage burst signal (interpolated)" UWORD _CNV_A_R_LINEAR_____123_CM 1 0. 0. 255. DISPLAY_IDENTIFIER V_INJ_BURST_INTP__39_ ECU_ADDRESS 0x7faf0c BYTE_ORDER MSB_LAST FORMAT "%4.1" /end MEASUREMENT
/begin MEASUREMENT v_inj_burst_intp_[40] "voltage burst signal (interpolated)" UWORD _CNV_A_R_LINEAR_____123_CM 1 0. 0. 255. DISPLAY_IDENTIFIER V_INJ_BURST_INTP__40_ ECU_ADDRESS 0x7faf0e BYTE_ORDER MSB_LAST FORMAT "%4.1" /end MEASUREMENT
/begin MEASUREMENT v_inj_burst_intp_[41] "voltage burst signal (interpolated)" UWORD _CNV_A_R_LINEAR_____123_CM 1 0. 0. 255. DISPLAY_IDENTIFIER V_INJ_BURST_INTP__41_ ECU_ADDRESS 0x7faf10 BYTE_ORDER MSB_LAST FORMAT "%4.1" /end MEASUREMENT
/begin MEASUREMENT v_inj_burst_intp_[42] "voltage burst signal (interpolated)" UWORD _CNV_A_R_LINEAR_____123_CM 1 0. 0. 255. DISPLAY_IDENTIFIER V_INJ_BURST_INTP__42_ ECU_ADDRESS 0x7faf12 BYTE_ORDER MSB_LAST FORMAT "%4.1" /end MEASUREMENT
/begin MEASUREMENT v_inj_burst_intp_[43] "voltage burst signal (interpolated)" UWORD _CNV_A_R_LINEAR_____123_CM 1 0. 0. 255. DISPLAY_IDENTIFIER V_INJ_BURST_INTP__43_ ECU_ADDRESS 0x7faf14 BYTE_ORDER MSB_LAST FORMAT "%4.1" /end MEASUREMENT
/begin MEASUREMENT v_inj_burst_intp_[44] "voltage burst signal (interpolated)" UWORD _CNV_A_R_LINEAR_____123_CM 1 0. 0. 255. DISPLAY_IDENTIFIER V_INJ_BURST_INTP__44_ ECU_ADDRESS 0x7faf16 BYTE_ORDER MSB_LAST FORMAT "%4.1" /end MEASUREMENT
/begin MEASUREMENT v_inj_burst_intp_[45] "voltage burst signal (interpolated)" UWORD _CNV_A_R_LINEAR_____123_CM 1 0. 0. 255. DISPLAY_IDENTIFIER V_INJ_BURST_INTP__45_ ECU_ADDRESS 0x7faf18 BYTE_ORDER MSB_LAST FORMAT "%4.1" /end MEASUREMENT
/begin MEASUREMENT v_inj_burst_intp_[46] "voltage burst signal (interpolated)" UWORD _CNV_A_R_LINEAR_____123_CM 1 0. 0. 255. DISPLAY_IDENTIFIER V_INJ_BURST_INTP__46_ ECU_ADDRESS 0x7faf1a BYTE_ORDER MSB_LAST FORMAT "%4.1" /end MEASUREMENT
/begin MEASUREMENT v_inj_burst_intp_[47] "voltage burst signal (interpolated)" UWORD _CNV_A_R_LINEAR_____123_CM 1 0. 0. 255. DISPLAY_IDENTIFIER V_INJ_BURST_INTP__47_ ECU_ADDRESS 0x7faf1c BYTE_ORDER MSB_LAST FORMAT "%4.1" /end MEASUREMENT
/begin MEASUREMENT v_inj_burst_intp_[48] "voltage burst signal (interpolated)" UWORD _CNV_A_R_LINEAR_____123_CM 1 0. 0. 255. DISPLAY_IDENTIFIER V_INJ_BURST_INTP__48_ ECU_ADDRESS 0x7faf1e BYTE_ORDER MSB_LAST FORMAT "%4.1" /end MEASUREMENT
/begin MEASUREMENT v_inj_burst_intp_[49] "voltage burst signal (interpolated)" UWORD _CNV_A_R_LINEAR_____123_CM 1 0. 0. 255. DISPLAY_IDENTIFIER V_INJ_BURST_INTP__49_ ECU_ADDRESS 0x7faf20 BYTE_ORDER MSB_LAST FORMAT "%4.1" /end MEASUREMENT
/begin MEASUREMENT v_inj_burst_intp_[50] "voltage burst signal (interpolated)" UWORD _CNV_A_R_LINEAR_____123_CM 1 0. 0. 255. DISPLAY_IDENTIFIER V_INJ_BURST_INTP__50_ ECU_ADDRESS 0x7faf22 BYTE_ORDER MSB_LAST FORMAT "%4.1" /end MEASUREMENT
/begin MEASUREMENT v_inj_burst_intp_[51] "voltage burst signal (interpolated)" UWORD _CNV_A_R_LINEAR_____123_CM 1 0. 0. 255. DISPLAY_IDENTIFIER V_INJ_BURST_INTP__51_ ECU_ADDRESS 0x7faf24 BYTE_ORDER MSB_LAST FORMAT "%4.1" /end MEASUREMENT
/begin MEASUREMENT v_inj_burst_intp_[52] "voltage burst signal (interpolated)" UWORD _CNV_A_R_LINEAR_____123_CM 1 0. 0. 255. DISPLAY_IDENTIFIER V_INJ_BURST_INTP__52_ ECU_ADDRESS 0x7faf26 BYTE_ORDER MSB_LAST FORMAT "%4.1" /end MEASUREMENT
/begin MEASUREMENT v_inj_burst_intp_[53] "voltage burst signal (interpolated)" UWORD _CNV_A_R_LINEAR_____123_CM 1 0. 0. 255. DISPLAY_IDENTIFIER V_INJ_BURST_INTP__53_ ECU_ADDRESS 0x7faf28 BYTE_ORDER MSB_LAST FORMAT "%4.1" /end MEASUREMENT
/begin MEASUREMENT v_inj_burst_intp_[54] "voltage burst signal (interpolated)" UWORD _CNV_A_R_LINEAR_____123_CM 1 0. 0. 255. DISPLAY_IDENTIFIER V_INJ_BURST_INTP__54_ ECU_ADDRESS 0x7faf2a BYTE_ORDER MSB_LAST FORMAT "%4.1" /end MEASUREMENT
/begin MEASUREMENT v_inj_burst_intp_[55] "voltage burst signal (interpolated)" UWORD _CNV_A_R_LINEAR_____123_CM 1 0. 0. 255. DISPLAY_IDENTIFIER V_INJ_BURST_INTP__55_ ECU_ADDRESS 0x7faf2c BYTE_ORDER MSB_LAST FORMAT "%4.1" /end MEASUREMENT
/begin MEASUREMENT v_inj_burst_intp_[56] "voltage burst signal (interpolated)" UWORD _CNV_A_R_LINEAR_____123_CM 1 0. 0. 255. DISPLAY_IDENTIFIER V_INJ_BURST_INTP__56_ ECU_ADDRESS 0x7faf2e BYTE_ORDER MSB_LAST FORMAT "%4.1" /end MEASUREMENT
/begin MEASUREMENT v_inj_burst_intp_[57] "voltage burst signal (interpolated)" UWORD _CNV_A_R_LINEAR_____123_CM 1 0. 0. 255. DISPLAY_IDENTIFIER V_INJ_BURST_INTP__57_ ECU_ADDRESS 0x7faf30 BYTE_ORDER MSB_LAST FORMAT "%4.1" /end MEASUREMENT
/begin MEASUREMENT v_inj_burst_intp_[58] "voltage burst signal (interpolated)" UWORD _CNV_A_R_LINEAR_____123_CM 1 0. 0. 255. DISPLAY_IDENTIFIER V_INJ_BURST_INTP__58_ ECU_ADDRESS 0x7faf32 BYTE_ORDER MSB_LAST FORMAT "%4.1" /end MEASUREMENT
/begin MEASUREMENT v_inj_burst_intp_[59] "voltage burst signal (interpolated)" UWORD _CNV_A_R_LINEAR_____123_CM 1 0. 0. 255. DISPLAY_IDENTIFIER V_INJ_BURST_INTP__59_ ECU_ADDRESS 0x7faf34 BYTE_ORDER MSB_LAST FORMAT "%4.1" /end MEASUREMENT
/begin MEASUREMENT v_inj_burst_intp_[60] "voltage burst signal (interpolated)" UWORD _CNV_A_R_LINEAR_____123_CM 1 0. 0. 255. DISPLAY_IDENTIFIER V_INJ_BURST_INTP__60_ ECU_ADDRESS 0x7faf36 BYTE_ORDER MSB_LAST FORMAT "%4.1" /end MEASUREMENT
/begin MEASUREMENT v_inj_burst_intp_[61] "voltage burst signal (interpolated)" UWORD _CNV_A_R_LINEAR_____123_CM 1 0. 0. 255. DISPLAY_IDENTIFIER V_INJ_BURST_INTP__61_ ECU_ADDRESS 0x7faf38 BYTE_ORDER MSB_LAST FORMAT "%4.1" /end MEASUREMENT
/begin MEASUREMENT v_inj_burst_intp_[62] "voltage burst signal (interpolated)" UWORD _CNV_A_R_LINEAR_____123_CM 1 0. 0. 255. DISPLAY_IDENTIFIER V_INJ_BURST_INTP__62_ ECU_ADDRESS 0x7faf3a BYTE_ORDER MSB_LAST FORMAT "%4.1" /end MEASUREMENT
/begin MEASUREMENT v_inj_burst_intp_[63] "voltage burst signal (interpolated)" UWORD _CNV_A_R_LINEAR_____123_CM 1 0. 0. 255. DISPLAY_IDENTIFIER V_INJ_BURST_INTP__63_ ECU_ADDRESS 0x7faf3c BYTE_ORDER MSB_LAST FORMAT "%4.1" /end MEASUREMENT
/begin MEASUREMENT v_inj_burst_intp_[64] "voltage burst signal (interpolated)" UWORD _CNV_A_R_LINEAR_____123_CM 1 0. 0. 255. DISPLAY_IDENTIFIER V_INJ_BURST_INTP__64_ ECU_ADDRESS 0x7faf3e BYTE_ORDER MSB_LAST FORMAT "%4.1" /end MEASUREMENT
/begin MEASUREMENT v_inj_burst_intp_[65] "voltage burst signal (interpolated)" UWORD _CNV_A_R_LINEAR_____123_CM 1 0. 0. 255. DISPLAY_IDENTIFIER V_INJ_BURST_INTP__65_ ECU_ADDRESS 0x7faf40 BYTE_ORDER MSB_LAST FORMAT "%4.1" /end MEASUREMENT
/begin MEASUREMENT v_inj_burst_intp_[66] "voltage burst signal (interpolated)" UWORD _CNV_A_R_LINEAR_____123_CM 1 0. 0. 255. DISPLAY_IDENTIFIER V_INJ_BURST_INTP__66_ ECU_ADDRESS 0x7faf42 BYTE_ORDER MSB_LAST FORMAT "%4.1" /end MEASUREMENT
/begin MEASUREMENT v_inj_burst_intp_[67] "voltage burst signal (interpolated)" UWORD _CNV_A_R_LINEAR_____123_CM 1 0. 0. 255. DISPLAY_IDENTIFIER V_INJ_BURST_INTP__67_ ECU_ADDRESS 0x7faf44 BYTE_ORDER MSB_LAST FORMAT "%4.1" /end MEASUREMENT
/begin MEASUREMENT v_inj_burst_intp_[68] "voltage burst signal (interpolated)" UWORD _CNV_A_R_LINEAR_____123_CM 1 0. 0. 255. DISPLAY_IDENTIFIER V_INJ_BURST_INTP__68_ ECU_ADDRESS 0x7faf46 BYTE_ORDER MSB_LAST FORMAT "%4.1" /end MEASUREMENT
/begin MEASUREMENT v_inj_burst_intp_[69] "voltage burst signal (interpolated)" UWORD _CNV_A_R_LINEAR_____123_CM 1 0. 0. 255. DISPLAY_IDENTIFIER V_INJ_BURST_INTP__69_ ECU_ADDRESS 0x7faf48 BYTE_ORDER MSB_LAST FORMAT "%4.1" /end MEASUREMENT
/begin MEASUREMENT v_inj_burst_intp_[70] "voltage burst signal (interpolated)" UWORD _CNV_A_R_LINEAR_____123_CM 1 0. 0. 255. DISPLAY_IDENTIFIER V_INJ_BURST_INTP__70_ ECU_ADDRESS 0x7faf4a BYTE_ORDER MSB_LAST FORMAT "%4.1" /end MEASUREMENT
/begin MEASUREMENT v_inj_burst_intp_[71] "voltage burst signal (interpolated)" UWORD _CNV_A_R_LINEAR_____123_CM 1 0. 0. 255. DISPLAY_IDENTIFIER V_INJ_BURST_INTP__71_ ECU_ADDRESS 0x7faf4c BYTE_ORDER MSB_LAST FORMAT "%4.1" /end MEASUREMENT
/begin MEASUREMENT v_inj_burst_intp_[72] "voltage burst signal (interpolated)" UWORD _CNV_A_R_LINEAR_____123_CM 1 0. 0. 255. DISPLAY_IDENTIFIER V_INJ_BURST_INTP__72_ ECU_ADDRESS 0x7faf4e BYTE_ORDER MSB_LAST FORMAT "%4.1" /end MEASUREMENT
/begin MEASUREMENT v_inj_burst_intp_[73] "voltage burst signal (interpolated)" UWORD _CNV_A_R_LINEAR_____123_CM 1 0. 0. 255. DISPLAY_IDENTIFIER V_INJ_BURST_INTP__73_ ECU_ADDRESS 0x7faf50 BYTE_ORDER MSB_LAST FORMAT "%4.1" /end MEASUREMENT
/begin MEASUREMENT v_inj_burst_intp_[74] "voltage burst signal (interpolated)" UWORD _CNV_A_R_LINEAR_____123_CM 1 0. 0. 255. DISPLAY_IDENTIFIER V_INJ_BURST_INTP__74_ ECU_ADDRESS 0x7faf52 BYTE_ORDER MSB_LAST FORMAT "%4.1" /end MEASUREMENT
/begin MEASUREMENT v_inj_burst_intp_[75] "voltage burst signal (interpolated)" UWORD _CNV_A_R_LINEAR_____123_CM 1 0. 0. 255. DISPLAY_IDENTIFIER V_INJ_BURST_INTP__75_ ECU_ADDRESS 0x7faf54 BYTE_ORDER MSB_LAST FORMAT "%4.1" /end MEASUREMENT
/begin MEASUREMENT v_inj_burst_intp_[76] "voltage burst signal (interpolated)" UWORD _CNV_A_R_LINEAR_____123_CM 1 0. 0. 255. DISPLAY_IDENTIFIER V_INJ_BURST_INTP__76_ ECU_ADDRESS 0x7faf56 BYTE_ORDER MSB_LAST FORMAT "%4.1" /end MEASUREMENT
/begin MEASUREMENT v_inj_burst_intp_[77] "voltage burst signal (interpolated)" UWORD _CNV_A_R_LINEAR_____123_CM 1 0. 0. 255. DISPLAY_IDENTIFIER V_INJ_BURST_INTP__77_ ECU_ADDRESS 0x7faf58 BYTE_ORDER MSB_LAST FORMAT "%4.1" /end MEASUREMENT
/begin MEASUREMENT v_inj_burst_intp_[78] "voltage burst signal (interpolated)" UWORD _CNV_A_R_LINEAR_____123_CM 1 0. 0. 255. DISPLAY_IDENTIFIER V_INJ_BURST_INTP__78_ ECU_ADDRESS 0x7faf5a BYTE_ORDER MSB_LAST FORMAT "%4.1" /end MEASUREMENT
/begin MEASUREMENT v_inj_burst_intp_[79] "voltage burst signal (interpolated)" UWORD _CNV_A_R_LINEAR_____123_CM 1 0. 0. 255. DISPLAY_IDENTIFIER V_INJ_BURST_INTP__79_ ECU_ADDRESS 0x7faf5c BYTE_ORDER MSB_LAST FORMAT "%4.1" /end MEASUREMENT
/begin MEASUREMENT v_inj_burst_intp_[80] "voltage burst signal (interpolated)" UWORD _CNV_A_R_LINEAR_____123_CM 1 0. 0. 255. DISPLAY_IDENTIFIER V_INJ_BURST_INTP__80_ ECU_ADDRESS 0x7faf5e BYTE_ORDER MSB_LAST FORMAT "%4.1" /end MEASUREMENT
/begin MEASUREMENT v_inj_burst_intp_[81] "voltage burst signal (interpolated)" UWORD _CNV_A_R_LINEAR_____123_CM 1 0. 0. 255. DISPLAY_IDENTIFIER V_INJ_BURST_INTP__81_ ECU_ADDRESS 0x7faf60 BYTE_ORDER MSB_LAST FORMAT "%4.1" /end MEASUREMENT
/begin MEASUREMENT v_inj_burst_intp_[82] "voltage burst signal (interpolated)" UWORD _CNV_A_R_LINEAR_____123_CM 1 0. 0. 255. DISPLAY_IDENTIFIER V_INJ_BURST_INTP__82_ ECU_ADDRESS 0x7faf62 BYTE_ORDER MSB_LAST FORMAT "%4.1" /end MEASUREMENT
/begin MEASUREMENT v_inj_burst_intp_[83] "voltage burst signal (interpolated)" UWORD _CNV_A_R_LINEAR_____123_CM 1 0. 0. 255. DISPLAY_IDENTIFIER V_INJ_BURST_INTP__83_ ECU_ADDRESS 0x7faf64 BYTE_ORDER MSB_LAST FORMAT "%4.1" /end MEASUREMENT
/begin MEASUREMENT v_inj_burst_intp_[84] "voltage burst signal (interpolated)" UWORD _CNV_A_R_LINEAR_____123_CM 1 0. 0. 255. DISPLAY_IDENTIFIER V_INJ_BURST_INTP__84_ ECU_ADDRESS 0x7faf66 BYTE_ORDER MSB_LAST FORMAT "%4.1" /end MEASUREMENT
/begin MEASUREMENT v_inj_burst_intp_[85] "voltage burst signal (interpolated)" UWORD _CNV_A_R_LINEAR_____123_CM 1 0. 0. 255. DISPLAY_IDENTIFIER V_INJ_BURST_INTP__85_ ECU_ADDRESS 0x7faf68 BYTE_ORDER MSB_LAST FORMAT "%4.1" /end MEASUREMENT
/begin MEASUREMENT v_inj_burst_intp_[86] "voltage burst signal (interpolated)" UWORD _CNV_A_R_LINEAR_____123_CM 1 0. 0. 255. DISPLAY_IDENTIFIER V_INJ_BURST_INTP__86_ ECU_ADDRESS 0x7faf6a BYTE_ORDER MSB_LAST FORMAT "%4.1" /end MEASUREMENT
/begin MEASUREMENT v_inj_burst_intp_[87] "voltage burst signal (interpolated)" UWORD _CNV_A_R_LINEAR_____123_CM 1 0. 0. 255. DISPLAY_IDENTIFIER V_INJ_BURST_INTP__87_ ECU_ADDRESS 0x7faf6c BYTE_ORDER MSB_LAST FORMAT "%4.1" /end MEASUREMENT
/begin MEASUREMENT v_iv_foc_[0] "injector voltage at detection point (cylinder individual)" UWORD _CNV_A_R_LINEAR_____123_CM 1 0. 0. 255. DISPLAY_IDENTIFIER V_IV_FOC__0_ ECU_ADDRESS 0x7faf6e BYTE_ORDER MSB_LAST FORMAT "%4.1" /end MEASUREMENT
/begin MEASUREMENT v_iv_foc_[1] "injector voltage at detection point (cylinder individual)" UWORD _CNV_A_R_LINEAR_____123_CM 1 0. 0. 255. DISPLAY_IDENTIFIER V_IV_FOC__1_ ECU_ADDRESS 0x7faf70 BYTE_ORDER MSB_LAST FORMAT "%4.1" /end MEASUREMENT
/begin MEASUREMENT v_iv_foc_[2] "injector voltage at detection point (cylinder individual)" UWORD _CNV_A_R_LINEAR_____123_CM 1 0. 0. 255. DISPLAY_IDENTIFIER V_IV_FOC__2_ ECU_ADDRESS 0x7faf72 BYTE_ORDER MSB_LAST FORMAT "%4.1" /end MEASUREMENT
/begin MEASUREMENT v_iv_foc_[3] "injector voltage at detection point (cylinder individual)" UWORD _CNV_A_R_LINEAR_____123_CM 1 0. 0. 255. DISPLAY_IDENTIFIER V_IV_FOC__3_ ECU_ADDRESS 0x7faf74 BYTE_ORDER MSB_LAST FORMAT "%4.1" /end MEASUREMENT
/begin CHARACTERISTIC c_acq_intp_fil_ini "initialisation value for FIR filter state variables" VALUE 0x8482f8 _REC_VAL_20_u2 255. _CNV_A_R_LINEAR_____550_CM 0. 255. DISPLAY_IDENTIFIER C_ACQ_INTP_FIL_INI FORMAT "%6.5" /end CHARACTERISTIC
/begin CHARACTERISTIC c_num_fil_value_egy_det_ma[0] "FIR filter numerator coefficient vector for egy_det_ma" VALUE 0x84853c _REC_VAL_20_s2 2. _CNV_A_R_LINEAR_____15_CM -1. 1. DISPLAY_IDENTIFIER C_NUM_FIL_VALUE_EGY_DET_MA_0_ FORMAT "%6.5" /end CHARACTERISTIC
/begin CHARACTERISTIC c_num_fil_value_egy_det_ma[1] "FIR filter numerator coefficient vector for egy_det_ma" VALUE 0x84853e _REC_VAL_20_s2 2. _CNV_A_R_LINEAR_____15_CM -1. 1. DISPLAY_IDENTIFIER C_NUM_FIL_VALUE_EGY_DET_MA_1_ FORMAT "%6.5" /end CHARACTERISTIC
/begin CHARACTERISTIC c_num_fil_value_egy_det_ma[2] "FIR filter numerator coefficient vector for egy_det_ma" VALUE 0x848540 _REC_VAL_20_s2 2. _CNV_A_R_LINEAR_____15_CM -1. 1. DISPLAY_IDENTIFIER C_NUM_FIL_VALUE_EGY_DET_MA_2_ FORMAT "%6.5" /end CHARACTERISTIC
/begin CHARACTERISTIC c_num_fil_value_egy_det_ma[3] "FIR filter numerator coefficient vector for egy_det_ma" VALUE 0x848542 _REC_VAL_20_s2 2. _CNV_A_R_LINEAR_____15_CM -1. 1. DISPLAY_IDENTIFIER C_NUM_FIL_VALUE_EGY_DET_MA_3_ FORMAT "%6.5" /end CHARACTERISTIC
/begin CHARACTERISTIC c_num_fil_value_egy_det_ma[4] "FIR filter numerator coefficient vector for egy_det_ma" VALUE 0x848544 _REC_VAL_20_s2 2. _CNV_A_R_LINEAR_____15_CM -1. 1. DISPLAY_IDENTIFIER C_NUM_FIL_VALUE_EGY_DET_MA_4_ FORMAT "%6.5" /end CHARACTERISTIC
/begin CHARACTERISTIC c_num_fil_value_egy_det_ma[5] "FIR filter numerator coefficient vector for egy_det_ma" VALUE 0x848546 _REC_VAL_20_s2 2. _CNV_A_R_LINEAR_____15_CM -1. 1. DISPLAY_IDENTIFIER C_NUM_FIL_VALUE_EGY_DET_MA_5_ FORMAT "%6.5" /end CHARACTERISTIC
/begin CHARACTERISTIC c_num_fil_value_egy_det_ma[6] "FIR filter numerator coefficient vector for egy_det_ma" VALUE 0x848548 _REC_VAL_20_s2 2. _CNV_A_R_LINEAR_____15_CM -1. 1. DISPLAY_IDENTIFIER C_NUM_FIL_VALUE_EGY_DET_MA_6_ FORMAT "%6.5" /end CHARACTERISTIC
/begin CHARACTERISTIC c_num_fil_value_egy_det_ma[7] "FIR filter numerator coefficient vector for egy_det_ma" VALUE 0x84854a _REC_VAL_20_s2 2. _CNV_A_R_LINEAR_____15_CM -1. 1. DISPLAY_IDENTIFIER C_NUM_FIL_VALUE_EGY_DET_MA_7_ FORMAT "%6.5" /end CHARACTERISTIC
/begin CHARACTERISTIC c_num_fil_value_egy_det_ma[8] "FIR filter numerator coefficient vector for egy_det_ma" VALUE 0x84854c _REC_VAL_20_s2 2. _CNV_A_R_LINEAR_____15_CM -1. 1. DISPLAY_IDENTIFIER C_NUM_FIL_VALUE_EGY_DET_MA_8_ FORMAT "%6.5" /end CHARACTERISTIC
/begin CHARACTERISTIC c_num_fil_value_egy_det_ma[9] "FIR filter numerator coefficient vector for egy_det_ma" VALUE 0x84854e _REC_VAL_20_s2 2. _CNV_A_R_LINEAR_____15_CM -1. 1. DISPLAY_IDENTIFIER C_NUM_FIL_VALUE_EGY_DET_MA_9_ FORMAT "%6.5" /end CHARACTERISTIC
/begin CHARACTERISTIC c_dnom_fil_value_egy_det_ma[0] "FIR filter denominator coefficient vector for egy_det_ma" VALUE 0x84837e _REC_VAL_20_s2 2. _CNV_A_R_LINEAR_____15_CM -1. 1. DISPLAY_IDENTIFIER C_DNOM_FIL_VALUE_EGY_DET_MA_0_ FORMAT "%6.5" /end CHARACTERISTIC
/begin CHARACTERISTIC c_dnom_fil_value_egy_det_ma[1] "FIR filter denominator coefficient vector for egy_det_ma" VALUE 0x848380 _REC_VAL_20_s2 2. _CNV_A_R_LINEAR_____15_CM -1. 1. DISPLAY_IDENTIFIER C_DNOM_FIL_VALUE_EGY_DET_MA_1_ FORMAT "%6.5" /end CHARACTERISTIC
/begin CHARACTERISTIC c_dnom_fil_value_egy_det_ma[2] "FIR filter denominator coefficient vector for egy_det_ma" VALUE 0x848382 _REC_VAL_20_s2 2. _CNV_A_R_LINEAR_____15_CM -1. 1. DISPLAY_IDENTIFIER C_DNOM_FIL_VALUE_EGY_DET_MA_2_ FORMAT "%6.5" /end CHARACTERISTIC
/begin CHARACTERISTIC c_dnom_fil_value_egy_det_ma[3] "FIR filter denominator coefficient vector for egy_det_ma" VALUE 0x848384 _REC_VAL_20_s2 2. _CNV_A_R_LINEAR_____15_CM -1. 1. DISPLAY_IDENTIFIER C_DNOM_FIL_VALUE_EGY_DET_MA_3_ FORMAT "%6.5" /end CHARACTERISTIC
/begin CHARACTERISTIC c_dnom_fil_value_egy_det_ma[4] "FIR filter denominator coefficient vector for egy_det_ma" VALUE 0x848386 _REC_VAL_20_s2 2. _CNV_A_R_LINEAR_____15_CM -1. 1. DISPLAY_IDENTIFIER C_DNOM_FIL_VALUE_EGY_DET_MA_4_ FORMAT "%6.5" /end CHARACTERISTIC
/begin CHARACTERISTIC c_dnom_fil_value_egy_det_ma[5] "FIR filter denominator coefficient vector for egy_det_ma" VALUE 0x848388 _REC_VAL_20_s2 2. _CNV_A_R_LINEAR_____15_CM -1. 1. DISPLAY_IDENTIFIER C_DNOM_FIL_VALUE_EGY_DET_MA_5_ FORMAT "%6.5" /end CHARACTERISTIC
/begin CHARACTERISTIC c_dnom_fil_value_egy_det_ma[6] "FIR filter denominator coefficient vector for egy_det_ma" VALUE 0x84838a _REC_VAL_20_s2 2. _CNV_A_R_LINEAR_____15_CM -1. 1. DISPLAY_IDENTIFIER C_DNOM_FIL_VALUE_EGY_DET_MA_6_ FORMAT "%6.5" /end CHARACTERISTIC
/begin CHARACTERISTIC c_dnom_fil_value_egy_det_ma[7] "FIR filter denominator coefficient vector for egy_det_ma" VALUE 0x84838c _REC_VAL_20_s2 2. _CNV_A_R_LINEAR_____15_CM -1. 1. DISPLAY_IDENTIFIER C_DNOM_FIL_VALUE_EGY_DET_MA_7_ FORMAT "%6.5" /end CHARACTERISTIC
/begin CHARACTERISTIC c_dnom_fil_value_egy_det_ma[8] "FIR filter denominator coefficient vector for egy_det_ma" VALUE 0x84838e _REC_VAL_20_s2 2. _CNV_A_R_LINEAR_____15_CM -1. 1. DISPLAY_IDENTIFIER C_DNOM_FIL_VALUE_EGY_DET_MA_8_ FORMAT "%6.5" /end CHARACTERISTIC
/begin CHARACTERISTIC c_dnom_fil_value_egy_det_ma[9] "FIR filter denominator coefficient vector for egy_det_ma" VALUE 0x848390 _REC_VAL_20_s2 2. _CNV_A_R_LINEAR_____15_CM -1. 1. DISPLAY_IDENTIFIER C_DNOM_FIL_VALUE_EGY_DET_MA_9_ FORMAT "%6.5" /end CHARACTERISTIC
/begin CHARACTERISTIC c_dnom_fil_value_acq_intp[0] "FIR filter denominator coefficient vector" VALUE 0x84836c _REC_VAL_20_s2 2. _CNV_A_R_LINEAR_____15_CM -1. 1. DISPLAY_IDENTIFIER C_DNOM_FIL_VALUE_ACQ_INTP_0_ FORMAT "%6.5" /end CHARACTERISTIC
/begin CHARACTERISTIC c_dnom_fil_value_acq_intp[1] "FIR filter denominator coefficient vector" VALUE 0x84836e _REC_VAL_20_s2 2. _CNV_A_R_LINEAR_____15_CM -1. 1. DISPLAY_IDENTIFIER C_DNOM_FIL_VALUE_ACQ_INTP_1_ FORMAT "%6.5" /end CHARACTERISTIC
/begin CHARACTERISTIC c_dnom_fil_value_acq_intp[2] "FIR filter denominator coefficient vector" VALUE 0x848370 _REC_VAL_20_s2 2. _CNV_A_R_LINEAR_____15_CM -1. 1. DISPLAY_IDENTIFIER C_DNOM_FIL_VALUE_ACQ_INTP_2_ FORMAT "%6.5" /end CHARACTERISTIC
/begin CHARACTERISTIC c_dnom_fil_value_acq_intp[3] "FIR filter denominator coefficient vector" VALUE 0x848372 _REC_VAL_20_s2 2. _CNV_A_R_LINEAR_____15_CM -1. 1. DISPLAY_IDENTIFIER C_DNOM_FIL_VALUE_ACQ_INTP_3_ FORMAT "%6.5" /end CHARACTERISTIC
/begin CHARACTERISTIC c_dnom_fil_value_acq_intp[4] "FIR filter denominator coefficient vector" VALUE 0x848374 _REC_VAL_20_s2 2. _CNV_A_R_LINEAR_____15_CM -1. 1. DISPLAY_IDENTIFIER C_DNOM_FIL_VALUE_ACQ_INTP_4_ FORMAT "%6.5" /end CHARACTERISTIC
/begin CHARACTERISTIC c_dnom_fil_value_acq_intp[5] "FIR filter denominator coefficient vector" VALUE 0x848376 _REC_VAL_20_s2 2. _CNV_A_R_LINEAR_____15_CM -1. 1. DISPLAY_IDENTIFIER C_DNOM_FIL_VALUE_ACQ_INTP_5_ FORMAT "%6.5" /end CHARACTERISTIC
/begin CHARACTERISTIC c_dnom_fil_value_acq_intp[6] "FIR filter denominator coefficient vector" VALUE 0x848378 _REC_VAL_20_s2 2. _CNV_A_R_LINEAR_____15_CM -1. 1. DISPLAY_IDENTIFIER C_DNOM_FIL_VALUE_ACQ_INTP_6_ FORMAT "%6.5" /end CHARACTERISTIC
/begin CHARACTERISTIC c_dnom_fil_value_acq_intp[7] "FIR filter denominator coefficient vector" VALUE 0x84837a _REC_VAL_20_s2 2. _CNV_A_R_LINEAR_____15_CM -1. 1. DISPLAY_IDENTIFIER C_DNOM_FIL_VALUE_ACQ_INTP_7_ FORMAT "%6.5" /end CHARACTERISTIC
/begin CHARACTERISTIC c_dnom_fil_value_acq_intp[8] "FIR filter denominator coefficient vector" VALUE 0x84837c _REC_VAL_20_s2 2. _CNV_A_R_LINEAR_____15_CM -1. 1. DISPLAY_IDENTIFIER C_DNOM_FIL_VALUE_ACQ_INTP_8_ FORMAT "%6.5" /end CHARACTERISTIC
/begin CHARACTERISTIC c_egy_det_ma_fil_ini "moving average EGY_INJ_DET filter initialisation value" VALUE 0x848410 _REC_VAL_20_u2 522.7750632 _CNV_A_R_LINEAR_____534_CM 0. 522.7750632 DISPLAY_IDENTIFIER C_EGY_DET_MA_FIL_INI /end CHARACTERISTIC
/begin CHARACTERISTIC c_num_fil_value_acq_intp[0] "FIR filter numerator coefficient vector" VALUE 0x84852a _REC_VAL_20_s2 2. _CNV_A_R_LINEAR_____15_CM -1. 1. DISPLAY_IDENTIFIER C_NUM_FIL_VALUE_ACQ_INTP_0_ FORMAT "%6.5" /end CHARACTERISTIC
/begin CHARACTERISTIC c_num_fil_value_acq_intp[1] "FIR filter numerator coefficient vector" VALUE 0x84852c _REC_VAL_20_s2 2. _CNV_A_R_LINEAR_____15_CM -1. 1. DISPLAY_IDENTIFIER C_NUM_FIL_VALUE_ACQ_INTP_1_ FORMAT "%6.5" /end CHARACTERISTIC
/begin CHARACTERISTIC c_num_fil_value_acq_intp[2] "FIR filter numerator coefficient vector" VALUE 0x84852e _REC_VAL_20_s2 2. _CNV_A_R_LINEAR_____15_CM -1. 1. DISPLAY_IDENTIFIER C_NUM_FIL_VALUE_ACQ_INTP_2_ FORMAT "%6.5" /end CHARACTERISTIC
/begin CHARACTERISTIC c_num_fil_value_acq_intp[3] "FIR filter numerator coefficient vector" VALUE 0x848530 _REC_VAL_20_s2 2. _CNV_A_R_LINEAR_____15_CM -1. 1. DISPLAY_IDENTIFIER C_NUM_FIL_VALUE_ACQ_INTP_3_ FORMAT "%6.5" /end CHARACTERISTIC
/begin CHARACTERISTIC c_num_fil_value_acq_intp[4] "FIR filter numerator coefficient vector" VALUE 0x848532 _REC_VAL_20_s2 2. _CNV_A_R_LINEAR_____15_CM -1. 1. DISPLAY_IDENTIFIER C_NUM_FIL_VALUE_ACQ_INTP_4_ FORMAT "%6.5" /end CHARACTERISTIC
/begin CHARACTERISTIC c_num_fil_value_acq_intp[5] "FIR filter numerator coefficient vector" VALUE 0x848534 _REC_VAL_20_s2 2. _CNV_A_R_LINEAR_____15_CM -1. 1. DISPLAY_IDENTIFIER C_NUM_FIL_VALUE_ACQ_INTP_5_ FORMAT "%6.5" /end CHARACTERISTIC
/begin CHARACTERISTIC c_num_fil_value_acq_intp[6] "FIR filter numerator coefficient vector" VALUE 0x848536 _REC_VAL_20_s2 2. _CNV_A_R_LINEAR_____15_CM -1. 1. DISPLAY_IDENTIFIER C_NUM_FIL_VALUE_ACQ_INTP_6_ FORMAT "%6.5" /end CHARACTERISTIC
/begin CHARACTERISTIC c_num_fil_value_acq_intp[7] "FIR filter numerator coefficient vector" VALUE 0x848538 _REC_VAL_20_s2 2. _CNV_A_R_LINEAR_____15_CM -1. 1. DISPLAY_IDENTIFIER C_NUM_FIL_VALUE_ACQ_INTP_7_ FORMAT "%6.5" /end CHARACTERISTIC
/begin CHARACTERISTIC c_num_fil_value_acq_intp[8] "FIR filter numerator coefficient vector" VALUE 0x84853a _REC_VAL_20_s2 2. _CNV_A_R_LINEAR_____15_CM -1. 1. DISPLAY_IDENTIFIER C_NUM_FIL_VALUE_ACQ_INTP_8_ FORMAT "%6.5" /end CHARACTERISTIC
/begin CHARACTERISTIC c_sample_nr_det_beg "start sample of detection window" VALUE 0x8485bc _REC_VAL_20_u1 255. _CNV_A_R_LINEAR_____0_CM 0. 255. DISPLAY_IDENTIFIER C_SAMPLE_NR_DET_BEG FORMAT "%3.0" /end CHARACTERISTIC
/begin CHARACTERISTIC c_sample_nr_det_dly "number of samples until trigger of detection" VALUE 0x8485bd _REC_VAL_20_u1 255. _CNV_A_R_LINEAR_____0_CM 0. 255. DISPLAY_IDENTIFIER C_SAMPLE_NR_DET_DLY FORMAT "%3.0" /end CHARACTERISTIC
/begin CHARACTERISTIC c_sample_nr_det_end "final sample of detection window" VALUE 0x8485be _REC_VAL_20_u1 255. _CNV_A_R_LINEAR_____0_CM 0. 255. DISPLAY_IDENTIFIER C_SAMPLE_NR_DET_END FORMAT "%3.0" /end CHARACTERISTIC
/begin CHARACTERISTIC c_sample_nr_det_lst "number of samples until last vector point (during detection)" VALUE 0x8485bf _REC_VAL_20_u1 255. _CNV_A_R_LINEAR_____0_CM 0. 255. DISPLAY_IDENTIFIER C_SAMPLE_NR_DET_LST FORMAT "%3.0" /end CHARACTERISTIC
/begin CHARACTERISTIC c_t_egy_inj_det_dly "group delay of FIR moving average filter" VALUE 0x848638 _REC_VAL_20_s2 0.6553500000000001 _CNV_A_R_LINEAR_____551_CM -0.32768 0.32767 DISPLAY_IDENTIFIER C_T_EGY_INJ_DET_DLY FORMAT "%7.5" /end CHARACTERISTIC
/begin CHARACTERISTIC c_t_sample_burst "burst measurement sample time" VALUE 0x8486a2 _REC_VAL_20_u2 0.32767 _CNV_A_R_LINEAR_____552_CM 0. 0.32767 DISPLAY_IDENTIFIER C_T_SAMPLE_BURST FORMAT "%7.5" /end CHARACTERISTIC
/begin CHARACTERISTIC c_v_inj_burst_dif_min "plausibility of signal minimum" VALUE 0x84873e _REC_VAL_20_s2 511. _CNV_A_R_LINEAR_____549_CM -256. 255. DISPLAY_IDENTIFIER C_V_INJ_BURST_DIF_MIN FORMAT "%4.1" /end CHARACTERISTIC
/begin CHARACTERISTIC lc_v_inj_burst_dif_sel "select first or second order derivative" VALUE 0x8487e6 _REC_VAL_20_u1 1. _CNV_A_R_LINEAR_____0_CM 0. 1. DISPLAY_IDENTIFIER LC_V_INJ_BURST_DIF_SEL FORMAT "%1.0" /end CHARACTERISTIC
/begin CHARACTERISTIC lc_v_inj_burst_fil_max "single or multiple maximum detection" VALUE 0x8487e7 _REC_VAL_20_u1 1. _CNV_A_R_LINEAR_____0_CM 0. 1. DISPLAY_IDENTIFIER LC_V_INJ_BURST_FIL_MAX FORMAT "%1.0" /end CHARACTERISTIC
/begin CHARACTERISTIC lc_v_inj_burst_intp_on "switch interpolation of V_INJ_BURST on" VALUE 0x8487e8 _REC_VAL_20_u1 1. _CNV_A_R_LINEAR_____0_CM 0. 1. DISPLAY_IDENTIFIER LC_V_INJ_BURST_INTP_ON FORMAT "%1.0" /end CHARACTERISTIC
/begin CHARACTERISTIC lc_v_inj_burst_lnr_on "switch linearization of V_INJ_INTP" VALUE 0x8487e9 _REC_VAL_20_u1 1. _CNV_A_R_LINEAR_____0_CM 0. 1. DISPLAY_IDENTIFIER LC_V_INJ_BURST_LNR_ON FORMAT "%1.0" /end CHARACTERISTIC
/begin MEASUREMENT cnt_t_iv_close_statistics_succ_[0] "success of t_iv_close determination counter (cylinder individual)" UWORD _CNV_A_R_LINEAR_____0_CM 1 0. 0. 65535. DISPLAY_IDENTIFIER CNT_T_IV_CLOSE_STATISTICS_SUCC__ ECU_ADDRESS 0x7f9f00 BYTE_ORDER MSB_LAST FORMAT "%5.0" /end MEASUREMENT
/begin MEASUREMENT cnt_t_iv_close_statistics_succ_[1] "success of t_iv_close determination counter (cylinder individual)" UWORD _CNV_A_R_LINEAR_____0_CM 1 0. 0. 65535. DISPLAY_IDENTIFIER CNT_T_IV_CLOSE_STATISTICS_SUCC__ ECU_ADDRESS 0x7f9f02 BYTE_ORDER MSB_LAST FORMAT "%5.0" /end MEASUREMENT
/begin MEASUREMENT cnt_t_iv_close_statistics_succ_[2] "success of t_iv_close determination counter (cylinder individual)" UWORD _CNV_A_R_LINEAR_____0_CM 1 0. 0. 65535. DISPLAY_IDENTIFIER CNT_T_IV_CLOSE_STATISTICS_SUCC__ ECU_ADDRESS 0x7f9f04 BYTE_ORDER MSB_LAST FORMAT "%5.0" /end MEASUREMENT
/begin MEASUREMENT cnt_t_iv_close_statistics_succ_[3] "success of t_iv_close determination counter (cylinder individual)" UWORD _CNV_A_R_LINEAR_____0_CM 1 0. 0. 65535. DISPLAY_IDENTIFIER CNT_T_IV_CLOSE_STATISTICS_SUCC__ ECU_ADDRESS 0x7f9f06 BYTE_ORDER MSB_LAST FORMAT "%5.0" /end MEASUREMENT
/begin MEASUREMENT cnt_t_iv_close_statistics_fail_cont_[0] "fail of t_iv_close determination continous counter (cylinder individual)" UWORD _CNV_A_R_LINEAR_____0_CM 1 0. 0. 65535. DISPLAY_IDENTIFIER CNT_T_IV_CLOSE_STATISTICS_FAIL_C ECU_ADDRESS 0x7f9f08 BYTE_ORDER MSB_LAST FORMAT "%5.0" /end MEASUREMENT
/begin MEASUREMENT cnt_t_iv_close_statistics_fail_cont_[1] "fail of t_iv_close determination continous counter (cylinder individual)" UWORD _CNV_A_R_LINEAR_____0_CM 1 0. 0. 65535. DISPLAY_IDENTIFIER CNT_T_IV_CLOSE_STATISTICS_FAIL_C ECU_ADDRESS 0x7f9f0a BYTE_ORDER MSB_LAST FORMAT "%5.0" /end MEASUREMENT
/begin MEASUREMENT cnt_t_iv_close_statistics_fail_cont_[2] "fail of t_iv_close determination continous counter (cylinder individual)" UWORD _CNV_A_R_LINEAR_____0_CM 1 0. 0. 65535. DISPLAY_IDENTIFIER CNT_T_IV_CLOSE_STATISTICS_FAIL_C ECU_ADDRESS 0x7f9f0c BYTE_ORDER MSB_LAST FORMAT "%5.0" /end MEASUREMENT
/begin MEASUREMENT cnt_t_iv_close_statistics_fail_cont_[3] "fail of t_iv_close determination continous counter (cylinder individual)" UWORD _CNV_A_R_LINEAR_____0_CM 1 0. 0. 65535. DISPLAY_IDENTIFIER CNT_T_IV_CLOSE_STATISTICS_FAIL_C ECU_ADDRESS 0x7f9f0e BYTE_ORDER MSB_LAST FORMAT "%5.0" /end MEASUREMENT
/begin MEASUREMENT cnt_t_iv_close_statistics_fail_[0] "fail of t_iv_close determination continous counter (cylinder individual)" UWORD _CNV_A_R_LINEAR_____0_CM 1 0. 0. 65535. DISPLAY_IDENTIFIER CNT_T_IV_CLOSE_STATISTICS_FAIL__ ECU_ADDRESS 0x7f9f18 BYTE_ORDER MSB_LAST FORMAT "%5.0" /end MEASUREMENT
/begin MEASUREMENT cnt_t_iv_close_statistics_fail_[1] "fail of t_iv_close determination continous counter (cylinder individual)" UWORD _CNV_A_R_LINEAR_____0_CM 1 0. 0. 65535. DISPLAY_IDENTIFIER CNT_T_IV_CLOSE_STATISTICS_FAIL__ ECU_ADDRESS 0x7f9f1a BYTE_ORDER MSB_LAST FORMAT "%5.0" /end MEASUREMENT
/begin MEASUREMENT cnt_t_iv_close_statistics_fail_[2] "fail of t_iv_close determination continous counter (cylinder individual)" UWORD _CNV_A_R_LINEAR_____0_CM 1 0. 0. 65535. DISPLAY_IDENTIFIER CNT_T_IV_CLOSE_STATISTICS_FAIL__ ECU_ADDRESS 0x7f9f1c BYTE_ORDER MSB_LAST FORMAT "%5.0" /end MEASUREMENT
/begin MEASUREMENT cnt_t_iv_close_statistics_fail_[3] "fail of t_iv_close determination continous counter (cylinder individual)" UWORD _CNV_A_R_LINEAR_____0_CM 1 0. 0. 65535. DISPLAY_IDENTIFIER CNT_T_IV_CLOSE_STATISTICS_FAIL__ ECU_ADDRESS 0x7f9f1e BYTE_ORDER MSB_LAST FORMAT "%5.0" /end MEASUREMENT
/begin MEASUREMENT cnt_t_iv_close_statistics_0[0] "fail of t_iv_close determination continous counter (cylinder 0)" UWORD _CNV_A_R_LINEAR_____0_CM 1 0. 0. 65535. DISPLAY_IDENTIFIER CNT_T_IV_CLOSE_STATISTICS_0_0_ ECU_ADDRESS 0x7f9f20 BYTE_ORDER MSB_LAST FORMAT "%5.0" /end MEASUREMENT
/begin MEASUREMENT cnt_t_iv_close_statistics_0[1] "fail of t_iv_close determination continous counter (cylinder 0)" UWORD _CNV_A_R_LINEAR_____0_CM 1 0. 0. 65535. DISPLAY_IDENTIFIER CNT_T_IV_CLOSE_STATISTICS_0_1_ ECU_ADDRESS 0x7f9f22 BYTE_ORDER MSB_LAST FORMAT "%5.0" /end MEASUREMENT
/begin MEASUREMENT cnt_t_iv_close_statistics_0[2] "fail of t_iv_close determination continous counter (cylinder 0)" UWORD _CNV_A_R_LINEAR_____0_CM 1 0. 0. 65535. DISPLAY_IDENTIFIER CNT_T_IV_CLOSE_STATISTICS_0_2_ ECU_ADDRESS 0x7f9f24 BYTE_ORDER MSB_LAST FORMAT "%5.0" /end MEASUREMENT
/begin MEASUREMENT cnt_t_iv_close_statistics_0[3] "fail of t_iv_close determination continous counter (cylinder 0)" UWORD _CNV_A_R_LINEAR_____0_CM 1 0. 0. 65535. DISPLAY_IDENTIFIER CNT_T_IV_CLOSE_STATISTICS_0_3_ ECU_ADDRESS 0x7f9f26 BYTE_ORDER MSB_LAST FORMAT "%5.0" /end MEASUREMENT
/begin MEASUREMENT cnt_t_iv_close_statistics_0[4] "fail of t_iv_close determination continous counter (cylinder 0)" UWORD _CNV_A_R_LINEAR_____0_CM 1 0. 0. 65535. DISPLAY_IDENTIFIER CNT_T_IV_CLOSE_STATISTICS_0_4_ ECU_ADDRESS 0x7f9f28 BYTE_ORDER MSB_LAST FORMAT "%5.0" /end MEASUREMENT
/begin MEASUREMENT cnt_t_iv_close_statistics_0[5] "fail of t_iv_close determination continous counter (cylinder 0)" UWORD _CNV_A_R_LINEAR_____0_CM 1 0. 0. 65535. DISPLAY_IDENTIFIER CNT_T_IV_CLOSE_STATISTICS_0_5_ ECU_ADDRESS 0x7f9f2a BYTE_ORDER MSB_LAST FORMAT "%5.0" /end MEASUREMENT
/begin MEASUREMENT cnt_t_iv_close_statistics_0[6] "fail of t_iv_close determination continous counter (cylinder 0)" UWORD _CNV_A_R_LINEAR_____0_CM 1 0. 0. 65535. DISPLAY_IDENTIFIER CNT_T_IV_CLOSE_STATISTICS_0_6_ ECU_ADDRESS 0x7f9f2c BYTE_ORDER MSB_LAST FORMAT "%5.0" /end MEASUREMENT
/begin MEASUREMENT cnt_t_iv_close_statistics_0[7] "fail of t_iv_close determination continous counter (cylinder 0)" UWORD _CNV_A_R_LINEAR_____0_CM 1 0. 0. 65535. DISPLAY_IDENTIFIER CNT_T_IV_CLOSE_STATISTICS_0_7_ ECU_ADDRESS 0x7f9f2e BYTE_ORDER MSB_LAST FORMAT "%5.0" /end MEASUREMENT
/begin MEASUREMENT cnt_t_iv_close_statistics_0[8] "fail of t_iv_close determination continous counter (cylinder 0)" UWORD _CNV_A_R_LINEAR_____0_CM 1 0. 0. 65535. DISPLAY_IDENTIFIER CNT_T_IV_CLOSE_STATISTICS_0_8_ ECU_ADDRESS 0x7f9f30 BYTE_ORDER MSB_LAST FORMAT "%5.0" /end MEASUREMENT
/begin MEASUREMENT cnt_t_iv_close_statistics_0[9] "fail of t_iv_close determination continous counter (cylinder 0)" UWORD _CNV_A_R_LINEAR_____0_CM 1 0. 0. 65535. DISPLAY_IDENTIFIER CNT_T_IV_CLOSE_STATISTICS_0_9_ ECU_ADDRESS 0x7f9f32 BYTE_ORDER MSB_LAST FORMAT "%5.0" /end MEASUREMENT
/begin MEASUREMENT cnt_t_iv_close_statistics_0[10] "fail of t_iv_close determination continous counter (cylinder 0)" UWORD _CNV_A_R_LINEAR_____0_CM 1 0. 0. 65535. DISPLAY_IDENTIFIER CNT_T_IV_CLOSE_STATISTICS_0_10_ ECU_ADDRESS 0x7f9f34 BYTE_ORDER MSB_LAST FORMAT "%5.0" /end MEASUREMENT
/begin MEASUREMENT cnt_t_iv_close_statistics_0[11] "fail of t_iv_close determination continous counter (cylinder 0)" UWORD _CNV_A_R_LINEAR_____0_CM 1 0. 0. 65535. DISPLAY_IDENTIFIER CNT_T_IV_CLOSE_STATISTICS_0_11_ ECU_ADDRESS 0x7f9f36 BYTE_ORDER MSB_LAST FORMAT "%5.0" /end MEASUREMENT
/begin MEASUREMENT cnt_t_iv_close_statistics_0[12] "fail of t_iv_close determination continous counter (cylinder 0)" UWORD _CNV_A_R_LINEAR_____0_CM 1 0. 0. 65535. DISPLAY_IDENTIFIER CNT_T_IV_CLOSE_STATISTICS_0_12_ ECU_ADDRESS 0x7f9f38 BYTE_ORDER MSB_LAST FORMAT "%5.0" /end MEASUREMENT
/begin MEASUREMENT cnt_t_iv_close_statistics_1[0] "fail of t_iv_close determination continous counter (cylinder 0)" UWORD _CNV_A_R_LINEAR_____0_CM 1 0. 0. 65535. DISPLAY_IDENTIFIER CNT_T_IV_CLOSE_STATISTICS_1_0_ ECU_ADDRESS 0x7f9f3a BYTE_ORDER MSB_LAST FORMAT "%5.0" /end MEASUREMENT
/begin MEASUREMENT cnt_t_iv_close_statistics_1[1] "fail of t_iv_close determination continous counter (cylinder 0)" UWORD _CNV_A_R_LINEAR_____0_CM 1 0. 0. 65535. DISPLAY_IDENTIFIER CNT_T_IV_CLOSE_STATISTICS_1_1_ ECU_ADDRESS 0x7f9f3c BYTE_ORDER MSB_LAST FORMAT "%5.0" /end MEASUREMENT
/begin MEASUREMENT cnt_t_iv_close_statistics_1[2] "fail of t_iv_close determination continous counter (cylinder 0)" UWORD _CNV_A_R_LINEAR_____0_CM 1 0. 0. 65535. DISPLAY_IDENTIFIER CNT_T_IV_CLOSE_STATISTICS_1_2_ ECU_ADDRESS 0x7f9f3e BYTE_ORDER MSB_LAST FORMAT "%5.0" /end MEASUREMENT
/begin MEASUREMENT cnt_t_iv_close_statistics_1[3] "fail of t_iv_close determination continous counter (cylinder 0)" UWORD _CNV_A_R_LINEAR_____0_CM 1 0. 0. 65535. DISPLAY_IDENTIFIER CNT_T_IV_CLOSE_STATISTICS_1_3_ ECU_ADDRESS 0x7f9f40 BYTE_ORDER MSB_LAST FORMAT "%5.0" /end MEASUREMENT
/begin MEASUREMENT cnt_t_iv_close_statistics_1[4] "fail of t_iv_close determination continous counter (cylinder 0)" UWORD _CNV_A_R_LINEAR_____0_CM 1 0. 0. 65535. DISPLAY_IDENTIFIER CNT_T_IV_CLOSE_STATISTICS_1_4_ ECU_ADDRESS 0x7f9f42 BYTE_ORDER MSB_LAST FORMAT "%5.0" /end MEASUREMENT
/begin MEASUREMENT cnt_t_iv_close_statistics_1[5] "fail of t_iv_close determination continous counter (cylinder 0)" UWORD _CNV_A_R_LINEAR_____0_CM 1 0. 0. 65535. DISPLAY_IDENTIFIER CNT_T_IV_CLOSE_STATISTICS_1_5_ ECU_ADDRESS 0x7f9f44 BYTE_ORDER MSB_LAST FORMAT "%5.0" /end MEASUREMENT
/begin MEASUREMENT cnt_t_iv_close_statistics_1[6] "fail of t_iv_close determination continous counter (cylinder 0)" UWORD _CNV_A_R_LINEAR_____0_CM 1 0. 0. 65535. DISPLAY_IDENTIFIER CNT_T_IV_CLOSE_STATISTICS_1_6_ ECU_ADDRESS 0x7f9f46 BYTE_ORDER MSB_LAST FORMAT "%5.0" /end MEASUREMENT
/begin MEASUREMENT cnt_t_iv_close_statistics_1[7] "fail of t_iv_close determination continous counter (cylinder 0)" UWORD _CNV_A_R_LINEAR_____0_CM 1 0. 0. 65535. DISPLAY_IDENTIFIER CNT_T_IV_CLOSE_STATISTICS_1_7_ ECU_ADDRESS 0x7f9f48 BYTE_ORDER MSB_LAST FORMAT "%5.0" /end MEASUREMENT
/begin MEASUREMENT cnt_t_iv_close_statistics_1[8] "fail of t_iv_close determination continous counter (cylinder 0)" UWORD _CNV_A_R_LINEAR_____0_CM 1 0. 0. 65535. DISPLAY_IDENTIFIER CNT_T_IV_CLOSE_STATISTICS_1_8_ ECU_ADDRESS 0x7f9f4a BYTE_ORDER MSB_LAST FORMAT "%5.0" /end MEASUREMENT
/begin MEASUREMENT cnt_t_iv_close_statistics_1[9] "fail of t_iv_close determination continous counter (cylinder 0)" UWORD _CNV_A_R_LINEAR_____0_CM 1 0. 0. 65535. DISPLAY_IDENTIFIER CNT_T_IV_CLOSE_STATISTICS_1_9_ ECU_ADDRESS 0x7f9f4c BYTE_ORDER MSB_LAST FORMAT "%5.0" /end MEASUREMENT
/begin MEASUREMENT cnt_t_iv_close_statistics_1[10] "fail of t_iv_close determination continous counter (cylinder 0)" UWORD _CNV_A_R_LINEAR_____0_CM 1 0. 0. 65535. DISPLAY_IDENTIFIER CNT_T_IV_CLOSE_STATISTICS_1_10_ ECU_ADDRESS 0x7f9f4e BYTE_ORDER MSB_LAST FORMAT "%5.0" /end MEASUREMENT
/begin MEASUREMENT cnt_t_iv_close_statistics_1[11] "fail of t_iv_close determination continous counter (cylinder 0)" UWORD _CNV_A_R_LINEAR_____0_CM 1 0. 0. 65535. DISPLAY_IDENTIFIER CNT_T_IV_CLOSE_STATISTICS_1_11_ ECU_ADDRESS 0x7f9f50 BYTE_ORDER MSB_LAST FORMAT "%5.0" /end MEASUREMENT
/begin MEASUREMENT cnt_t_iv_close_statistics_1[12] "fail of t_iv_close determination continous counter (cylinder 0)" UWORD _CNV_A_R_LINEAR_____0_CM 1 0. 0. 65535. DISPLAY_IDENTIFIER CNT_T_IV_CLOSE_STATISTICS_1_12_ ECU_ADDRESS 0x7f9f52 BYTE_ORDER MSB_LAST FORMAT "%5.0" /end MEASUREMENT
/begin MEASUREMENT cnt_t_iv_close_statistics_2[0] "fail of t_iv_close determination continous counter (cylinder 0)" UWORD _CNV_A_R_LINEAR_____0_CM 1 0. 0. 65535. DISPLAY_IDENTIFIER CNT_T_IV_CLOSE_STATISTICS_2_0_ ECU_ADDRESS 0x7f9f54 BYTE_ORDER MSB_LAST FORMAT "%5.0" /end MEASUREMENT
/begin MEASUREMENT cnt_t_iv_close_statistics_2[1] "fail of t_iv_close determination continous counter (cylinder 0)" UWORD _CNV_A_R_LINEAR_____0_CM 1 0. 0. 65535. DISPLAY_IDENTIFIER CNT_T_IV_CLOSE_STATISTICS_2_1_ ECU_ADDRESS 0x7f9f56 BYTE_ORDER MSB_LAST FORMAT "%5.0" /end MEASUREMENT
/begin MEASUREMENT cnt_t_iv_close_statistics_2[2] "fail of t_iv_close determination continous counter (cylinder 0)" UWORD _CNV_A_R_LINEAR_____0_CM 1 0. 0. 65535. DISPLAY_IDENTIFIER CNT_T_IV_CLOSE_STATISTICS_2_2_ ECU_ADDRESS 0x7f9f58 BYTE_ORDER MSB_LAST FORMAT "%5.0" /end MEASUREMENT
/begin MEASUREMENT cnt_t_iv_close_statistics_2[3] "fail of t_iv_close determination continous counter (cylinder 0)" UWORD _CNV_A_R_LINEAR_____0_CM 1 0. 0. 65535. DISPLAY_IDENTIFIER CNT_T_IV_CLOSE_STATISTICS_2_3_ ECU_ADDRESS 0x7f9f5a BYTE_ORDER MSB_LAST FORMAT "%5.0" /end MEASUREMENT
/begin MEASUREMENT cnt_t_iv_close_statistics_2[4] "fail of t_iv_close determination continous counter (cylinder 0)" UWORD _CNV_A_R_LINEAR_____0_CM 1 0. 0. 65535. DISPLAY_IDENTIFIER CNT_T_IV_CLOSE_STATISTICS_2_4_ ECU_ADDRESS 0x7f9f5c BYTE_ORDER MSB_LAST FORMAT "%5.0" /end MEASUREMENT
/begin MEASUREMENT cnt_t_iv_close_statistics_2[5] "fail of t_iv_close determination continous counter (cylinder 0)" UWORD _CNV_A_R_LINEAR_____0_CM 1 0. 0. 65535. DISPLAY_IDENTIFIER CNT_T_IV_CLOSE_STATISTICS_2_5_ ECU_ADDRESS 0x7f9f5e BYTE_ORDER MSB_LAST FORMAT "%5.0" /end MEASUREMENT
/begin MEASUREMENT cnt_t_iv_close_statistics_2[6] "fail of t_iv_close determination continous counter (cylinder 0)" UWORD _CNV_A_R_LINEAR_____0_CM 1 0. 0. 65535. DISPLAY_IDENTIFIER CNT_T_IV_CLOSE_STATISTICS_2_6_ ECU_ADDRESS 0x7f9f60 BYTE_ORDER MSB_LAST FORMAT "%5.0" /end MEASUREMENT
/begin MEASUREMENT cnt_t_iv_close_statistics_2[7] "fail of t_iv_close determination continous counter (cylinder 0)" UWORD _CNV_A_R_LINEAR_____0_CM 1 0. 0. 65535. DISPLAY_IDENTIFIER CNT_T_IV_CLOSE_STATISTICS_2_7_ ECU_ADDRESS 0x7f9f62 BYTE_ORDER MSB_LAST FORMAT "%5.0" /end MEASUREMENT
/begin MEASUREMENT cnt_t_iv_close_statistics_2[8] "fail of t_iv_close determination continous counter (cylinder 0)" UWORD _CNV_A_R_LINEAR_____0_CM 1 0. 0. 65535. DISPLAY_IDENTIFIER CNT_T_IV_CLOSE_STATISTICS_2_8_ ECU_ADDRESS 0x7f9f64 BYTE_ORDER MSB_LAST FORMAT "%5.0" /end MEASUREMENT
/begin MEASUREMENT cnt_t_iv_close_statistics_2[9] "fail of t_iv_close determination continous counter (cylinder 0)" UWORD _CNV_A_R_LINEAR_____0_CM 1 0. 0. 65535. DISPLAY_IDENTIFIER CNT_T_IV_CLOSE_STATISTICS_2_9_ ECU_ADDRESS 0x7f9f66 BYTE_ORDER MSB_LAST FORMAT "%5.0" /end MEASUREMENT
/begin MEASUREMENT cnt_t_iv_close_statistics_2[10] "fail of t_iv_close determination continous counter (cylinder 0)" UWORD _CNV_A_R_LINEAR_____0_CM 1 0. 0. 65535. DISPLAY_IDENTIFIER CNT_T_IV_CLOSE_STATISTICS_2_10_ ECU_ADDRESS 0x7f9f68 BYTE_ORDER MSB_LAST FORMAT "%5.0" /end MEASUREMENT
/begin MEASUREMENT cnt_t_iv_close_statistics_2[11] "fail of t_iv_close determination continous counter (cylinder 0)" UWORD _CNV_A_R_LINEAR_____0_CM 1 0. 0. 65535. DISPLAY_IDENTIFIER CNT_T_IV_CLOSE_STATISTICS_2_11_ ECU_ADDRESS 0x7f9f6a BYTE_ORDER MSB_LAST FORMAT "%5.0" /end MEASUREMENT
/begin MEASUREMENT cnt_t_iv_close_statistics_2[12] "fail of t_iv_close determination continous counter (cylinder 0)" UWORD _CNV_A_R_LINEAR_____0_CM 1 0. 0. 65535. DISPLAY_IDENTIFIER CNT_T_IV_CLOSE_STATISTICS_2_12_ ECU_ADDRESS 0x7f9f6c BYTE_ORDER MSB_LAST FORMAT "%5.0" /end MEASUREMENT
/begin MEASUREMENT cnt_t_iv_close_statistics_3[0] "fail of t_iv_close determination continous counter (cylinder 0)" UWORD _CNV_A_R_LINEAR_____0_CM 1 0. 0. 65535. DISPLAY_IDENTIFIER CNT_T_IV_CLOSE_STATISTICS_3_0_ ECU_ADDRESS 0x7f9f6e BYTE_ORDER MSB_LAST FORMAT "%5.0" /end MEASUREMENT
/begin MEASUREMENT cnt_t_iv_close_statistics_3[1] "fail of t_iv_close determination continous counter (cylinder 0)" UWORD _CNV_A_R_LINEAR_____0_CM 1 0. 0. 65535. DISPLAY_IDENTIFIER CNT_T_IV_CLOSE_STATISTICS_3_1_ ECU_ADDRESS 0x7f9f70 BYTE_ORDER MSB_LAST FORMAT "%5.0" /end MEASUREMENT
/begin MEASUREMENT cnt_t_iv_close_statistics_3[2] "fail of t_iv_close determination continous counter (cylinder 0)" UWORD _CNV_A_R_LINEAR_____0_CM 1 0. 0. 65535. DISPLAY_IDENTIFIER CNT_T_IV_CLOSE_STATISTICS_3_2_ ECU_ADDRESS 0x7f9f72 BYTE_ORDER MSB_LAST FORMAT "%5.0" /end MEASUREMENT
/begin MEASUREMENT cnt_t_iv_close_statistics_3[3] "fail of t_iv_close determination continous counter (cylinder 0)" UWORD _CNV_A_R_LINEAR_____0_CM 1 0. 0. 65535. DISPLAY_IDENTIFIER CNT_T_IV_CLOSE_STATISTICS_3_3_ ECU_ADDRESS 0x7f9f74 BYTE_ORDER MSB_LAST FORMAT "%5.0" /end MEASUREMENT
/begin MEASUREMENT cnt_t_iv_close_statistics_3[4] "fail of t_iv_close determination continous counter (cylinder 0)" UWORD _CNV_A_R_LINEAR_____0_CM 1 0. 0. 65535. DISPLAY_IDENTIFIER CNT_T_IV_CLOSE_STATISTICS_3_4_ ECU_ADDRESS 0x7f9f76 BYTE_ORDER MSB_LAST FORMAT "%5.0" /end MEASUREMENT
/begin MEASUREMENT cnt_t_iv_close_statistics_3[5] "fail of t_iv_close determination continous counter (cylinder 0)" UWORD _CNV_A_R_LINEAR_____0_CM 1 0. 0. 65535. DISPLAY_IDENTIFIER CNT_T_IV_CLOSE_STATISTICS_3_5_ ECU_ADDRESS 0x7f9f78 BYTE_ORDER MSB_LAST FORMAT "%5.0" /end MEASUREMENT
/begin MEASUREMENT cnt_t_iv_close_statistics_3[6] "fail of t_iv_close determination continous counter (cylinder 0)" UWORD _CNV_A_R_LINEAR_____0_CM 1 0. 0. 65535. DISPLAY_IDENTIFIER CNT_T_IV_CLOSE_STATISTICS_3_6_ ECU_ADDRESS 0x7f9f7a BYTE_ORDER MSB_LAST FORMAT "%5.0" /end MEASUREMENT
/begin MEASUREMENT cnt_t_iv_close_statistics_3[7] "fail of t_iv_close determination continous counter (cylinder 0)" UWORD _CNV_A_R_LINEAR_____0_CM 1 0. 0. 65535. DISPLAY_IDENTIFIER CNT_T_IV_CLOSE_STATISTICS_3_7_ ECU_ADDRESS 0x7f9f7c BYTE_ORDER MSB_LAST FORMAT "%5.0" /end MEASUREMENT
/begin MEASUREMENT cnt_t_iv_close_statistics_3[8] "fail of t_iv_close determination continous counter (cylinder 0)" UWORD _CNV_A_R_LINEAR_____0_CM 1 0. 0. 65535. DISPLAY_IDENTIFIER CNT_T_IV_CLOSE_STATISTICS_3_8_ ECU_ADDRESS 0x7f9f7e BYTE_ORDER MSB_LAST FORMAT "%5.0" /end MEASUREMENT
/begin MEASUREMENT cnt_t_iv_close_statistics_3[9] "fail of t_iv_close determination continous counter (cylinder 0)" UWORD _CNV_A_R_LINEAR_____0_CM 1 0. 0. 65535. DISPLAY_IDENTIFIER CNT_T_IV_CLOSE_STATISTICS_3_9_ ECU_ADDRESS 0x7f9f80 BYTE_ORDER MSB_LAST FORMAT "%5.0" /end MEASUREMENT
/begin MEASUREMENT cnt_t_iv_close_statistics_3[10] "fail of t_iv_close determination continous counter (cylinder 0)" UWORD _CNV_A_R_LINEAR_____0_CM 1 0. 0. 65535. DISPLAY_IDENTIFIER CNT_T_IV_CLOSE_STATISTICS_3_10_ ECU_ADDRESS 0x7f9f82 BYTE_ORDER MSB_LAST FORMAT "%5.0" /end MEASUREMENT
/begin MEASUREMENT cnt_t_iv_close_statistics_3[11] "fail of t_iv_close determination continous counter (cylinder 0)" UWORD _CNV_A_R_LINEAR_____0_CM 1 0. 0. 65535. DISPLAY_IDENTIFIER CNT_T_IV_CLOSE_STATISTICS_3_11_ ECU_ADDRESS 0x7f9f84 BYTE_ORDER MSB_LAST FORMAT "%5.0" /end MEASUREMENT
/begin MEASUREMENT cnt_t_iv_close_statistics_3[12] "fail of t_iv_close determination continous counter (cylinder 0)" UWORD _CNV_A_R_LINEAR_____0_CM 1 0. 0. 65535. DISPLAY_IDENTIFIER CNT_T_IV_CLOSE_STATISTICS_3_12_ ECU_ADDRESS 0x7f9f86 BYTE_ORDER MSB_LAST FORMAT "%5.0" /end MEASUREMENT
/begin MEASUREMENT t_iv_close_last_[0] "last determined injector valve closing time (cylinder individual)" UWORD _CNV_A_R_LINEAR_____533_CM 1 0. 0. 0.512 DISPLAY_IDENTIFIER T_IV_CLOSE_LAST__0_ ECU_ADDRESS 0x7f9f10 BYTE_ORDER MSB_LAST FORMAT "%4.3" /end MEASUREMENT
/begin MEASUREMENT t_iv_close_last_[1] "last determined injector valve closing time (cylinder individual)" UWORD _CNV_A_R_LINEAR_____533_CM 1 0. 0. 0.512 DISPLAY_IDENTIFIER T_IV_CLOSE_LAST__1_ ECU_ADDRESS 0x7f9f12 BYTE_ORDER MSB_LAST FORMAT "%4.3" /end MEASUREMENT
/begin MEASUREMENT t_iv_close_last_[2] "last determined injector valve closing time (cylinder individual)" UWORD _CNV_A_R_LINEAR_____533_CM 1 0. 0. 0.512 DISPLAY_IDENTIFIER T_IV_CLOSE_LAST__2_ ECU_ADDRESS 0x7f9f14 BYTE_ORDER MSB_LAST FORMAT "%4.3" /end MEASUREMENT
/begin MEASUREMENT t_iv_close_last_[3] "last determined injector valve closing time (cylinder individual)" UWORD _CNV_A_R_LINEAR_____533_CM 1 0. 0. 0.512 DISPLAY_IDENTIFIER T_IV_CLOSE_LAST__3_ ECU_ADDRESS 0x7f9f16 BYTE_ORDER MSB_LAST FORMAT "%4.3" /end MEASUREMENT
/begin CHARACTERISTIC c_t_iv_close_fail_replace "t_iv_close replacement value" VALUE 0x848662 _REC_VAL_20_u2 0.32767 _CNV_A_R_LINEAR_____552_CM 0. 0.32767 DISPLAY_IDENTIFIER C_T_IV_CLOSE_FAIL_REPLACE FORMAT "%7.5" /end CHARACTERISTIC
/begin CHARACTERISTIC c_cnt_t_iv_close_statistics_max "t_iv_close replacement value" VALUE 0x84834a _REC_VAL_20_u2 65535. _CNV_A_R_LINEAR_____0_CM 0. 65535. DISPLAY_IDENTIFIER C_CNT_T_IV_CLOSE_STATISTICS_MAX FORMAT "%5.0" /end CHARACTERISTIC
/begin CHARACTERISTIC c_cnt_t_iv_close_statistics_repl_max "t_iv_close replacement value" VALUE 0x84834c _REC_VAL_20_u2 65535. _CNV_A_R_LINEAR_____0_CM 0. 65535. DISPLAY_IDENTIFIER C_CNT_T_IV_CLOSE_STATISTICS_REPL FORMAT "%5.0" /end CHARACTERISTIC
/begin CHARACTERISTIC c_t_iv_close_statistics_min_lim "t_iv_close statistics minimum limit" VALUE 0x848674 _REC_VAL_20_u2 0.512 _CNV_A_R_LINEAR_____533_CM 0. 0.512 DISPLAY_IDENTIFIER C_T_IV_CLOSE_STATISTICS_MIN_LIM FORMAT "%4.3" /end CHARACTERISTIC
/begin CHARACTERISTIC c_t_iv_close_statistics_max_lim "t_iv_close statistics maximum limit" VALUE 0x848672 _REC_VAL_20_u2 0.512 _CNV_A_R_LINEAR_____533_CM 0. 0.512 DISPLAY_IDENTIFIER C_T_IV_CLOSE_STATISTICS_MAX_LIM FORMAT "%4.3" /end CHARACTERISTIC
/begin MEASUREMENT t_iv_close_stat_mean_[0] "mean value of injector valve closing time (cylinder individual)" UWORD _CNV_A_R_LINEAR_____533_CM 1 0. 0. 0.512 DISPLAY_IDENTIFIER T_IV_CLOSE_STAT_MEAN__0_ ECU_ADDRESS 0x7f9f90 BYTE_ORDER MSB_LAST FORMAT "%4.3" /end MEASUREMENT
/begin MEASUREMENT t_iv_close_stat_mean_[1] "mean value of injector valve closing time (cylinder individual)" UWORD _CNV_A_R_LINEAR_____533_CM 1 0. 0. 0.512 DISPLAY_IDENTIFIER T_IV_CLOSE_STAT_MEAN__1_ ECU_ADDRESS 0x7f9f92 BYTE_ORDER MSB_LAST FORMAT "%4.3" /end MEASUREMENT
/begin MEASUREMENT t_iv_close_stat_mean_[2] "mean value of injector valve closing time (cylinder individual)" UWORD _CNV_A_R_LINEAR_____533_CM 1 0. 0. 0.512 DISPLAY_IDENTIFIER T_IV_CLOSE_STAT_MEAN__2_ ECU_ADDRESS 0x7f9f94 BYTE_ORDER MSB_LAST FORMAT "%4.3" /end MEASUREMENT
/begin MEASUREMENT t_iv_close_stat_mean_[3] "mean value of injector valve closing time (cylinder individual)" UWORD _CNV_A_R_LINEAR_____533_CM 1 0. 0. 0.512 DISPLAY_IDENTIFIER T_IV_CLOSE_STAT_MEAN__3_ ECU_ADDRESS 0x7f9f96 BYTE_ORDER MSB_LAST FORMAT "%4.3" /end MEASUREMENT
/begin MEASUREMENT pct_t_iv_close_statistics_[0] "percentage of successful t_iv_close determinations (cylinder individual)" UWORD _CNV_A_R_LINEAR_____0_CM 1 0. 0. 65535. DISPLAY_IDENTIFIER PCT_T_IV_CLOSE_STATISTICS__0_ ECU_ADDRESS 0x7f9f88 BYTE_ORDER MSB_LAST FORMAT "%5.0" /end MEASUREMENT
/begin MEASUREMENT pct_t_iv_close_statistics_[1] "percentage of successful t_iv_close determinations (cylinder individual)" UWORD _CNV_A_R_LINEAR_____0_CM 1 0. 0. 65535. DISPLAY_IDENTIFIER PCT_T_IV_CLOSE_STATISTICS__1_ ECU_ADDRESS 0x7f9f8a BYTE_ORDER MSB_LAST FORMAT "%5.0" /end MEASUREMENT
/begin MEASUREMENT pct_t_iv_close_statistics_[2] "percentage of successful t_iv_close determinations (cylinder individual)" UWORD _CNV_A_R_LINEAR_____0_CM 1 0. 0. 65535. DISPLAY_IDENTIFIER PCT_T_IV_CLOSE_STATISTICS__2_ ECU_ADDRESS 0x7f9f8c BYTE_ORDER MSB_LAST FORMAT "%5.0" /end MEASUREMENT
/begin MEASUREMENT pct_t_iv_close_statistics_[3] "percentage of successful t_iv_close determinations (cylinder individual)" UWORD _CNV_A_R_LINEAR_____0_CM 1 0. 0. 65535. DISPLAY_IDENTIFIER PCT_T_IV_CLOSE_STATISTICS__3_ ECU_ADDRESS 0x7f9f8e BYTE_ORDER MSB_LAST FORMAT "%5.0" /end MEASUREMENT
/begin MEASUREMENT idx_max_t_iv_close_statistics_[0] "Haeufigkeitspunkt of t_iv_close determination (cylinder individual)" UWORD _CNV_A_R_LINEAR_____0_CM 1 0. 0. 65535. DISPLAY_IDENTIFIER IDX_MAX_T_IV_CLOSE_STATISTICS__0 ECU_ADDRESS 0x7f9f98 BYTE_ORDER MSB_LAST FORMAT "%5.0" /end MEASUREMENT
/begin MEASUREMENT idx_max_t_iv_close_statistics_[1] "Haeufigkeitspunkt of t_iv_close determination (cylinder individual)" UWORD _CNV_A_R_LINEAR_____0_CM 1 0. 0. 65535. DISPLAY_IDENTIFIER IDX_MAX_T_IV_CLOSE_STATISTICS__1 ECU_ADDRESS 0x7f9f9a BYTE_ORDER MSB_LAST FORMAT "%5.0" /end MEASUREMENT
/begin MEASUREMENT idx_max_t_iv_close_statistics_[2] "Haeufigkeitspunkt of t_iv_close determination (cylinder individual)" UWORD _CNV_A_R_LINEAR_____0_CM 1 0. 0. 65535. DISPLAY_IDENTIFIER IDX_MAX_T_IV_CLOSE_STATISTICS__2 ECU_ADDRESS 0x7f9f9c BYTE_ORDER MSB_LAST FORMAT "%5.0" /end MEASUREMENT
/begin MEASUREMENT idx_max_t_iv_close_statistics_[3] "Haeufigkeitspunkt of t_iv_close determination (cylinder individual)" UWORD _CNV_A_R_LINEAR_____0_CM 1 0. 0. 65535. DISPLAY_IDENTIFIER IDX_MAX_T_IV_CLOSE_STATISTICS__3 ECU_ADDRESS 0x7f9f9e BYTE_ORDER MSB_LAST FORMAT "%5.0" /end MEASUREMENT
/begin MEASUREMENT var_t_iv_close_statistics_[0] "Varianz of t_iv_close determination (cylinder individual)" SLONG _CNV_A_R_LINEAR_____0_CM 1 0. -2147483648. 2147483647. DISPLAY_IDENTIFIER VAR_T_IV_CLOSE_STATISTICS__0_ ECU_ADDRESS 0x7f8690 BYTE_ORDER MSB_LAST FORMAT "%5.0" /end MEASUREMENT
/begin MEASUREMENT var_t_iv_close_statistics_[1] "Varianz of t_iv_close determination (cylinder individual)" SLONG _CNV_A_R_LINEAR_____0_CM 1 0. -2147483648. 2147483647. DISPLAY_IDENTIFIER VAR_T_IV_CLOSE_STATISTICS__1_ ECU_ADDRESS 0x7f8694 BYTE_ORDER MSB_LAST FORMAT "%5.0" /end MEASUREMENT
/begin MEASUREMENT var_t_iv_close_statistics_[2] "Varianz of t_iv_close determination (cylinder individual)" SLONG _CNV_A_R_LINEAR_____0_CM 1 0. -2147483648. 2147483647. DISPLAY_IDENTIFIER VAR_T_IV_CLOSE_STATISTICS__2_ ECU_ADDRESS 0x7f8698 BYTE_ORDER MSB_LAST FORMAT "%5.0" /end MEASUREMENT
/begin MEASUREMENT var_t_iv_close_statistics_[3] "Varianz of t_iv_close determination (cylinder individual)" SLONG _CNV_A_R_LINEAR_____0_CM 1 0. -2147483648. 2147483647. DISPLAY_IDENTIFIER VAR_T_IV_CLOSE_STATISTICS__3_ ECU_ADDRESS 0x7f869c BYTE_ORDER MSB_LAST FORMAT "%5.0" /end MEASUREMENT
/begin MEASUREMENT sf_mes_egy_inj_vld "energy measurement active" UWORD _CNV_A_R_LINEAR_____0_CM 1 0. 0. 65535. DISPLAY_IDENTIFIER SF_MES_EGY_INJ_VLD ECU_ADDRESS 0x7f9e56 BYTE_ORDER MSB_LAST FORMAT "%5.0" /end MEASUREMENT
/begin MEASUREMENT egy_inj_seq1_[0] "energy of injection sequence 1 (cylinder individual)" UWORD _CNV_A_R_LINEAR_____534_CM 1 0. 0. 522.7750632 DISPLAY_IDENTIFIER EGY_INJ_SEQ1__0_ ECU_ADDRESS 0x7f9e58 BYTE_ORDER MSB_LAST /end MEASUREMENT
/begin MEASUREMENT egy_inj_seq1_[1] "energy of injection sequence 1 (cylinder individual)" UWORD _CNV_A_R_LINEAR_____534_CM 1 0. 0. 522.7750632 DISPLAY_IDENTIFIER EGY_INJ_SEQ1__1_ ECU_ADDRESS 0x7f9e5a BYTE_ORDER MSB_LAST /end MEASUREMENT
/begin MEASUREMENT egy_inj_seq1_[2] "energy of injection sequence 1 (cylinder individual)" UWORD _CNV_A_R_LINEAR_____534_CM 1 0. 0. 522.7750632 DISPLAY_IDENTIFIER EGY_INJ_SEQ1__2_ ECU_ADDRESS 0x7f9e5c BYTE_ORDER MSB_LAST /end MEASUREMENT
/begin MEASUREMENT egy_inj_seq1_[3] "energy of injection sequence 1 (cylinder individual)" UWORD _CNV_A_R_LINEAR_____534_CM 1 0. 0. 522.7750632 DISPLAY_IDENTIFIER EGY_INJ_SEQ1__3_ ECU_ADDRESS 0x7f9e5e BYTE_ORDER MSB_LAST /end MEASUREMENT
/begin MEASUREMENT seg_nr_egy_mes "actual segment number of energy measurement" UBYTE _CNV_A_R_LINEAR_____0_CM 1 0. 0. 15. DISPLAY_IDENTIFIER SEG_NR_EGY_MES ECU_ADDRESS 0x7fbaf5 FORMAT "%2.0" /end MEASUREMENT
/begin COMPU_METHOD _CNV_A_R_LINEAR_____0_CM "" RAT_FUNC "%6.3" "[-]" COEFFS 0 1. 0. 0 0 1 /end COMPU_METHOD
/begin COMPU_METHOD _CNV_A_R_LINEAR_____1_CM "" RAT_FUNC "%6.3" "-" COEFFS 0 1. 0. 0 0 1 /end COMPU_METHOD
/begin COMPU_METHOD _CNV_A_R_LINEAR_____5_CM "" RAT_FUNC "%6.3" "[rpm]" COEFFS 0 1. 0. 0 0 1 /end COMPU_METHOD
/begin COMPU_METHOD _CNV_A_R_LINEAR_____7_CM "" RAT_FUNC "%6.3" "[cm^2]" COEFFS 0 839.3314549180328 0. 0 0 1 /end COMPU_METHOD
/begin COMPU_METHOD _CNV_A_R_LINEAR_____8_CM "" RAT_FUNC "%6.3" "[%]" COEFFS 0 655.3599999999997 0. 0 0 1 /end COMPU_METHOD
/begin COMPU_METHOD _CNV_A_R_LINEAR_____12_CM "" RAT_FUNC "%6.3" "[%]" COEFFS 0 327.6800000003072 3.071909304708242e-008 0 0 1 /end COMPU_METHOD
/begin COMPU_METHOD _CNV_A_R_LINEAR_____14_CM "" RAT_FUNC "%6.3" "[-]" COEFFS 0 65535.99999999996 0. 0 0 1 /end COMPU_METHOD
/begin COMPU_METHOD _CNV_A_R_LINEAR_____15_CM "" RAT_FUNC "%6.3" "[-]" COEFFS 0 16384. 0. 0 0 1 /end COMPU_METHOD
/begin COMPU_METHOD _CNV_A_R_LINEAR_____18_CM "" RAT_FUNC "%6.3" "[°C]" COEFFS 0 1. 50. 0 0 1 /end COMPU_METHOD
/begin COMPU_METHOD _CNV_A_R_LINEAR_____19_CM "" RAT_FUNC "%6.3" "[s]" COEFFS 0 10. 0. 0 0 1 /end COMPU_METHOD
/begin COMPU_METHOD _CNV_A_R_LINEAR_____20_CM "" RAT_FUNC "%6.3" "[°C]" COEFFS 0 1. 0. 0 0 1 /end COMPU_METHOD
/begin COMPU_METHOD _CNV_A_R_LINEAR_____24_CM "" RAT_FUNC "%6.3" "[-]" COEFFS 0 128. 0. 0 0 1 /end COMPU_METHOD
/begin COMPU_METHOD _CNV_A_R_LINEAR_____33_CM "" RAT_FUNC "%6.3" "[V]" COEFFS 0 204.8 0. 0 0 1 /end COMPU_METHOD
/begin COMPU_METHOD _CNV_A_R_LINEAR_____35_CM "" RAT_FUNC "%6.3" "[1/min]" COEFFS 0 3.125e-002 0. 0 0 1 /end COMPU_METHOD
/begin COMPU_METHOD _CNV_A_R_LINEAR_____48_CM "" RAT_FUNC "%6.3" "[V]" COEFFS 0 8.854166666666666 0. 0 0 1 /end COMPU_METHOD
/begin COMPU_METHOD _CNV_A_R_LINEAR_____53_CM "" RAT_FUNC "%6.3" "[-]" COEFFS 0 32767.99807357072 0. 0 0 1 /end COMPU_METHOD
/begin COMPU_METHOD _CNV_A_R_LINEAR_____58_CM "" RAT_FUNC "%6.3" "[rpm]" COEFFS 0 3.125e-002 0. 0 0 1 /end COMPU_METHOD
/begin COMPU_METHOD _CNV_A_R_LINEAR_____62_CM "" RAT_FUNC "%6.3" "[Nm]" COEFFS 0 32. 0. 0 0 1 /end COMPU_METHOD
/begin COMPU_METHOD _CNV_A_R_LINEAR_____63_CM "" RAT_FUNC "%6.3" "[-]" COEFFS 0 16383.81262712377 0. 0 0 1 /end COMPU_METHOD
/begin COMPU_METHOD _CNV_P_8_TABLE_______71_CM "" TAB_NOINTP "%6.3" "[-]" COMPU_TAB_REF _CNV_P_8_TABLE_______71 /end COMPU_METHOD
/begin COMPU_TAB _CNV_P_8_TABLE_______71 "" TAB_NOINTP 8 0 0. 1 1. 2 2. 3 3. 4 4. 5 5. 6 6. 15 15. /end COMPU_TAB
/begin COMPU_METHOD _CNV_A_R_LINEAR_____73_CM "" RAT_FUNC "%6.3" "[(km/h)/rpm]" COEFFS 0 655350. 0. 0 0 1 /end COMPU_METHOD
/begin COMPU_METHOD _CNV_A_R_LINEAR_____76_CM "" RAT_FUNC "%6.3" "[s]" COEFFS 0 1000. 0. 0 0 1 /end COMPU_METHOD
/begin COMPU_METHOD _CNV_A_R_LINEAR_____83_CM "" RAT_FUNC "%6.3" "[Nm]" COEFFS 0 31.99984374837874 32767.83999833983 0 0 1 /end COMPU_METHOD
/begin COMPU_METHOD _CNV_A_R_LINEAR_____84_CM "" RAT_FUNC "%6.3" "rpm" COEFFS 0 3.125e-002 0. 0 0 1 /end COMPU_METHOD
/begin COMPU_METHOD _CNV_A_R_LINEAR_____120_CM "" RAT_FUNC "%6.3" "[°CRK]" COEFFS 0 42.66666666666666 5120. 0 0 1 /end COMPU_METHOD
/begin COMPU_METHOD _CNV_A_R_LINEAR_____121_CM "" RAT_FUNC "%6.3" "[°CRK]" COEFFS 0 42.66666666666666 0. 0 0 1 /end COMPU_METHOD
/begin COMPU_METHOD _CNV_A_R_LINEAR_____122_CM "" RAT_FUNC "%6.3" "[uF]" COEFFS 0 7.976539589442815 0. 0 0 1 /end COMPU_METHOD
/begin COMPU_METHOD _CNV_A_R_LINEAR_____123_CM "" RAT_FUNC "%6.3" "[V]" COEFFS 0 4.011764705882353 0. 0 0 1 /end COMPU_METHOD
/begin COMPU_METHOD _CNV_A_R_LINEAR_____155_CM "" RAT_FUNC "%6.3" "[%]" COEFFS 0 327.68 0. 0 0 1 /end COMPU_METHOD
/begin COMPU_METHOD _CNV_A_R_LINEAR_____159_CM "" RAT_FUNC "%6.3" "[-]" COEFFS 0 1000. 0. 0 0 1 /end COMPU_METHOD
/begin COMPU_METHOD _CNV_A_R_LINEAR_____208_CM "" RAT_FUNC "%6.3" "[ms]" COEFFS 0 999.9999999999999 0. 0 0 1 /end COMPU_METHOD
/begin COMPU_METHOD _CNV_A_R_LINEAR_____220_CM "" RAT_FUNC "%6.3" "[ms]" COEFFS 0 100. 0. 0 0 1 /end COMPU_METHOD
/begin COMPU_METHOD _CNV_A_R_LINEAR_____234_CM "" RAT_FUNC "%6.3" "s" COEFFS 0 10. 0. 0 0 1 /end COMPU_METHOD
/begin COMPU_METHOD _CNV_A_R_LINEAR_____235_CM "" RAT_FUNC "%6.3" "[\260C]" COEFFS 0 1.333333333333333 64. 0 0 1 /end COMPU_METHOD
/begin COMPU_METHOD _CNV_A_R_LINEAR_____249_CM "" RAT_FUNC "%6.3" "ml/s" COEFFS 0 4000. 0. 0 0 1 /end COMPU_METHOD
/begin COMPU_METHOD _CNV_A_R_LINEAR_____257_CM "" RAT_FUNC "%6.3" "rpm" COEFFS 0 1. 0. 0 0 1 /end COMPU_METHOD
/begin COMPU_METHOD _CNV_A_R_LINEAR_____261_CM "" RAT_FUNC "%6.3" "[%]" COEFFS 0 10.24024024024024 0. 0 0 1 /end COMPU_METHOD
/begin COMPU_METHOD _CNV_A_R_LINEAR_____295_CM "" RAT_FUNC "%6.3" "°C" COEFFS 0 1. 60. 0 0 1 /end COMPU_METHOD
/begin COMPU_METHOD _CNV_A_R_LINEAR_____300_CM "" RAT_FUNC "%6.3" "-" COEFFS 0 65535.99999999996 0. 0 0 1 /end COMPU_METHOD
/begin COMPU_METHOD _CNV_A_R_LINEAR_____405_CM "" RAT_FUNC "%6.3" "[-]" COEFFS 0 16383.99985599781 -2.880043903132901e-004 0 0 1 /end COMPU_METHOD
/begin COMPU_METHOD _CNV_S_6_STATE_C_MA_531_CM "" TAB_VERB "%6.3" "[-]" COMPU_TAB_REF _CNV_S_6_STATE_C_MA_531 /end COMPU_METHOD
/begin COMPU_VTAB _CNV_S_6_STATE_C_MA_531 "" TAB_VERB 6 1 "VW" 2 "Lamborghini" 3 "Audi" 4 "Bentley" 5 "Seat" 6 "Skoda" /end COMPU_VTAB
/begin COMPU_METHOD _CNV_A_R_LINEAR_____532_CM "" RAT_FUNC "%6.3" "[V]" COEFFS 0 257. 0. 0 0 1 /end COMPU_METHOD
/begin COMPU_METHOD _CNV_A_R_LINEAR_____533_CM "" RAT_FUNC "%6.3" "[ms]" COEFFS 0 1000. 0. 0 0 1 /end COMPU_METHOD
/begin COMPU_METHOD _CNV_A_R_LINEAR_____534_CM "" RAT_FUNC "%6.3" "[mJ]" COEFFS 0 125.3598432925406 0. 0 0 1 /end COMPU_METHOD
/begin COMPU_METHOD _CNV_A_R_LINEAR_____536_CM "" RAT_FUNC "%6.3" "[%/mJ]" COEFFS 0 327.6800000003072 3.071909304708242e-008 0 0 1 /end COMPU_METHOD
/begin COMPU_METHOD _CNV_A_R_LINEAR_____537_CM "" RAT_FUNC "%6.3" "[%]" COEFFS 0 655.3600015872485 0. 0 0 1 /end COMPU_METHOD
/begin COMPU_METHOD _CNV_A_R_LINEAR_____538_CM "" RAT_FUNC "%6.3" "[%]" COEFFS 0 655.36 0. 0 0 1 /end COMPU_METHOD
/begin COMPU_METHOD _CNV_A_R_LINEAR_____539_CM "" RAT_FUNC "%6.3" "[-]" COEFFS 0 655.3600000071681 3.584063961170614e-007 0 0 1 /end COMPU_METHOD
/begin COMPU_METHOD _CNV_A_R_LINEAR_____540_CM "" RAT_FUNC "%6.3" "[ms]" COEFFS 0 10. 0. 0 0 1 /end COMPU_METHOD
/begin COMPU_METHOD _CNV_A_R_LINEAR_____541_CM "" RAT_FUNC "%6.3" "[ms]" COEFFS 0 1000. 32768. 0 0 1 /end COMPU_METHOD
/begin COMPU_METHOD _CNV_A_R_LINEAR_____543_CM "" RAT_FUNC "%6.3" "[mJ/V]" COEFFS 0 327.6800000003072 3.071909304708242e-008 0 0 1 /end COMPU_METHOD
/begin COMPU_METHOD _CNV_A_R_LINEAR_____544_CM "" RAT_FUNC "%6.3" "[mJ]" COEFFS 0 125.3579304719055 0. 0 0 1 /end COMPU_METHOD
/begin COMPU_METHOD _CNV_A_R_LINEAR_____545_CM "" RAT_FUNC "%6.3" "[mJ]" COEFFS 0 125.3617562090945 0. 0 0 1 /end COMPU_METHOD
/begin COMPU_METHOD _CNV_A_R_LINEAR_____546_CM "" RAT_FUNC "%6.3" "[mJ]" COEFFS 0 125.3598433405 32767.5 0 0 1 /end COMPU_METHOD
/begin COMPU_METHOD _CNV_A_R_LINEAR_____547_CM "" RAT_FUNC "%6.3" "[-]" COEFFS 0 32.76800003968061 3.96806062781252e-005 0 0 1 /end COMPU_METHOD
/begin COMPU_METHOD _CNV_A_R_LINEAR_____548_CM "" RAT_FUNC "%6.3" "[mJ/ms]" COEFFS 0 32.76800003968061 3.96806062781252e-005 0 0 1 /end COMPU_METHOD
/begin COMPU_METHOD _CNV_A_R_LINEAR_____549_CM "" RAT_FUNC "%6.3" "[V]" COEFFS 0 4.00587084148728 1.502935420743597 0 0 1 /end COMPU_METHOD
/begin COMPU_METHOD _CNV_A_R_LINEAR_____550_CM "" RAT_FUNC "%6.3" "[-]" COEFFS 0 4.011764705882353 0. 0 0 1 /end COMPU_METHOD
/begin COMPU_METHOD _CNV_A_R_LINEAR_____551_CM "" RAT_FUNC "%6.3" "[ms]" COEFFS 0 99999.99999999999 -3.637978807091713e-012 0 0 1 /end COMPU_METHOD
/begin COMPU_METHOD _CNV_A_R_LINEAR_____552_CM "" RAT_FUNC "%6.3" "[ms]" COEFFS 0 100000. 0. 0 0 1 /end COMPU_METHOD
/begin RECORD_LAYOUT _REC_VAL_20_u1 FNC_VALUES 1 UBYTE COLUMN_DIR DIRECT /end RECORD_LAYOUT
/begin RECORD_LAYOUT _REC_AXS_20_u2 NO_AXIS_PTS_X 1 UWORD AXIS_PTS_X 2 UWORD INDEX_INCR DIRECT /end RECORD_LAYOUT
/begin RECORD_LAYOUT _REC_MAP_20_u1_u2_u2 FNC_VALUES 1 UBYTE COLUMN_DIR DIRECT /end RECORD_LAYOUT
/begin RECORD_LAYOUT _REC_MAP_20_u2_u2_u2 FNC_VALUES 1 UWORD COLUMN_DIR DIRECT /end RECORD_LAYOUT
/begin RECORD_LAYOUT _REC_VAL_20_u2 FNC_VALUES 1 UWORD COLUMN_DIR DIRECT /end RECORD_LAYOUT
/begin RECORD_LAYOUT _REC_VAL_20_s2 FNC_VALUES 1 SWORD COLUMN_DIR DIRECT /end RECORD_LAYOUT
/begin RECORD_LAYOUT _REC_AXS_20_u1 NO_AXIS_PTS_X 1 UBYTE AXIS_PTS_X 2 UBYTE INDEX_INCR DIRECT /end RECORD_LAYOUT
/begin RECORD_LAYOUT _REC_MAP_20_u1_u1_u2 FNC_VALUES 1 UBYTE COLUMN_DIR DIRECT /end RECORD_LAYOUT
/begin RECORD_LAYOUT _REC_CUR_20_u2_u2 FNC_VALUES 1 UWORD COLUMN_DIR DIRECT /end RECORD_LAYOUT
/begin RECORD_LAYOUT _REC_CUR_20_u2_u1 FNC_VALUES 1 UWORD COLUMN_DIR DIRECT /end RECORD_LAYOUT
/begin RECORD_LAYOUT _REC_MAP_20_u2_u1_u1 FNC_VALUES 1 UWORD COLUMN_DIR DIRECT /end RECORD_LAYOUT
/begin RECORD_LAYOUT _REC_CUR_20_u1_u1 FNC_VALUES 1 UBYTE COLUMN_DIR DIRECT /end RECORD_LAYOUT
/begin RECORD_LAYOUT _REC_MAP_20_u1_u2_u1 FNC_VALUES 1 UBYTE COLUMN_DIR DIRECT /end RECORD_LAYOUT
/begin FUNCTION __DDS_EXPA2_DEFAULT_FUNC__ "__DDS_EXPA2_DEFAULT_FUNC__"
 /begin DEF_CHARACTERISTIC ldpm_clas_a_id_clas_fmy ldp_clas_b_id_clas_fmy ldp_1_id_err_dtc_mis ldp_2_id_err_dtc_mis lc_test_hbr[0] lc_test_hbr[1] lc_dir_chg_hbr[0] lc_dir_chg_hbr[1] c_test_hbr[0] c_test_hbr[1] c_crlc_cor_hbr[0] c_crlc_cor_hbr[1] lc_err_det_upd lc_clr_err_intm ldp_v_tfu_ip_tfu_mes ldp_dri_id_fac_pl_is ldp_tco_ip_fac_fil_pl_is ldp_tco_ip_fac_fil_st_is ldp_vs_n_id_dri ldpm_dri_aj ldpm_vb_fil_ip_n_inh ldp_quo_mfw_ip_fac_temp_egr ip_tco_warn ldp_tco_ip_tco_warn ldp_fco_t_ip_tco_warn c_tqi_sp_max_toil_mdl c_tqi_sp_min_toil_mdl c_n_max_toil_mdl c_n_min_toil_mdl ip_toil_mdl ldp_tqi_sp c_fac_toil_mdl c_toil_mdl_sub ldpm_n_32__drv2_er ldp_n_32_n_grd_thd ldpm_gear ldp_v_maf_id_maf_x ldp_v_maf_id_maf_y ldp_tco_2_inj_x ldp_tco_3_inj_x ip_fac_mf_prev2_cor_tco_rgn_1 ldp_t_ad_bpa_tol__ip_ad_bpa ldp_t_ad_bpa_bol__ip_ad_bpa ldp_t_ad_egrv_tol__ip_ad_egrv ldp_t_ad_egrv_bol__ip_ad_egrv ldp_n_ip_egrvpwm ldp_mafpwm_ip_egrvpwm ldp_ar_egrv_ip_egrvpwm c_can_imob_data_req_max c_imob4_max_req_time lc_ena_dwnld c_marken_id c_p_klasse lc_ena_retrain_ecu lc_ena_retrain_ims c_mon_startstop c_mon_sel c_num_stk_ast c_t_eoi_burst_dly_max c_t_eoi_burst_dly_min c_t_soi_burst_dly_max c_t_soi_burst_dly_min c_nr_test_pls_cyc_hld c_nr_test_pls_cyc_hld_st c_nr_seg_test_pls_wait c_nr_seg_test_pls_wait_st c_n_test_pls_max c_nr_seg_test_pls_gap c_nr_seg_test_pls_gap_st c_t_ast_test_pls c_t_cha_test_pls c_t_dcha_test_pls lc_test_pls_on ip_t_eoi_burst_dly__n ldpm_n_ip_t_burst_dly ip_t_soi_burst_dly__n c_num_fil_value_stk_ma[0] c_num_fil_value_stk_ma[1] c_num_fil_value_stk_ma[2] c_num_fil_value_stk_ma[3] c_dnom_fil_value_stk_ma[0] c_dnom_fil_value_stk_ma[1] c_dnom_fil_value_stk_ma[2] c_dnom_fil_value_stk_ma[3] c_fac_pwm_dcha_man c_fac_t_per_t_hld_frze c_fac_t_per_t_hld_toze c_step_nr_cha_frze_main1_man c_step_nr_cha_frze_post1_man c_step_nr_cha_frze_prev1_man c_step_nr_dcha_main1_man c_step_nr_dcha_post1_man c_step_nr_dcha_prev1_man c_stk_ma_fil_ini c_t_hld_frze_main1_stk_man c_t_hld_frze_post1_stk_man c_t_hld_frze_prev1_stk_man c_t_hld_toze_main1_stk_man c_t_hld_toze_post1_stk_man c_t_hld_toze_prev1_stk_man lc_tun_stk_ctl_man ip_fac_t_iv_opg_min_cor__tfu ldp_tfu_ip_fac_t_iv_opg_min_cor ip_fac_step_nr_cha_frze__n__tfu ldp_n_ip_fac_step_nr_cha_frze ldp_tfu_ip_fac_step_nr_cha_frze ip_t_iv_opg_min__n__soi ldp_n_ip_t_iv_opg_min ldp_soi_ip_t_iv_opg_min c_n_stk_ctl_act_max ip_fac_t_iv_opg_min_cor__n ldp_n_ip_fac_t_iv_opg_min_cor c_pv_av_stk_ctl_act_max c_egy_inj_sp_man_[0] c_egy_inj_sp_man_[1] c_egy_inj_sp_man_[2] c_egy_inj_sp_man_[3] c_egy_inj_sp_max c_egy_inj_sp_min c_fac_pwm_dcha_pwm_cha c_kr_pi_egy_ctl c_lim_pi_egy_ctl_max c_lim_pi_egy_ctl_min c_lim_pwm_cha_err_ctl_max c_lim_pwm_cha_err_ctl_min c_pwm_cha_ini_[0] c_pwm_cha_ini_[1] c_pwm_cha_ini_[2] c_pwm_cha_ini_[3] c_pwm_cha_max c_pwm_cha_min c_pwm_dcha_man_[0] c_pwm_dcha_man_[1] c_pwm_dcha_man_[2] c_pwm_dcha_man_[3] c_pwm_dcha_max c_pwm_dcha_min c_pwm_dcha_ofs lc_dcha_ctl_on lc_egy_ctl_on lc_egy_inj_sp_man id_fac_egy_inj_sp_cor__t_cha ldp_t_cha_id_fac_egy_inj_sp_cor ip_pwm_cha_pctl__egy ldp_egy_ip_pwm_cha_pctl ip_tn_pi_neg_egy_ctl__n ldpm_n_ip_tn_pi_egy_ctl ip_tn_pi_pos_egy_ctl__n ip_t_eoi_ofs_ctl__pwm ldp_pwm_ip_t_eoi_ofs_ctl c_dnom_fil_value_v_delta_mmv[0] c_dnom_fil_value_v_delta_mmv[1] c_dnom_fil_value_v_delta_mmv[2] c_dnom_fil_value_v_delta_mmv[3] c_dnom_fil_value_v_delta_mmv[4] c_dnom_fil_value_v_delta_mmv[5] c_dnom_fil_value_v_delta_mmv[6] c_dnom_fil_value_v_delta_mmv[7] c_dnom_fil_value_v_delta_mmv[8] c_dnom_fil_value_v_delta_mmv[9] c_kr_pi_iv_foc_ctl c_lim_egy_sp_err_iv_foc_ctl_max c_lim_egy_sp_err_iv_foc_ctl_min c_lim_pi_iv_foc_ctl_max c_lim_pi_iv_foc_ctl_min c_num_fil_value_v_delta_mmv[0] c_num_fil_value_v_delta_mmv[1] c_num_fil_value_v_delta_mmv[2] c_num_fil_value_v_delta_mmv[3] c_num_fil_value_v_delta_mmv[4] c_num_fil_value_v_delta_mmv[5] c_num_fil_value_v_delta_mmv[6] c_num_fil_value_v_delta_mmv[7] c_num_fil_value_v_delta_mmv[8] c_num_fil_value_v_delta_mmv[9] c_v_delta_max c_v_delta_min c_v_delta_mmv_fil_ini c_v_delta_mmv_inp_max_lim c_v_delta_mmv_inp_min_lim c_v_delta_mmv_out_max_lim c_v_delta_mmv_out_min_lim lc_iv_foc_ctl_on lc_v_delta_rel_iv_foc_ctl_on ip_egy_sp_ofs_foc_ctl__tco ldpm_tco_ip_egy_sp_foc_ctl ip_tn_pi_neg_iv_foc_ctl__n ldpm_n_ip_tn_pi_iv_foc_ctl ip_tn_pi_pos_iv_foc_ctl__n ip_egy_sp_foc_ctl__n__doi ldpm_n_ip_egy_sp_foc_ctl ldp_doi_ip_egy_sp_foc_ctl ip_egy_sp_foc_ctl__n__soi ldp_soi_ip_egy_sp_foc_ctl ip_fac_egy_sp_foc__tco__capa ldp_capa_ip_egy_sp_foc_ctl ip_v_delta_sp__n__doi ldpm_n_ip_v_delta_sp ldp_doi_ip_v_delta_sp ip_v_delta_sp__n__soi ldp_soi_ip_v_delta_sp ip_v_delta_sp__tco__capa ldp_tco_ip_v_delta_sp ldp_capa_ip_v_delta_sp c_dnom_fil_value_t_iv_close_mmv[0] c_dnom_fil_value_t_iv_close_mmv[1] c_dnom_fil_value_t_iv_close_mmv[2] c_dnom_fil_value_t_iv_close_mmv[3] c_dnom_fil_value_t_iv_close_mmv[4] c_dnom_fil_value_t_iv_close_mmv[5] c_dnom_fil_value_t_iv_close_mmv[6] c_dnom_fil_value_t_iv_close_mmv[7] c_dnom_fil_value_t_iv_close_mmv[8] c_dnom_fil_value_t_iv_close_mmv[9] c_kr_pi_soi_ctl c_kr_pi_t_iv_close_ctl c_lim_egy_sp_err_t_iv_ctl_max c_lim_egy_sp_err_t_iv_ctl_min c_lim_pi_t_iv_close_ctl_max c_lim_pi_t_iv_close_ctl_min c_lim_t_pi_soi_ctl_max c_lim_t_pi_soi_ctl_min c_lim_t_soi_ofs_soi_ctl_max c_lim_t_soi_ofs_soi_ctl_min c_num_fil_value_t_iv_close_mmv[0] c_num_fil_value_t_iv_close_mmv[1] c_num_fil_value_t_iv_close_mmv[2] c_num_fil_value_t_iv_close_mmv[3] c_num_fil_value_t_iv_close_mmv[4] c_num_fil_value_t_iv_close_mmv[5] c_num_fil_value_t_iv_close_mmv[6] c_num_fil_value_t_iv_close_mmv[7] c_num_fil_value_t_iv_close_mmv[8] c_num_fil_value_t_iv_close_mmv[9] c_t_iv_close_max c_t_iv_close_min c_t_iv_close_mmv_fil_ini c_t_iv_close_mmv_inp_max_lim c_t_iv_close_mmv_inp_min_lim c_t_iv_close_mmv_out_max_lim c_t_iv_close_mmv_out_min_lim lc_iv_foc_iv_close_ctl_sel lc_soi_ctl_on lc_t_iv_close_ctl_on ip_egy_sp_ofs_t_ctl__tco ldpm_tco_ip_egy_sp_close_ctl ip_tn_pi_neg_soi_ctl__n ldpm_n_ip_tn_pi_iv_close_ctl ip_tn_pi_neg_t_iv_close_ctl__n ip_tn_pi_pos_soi_ctl__n ip_tn_pi_pos_t_iv_close_ctl__n ip_egy_sp_t_close_ctl__n__doi ldpm_n_ip_egy_sp_close_ctl ldp_doi_ip_egy_sp_close_ctl ip_egy_sp_t_close_ctl__n__soi ldp_soi_ip_egy_sp_close_ctl ip_fac_egy_sp_t_ctl__tco__capa ldp_capa_ip_egy_sp_close_ctl ip_t_iv_close_sp__n__doi ldpm_n_ip_t_iv_close_sp ldp_doi_ip_t_iv_close_sp ip_t_iv_close_sp__n__soi ldp_soi_ip_t_iv_close_sp ip_t_iv_close_sp__tco__capa ldp_tco_ip_t_iv_close_sp ldp_capa_ip_t_iv_close_sp lc_t_iv_close_sel c_acq_intp_fil_ini c_num_fil_value_egy_det_ma[0] c_num_fil_value_egy_det_ma[1] c_num_fil_value_egy_det_ma[2] c_num_fil_value_egy_det_ma[3] c_num_fil_value_egy_det_ma[4] c_num_fil_value_egy_det_ma[5] c_num_fil_value_egy_det_ma[6] c_num_fil_value_egy_det_ma[7] c_num_fil_value_egy_det_ma[8] c_num_fil_value_egy_det_ma[9] c_dnom_fil_value_egy_det_ma[0] c_dnom_fil_value_egy_det_ma[1] c_dnom_fil_value_egy_det_ma[2] c_dnom_fil_value_egy_det_ma[3] c_dnom_fil_value_egy_det_ma[4] c_dnom_fil_value_egy_det_ma[5] c_dnom_fil_value_egy_det_ma[6] c_dnom_fil_value_egy_det_ma[7] c_dnom_fil_value_egy_det_ma[8] c_dnom_fil_value_egy_det_ma[9] c_dnom_fil_value_acq_intp[0] c_dnom_fil_value_acq_intp[1] c_dnom_fil_value_acq_intp[2] c_dnom_fil_value_acq_intp[3] c_dnom_fil_value_acq_intp[4] c_dnom_fil_value_acq_intp[5] c_dnom_fil_value_acq_intp[6] c_dnom_fil_value_acq_intp[7] c_dnom_fil_value_acq_intp[8] c_egy_det_ma_fil_ini c_num_fil_value_acq_intp[0] c_num_fil_value_acq_intp[1] c_num_fil_value_acq_intp[2] c_num_fil_value_acq_intp[3] c_num_fil_value_acq_intp[4] c_num_fil_value_acq_intp[5] c_num_fil_value_acq_intp[6] c_num_fil_value_acq_intp[7] c_num_fil_value_acq_intp[8] c_sample_nr_det_beg c_sample_nr_det_dly c_sample_nr_det_end c_sample_nr_det_lst c_t_egy_inj_det_dly c_t_sample_burst c_v_inj_burst_dif_min lc_v_inj_burst_dif_sel lc_v_inj_burst_fil_max lc_v_inj_burst_intp_on lc_v_inj_burst_lnr_on c_t_iv_close_fail_replace c_cnt_t_iv_close_statistics_max c_cnt_t_iv_close_statistics_repl_max c_t_iv_close_statistics_min_lim c_t_iv_close_statistics_max_lim /end DEF_CHARACTERISTIC
 /begin OUT_MEASUREMENT v_inj_burst_act_[73] v_inj_burst_act_[74] v_inj_burst_act_[75] v_inj_burst_act_[76] v_inj_burst_act_[77] v_inj_burst_act_[78] v_inj_burst_act_[79] v_inj_burst_act_[80] v_inj_burst_act_[81] v_inj_burst_act_[82] v_inj_burst_act_[83] v_inj_burst_act_[84] v_inj_burst_act_[85] v_inj_burst_act_[86] v_inj_burst_act_[87] v_inj_burst_dif1_[0] v_inj_burst_dif1_[1] v_inj_burst_dif1_[2] v_inj_burst_dif1_[3] v_inj_burst_dif2_[0] v_inj_burst_dif2_[1] v_inj_burst_dif2_[2] v_inj_burst_dif2_[3] v_inj_burst_exp_[0] v_inj_burst_exp_[1] v_inj_burst_exp_[2] v_inj_burst_exp_[3] v_inj_burst_exp_[4] v_inj_burst_exp_[5] v_inj_burst_exp_[6] v_inj_burst_exp_[7] v_inj_burst_exp_[8] v_inj_burst_exp_[9] v_inj_burst_exp_[10] v_inj_burst_exp_[11] v_inj_burst_exp_[12] v_inj_burst_exp_[13] v_inj_burst_exp_[14] v_inj_burst_exp_[15] v_inj_burst_exp_[16] v_inj_burst_exp_[17] v_inj_burst_exp_[18] v_inj_burst_exp_[19] v_inj_burst_exp_[20] v_inj_burst_exp_[21] v_inj_burst_exp_[22] v_inj_burst_exp_[23] v_inj_burst_exp_[24] v_inj_burst_exp_[25] v_inj_burst_exp_[26] v_inj_burst_exp_[27] v_inj_burst_exp_[28] v_inj_burst_exp_[29] v_inj_burst_exp_[30] v_inj_burst_exp_[31] v_inj_burst_exp_[32] v_inj_burst_exp_[33] v_inj_burst_exp_[34] v_inj_burst_exp_[35] v_inj_burst_exp_[36] v_inj_burst_exp_[37] v_inj_burst_exp_[38] v_inj_burst_exp_[39] v_inj_burst_exp_[40] v_inj_burst_exp_[41] v_inj_burst_exp_[42] v_inj_burst_exp_[43] v_inj_burst_exp_[44] v_inj_burst_exp_[45] v_inj_burst_exp_[46] v_inj_burst_exp_[47] v_inj_burst_exp_[48] v_inj_burst_exp_[49] v_inj_burst_exp_[50] v_inj_burst_exp_[51] v_inj_burst_exp_[52] v_inj_burst_exp_[53] v_inj_burst_exp_[54] v_inj_burst_exp_[55] v_inj_burst_exp_[56] v_inj_burst_exp_[57] v_inj_burst_exp_[58] v_inj_burst_exp_[59] v_inj_burst_exp_[60] v_inj_burst_exp_[61] v_inj_burst_exp_[62] v_inj_burst_exp_[63] v_inj_burst_exp_[64] v_inj_burst_exp_[65] v_inj_burst_exp_[66] v_inj_burst_exp_[67] v_inj_burst_exp_[68] v_inj_burst_exp_[69] v_inj_burst_exp_[70] v_inj_burst_exp_[71] v_inj_burst_exp_[72] v_inj_burst_exp_[73] v_inj_burst_exp_[74] v_inj_burst_exp_[75] v_inj_burst_exp_[76] v_inj_burst_exp_[77] v_inj_burst_exp_[78] v_inj_burst_exp_[79] v_inj_burst_exp_[80] v_inj_burst_exp_[81] v_inj_burst_exp_[82] v_inj_burst_exp_[83] v_inj_burst_exp_[84] v_inj_burst_exp_[85] v_inj_burst_exp_[86] v_inj_burst_exp_[87] v_inj_burst_fil_max_[0] v_inj_burst_fil_max_[1] v_inj_burst_fil_max_[2] v_inj_burst_fil_max_[3] v_inj_burst_fil_max_[4] v_inj_burst_fil_max_[5] v_inj_burst_intp_[0] v_inj_burst_intp_[1] v_inj_burst_intp_[2] v_inj_burst_intp_[3] v_inj_burst_intp_[4] v_inj_burst_intp_[5] v_inj_burst_intp_[6] v_inj_burst_intp_[7] v_inj_burst_intp_[8] v_inj_burst_intp_[9] v_inj_burst_intp_[10] v_inj_burst_intp_[11] v_inj_burst_intp_[12] v_inj_burst_intp_[13] v_inj_burst_intp_[14] v_inj_burst_intp_[15] v_inj_burst_intp_[16] v_inj_burst_intp_[17] v_inj_burst_intp_[18] v_inj_burst_intp_[19] v_inj_burst_intp_[20] v_inj_burst_intp_[21] v_inj_burst_intp_[22] v_inj_burst_intp_[23] v_inj_burst_intp_[24] v_inj_burst_intp_[25] v_inj_burst_intp_[26] v_inj_burst_intp_[27] v_inj_burst_intp_[28] v_inj_burst_intp_[29] v_inj_burst_intp_[30] v_inj_burst_intp_[31] v_inj_burst_intp_[32] v_inj_burst_intp_[33] v_inj_burst_intp_[34] v_inj_burst_intp_[35] v_inj_burst_intp_[36] v_inj_burst_intp_[37] v_inj_burst_intp_[38] v_inj_burst_intp_[39] v_inj_burst_intp_[40] v_inj_burst_intp_[41] v_inj_burst_intp_[42] v_inj_burst_intp_[43] v_inj_burst_intp_[44] v_inj_burst_intp_[45] v_inj_burst_intp_[46] v_inj_burst_intp_[47] v_inj_burst_intp_[48] v_inj_burst_intp_[49] v_inj_burst_intp_[50] v_inj_burst_intp_[51] v_inj_burst_intp_[52] v_inj_burst_intp_[53] v_inj_burst_intp_[54] v_inj_burst_intp_[55] v_inj_burst_intp_[56] v_inj_burst_intp_[57] v_inj_burst_intp_[58] v_inj_burst_intp_[59] v_inj_burst_intp_[60] v_inj_burst_intp_[61] v_inj_burst_intp_[62] v_inj_burst_intp_[63] v_inj_burst_intp_[64] v_inj_burst_intp_[65] v_inj_burst_intp_[66] v_inj_burst_intp_[67] v_inj_burst_intp_[68] v_inj_burst_intp_[69] v_inj_burst_intp_[70] v_inj_burst_intp_[71] v_inj_burst_intp_[72] v_inj_burst_intp_[73] v_inj_burst_intp_[74] v_inj_burst_intp_[75] v_inj_burst_intp_[76] v_inj_burst_intp_[77] v_inj_burst_intp_[78] v_inj_burst_intp_[79] v_inj_burst_intp_[80] v_inj_burst_intp_[81] v_inj_burst_intp_[82] v_inj_burst_intp_[83] v_inj_burst_intp_[84] v_inj_burst_intp_[85] v_inj_burst_intp_[86] v_inj_burst_intp_[87] v_iv_foc_[0] v_iv_foc_[1] v_iv_foc_[2] v_iv_foc_[3] cnt_t_iv_close_statistics_succ_[0] cnt_t_iv_close_statistics_succ_[1] cnt_t_iv_close_statistics_succ_[2] cnt_t_iv_close_statistics_succ_[3] cnt_t_iv_close_statistics_fail_cont_[0] cnt_t_iv_close_statistics_fail_cont_[1] cnt_t_iv_close_statistics_fail_cont_[2] cnt_t_iv_close_statistics_fail_cont_[3] cnt_t_iv_close_statistics_fail_[0] cnt_t_iv_close_statistics_fail_[1] cnt_t_iv_close_statistics_fail_[2] cnt_t_iv_close_statistics_fail_[3] cnt_t_iv_close_statistics_0[0] cnt_t_iv_close_statistics_0[1] cnt_t_iv_close_statistics_0[2] cnt_t_iv_close_statistics_0[3] cnt_t_iv_close_statistics_0[4] cnt_t_iv_close_statistics_0[5] cnt_t_iv_close_statistics_0[6] cnt_t_iv_close_statistics_0[7] cnt_t_iv_close_statistics_0[8] cnt_t_iv_close_statistics_0[9] cnt_t_iv_close_statistics_0[10] cnt_t_iv_close_statistics_0[11] cnt_t_iv_close_statistics_0[12] cnt_t_iv_close_statistics_1[0] cnt_t_iv_close_statistics_1[1] cnt_t_iv_close_statistics_1[2] cnt_t_iv_close_statistics_1[3] cnt_t_iv_close_statistics_1[4] cnt_t_iv_close_statistics_1[5] cnt_t_iv_close_statistics_1[6] cnt_t_iv_close_statistics_1[7] cnt_t_iv_close_statistics_1[8] cnt_t_iv_close_statistics_1[9] cnt_t_iv_close_statistics_1[10] cnt_t_iv_close_statistics_1[11] cnt_t_iv_close_statistics_1[12] cnt_t_iv_close_statistics_2[0] cnt_t_iv_close_statistics_2[1] cnt_t_iv_close_statistics_2[2] cnt_t_iv_close_statistics_2[3] cnt_t_iv_close_statistics_2[4] cnt_t_iv_close_statistics_2[5] cnt_t_iv_close_statistics_2[6] cnt_t_iv_close_statistics_2[7] cnt_t_iv_close_statistics_2[8] cnt_t_iv_close_statistics_2[9] cnt_t_iv_close_statistics_2[10] cnt_t_iv_close_statistics_2[11] cnt_t_iv_close_statistics_2[12] cnt_t_iv_close_statistics_3[0] cnt_t_iv_close_statistics_3[1] cnt_t_iv_close_statistics_3[2] cnt_t_iv_close_statistics_3[3] cnt_t_iv_close_statistics_3[4] cnt_t_iv_close_statistics_3[5] cnt_t_iv_close_statistics_3[6] cnt_t_iv_close_statistics_3[7] cnt_t_iv_close_statistics_3[8] cnt_t_iv_close_statistics_3[9] cnt_t_iv_close_statistics_3[10] cnt_t_iv_close_statistics_3[11] cnt_t_iv_close_statistics_3[12] t_iv_close_last_[0] t_iv_close_last_[1] t_iv_close_last_[2] t_iv_close_last_[3] t_iv_close_stat_mean_[0] t_iv_close_stat_mean_[1] t_iv_close_stat_mean_[2] t_iv_close_stat_mean_[3] pct_t_iv_close_statistics_[0] pct_t_iv_close_statistics_[1] pct_t_iv_close_statistics_[2] pct_t_iv_close_statistics_[3] idx_max_t_iv_close_statistics_[0] idx_max_t_iv_close_statistics_[1] idx_max_t_iv_close_statistics_[2] idx_max_t_iv_close_statistics_[3] var_t_iv_close_statistics_[0] var_t_iv_close_statistics_[1] var_t_iv_close_statistics_[2] var_t_iv_close_statistics_[3] sf_mes_egy_inj_vld egy_inj_seq1_[0] egy_inj_seq1_[1] egy_inj_seq1_[2] egy_inj_seq1_[3] seg_nr_egy_mes /end OUT_MEASUREMENT
/end FUNCTION
/end MODULE
/end PROJECT
