ASAP2_VERSION 1 41
/begin PROJECT SN0 "SIMOS PPD"
/begin HEADER "_default_HeaderComment" PROJECT_NO PRJ_NUM /end HEADER
/begin MODULE _default_ModuleName "_default_ModuleLongIdentifier"
/begin MOD_COMMON "_default_ModCommonComment" DEPOSIT ABSOLUTE BYTE_ORDER MSB_FIRST ALIGNMENT_BYTE 1 ALIGNMENT_WORD 2 ALIGNMENT_LONG 4 ALIGNMENT_FLOAT32_IEEE 4 ALIGNMENT_FLOAT64_IEEE 8 /end MOD_COMMON
/begin CHARACTERISTIC c_abc_max_var_cod "" VALUE 0x85bcaa _REC_VAL_20_u1 255. _CNV_A_R_LINEAR_____0_CM 0. 255. DISPLAY_IDENTIFIER C_ABC_MAX_VAR_COD FORMAT "%3.0" /end CHARACTERISTIC
/begin CHARACTERISTIC c_abc_inc_egr_ctl_min "" VALUE 0x84820f _REC_VAL_20_u1 255. _CNV_A_R_LINEAR_____0_CM 0. 255. DISPLAY_IDENTIFIER C_ABC_INC_EGR_CTL_MIN FORMAT "%3.0" /end CHARACTERISTIC
/begin CHARACTERISTIC c_abc_max_egr_ctl_min "" VALUE 0x848291 _REC_VAL_20_u1 255. _CNV_A_R_LINEAR_____0_CM 0. 255. DISPLAY_IDENTIFIER C_ABC_MAX_EGR_CTL_MIN FORMAT "%3.0" /end CHARACTERISTIC
/begin CHARACTERISTIC c_abc_inc_egr_ctl_max "" VALUE 0x84820e _REC_VAL_20_u1 255. _CNV_A_R_LINEAR_____0_CM 0. 255. DISPLAY_IDENTIFIER C_ABC_INC_EGR_CTL_MAX FORMAT "%3.0" /end CHARACTERISTIC
/begin CHARACTERISTIC c_abc_max_egr_ctl_max "" VALUE 0x848290 _REC_VAL_20_u1 255. _CNV_A_R_LINEAR_____0_CM 0. 255. DISPLAY_IDENTIFIER C_ABC_MAX_EGR_CTL_MAX FORMAT "%3.0" /end CHARACTERISTIC
/begin CHARACTERISTIC c_egr_dif_min_diag "" VALUE 0x85bde0 _REC_VAL_20_s2 99.99694814999999 _CNV_A_R_LINEAR_____12_CM -100. -3.05185e-003 DISPLAY_IDENTIFIER C_EGR_DIF_MIN_DIAG /end CHARACTERISTIC
/begin CHARACTERISTIC c_egr_dif_max_diag "" VALUE 0x85bdde _REC_VAL_20_s2 99.996948242 _CNV_A_R_LINEAR_____50_CM 0. 99.996948242 DISPLAY_IDENTIFIER C_EGR_DIF_MAX_DIAG /end CHARACTERISTIC
/begin MEASUREMENT ctr_egr_ctl_min "" UBYTE _CNV_A_R_LINEAR_____0_CM 1 0. 0. 255. DISPLAY_IDENTIFIER CTR_EGR_CTL_MIN ECU_ADDRESS 0x7fb9f1 FORMAT "%3.0" /end MEASUREMENT
/begin MEASUREMENT ctr_egr_ctl_max "" UBYTE _CNV_A_R_LINEAR_____0_CM 1 0. 0. 255. DISPLAY_IDENTIFIER CTR_EGR_CTL_MAX ECU_ADDRESS 0x7fb9f2 FORMAT "%3.0" /end MEASUREMENT
/begin CHARACTERISTIC ip_ctr_max_egr_ctl_min__n "DIAG_EGR_CTL: maximum value of CTR_EGR_CTL_MIN" CURVE 0x84a442 _REC_CUR_20_u1_u2 255. _CNV_A_R_LINEAR_____0_CM 0. 255. DISPLAY_IDENTIFIER IP_CTR_MAX_EGR_CTL_MIN__N FORMAT "%3.0"
 /begin AXIS_DESCR COM_AXIS n _CNV_A_R_LINEAR_____5_CM 8 0. 6375. FORMAT "%4.0" AXIS_PTS_REF ldpm_n_ip_ctr_max_egr_ctl_diag /end AXIS_DESCR
/end CHARACTERISTIC
/begin CHARACTERISTIC ip_ctr_max_egr_ctl_max__n "DIAG_EGR_CTL: maximum value of CTR_EGR_CTL_MAX" CURVE 0x84a43a _REC_CUR_20_u1_u2 255. _CNV_A_R_LINEAR_____0_CM 0. 255. DISPLAY_IDENTIFIER IP_CTR_MAX_EGR_CTL_MAX__N FORMAT "%3.0"
 /begin AXIS_DESCR COM_AXIS n _CNV_A_R_LINEAR_____5_CM 8 0. 6375. FORMAT "%4.0" AXIS_PTS_REF ldpm_n_ip_ctr_max_egr_ctl_diag /end AXIS_DESCR
/end CHARACTERISTIC
/begin AXIS_PTS ldpm_n_ip_ctr_max_egr_ctl_diag "" 0x84398a n _REC_AXS_20_u2 6375. _CNV_A_R_LINEAR_____5_CM 8 0. 6375. FORMAT "%4.0" /end AXIS_PTS
/begin CHARACTERISTIC c_abc_inc_v_tpc_rng "" VALUE 0x848264 _REC_VAL_20_u1 255. _CNV_A_R_LINEAR_____0_CM 0. 255. DISPLAY_IDENTIFIER C_ABC_INC_V_TPC_RNG FORMAT "%3.0" /end CHARACTERISTIC
/begin CHARACTERISTIC c_abc_max_v_tpc_rng "" VALUE 0x8482e6 _REC_VAL_20_u1 255. _CNV_A_R_LINEAR_____0_CM 0. 255. DISPLAY_IDENTIFIER C_ABC_MAX_V_TPC_RNG FORMAT "%3.0" /end CHARACTERISTIC
/begin CHARACTERISTIC c_abc_inc_tpc_mes_plaus "" VALUE 0x84824f _REC_VAL_20_u1 255. _CNV_A_R_LINEAR_____0_CM 0. 255. DISPLAY_IDENTIFIER C_ABC_INC_TPC_MES_PLAUS FORMAT "%3.0" /end CHARACTERISTIC
/begin CHARACTERISTIC c_abc_max_tpc_mes_plaus "" VALUE 0x8482d1 _REC_VAL_20_u1 255. _CNV_A_R_LINEAR_____0_CM 0. 255. DISPLAY_IDENTIFIER C_ABC_MAX_TPC_MES_PLAUS FORMAT "%3.0" /end CHARACTERISTIC
/begin MEASUREMENT lv_err_tpc_mes "" UBYTE _CNV_S_2_RANGE______28_CM 1 0. 0. 1. DISPLAY_IDENTIFIER LV_ERR_TPC_MES ECU_ADDRESS 0x7fb454 /end MEASUREMENT
/begin MEASUREMENT t_v_tpc_rng_diag "" UWORD _CNV_A_R_LINEAR_____19_CM 1 0. 0. 6553.5 DISPLAY_IDENTIFIER T_V_TPC_RNG_DIAG ECU_ADDRESS 0x7fa59e BYTE_ORDER MSB_LAST FORMAT "%4.1" /end MEASUREMENT
/begin CHARACTERISTIC c_v_tpc_max_diag "" VALUE 0x85c2a4 _REC_VAL_20_u2 4.9951171875 _CNV_A_R_LINEAR_____33_CM 0. 4.9951171875 DISPLAY_IDENTIFIER C_V_TPC_MAX_DIAG FORMAT "%3.2" /end CHARACTERISTIC
/begin CHARACTERISTIC c_v_tpc_min_diag "" VALUE 0x85c2a6 _REC_VAL_20_u2 4.9951171875 _CNV_A_R_LINEAR_____33_CM 0. 4.9951171875 DISPLAY_IDENTIFIER C_V_TPC_MIN_DIAG FORMAT "%3.2" /end CHARACTERISTIC
/begin CHARACTERISTIC c_n_v_tpc_rng_diag "" VALUE 0x85bfda _REC_VAL_20_u2 6375. _CNV_A_R_LINEAR_____5_CM 0. 6375. DISPLAY_IDENTIFIER C_N_V_TPC_RNG_DIAG FORMAT "%4.0" /end CHARACTERISTIC
/begin CHARACTERISTIC c_mf_tot_v_tpc_rng_diag "" VALUE 0x85bf74 _REC_VAL_20_u2 65.535 _CNV_A_R_LINEAR_____55_CM 0. 65.535 DISPLAY_IDENTIFIER C_MF_TOT_V_TPC_RNG_DIAG FORMAT "%4.2" /end CHARACTERISTIC
/begin CHARACTERISTIC c_t_max_v_tpc_rng_diag "" VALUE 0x85c0fa _REC_VAL_20_u2 6553.5 _CNV_A_R_LINEAR_____19_CM 0. 6553.5 DISPLAY_IDENTIFIER C_T_MAX_V_TPC_RNG_DIAG FORMAT "%5.1" /end CHARACTERISTIC
/begin CHARACTERISTIC c_tco_tpc_mes_plaus_diag "" VALUE 0x85c15b _REC_VAL_20_u1 255. _CNV_A_R_LINEAR_____18_CM -50. 205. DISPLAY_IDENTIFIER C_TCO_TPC_MES_PLAUS_DIAG /end CHARACTERISTIC
/begin CHARACTERISTIC c_tpc_mes_plaus_diag "" VALUE 0x85c1c0 _REC_VAL_20_u2 1024. _CNV_A_R_LINEAR_____56_CM 0. 1024. DISPLAY_IDENTIFIER C_TPC_MES_PLAUS_DIAG FORMAT "%6.2" /end CHARACTERISTIC
/begin CHARACTERISTIC c_abc_inc_v_tac_rng "" VALUE 0x84825d _REC_VAL_20_u1 255. _CNV_A_R_LINEAR_____0_CM 0. 255. DISPLAY_IDENTIFIER C_ABC_INC_V_TAC_RNG FORMAT "%3.0" /end CHARACTERISTIC
/begin CHARACTERISTIC c_abc_max_v_tac_rng "" VALUE 0x8482df _REC_VAL_20_u1 255. _CNV_A_R_LINEAR_____0_CM 0. 255. DISPLAY_IDENTIFIER C_ABC_MAX_V_TAC_RNG FORMAT "%3.0" /end CHARACTERISTIC
/begin CHARACTERISTIC c_abc_inc_tac_mes_plaus "" VALUE 0x848244 _REC_VAL_20_u1 255. _CNV_A_R_LINEAR_____0_CM 0. 255. DISPLAY_IDENTIFIER C_ABC_INC_TAC_MES_PLAUS FORMAT "%3.0" /end CHARACTERISTIC
/begin CHARACTERISTIC c_abc_max_tac_mes_plaus "" VALUE 0x8482c6 _REC_VAL_20_u1 255. _CNV_A_R_LINEAR_____0_CM 0. 255. DISPLAY_IDENTIFIER C_ABC_MAX_TAC_MES_PLAUS FORMAT "%3.0" /end CHARACTERISTIC
/begin MEASUREMENT lv_err_tac_mes "" UBYTE _CNV_S_2_RANGE______28_CM 1 0. 0. 1. DISPLAY_IDENTIFIER LV_ERR_TAC_MES ECU_ADDRESS 0x7fb455 /end MEASUREMENT
/begin MEASUREMENT t_v_tac_rng_diag "" UWORD _CNV_A_R_LINEAR_____19_CM 1 0. 0. 6553.5 DISPLAY_IDENTIFIER T_V_TAC_RNG_DIAG ECU_ADDRESS 0x7fa5a0 BYTE_ORDER MSB_LAST FORMAT "%4.1" /end MEASUREMENT
/begin CHARACTERISTIC c_v_tac_max_diag "" VALUE 0x85c274 _REC_VAL_20_u2 4.9951171875 _CNV_A_R_LINEAR_____33_CM 0. 4.9951171875 DISPLAY_IDENTIFIER C_V_TAC_MAX_DIAG FORMAT "%3.2" /end CHARACTERISTIC
/begin CHARACTERISTIC c_v_tac_min_diag "" VALUE 0x85c276 _REC_VAL_20_u2 4.9951171875 _CNV_A_R_LINEAR_____33_CM 0. 4.9951171875 DISPLAY_IDENTIFIER C_V_TAC_MIN_DIAG FORMAT "%3.2" /end CHARACTERISTIC
/begin CHARACTERISTIC c_n_v_tac_rng_diag "" VALUE 0x85bfd8 _REC_VAL_20_u2 6375. _CNV_A_R_LINEAR_____5_CM 0. 6375. DISPLAY_IDENTIFIER C_N_V_TAC_RNG_DIAG FORMAT "%4.0" /end CHARACTERISTIC
/begin CHARACTERISTIC c_n_tac_mes_plaus_diag "" VALUE 0x85bfce _REC_VAL_20_u2 6375. _CNV_A_R_LINEAR_____5_CM 0. 6375. DISPLAY_IDENTIFIER C_N_TAC_MES_PLAUS_DIAG FORMAT "%4.0" /end CHARACTERISTIC
/begin CHARACTERISTIC c_mf_tot_v_tac_rng_diag "" VALUE 0x85bf72 _REC_VAL_20_u2 65.535 _CNV_A_R_LINEAR_____55_CM 0. 65.535 DISPLAY_IDENTIFIER C_MF_TOT_V_TAC_RNG_DIAG FORMAT "%4.2" /end CHARACTERISTIC
/begin CHARACTERISTIC c_mf_tot_tac_mes_plaus_diag "" VALUE 0x85bf70 _REC_VAL_20_u2 65.535 _CNV_A_R_LINEAR_____55_CM 0. 65.535 DISPLAY_IDENTIFIER C_MF_TOT_TAC_MES_PLAUS_DIAG FORMAT "%4.2" /end CHARACTERISTIC
/begin CHARACTERISTIC c_tco_tac_mes_plaus_diag "" VALUE 0x85c15a _REC_VAL_20_u1 255. _CNV_A_R_LINEAR_____18_CM -50. 205. DISPLAY_IDENTIFIER C_TCO_TAC_MES_PLAUS_DIAG /end CHARACTERISTIC
/begin CHARACTERISTIC c_t_max_v_tac_rng_diag "" VALUE 0x85c0f8 _REC_VAL_20_u2 6553.5 _CNV_A_R_LINEAR_____19_CM 0. 6553.5 DISPLAY_IDENTIFIER C_T_MAX_V_TAC_RNG_DIAG FORMAT "%5.1" /end CHARACTERISTIC
/begin CHARACTERISTIC c_t_ast_tac_mes_plaus_diag "" VALUE 0x85c09c _REC_VAL_20_u2 6553.5 _CNV_A_R_LINEAR_____19_CM 0. 6553.5 DISPLAY_IDENTIFIER C_T_AST_TAC_MES_PLAUS_DIAG FORMAT "%5.1" /end CHARACTERISTIC
/begin CHARACTERISTIC c_absv_tpc_tac_dif_diag "" VALUE 0x85bcb0 _REC_VAL_20_u2 1024. _CNV_A_R_LINEAR_____56_CM 0. 1024. DISPLAY_IDENTIFIER C_ABSV_TPC_TAC_DIF_DIAG FORMAT "%6.2" /end CHARACTERISTIC
/begin CHARACTERISTIC c_abc_inc_mf_is_obd "" VALUE 0x848221 _REC_VAL_20_u1 255. _CNV_A_R_LINEAR_____0_CM 0. 255. DISPLAY_IDENTIFIER C_ABC_INC_MF_IS_OBD FORMAT "%3.0" /end CHARACTERISTIC
/begin CHARACTERISTIC c_abc_max_mf_is_obd "" VALUE 0x8482a3 _REC_VAL_20_u1 255. _CNV_A_R_LINEAR_____0_CM 0. 255. DISPLAY_IDENTIFIER C_ABC_MAX_MF_IS_OBD FORMAT "%3.0" /end CHARACTERISTIC
/begin CHARACTERISTIC lc_mf_is_obd_rst "" VALUE 0x85c344 _REC_VAL_20_u1 1. _CNV_S_2_RANGE______11_CM 0. 1. DISPLAY_IDENTIFIER LC_MF_IS_OBD_RST /end CHARACTERISTIC
/begin CHARACTERISTIC c_t_dly_mf_is_obd "" VALUE 0x85c0bc _REC_VAL_20_u2 41.9424 _CNV_A_R_LINEAR_____57_CM 0. 41.9424 DISPLAY_IDENTIFIER C_T_DLY_MF_IS_OBD FORMAT "%5.3" /end CHARACTERISTIC
/begin CHARACTERISTIC c_ctr_mf_is_obd "" VALUE 0x85bdbe _REC_VAL_20_u1 255. _CNV_A_R_LINEAR_____0_CM 0. 255. DISPLAY_IDENTIFIER C_CTR_MF_IS_OBD FORMAT "%3.0" /end CHARACTERISTIC
/begin CHARACTERISTIC c_mf_is_max_obd "" VALUE 0x85bf5a _REC_VAL_20_u2 262.14 _CNV_A_R_LINEAR_____43_CM 0. 262.14 DISPLAY_IDENTIFIER C_MF_IS_MAX_OBD FORMAT "%5.3" /end CHARACTERISTIC
/begin CHARACTERISTIC c_mf_is_min_obd "" VALUE 0x85bf5c _REC_VAL_20_u2 262.14 _CNV_A_R_LINEAR_____43_CM 0. 262.14 DISPLAY_IDENTIFIER C_MF_IS_MIN_OBD FORMAT "%5.3" /end CHARACTERISTIC
/begin MEASUREMENT t_dly_mf_is_obd "" UWORD _CNV_A_R_LINEAR_____57_CM 1 0. 0. 41.9424 DISPLAY_IDENTIFIER T_DLY_MF_IS_OBD ECU_ADDRESS 0x7fc912 BYTE_ORDER MSB_LAST FORMAT "%5.3" /end MEASUREMENT
/begin MEASUREMENT ctr_mf_is_max_obd "" UBYTE _CNV_A_R_LINEAR_____0_CM 1 0. 0. 255. DISPLAY_IDENTIFIER CTR_MF_IS_MAX_OBD ECU_ADDRESS 0x7fca2b FORMAT "%3.0" /end MEASUREMENT
/begin MEASUREMENT ctr_mf_is_min_obd "" UBYTE _CNV_A_R_LINEAR_____0_CM 1 0. 0. 255. DISPLAY_IDENTIFIER CTR_MF_IS_MIN_OBD ECU_ADDRESS 0x7fca2a FORMAT "%3.0" /end MEASUREMENT
/begin MEASUREMENT mf_is_max_obd "" UWORD _CNV_A_R_LINEAR_____43_CM 1 0. 0. 262.14 DISPLAY_IDENTIFIER MF_IS_MAX_OBD ECU_ADDRESS 0x7fc910 BYTE_ORDER MSB_LAST FORMAT "%5.3" /end MEASUREMENT
/begin MEASUREMENT mf_is_min_obd "" UWORD _CNV_A_R_LINEAR_____43_CM 1 0. 0. 262.14 DISPLAY_IDENTIFIER MF_IS_MIN_OBD ECU_ADDRESS 0x7fc90e BYTE_ORDER MSB_LAST FORMAT "%5.3" /end MEASUREMENT
/begin CHARACTERISTIC c_n_thd_byp_ect "" VALUE 0x85bfd2 _REC_VAL_20_u1 8160. _CNV_A_R_LINEAR_____58_CM 0. 8160. DISPLAY_IDENTIFIER C_N_THD_BYP_ECT FORMAT "%4.0" /end CHARACTERISTIC
/begin CHARACTERISTIC c_pwm_byp_ect_min "" VALUE 0x85c002 _REC_VAL_20_u1 99.99600000000001 _CNV_A_R_LINEAR_____42_CM 0. 99.996 DISPLAY_IDENTIFIER C_PWM_BYP_ECT_MIN FORMAT "%4.2" /end CHARACTERISTIC
/begin CHARACTERISTIC c_tco_hys_byp_ect_warm "" VALUE 0x85c149 _REC_VAL_20_u1 255. _CNV_A_R_LINEAR_____20_CM 0. 255. DISPLAY_IDENTIFIER C_TCO_HYS_BYP_ECT_WARM FORMAT "%3.0" /end CHARACTERISTIC
/begin CHARACTERISTIC c_tco_hys_byp_ect_hot "" VALUE 0x85c148 _REC_VAL_20_u1 255. _CNV_A_R_LINEAR_____20_CM 0. 255. DISPLAY_IDENTIFIER C_TCO_HYS_BYP_ECT_HOT FORMAT "%3.0" /end CHARACTERISTIC
/begin CHARACTERISTIC c_tco_add_ect "" VALUE 0x85c13c _REC_VAL_20_u1 255. _CNV_A_R_LINEAR_____20_CM 0. 255. DISPLAY_IDENTIFIER C_TCO_ADD_ECT FORMAT "%3.0" /end CHARACTERISTIC
/begin CHARACTERISTIC ip_tco_ect__pwm_ect "Coolant temperature " CURVE 0x85ab68 _REC_CUR_20_u1_u1 255. _CNV_A_R_LINEAR_____18_CM -50. 205. DISPLAY_IDENTIFIER IP_TCO_ECT__PWM_ECT FORMAT "%3.0"
 /begin AXIS_DESCR COM_AXIS pwm_ect_ctl _CNV_A_R_LINEAR_____42_CM 10 0. 99.996 FORMAT "%4.2" AXIS_PTS_REF ldp_pwm_ect_ip_tco_ect /end AXIS_DESCR
/end CHARACTERISTIC
/begin MEASUREMENT pwm_byp_ect "" UBYTE _CNV_A_R_LINEAR_____42_CM 1 0. 0. 99.996 DISPLAY_IDENTIFIER PWM_BYP_ECT ECU_ADDRESS 0x7fb715 FORMAT "%4.2" /end MEASUREMENT
/begin MEASUREMENT lv_exv "" UBYTE _CNV_S_2_RANGE______11_CM 1 0. 0. 1. DISPLAY_IDENTIFIER LV_EXV ECU_ADDRESS 0x7fb714 /end MEASUREMENT
/begin AXIS_PTS ldp_pwm_ect_ip_tco_ect "" 0x842510 pwm_ect_ctl _REC_AXS_20_u1 99.99600000000001 _CNV_A_R_LINEAR_____42_CM 10 0. 99.996 FORMAT "%4.2" /end AXIS_PTS
/begin CHARACTERISTIC c_t_per_exv_cold "" VALUE 0x85c102 _REC_VAL_20_u1 255. _CNV_A_R_LINEAR_____16_CM 0. 255. DISPLAY_IDENTIFIER C_T_PER_EXV_COLD FORMAT "%3.0" /end CHARACTERISTIC
/begin CHARACTERISTIC c_t_act_exv_cold "" VALUE 0x85c078 _REC_VAL_20_u1 255. _CNV_A_R_LINEAR_____16_CM 0. 255. DISPLAY_IDENTIFIER C_T_ACT_EXV_COLD FORMAT "%3.0" /end CHARACTERISTIC
/begin CHARACTERISTIC c_t_act_exv_warm "" VALUE 0x85c079 _REC_VAL_20_u1 255. _CNV_A_R_LINEAR_____16_CM 0. 255. DISPLAY_IDENTIFIER C_T_ACT_EXV_WARM FORMAT "%3.0" /end CHARACTERISTIC
/begin MEASUREMENT pwm_ect_ctl "Control signal of the thermostat without VB correction" UBYTE _CNV_A_R_LINEAR_____42_CM 1 0. 0. 99.996 DISPLAY_IDENTIFIER PWM_ECT_CTL ECU_ADDRESS 0x7fb72f FORMAT "%4.2" /end MEASUREMENT
/begin CHARACTERISTIC c_abc_inc_maf_egr_thr_obd "anti bounce counter increment for diagnosis instance MAF_EGR_THR_OBD" VALUE 0x848219 _REC_VAL_20_u1 255. _CNV_A_R_LINEAR_____0_CM 0. 255. DISPLAY_IDENTIFIER C_ABC_INC_MAF_EGR_THR_OBD FORMAT "%3.0" /end CHARACTERISTIC
/begin CHARACTERISTIC c_abc_max_maf_egr_thr_obd "maximum value of anti bounce counter for diagnosis instance MAF_EGR_THR_OBD" VALUE 0x84829b _REC_VAL_20_u1 255. _CNV_A_R_LINEAR_____0_CM 0. 255. DISPLAY_IDENTIFIER C_ABC_MAX_MAF_EGR_THR_OBD FORMAT "%3.0" /end CHARACTERISTIC
/begin CHARACTERISTIC c_abc_inc_maf_dif_egr_thr_obd "anti bounce counter increment for diagnosis instance MAF_DIF_EGR_THR_OBD" VALUE 0x848218 _REC_VAL_20_u1 255. _CNV_A_R_LINEAR_____0_CM 0. 255. DISPLAY_IDENTIFIER C_ABC_INC_MAF_DIF_EGR_THR_OBD FORMAT "%3.0" /end CHARACTERISTIC
/begin CHARACTERISTIC c_abc_max_maf_dif_egr_thr_obd "maximum value of anti bounce counter for diagnosis instance MAF_DIF_EGR_THR_OBD" VALUE 0x84829a _REC_VAL_20_u1 255. _CNV_A_R_LINEAR_____0_CM 0. 255. DISPLAY_IDENTIFIER C_ABC_MAX_MAF_DIF_EGR_THR_OBD FORMAT "%3.0" /end CHARACTERISTIC
/begin CHARACTERISTIC c_abc_inc_map_dif_egr_thr_obd "anti bounce counter increment for diagnosis instance MAP_DIF_EGR_THR_OBD" VALUE 0x84821e _REC_VAL_20_u1 255. _CNV_A_R_LINEAR_____0_CM 0. 255. DISPLAY_IDENTIFIER C_ABC_INC_MAP_DIF_EGR_THR_OBD FORMAT "%3.0" /end CHARACTERISTIC
/begin CHARACTERISTIC c_abc_max_map_dif_egr_thr_obd "maximum value of anti bounce counter for diagnosis instance MAP_DIF_EGR_THR_OBD" VALUE 0x8482a0 _REC_VAL_20_u1 255. _CNV_A_R_LINEAR_____0_CM 0. 255. DISPLAY_IDENTIFIER C_ABC_MAX_MAP_DIF_EGR_THR_OBD FORMAT "%3.0" /end CHARACTERISTIC
/begin MEASUREMENT t_egr_thr_obd "timer for open loop EGR system check" UWORD _CNV_A_R_LINEAR_____57_CM 1 0. 0. 41.9424 DISPLAY_IDENTIFIER T_EGR_THR_OBD ECU_ADDRESS 0x7fa5a6 BYTE_ORDER MSB_LAST FORMAT "%6.4" /end MEASUREMENT
/begin MEASUREMENT lv_egr_thr_obd "flag indicating if open loop EGR system check is active - to switch the GES-actuators to calibratable values" UBYTE _CNV_S_2_RANGE______11_CM 1 0. 0. 1. DISPLAY_IDENTIFIER LV_EGR_THR_OBD ECU_ADDRESS 0x7fb462 /end MEASUREMENT
/begin MEASUREMENT egrvpwm_obd "pulse width for the EGR valve during open loop EGR system check when LV_EGR_THR_OBD = 1" UWORD _CNV_A_R_LINEAR_____8_CM 1 0. 0. 99.99847412109381 DISPLAY_IDENTIFIER EGRVPWM_OBD ECU_ADDRESS 0x7f97b6 BYTE_ORDER MSB_LAST FORMAT "%5.3" /end MEASUREMENT
/begin MEASUREMENT thrpwm_obd "pulse width for the EGR throttle during open loop EGR system check when LV_EGR_THR_OBD = 1" UWORD _CNV_A_R_LINEAR_____8_CM 1 0. 0. 99.99847412109381 DISPLAY_IDENTIFIER THRPWM_OBD ECU_ADDRESS 0x7f97b8 BYTE_ORDER MSB_LAST FORMAT "%5.3" /end MEASUREMENT
/begin MEASUREMENT byppwm_obd "pulse width for the EGR bypass throttle during open loop EGR system check when LV_EGR_THR_OBD = 1" UWORD _CNV_A_R_LINEAR_____8_CM 1 0. 0. 99.99847412109381 DISPLAY_IDENTIFIER BYPPWM_OBD ECU_ADDRESS 0x7f97ba BYTE_ORDER MSB_LAST FORMAT "%5.3" /end MEASUREMENT
/begin MEASUREMENT bpapwm_obd "pulse width for the BPA during open loop EGR system check when LV_EGR_THR_OBD = 1" UWORD _CNV_A_R_LINEAR_____8_CM 1 0. 0. 99.99847412109381 DISPLAY_IDENTIFIER BPAPWM_OBD ECU_ADDRESS 0x7f97bc BYTE_ORDER MSB_LAST FORMAT "%5.3" /end MEASUREMENT
/begin MEASUREMENT ctr_maf_egr_thr_obd "ctr_maf_egr_thr_obd" UBYTE _CNV_A_R_LINEAR_____0_CM 1 0. 0. 255. DISPLAY_IDENTIFIER CTR_MAF_EGR_THR_OBD ECU_ADDRESS 0x7fb9fc FORMAT "%3.0" /end MEASUREMENT
/begin MEASUREMENT ctr_maf_dif_egr_thr_obd "ctr_maf_dif_egr_thr_obd" UBYTE _CNV_A_R_LINEAR_____0_CM 1 0. 0. 255. DISPLAY_IDENTIFIER CTR_MAF_DIF_EGR_THR_OBD ECU_ADDRESS 0x7fb9fd FORMAT "%3.0" /end MEASUREMENT
/begin MEASUREMENT ctr_map_dif_egr_thr_obd "ctr_map_dif_egr_thr_obd" UBYTE _CNV_A_R_LINEAR_____0_CM 1 0. 0. 255. DISPLAY_IDENTIFIER CTR_MAP_DIF_EGR_THR_OBD ECU_ADDRESS 0x7fb9fe FORMAT "%3.0" /end MEASUREMENT
/begin MEASUREMENT maf_egr_thr_obd "maf_egr_thr_obd" UWORD _CNV_A_R_LINEAR_____23_CM 1 0. 0. 1389. DISPLAY_IDENTIFIER MAF_EGR_THR_OBD ECU_ADDRESS 0x7fa5a8 BYTE_ORDER MSB_LAST FORMAT "%6.2" /end MEASUREMENT
/begin MEASUREMENT map_mes_egr_thr_obd "map_mes_egr_thr_obd" UWORD _CNV_A_R_LINEAR_____21_CM 1 0. 0. 5434. DISPLAY_IDENTIFIER MAP_MES_EGR_THR_OBD ECU_ADDRESS 0x7fa5aa BYTE_ORDER MSB_LAST FORMAT "%6.2" /end MEASUREMENT
/begin MEASUREMENT lv_rst_diag_egr_thr_obd "flag if open loop EGR system check is to be done repeatedly - dependent on LC_RST_DIAG_EGR_THR_OBD" UBYTE _CNV_S_2_RANGE______11_CM 1 0. 0. 1. DISPLAY_IDENTIFIER LV_RST_DIAG_EGR_THR_OBD ECU_ADDRESS 0x7fb463 /end MEASUREMENT
/begin MEASUREMENT lv_inh_egr_thr_obd "inhibition flag for activation/disactivation of the open loop EGR system check" UBYTE _CNV_S_2_RANGE______11_CM 1 0. 0. 1. DISPLAY_IDENTIFIER LV_INH_EGR_THR_OBD ECU_ADDRESS 0x7fb464 /end MEASUREMENT
/begin CHARACTERISTIC c_t_egr_thr_obd_1 "c_t_egr_thr_obd_1" VALUE 0x85c0c6 _REC_VAL_20_u2 41.9424 _CNV_A_R_LINEAR_____57_CM 0. 41.9424 DISPLAY_IDENTIFIER C_T_EGR_THR_OBD_1 FORMAT "%6.4" /end CHARACTERISTIC
/begin CHARACTERISTIC c_egrvpwm_egr_thr_obd_1 "c_egrvpwm_egr_thr_obd_1" VALUE 0x85bdf4 _REC_VAL_20_u2 99.99847412109381 _CNV_A_R_LINEAR_____8_CM 0. 99.99847412109381 DISPLAY_IDENTIFIER C_EGRVPWM_EGR_THR_OBD_1 FORMAT "%5.3" /end CHARACTERISTIC
/begin CHARACTERISTIC c_thrpwm_egr_thr_obd_1 "c_thrpwm_egr_thr_obd_1" VALUE 0x85c1a2 _REC_VAL_20_u2 99.99847412109381 _CNV_A_R_LINEAR_____8_CM 0. 99.99847412109381 DISPLAY_IDENTIFIER C_THRPWM_EGR_THR_OBD_1 FORMAT "%5.3" /end CHARACTERISTIC
/begin CHARACTERISTIC c_byppwm_egr_thr_obd_1 "c_byppwm_egr_thr_obd_1" VALUE 0x85bd24 _REC_VAL_20_u2 99.99847412109381 _CNV_A_R_LINEAR_____8_CM 0. 99.99847412109381 DISPLAY_IDENTIFIER C_BYPPWM_EGR_THR_OBD_1 FORMAT "%5.3" /end CHARACTERISTIC
/begin CHARACTERISTIC c_bpapwm_egr_thr_obd_1 "c_bpapwm_egr_thr_obd_1" VALUE 0x85bd0a _REC_VAL_20_u2 99.99847412109381 _CNV_A_R_LINEAR_____8_CM 0. 99.99847412109381 DISPLAY_IDENTIFIER C_BPAPWM_EGR_THR_OBD_1 FORMAT "%5.3" /end CHARACTERISTIC
/begin CHARACTERISTIC c_t_dly_egr_thr_obd "delay time after start of each diagnostic section" VALUE 0x85c0b2 _REC_VAL_20_u2 41.9424 _CNV_A_R_LINEAR_____57_CM 0. 41.9424 DISPLAY_IDENTIFIER C_T_DLY_EGR_THR_OBD FORMAT "%6.4" /end CHARACTERISTIC
/begin CHARACTERISTIC c_maf_max_egr_thr_obd "c_maf_max_egr_thr_obd" VALUE 0x85bf0e _REC_VAL_20_u2 1389. _CNV_A_R_LINEAR_____23_CM 0. 1389. DISPLAY_IDENTIFIER C_MAF_MAX_EGR_THR_OBD FORMAT "%6.2" /end CHARACTERISTIC
/begin CHARACTERISTIC c_maf_min_egr_thr_obd "c_maf_min_egr_thr_obd" VALUE 0x85bf10 _REC_VAL_20_u2 1389. _CNV_A_R_LINEAR_____23_CM 0. 1389. DISPLAY_IDENTIFIER C_MAF_MIN_EGR_THR_OBD FORMAT "%6.2" /end CHARACTERISTIC
/begin CHARACTERISTIC c_t_egr_thr_obd_2 "c_t_egr_thr_obd_2" VALUE 0x85c0c8 _REC_VAL_20_u2 41.9424 _CNV_A_R_LINEAR_____57_CM 0. 41.9424 DISPLAY_IDENTIFIER C_T_EGR_THR_OBD_2 FORMAT "%6.4" /end CHARACTERISTIC
/begin CHARACTERISTIC c_egrvpwm_egr_thr_obd_2 "c_egrvpwm_egr_thr_obd_2" VALUE 0x85bdf6 _REC_VAL_20_u2 99.99847412109381 _CNV_A_R_LINEAR_____8_CM 0. 99.99847412109381 DISPLAY_IDENTIFIER C_EGRVPWM_EGR_THR_OBD_2 FORMAT "%5.3" /end CHARACTERISTIC
/begin CHARACTERISTIC c_thrpwm_egr_thr_obd_2 "c_thrpwm_egr_thr_obd_2" VALUE 0x85c1a4 _REC_VAL_20_u2 99.99847412109381 _CNV_A_R_LINEAR_____8_CM 0. 99.99847412109381 DISPLAY_IDENTIFIER C_THRPWM_EGR_THR_OBD_2 FORMAT "%5.3" /end CHARACTERISTIC
/begin CHARACTERISTIC c_byppwm_egr_thr_obd_2 "c_byppwm_egr_thr_obd_2" VALUE 0x85bd26 _REC_VAL_20_u2 99.99847412109381 _CNV_A_R_LINEAR_____8_CM 0. 99.99847412109381 DISPLAY_IDENTIFIER C_BYPPWM_EGR_THR_OBD_2 FORMAT "%5.3" /end CHARACTERISTIC
/begin CHARACTERISTIC c_bpapwm_egr_thr_obd_2 "c_bpapwm_egr_thr_obd_2" VALUE 0x85bd0c _REC_VAL_20_u2 99.99847412109381 _CNV_A_R_LINEAR_____8_CM 0. 99.99847412109381 DISPLAY_IDENTIFIER C_BPAPWM_EGR_THR_OBD_2 FORMAT "%5.3" /end CHARACTERISTIC
/begin CHARACTERISTIC c_maf_dif_max_egr_thr_obd "c_maf_dif_max_egr_thr_obd" VALUE 0x85bef8 _REC_VAL_20_u2 1389. _CNV_A_R_LINEAR_____23_CM 0. 1389. DISPLAY_IDENTIFIER C_MAF_DIF_MAX_EGR_THR_OBD FORMAT "%6.2" /end CHARACTERISTIC
/begin CHARACTERISTIC c_maf_dif_min_egr_thr_obd "c_maf_dif_min_egr_thr_obd" VALUE 0x85befa _REC_VAL_20_u2 1389. _CNV_A_R_LINEAR_____23_CM 0. 1389. DISPLAY_IDENTIFIER C_MAF_DIF_MIN_EGR_THR_OBD FORMAT "%6.2" /end CHARACTERISTIC
/begin CHARACTERISTIC c_ctr_maf_egr_thr_obd "threshold for CTR_MAF_EGR_THR_OBD" VALUE 0x85bdab _REC_VAL_20_u1 255. _CNV_A_R_LINEAR_____0_CM 0. 255. DISPLAY_IDENTIFIER C_CTR_MAF_EGR_THR_OBD FORMAT "%3.0" /end CHARACTERISTIC
/begin CHARACTERISTIC c_ctr_maf_dif_egr_thr_obd "threshold for CTR_MAF_DIF_EGR_THR_OBD" VALUE 0x85bdaa _REC_VAL_20_u1 255. _CNV_A_R_LINEAR_____0_CM 0. 255. DISPLAY_IDENTIFIER C_CTR_MAF_DIF_EGR_THR_OBD FORMAT "%3.0" /end CHARACTERISTIC
/begin CHARACTERISTIC c_t_egr_thr_obd_3 "c_t_egr_thr_obd_3" VALUE 0x85c0ca _REC_VAL_20_u2 41.9424 _CNV_A_R_LINEAR_____57_CM 0. 41.9424 DISPLAY_IDENTIFIER C_T_EGR_THR_OBD_3 FORMAT "%6.4" /end CHARACTERISTIC
/begin CHARACTERISTIC c_egrvpwm_egr_thr_obd_3 "c_egrvpwm_egr_thr_obd_3" VALUE 0x85bdf8 _REC_VAL_20_u2 99.99847412109381 _CNV_A_R_LINEAR_____8_CM 0. 99.99847412109381 DISPLAY_IDENTIFIER C_EGRVPWM_EGR_THR_OBD_3 FORMAT "%5.3" /end CHARACTERISTIC
/begin CHARACTERISTIC c_thrpwm_egr_thr_obd_3 "c_thrpwm_egr_thr_obd_3" VALUE 0x85c1a6 _REC_VAL_20_u2 99.99847412109381 _CNV_A_R_LINEAR_____8_CM 0. 99.99847412109381 DISPLAY_IDENTIFIER C_THRPWM_EGR_THR_OBD_3 FORMAT "%5.3" /end CHARACTERISTIC
/begin CHARACTERISTIC c_byppwm_egr_thr_obd_3 "c_byppwm_egr_thr_obd_3" VALUE 0x85bd28 _REC_VAL_20_u2 99.99847412109381 _CNV_A_R_LINEAR_____8_CM 0. 99.99847412109381 DISPLAY_IDENTIFIER C_BYPPWM_EGR_THR_OBD_3 FORMAT "%5.3" /end CHARACTERISTIC
/begin CHARACTERISTIC c_bpapwm_egr_thr_obd_3 "c_bpapwm_egr_thr_obd_3" VALUE 0x85bd0e _REC_VAL_20_u2 99.99847412109381 _CNV_A_R_LINEAR_____8_CM 0. 99.99847412109381 DISPLAY_IDENTIFIER C_BPAPWM_EGR_THR_OBD_3 FORMAT "%5.3" /end CHARACTERISTIC
/begin CHARACTERISTIC c_map_mes_dif_max_egr_thr_obd "c_map_mes_dif_max_egr_thr_obd" VALUE 0x85bf36 _REC_VAL_20_u2 5434. _CNV_A_R_LINEAR_____21_CM 0. 5434. DISPLAY_IDENTIFIER C_MAP_MES_DIF_MAX_EGR_THR_OBD FORMAT "%6.2" /end CHARACTERISTIC
/begin CHARACTERISTIC c_map_mes_dif_min_egr_thr_obd "c_map_mes_dif_min_egr_thr_obd" VALUE 0x85bf38 _REC_VAL_20_u2 5434. _CNV_A_R_LINEAR_____21_CM 0. 5434. DISPLAY_IDENTIFIER C_MAP_MES_DIF_MIN_EGR_THR_OBD FORMAT "%6.2" /end CHARACTERISTIC
/begin CHARACTERISTIC c_ctr_map_dif_egr_thr_obd "threshold for CTR_MAP_DIF_EGR_THR_OBD" VALUE 0x85bdae _REC_VAL_20_u1 255. _CNV_A_R_LINEAR_____0_CM 0. 255. DISPLAY_IDENTIFIER C_CTR_MAP_DIF_EGR_THR_OBD FORMAT "%3.0" /end CHARACTERISTIC
/begin CHARACTERISTIC lc_rst_diag_egr_thr_obd "reset button to allow repeated performance of open loop EGR system check (usually only once per DC)" VALUE 0x85c359 _REC_VAL_20_u1 1. _CNV_A_R_LINEAR_____0_CM 0. 1. DISPLAY_IDENTIFIER LC_RST_DIAG_EGR_THR_OBD FORMAT "%1.0" /end CHARACTERISTIC
/begin CHARACTERISTIC ip_fac_map_cor_egr_thr_obd__n "DIAG_EGR_OBD: correction facxtor for compensation of engine speed dependent influences on MAP" CURVE 0x84bd3e _REC_CUR_20_u2_u2 3.99998471 _CNV_A_R_LINEAR_____63_CM 0. 3.99998471 DISPLAY_IDENTIFIER IP_FAC_MAP_COR_EGR_THR_OBD__N FORMAT "%6.5"
 /begin AXIS_DESCR COM_AXIS n _CNV_A_R_LINEAR_____5_CM 2 0. 6375. FORMAT "%4.0" AXIS_PTS_REF ldp_n__ip_fac_map_egr_thr_obd /end AXIS_DESCR
/end CHARACTERISTIC
/begin AXIS_PTS ldp_n__ip_fac_map_egr_thr_obd "" 0x84192a n _REC_AXS_20_u2 6375. _CNV_A_R_LINEAR_____5_CM 2 0. 6375. FORMAT "%4.0" /end AXIS_PTS
/begin CHARACTERISTIC ip_fac_maf_egr_thr_obd "DIAG_EGR_OBD: ip_fac_maf_egr_thr_obd" MAP 0x84bc12 _REC_MAP_20_u2_u2_u1 3.99998471 _CNV_A_R_LINEAR_____63_CM 0. 3.99998471 DISPLAY_IDENTIFIER IP_FAC_MAF_EGR_THR_OBD FORMAT "%6.5"
 /begin AXIS_DESCR COM_AXIS amp _CNV_A_R_LINEAR_____21_CM 4 0. 5434. FORMAT "%6.2" AXIS_PTS_REF ldpm_amp__ip_fac_egr_thr_obd /end AXIS_DESCR
 /begin AXIS_DESCR COM_AXIS tia _CNV_A_R_LINEAR_____18_CM 4 -50. 205. FORMAT "%3.0" AXIS_PTS_REF ldpm_tia__ip_fac_egr_thr_obd /end AXIS_DESCR
/end CHARACTERISTIC
/begin AXIS_PTS ldpm_amp__ip_fac_egr_thr_obd "" 0x84340e amp _REC_AXS_20_u2 5434. _CNV_A_R_LINEAR_____21_CM 4 0. 5434. FORMAT "%6.2" /end AXIS_PTS
/begin AXIS_PTS ldpm_tia__ip_fac_egr_thr_obd "" 0x843efd tia _REC_AXS_20_u1 255. _CNV_A_R_LINEAR_____18_CM 4 -50. 205. FORMAT "%3.0" /end AXIS_PTS
/begin CHARACTERISTIC ip_fac_map_egr_thr_obd "DIAG_EGR_OBD: open loop EGR system check: AMP and TIA correction for MAP_MES related thresholds" MAP 0x84bd42 _REC_MAP_20_u2_u2_u1 3.99998471 _CNV_A_R_LINEAR_____63_CM 0. 3.99998471 DISPLAY_IDENTIFIER IP_FAC_MAP_EGR_THR_OBD FORMAT "%6.5"
 /begin AXIS_DESCR COM_AXIS amp _CNV_A_R_LINEAR_____21_CM 4 0. 5434. FORMAT "%6.2" AXIS_PTS_REF ldpm_amp__ip_fac_egr_thr_obd /end AXIS_DESCR
 /begin AXIS_DESCR COM_AXIS tia _CNV_A_R_LINEAR_____18_CM 4 -50. 205. FORMAT "%3.0" AXIS_PTS_REF ldpm_tia__ip_fac_egr_thr_obd /end AXIS_DESCR
/end CHARACTERISTIC
/begin CHARACTERISTIC c_tco_min_egr_thr_obd "minimum coolant temperature for activation of open loop EGR system check" VALUE 0x85c151 _REC_VAL_20_u1 255. _CNV_A_R_LINEAR_____18_CM -50. 205. DISPLAY_IDENTIFIER C_TCO_MIN_EGR_THR_OBD FORMAT "%3.0" /end CHARACTERISTIC
/begin MEASUREMENT tq_loss_add "additional torque losses" SWORD _CNV_A_R_LINEAR_____62_CM 1 0. -1024. 1023.96875 DISPLAY_IDENTIFIER TQ_LOSS_ADD ECU_ADDRESS 0x7fa218 BYTE_ORDER MSB_LAST FORMAT "%6.2" /end MEASUREMENT
/begin MEASUREMENT tq_add_req "torque losses for driver request compensation" SWORD _CNV_A_R_LINEAR_____62_CM 1 0. -1024. 1023.96875 DISPLAY_IDENTIFIER TQ_ADD_REQ ECU_ADDRESS 0x7fa21a BYTE_ORDER MSB_LAST FORMAT "%6.2" /end MEASUREMENT
/begin CHARACTERISTIC c_tq_add_conf "configuration of driver request compensation" VALUE 0x85c1c2 _REC_VAL_20_u1 255. _CNV_A_R_LINEAR_____0_CM 0. 255. DISPLAY_IDENTIFIER C_TQ_ADD_CONF FORMAT "%3.0" /end CHARACTERISTIC
/begin CHARACTERISTIC ip_fac_tq_add__pv_av "TQ_FRADD: scaling factor for torque loss compensation" CURVE 0x84c29c _REC_CUR_20_u2_u2 1. _CNV_A_R_LINEAR_____80_CM 0. 1. DISPLAY_IDENTIFIER IP_FAC_TQ_ADD__PV_AV FORMAT "%6.5"
 /begin AXIS_DESCR COM_AXIS pv_av _CNV_A_R_LINEAR_____81_CM 16 0. 100. FORMAT "%4.2" AXIS_PTS_REF ldpm_pv_av_ip_fac_tq_req /end AXIS_DESCR
/end CHARACTERISTIC
/begin AXIS_PTS ldp_gen_load__tq_loss_alter "" 0x844586 gen_load _REC_AXS_20_u1 99.609375 _CNV_A_R_LINEAR_____82_CM 8 0. 99.609375 FORMAT "%4.1" /end AXIS_PTS
/begin CHARACTERISTIC ip_tq_loss_alter "Alternator torque losses" MAP 0x847fca _REC_MAP_20_u2_u1_u1 2047.97875 _CNV_A_R_LINEAR_____83_CM -1024. 1023.97875 DISPLAY_IDENTIFIER IP_TQ_LOSS_ALTER FORMAT "%8.2"
 /begin AXIS_DESCR COM_AXIS n_32 _CNV_A_R_LINEAR_____84_CM 8 0. 8160. FORMAT "%4.0" AXIS_PTS_REF ldp_n32_tq_loss_alter /end AXIS_DESCR
 /begin AXIS_DESCR COM_AXIS gen_load _CNV_A_R_LINEAR_____82_CM 8 0. 99.609375 FORMAT "%4.1" AXIS_PTS_REF ldp_gen_load__tq_loss_alter /end AXIS_DESCR
/end CHARACTERISTIC
/begin MEASUREMENT tq_loss_alter "engine torque losses alternator" SWORD _CNV_A_R_LINEAR_____85_CM 1 0. -1024. 1023.96875 DISPLAY_IDENTIFIER TQ_LOSS_ALTER ECU_ADDRESS 0x7fa270 BYTE_ORDER MSB_LAST FORMAT "%8.2" /end MEASUREMENT
/begin CHARACTERISTIC c_lgrd_tq_loss_alter "Alternator torque losses limitation gradient" VALUE 0x84849a _REC_VAL_20_u2 1023.96875 _CNV_A_R_LINEAR_____86_CM 0. 1023.96875 DISPLAY_IDENTIFIER C_LGRD_TQ_LOSS_ALTER FORMAT "%7.2" /end CHARACTERISTIC
/begin CHARACTERISTIC c_tq_loss_alter_sub "Substitute value for TQ_LOSS_ALTER in case of missed CAN messages" VALUE 0x848706 _REC_VAL_20_u2 2047.96875 _CNV_A_R_LINEAR_____87_CM -1024. 1023.96875 DISPLAY_IDENTIFIER C_TQ_LOSS_ALTER_SUB FORMAT "%11.5" /end CHARACTERISTIC
/begin CHARACTERISTIC lc_use_tq_loss_alter_can "Logical switch to select between TQ_LOSS_ALTER using discrete input or CAN input" VALUE 0x8487e4 _REC_VAL_20_u1 1. _CNV_S_2_RANGE__0___88_CM 0. 1. DISPLAY_IDENTIFIER LC_USE_TQ_LOSS_ALTER_CAN /end CHARACTERISTIC
/begin AXIS_PTS ldp_n32_tq_loss_alter "" 0x844599 n_32 _REC_AXS_20_u1 8160. _CNV_A_R_LINEAR_____84_CM 8 0. 8160. FORMAT "%4.0" /end AXIS_PTS
/begin MEASUREMENT gen_load "Generator load value (0-100%)" UBYTE _CNV_A_R_LINEAR_____82_CM 1 0. 0. 99.609375 DISPLAY_IDENTIFIER GEN_LOAD ECU_ADDRESS 0x7fb800 FORMAT "%4.1" /end MEASUREMENT
/begin MEASUREMENT fac_tq_req_driv "Scaling Factor for requested torque at clutch from driver" UWORD _CNV_A_R_LINEAR_____53_CM 1 0. 0. 1.9999696 DISPLAY_IDENTIFIER FAC_TQ_REQ_DRIV ECU_ADDRESS 0x7fa1f8 BYTE_ORDER MSB_LAST FORMAT "%6.5" /end MEASUREMENT
/begin MEASUREMENT lv_fac_tq_req_dri_low "scaling factor from low gear map" UBYTE _CNV_S_2_RANGE______11_CM 1 0. 0. 1. DISPLAY_IDENTIFIER LV_FAC_TQ_REQ_DRI_LOW ECU_ADDRESS 0x7fb7e5 /end MEASUREMENT
/begin MEASUREMENT n_fil "filtered engine speed" UWORD _CNV_A_R_LINEAR_____5_CM 1 0. 0. 6375. DISPLAY_IDENTIFIER N_FIL ECU_ADDRESS 0x7fa1fa BYTE_ORDER MSB_LAST FORMAT "%4.0" /end MEASUREMENT
/begin CHARACTERISTIC c_dri_fac_tq_req "C_DRI_FAC_TQ_REQ" VALUE 0x85bdcf _REC_VAL_20_u1 255. _CNV_A_R_LINEAR_____0_CM 0. 255. DISPLAY_IDENTIFIER C_DRI_FAC_TQ_REQ FORMAT "%3.0" /end CHARACTERISTIC
/begin CHARACTERISTIC c_crlc_n "correlation constant for N for driver request" VALUE 0x85bd4c _REC_VAL_20_u2 0.9999874 _CNV_A_R_LINEAR_____90_CM 0. 0.9999874 DISPLAY_IDENTIFIER C_CRLC_N FORMAT "%6.5" /end CHARACTERISTIC
/begin CHARACTERISTIC ip_fac_tq_req_dri_h__n__pv_av "TQCLFAC: scaling factor for torque request (high gear)" MAP 0x84c418 _REC_MAP_20_u2_u2_u2 1.9999696 _CNV_A_R_LINEAR_____53_CM 0. 1.9999696 DISPLAY_IDENTIFIER IP_FAC_TQ_REQ_DRI_H__N__PV_AV FORMAT "%6.5"
 /begin AXIS_DESCR COM_AXIS n_fil _CNV_A_R_LINEAR_____5_CM 16 0. 6375. FORMAT "%4.0" AXIS_PTS_REF ldpm_n_ip_fac_tq_req /end AXIS_DESCR
 /begin AXIS_DESCR COM_AXIS pv_av _CNV_A_R_LINEAR_____81_CM 16 0. 100. FORMAT "%4.2" AXIS_PTS_REF ldpm_pv_av_ip_fac_tq_req /end AXIS_DESCR
/end CHARACTERISTIC
/begin AXIS_PTS ldpm_n_ip_fac_tq_req "scaling factor for torque request (high gear)" 0x843a5c n_fil _REC_AXS_20_u2 6375. _CNV_A_R_LINEAR_____5_CM 16 0. 6375. FORMAT "%4.0" /end AXIS_PTS
/begin AXIS_PTS ldpm_pv_av_ip_fac_tq_req "scaling factor for torque request (high gear)" 0x843e38 pv_av _REC_AXS_20_u2 100. _CNV_A_R_LINEAR_____81_CM 16 0. 100. FORMAT "%4.2" /end AXIS_PTS
/begin CHARACTERISTIC ip_fac_tq_req_dri_l__n__pv_av "TQCLFAC: scaling factor for torque request (low gear)" MAP 0x84c618 _REC_MAP_20_u2_u2_u2 1.9999696 _CNV_A_R_LINEAR_____53_CM 0. 1.9999696 DISPLAY_IDENTIFIER IP_FAC_TQ_REQ_DRI_L__N__PV_AV FORMAT "%6.5"
 /begin AXIS_DESCR COM_AXIS n_fil _CNV_A_R_LINEAR_____5_CM 16 0. 6375. FORMAT "%4.0" AXIS_PTS_REF ldpm_n_ip_fac_tq_req /end AXIS_DESCR
 /begin AXIS_DESCR COM_AXIS pv_av _CNV_A_R_LINEAR_____81_CM 16 0. 100. FORMAT "%4.2" AXIS_PTS_REF ldpm_pv_av_ip_fac_tq_req /end AXIS_DESCR
/end CHARACTERISTIC
/begin MEASUREMENT tq_ltc_sub "torque request after load transient correction" SWORD _CNV_A_R_LINEAR_____62_CM 1 0. -1024. 1023.96875 DISPLAY_IDENTIFIER TQ_LTC_SUB ECU_ADDRESS 0x7f971c BYTE_ORDER MSB_LAST FORMAT "%6.2" /end MEASUREMENT
/begin MEASUREMENT tqi_ltc_sub "indicated torque request after load transient correction" SWORD _CNV_A_R_LINEAR_____62_CM 1 0. -1024. 1023.96875 DISPLAY_IDENTIFIER TQI_LTC_SUB ECU_ADDRESS 0x7f971e BYTE_ORDER MSB_LAST FORMAT "%6.2" /end MEASUREMENT
/begin MEASUREMENT lv_act_ltc "LTC is active" UBYTE _CNV_S_2_RANGE______11_CM 1 0. 0. 1. DISPLAY_IDENTIFIER LV_ACT_LTC ECU_ADDRESS 0x7fb315 /end MEASUREMENT
/begin CHARACTERISTIC c_tq_ltc_thd_add_down_2 "increase threshold down 2 from TQ_LOSS" VALUE 0x85c1ca _REC_VAL_20_u2 1023.96875 _CNV_A_R_LINEAR_____62_CM 0. 1023.96875 DISPLAY_IDENTIFIER C_TQ_LTC_THD_ADD_DOWN_2 FORMAT "%6.2" /end CHARACTERISTIC
/begin CHARACTERISTIC c_tq_ltc_thd_down_2 "threshold LTC down 2" VALUE 0x85c1cc _REC_VAL_20_s2 2047.96875 _CNV_A_R_LINEAR_____62_CM -1024. 1023.96875 DISPLAY_IDENTIFIER C_TQ_LTC_THD_DOWN_2 FORMAT "%6.2" /end CHARACTERISTIC
/begin CHARACTERISTIC c_n_32_ltc_min "minimal engine speed LTC active" VALUE 0x85bf81 _REC_VAL_20_u1 8160. _CNV_A_R_LINEAR_____58_CM 0. 8160. DISPLAY_IDENTIFIER C_N_32_LTC_MIN FORMAT "%4.0" /end CHARACTERISTIC
/begin CHARACTERISTIC lc_ltc_on "switch LTC on" VALUE 0x85c337 _REC_VAL_20_u1 1. _CNV_A_R_LINEAR_____0_CM 0. 1. DISPLAY_IDENTIFIER LC_LTC_ON FORMAT "%1.0" /end CHARACTERISTIC
/begin CHARACTERISTIC lc_ltc_dri_di "switch LTC disabled by gear" VALUE 0x85c335 _REC_VAL_20_u1 1. _CNV_A_R_LINEAR_____0_CM 0. 1. DISPLAY_IDENTIFIER LC_LTC_DRI_DI FORMAT "%1.0" /end CHARACTERISTIC
/begin CHARACTERISTIC lc_ltc_clu_di "switch LTC disabled by clutch" VALUE 0x85c334 _REC_VAL_20_u1 1. _CNV_A_R_LINEAR_____0_CM 0. 1. DISPLAY_IDENTIFIER LC_LTC_CLU_DI FORMAT "%1.0" /end CHARACTERISTIC
/begin CHARACTERISTIC lc_ltc_is_ovs "switch idle speed request oversteer" VALUE 0x85c336 _REC_VAL_20_u1 1. _CNV_A_R_LINEAR_____0_CM 0. 1. DISPLAY_IDENTIFIER LC_LTC_IS_OVS FORMAT "%1.0" /end CHARACTERISTIC
/begin CHARACTERISTIC c_n_32_ltc_max "maximal engine speed LTC active" VALUE 0x85bf80 _REC_VAL_20_u1 8160. _CNV_A_R_LINEAR_____58_CM 0. 8160. DISPLAY_IDENTIFIER C_N_32_LTC_MAX FORMAT "%4.0" /end CHARACTERISTIC
/begin MEASUREMENT tq_tcs_req "" SWORD _CNV_A_R_LINEAR_____62_CM 1 0. -1024. 1023.96875 DISPLAY_IDENTIFIER TQ_TCS_REQ ECU_ADDRESS 0x7fa24c BYTE_ORDER MSB_LAST FORMAT "%7.2" /end MEASUREMENT
/begin MEASUREMENT lv_tcs_plaus "" UBYTE _CNV_S_2_RANGE______11_CM 1 0. 0. 1. DISPLAY_IDENTIFIER LV_TCS_PLAUS ECU_ADDRESS 0x7fb7f6 /end MEASUREMENT
/begin MEASUREMENT lv_tq_tcs_req_dec "" UBYTE _CNV_S_2_RANGE______11_CM 1 0. 0. 1. DISPLAY_IDENTIFIER LV_TQ_TCS_REQ_DEC ECU_ADDRESS 0x7fb7f5 /end MEASUREMENT
/begin MEASUREMENT tq_lgrd_neg_diag_tcs "" SWORD _CNV_A_R_LINEAR_____92_CM 1 0. -1024. 1023.96875 DISPLAY_IDENTIFIER TQ_LGRD_NEG_DIAG_TCS ECU_ADDRESS 0x7fa24e BYTE_ORDER MSB_LAST FORMAT "%7.2" /end MEASUREMENT
/begin MEASUREMENT tq_lgrd_pos_diag_tcs "" SWORD _CNV_A_R_LINEAR_____92_CM 1 0. -1024. 1023.96875 DISPLAY_IDENTIFIER TQ_LGRD_POS_DIAG_TCS ECU_ADDRESS 0x7fa250 BYTE_ORDER MSB_LAST FORMAT "%7.2" /end MEASUREMENT
/begin MEASUREMENT lv_req_tcs "" UBYTE _CNV_S_2_RANGE______11_CM 1 0. 0. 1. DISPLAY_IDENTIFIER LV_REQ_TCS ECU_ADDRESS 0x7fbbcd /end MEASUREMENT
/begin MEASUREMENT lv_tq_tcs_req_inc "" UBYTE _CNV_S_2_RANGE______11_CM 1 0. 0. 1. DISPLAY_IDENTIFIER LV_TQ_TCS_REQ_INC ECU_ADDRESS 0x7fb7f4 /end MEASUREMENT
/begin CHARACTERISTIC c_lgrd_tq_neg_diag_tcs "" VALUE 0x84849c _REC_VAL_20_s2 1024. _CNV_A_R_LINEAR_____92_CM -1024. 0. DISPLAY_IDENTIFIER C_LGRD_TQ_NEG_DIAG_TCS FORMAT "%7.2" /end CHARACTERISTIC
/begin CHARACTERISTIC c_lgrd_tq_pos_diag_tcs "" VALUE 0x84849e _REC_VAL_20_s2 1023.96875 _CNV_A_R_LINEAR_____92_CM 0. 1023.96875 DISPLAY_IDENTIFIER C_LGRD_TQ_POS_DIAG_TCS FORMAT "%7.2" /end CHARACTERISTIC
/begin MEASUREMENT lv_etcu_ena "logical variable for gearshift intervention enabling" UBYTE _CNV_S_2_RANGE______11_CM 1 0. 0. 1. DISPLAY_IDENTIFIER LV_ETCU_ENA ECU_ADDRESS 0x7fbbac /end MEASUREMENT
/begin MEASUREMENT lv_t_lim_etcu "time limitation enabled" UBYTE _CNV_S_2_RANGE______11_CM 1 0. 0. 1. DISPLAY_IDENTIFIER LV_T_LIM_ETCU ECU_ADDRESS 0x7fbbad /end MEASUREMENT
/begin MEASUREMENT lv_tq_inc_sum_etcu "limit of inc. tq integral" UBYTE _CNV_S_2_RANGE______11_CM 1 0. 0. 1. DISPLAY_IDENTIFIER LV_TQ_INC_SUM_ETCU ECU_ADDRESS 0x7fbbae /end MEASUREMENT
/begin MEASUREMENT tq_inc_sum_etcu "integral of increasing torque" UWORD _CNV_A_R_LINEAR_____93_CM 1 0. 0. 16383.75 DISPLAY_IDENTIFIER TQ_INC_SUM_ETCU ECU_ADDRESS 0x7fb0dc BYTE_ORDER MSB_LAST FORMAT "%6.1" /end MEASUREMENT
/begin MEASUREMENT lv_tq_etcu_req_dec "LV_TQ_ETCU_REQ_DEC" UBYTE _CNV_S_2_RANGE______11_CM 1 0. 0. 1. DISPLAY_IDENTIFIER LV_TQ_ETCU_REQ_DEC ECU_ADDRESS 0x7fbbaf /end MEASUREMENT
/begin MEASUREMENT lv_tq_etcu_req_inc "LV_TQ_ETCU_REQ_INC" UBYTE _CNV_S_2_RANGE______11_CM 1 0. 0. 1. DISPLAY_IDENTIFIER LV_TQ_ETCU_REQ_INC ECU_ADDRESS 0x7fbbb0 /end MEASUREMENT
/begin MEASUREMENT lv_etcu_inc_lih "increase demand incl. limp home" UBYTE _CNV_S_2_RANGE______11_CM 1 0. 0. 1. DISPLAY_IDENTIFIER LV_ETCU_INC_LIH ECU_ADDRESS 0x7fb7eb /end MEASUREMENT
/begin MEASUREMENT lv_etcu_dec_lih "decrease demand incl. limp home" UBYTE _CNV_S_2_RANGE______11_CM 1 0. 0. 1. DISPLAY_IDENTIFIER LV_ETCU_DEC_LIH ECU_ADDRESS 0x7fb7ec /end MEASUREMENT
/begin MEASUREMENT tq_req_etcu_lih "Torque request incl. limp home" SWORD _CNV_A_R_LINEAR_____62_CM 1 0. -1024. 1023.96875 DISPLAY_IDENTIFIER TQ_REQ_ETCU_LIH ECU_ADDRESS 0x7fb0de BYTE_ORDER MSB_LAST FORMAT "%6.2" /end MEASUREMENT
/begin MEASUREMENT lv_etcu_hold "LV_ETCU_HOLD" UBYTE _CNV_S_2_RANGE______11_CM 1 0. 0. 1. DISPLAY_IDENTIFIER LV_ETCU_HOLD ECU_ADDRESS 0x7fbbb1 /end MEASUREMENT
/begin MEASUREMENT lv_etcu_ramp "LV_ETCU_RAMP" UBYTE _CNV_S_2_RANGE______11_CM 1 0. 0. 1. DISPLAY_IDENTIFIER LV_ETCU_RAMP ECU_ADDRESS 0x7fbbb2 /end MEASUREMENT
/begin MEASUREMENT t_etcu_hold "T_ETCU_HOLD" UWORD _CNV_A_R_LINEAR_____59_CM 1 0. 0. 655.35 DISPLAY_IDENTIFIER T_ETCU_HOLD ECU_ADDRESS 0x7fb0e0 BYTE_ORDER MSB_LAST FORMAT "%5.2" /end MEASUREMENT
/begin MEASUREMENT tq_etcu_inter "TQ_ETCU_INTER" SWORD _CNV_A_R_LINEAR_____62_CM 1 0. -1024. 1023.96875 DISPLAY_IDENTIFIER TQ_ETCU_INTER ECU_ADDRESS 0x7fb0e2 BYTE_ORDER MSB_LAST FORMAT "%6.2" /end MEASUREMENT
/begin MEASUREMENT tq_etcu_dif "torque reduction for gearshift intervention" SWORD _CNV_A_R_LINEAR_____62_CM 1 0. -1024. 1023.96875 DISPLAY_IDENTIFIER TQ_ETCU_DIF ECU_ADDRESS 0x7fa214 BYTE_ORDER MSB_LAST FORMAT "%6.2" /end MEASUREMENT
/begin MEASUREMENT n_sp_amt "engine speed setpoint for ETCU" UWORD _CNV_A_R_LINEAR_____5_CM 1 0. 0. 6375. DISPLAY_IDENTIFIER N_SP_AMT ECU_ADDRESS 0x7fa216 BYTE_ORDER MSB_LAST FORMAT "%4.0" /end MEASUREMENT
/begin MEASUREMENT lv_amt_act "N-control demand for ETCU" UBYTE _CNV_S_2_RANGE______11_CM 1 0. 0. 1. DISPLAY_IDENTIFIER LV_AMT_ACT ECU_ADDRESS 0x7fb7e9 /end MEASUREMENT
/begin MEASUREMENT lv_tq_etcu_act "ETCU intervention active" UBYTE _CNV_S_2_RANGE______11_CM 1 0. 0. 1. DISPLAY_IDENTIFIER LV_TQ_ETCU_ACT ECU_ADDRESS 0x7fb7ea /end MEASUREMENT
/begin MEASUREMENT lv_tq_etcu_req_min "LV_ETCU_REQ_MIN" UBYTE _CNV_S_2_RANGE______11_CM 1 0. 0. 1. DISPLAY_IDENTIFIER LV_TQ_ETCU_REQ_MIN ECU_ADDRESS 0x7fb7ed /end MEASUREMENT
/begin MEASUREMENT lv_tq_etcu_req_max "LV_ETCU_REQ_MAX" UBYTE _CNV_S_2_RANGE______11_CM 1 0. 0. 1. DISPLAY_IDENTIFIER LV_TQ_ETCU_REQ_MAX ECU_ADDRESS 0x7fb7ee /end MEASUREMENT
/begin MEASUREMENT lv_etcu_inc "increasing or N-controlled ETCU intervention active and not in limp home mode" UBYTE _CNV_S_2_RANGE______11_CM 1 0. 0. 1. DISPLAY_IDENTIFIER LV_ETCU_INC ECU_ADDRESS 0x7fb7ef /end MEASUREMENT
/begin MEASUREMENT lv_etcu_ena_lih "LV_ETCU_ENA_LIH" UBYTE _CNV_S_2_RANGE______11_CM 1 0. 0. 1. DISPLAY_IDENTIFIER LV_ETCU_ENA_LIH ECU_ADDRESS 0x7fbbb3 /end MEASUREMENT
/begin MEASUREMENT lv_etcu_ramp_end "LV_ETCU_RAMP_END" UBYTE _CNV_S_2_RANGE______11_CM 1 0. 0. 1. DISPLAY_IDENTIFIER LV_ETCU_RAMP_END ECU_ADDRESS 0x7fbbb4 /end MEASUREMENT
/begin MEASUREMENT tqi_egs_sub "TQI_EGS_SUB" SWORD _CNV_A_R_LINEAR_____62_CM 1 0. -1024. 1023.96875 DISPLAY_IDENTIFIER TQI_EGS_SUB ECU_ADDRESS 0x7fa212 BYTE_ORDER MSB_LAST FORMAT "%6.2" /end MEASUREMENT
/begin MEASUREMENT tq_egs_sub "TQ_EGS_SUB" SWORD _CNV_A_R_LINEAR_____62_CM 1 0. -1024. 1023.96875 DISPLAY_IDENTIFIER TQ_EGS_SUB ECU_ADDRESS 0x7fa210 BYTE_ORDER MSB_LAST FORMAT "%6.2" /end MEASUREMENT
/begin MEASUREMENT lv_t_etcu_max "LV_T_ETCU_MAX" UBYTE _CNV_S_2_RANGE______11_CM 1 0. 0. 1. DISPLAY_IDENTIFIER LV_T_ETCU_MAX ECU_ADDRESS 0x7fb7f0 /end MEASUREMENT
/begin MEASUREMENT t_etcu "T_ETCU" UWORD _CNV_A_R_LINEAR_____59_CM 1 0. 0. 655.35 DISPLAY_IDENTIFIER T_ETCU ECU_ADDRESS 0x7fb0e4 BYTE_ORDER MSB_LAST FORMAT "%5.2" /end MEASUREMENT
/begin MEASUREMENT lv_t_etcu_inc_max "LV_T_ETCU_INC_MAX" UBYTE _CNV_S_2_RANGE______11_CM 1 0. 0. 1. DISPLAY_IDENTIFIER LV_T_ETCU_INC_MAX ECU_ADDRESS 0x7fbbb5 /end MEASUREMENT
/begin MEASUREMENT lv_etcu_inc_inh "LV_ETCU_INC_INH" UBYTE _CNV_S_2_RANGE______11_CM 1 0. 0. 1. DISPLAY_IDENTIFIER LV_ETCU_INC_INH ECU_ADDRESS 0x7fbbb6 /end MEASUREMENT
/begin MEASUREMENT lv_tq_inc_shift "LV_TQ_INC_SHIFT" UBYTE _CNV_S_2_RANGE______11_CM 1 0. 0. 1. DISPLAY_IDENTIFIER LV_TQ_INC_SHIFT ECU_ADDRESS 0x7fbbb7 /end MEASUREMENT
/begin MEASUREMENT t_etcu_inc "T_ETCU_INC" UWORD _CNV_A_R_LINEAR_____59_CM 1 0. 0. 655.35 DISPLAY_IDENTIFIER T_ETCU_INC ECU_ADDRESS 0x7fb0e6 BYTE_ORDER MSB_LAST FORMAT "%5.2" /end MEASUREMENT
/begin MEASUREMENT lv_cmd_inh_etcu "command for ETCU inhibit" UBYTE _CNV_S_2_RANGE______11_CM 1 0. 0. 1. DISPLAY_IDENTIFIER LV_CMD_INH_ETCU ECU_ADDRESS 0x7fbbb8 /end MEASUREMENT
/begin MEASUREMENT lv_req_shift "shifting process request" UBYTE _CNV_S_2_RANGE______11_CM 1 0. 0. 1. DISPLAY_IDENTIFIER LV_REQ_SHIFT ECU_ADDRESS 0x7fbbb9 /end MEASUREMENT
/begin MEASUREMENT dri_old_etcu "Gear before shifting process" UBYTE _CNV_A_R_LINEAR_____0_CM 1 0. 0. 6. DISPLAY_IDENTIFIER DRI_OLD_ETCU ECU_ADDRESS 0x7fbba8 FORMAT "%1.0" /end MEASUREMENT
/begin MEASUREMENT dri_new_etcu "Gear after shifting process" UBYTE _CNV_A_R_LINEAR_____0_CM 1 0. 0. 6. DISPLAY_IDENTIFIER DRI_NEW_ETCU ECU_ADDRESS 0x7fbba9 FORMAT "%1.0" /end MEASUREMENT
/begin MEASUREMENT t_max_etcu "max. time for shifting process" UWORD _CNV_A_R_LINEAR_____59_CM 1 0. 0. 655.35 DISPLAY_IDENTIFIER T_MAX_ETCU ECU_ADDRESS 0x7fb0e8 BYTE_ORDER MSB_LAST FORMAT "%5.2" /end MEASUREMENT
/begin CHARACTERISTIC lc_etcu_di_is "switch ETCU disabled by LV_IS" VALUE 0x85c324 _REC_VAL_20_u1 1. _CNV_A_R_LINEAR_____0_CM 0. 1. DISPLAY_IDENTIFIER LC_ETCU_DI_IS FORMAT "%1.0" /end CHARACTERISTIC
/begin CHARACTERISTIC lc_t_max_inh_etcu "switch ETCU time limit inhibit" VALUE 0x85c365 _REC_VAL_20_u1 1. _CNV_A_R_LINEAR_____0_CM 0. 1. DISPLAY_IDENTIFIER LC_T_MAX_INH_ETCU FORMAT "%1.0" /end CHARACTERISTIC
/begin CHARACTERISTIC c_tq_inc_sum_max_etcu "C_TQ_INC_SUM_MAX_ETCU" VALUE 0x85c1c8 _REC_VAL_20_u2 16383.75 _CNV_A_R_LINEAR_____93_CM 0. 16383.75 DISPLAY_IDENTIFIER C_TQ_INC_SUM_MAX_ETCU FORMAT "%6.1" /end CHARACTERISTIC
/begin CHARACTERISTIC c_t_dly_diag_etcu_dec "delay time for ramp activation at decreasing" VALUE 0x85c0ac _REC_VAL_20_u2 655.35 _CNV_A_R_LINEAR_____59_CM 0. 655.35 DISPLAY_IDENTIFIER C_T_DLY_DIAG_ETCU_DEC FORMAT "%5.2" /end CHARACTERISTIC
/begin CHARACTERISTIC c_lgrd_tqi_neg_diag_etcu "Decrementation step for TQ_ETCU_INTER at ERROR" VALUE 0x85beb4 _REC_VAL_20_s2 1024. _CNV_A_R_LINEAR_____92_CM -1024. 0. DISPLAY_IDENTIFIER C_LGRD_TQI_NEG_DIAG_ETCU FORMAT "%3.2" /end CHARACTERISTIC
/begin CHARACTERISTIC c_lgrd_tqi_pos_diag_etcu "Incrementation step for TQ_ETCU_INTER at ERROR" VALUE 0x85beb8 _REC_VAL_20_u2 1023.96875 _CNV_A_R_LINEAR_____92_CM 0. 1023.96875 DISPLAY_IDENTIFIER C_LGRD_TQI_POS_DIAG_ETCU FORMAT "%6.2" /end CHARACTERISTIC
/begin CHARACTERISTIC c_lgrd_tqi_neg_inh_etcu "Decrementation step for TQ_ETCU_INTER at inhibit" VALUE 0x85beb6 _REC_VAL_20_s2 1024. _CNV_A_R_LINEAR_____92_CM -1024. 0. DISPLAY_IDENTIFIER C_LGRD_TQI_NEG_INH_ETCU FORMAT "%3.2" /end CHARACTERISTIC
/begin CHARACTERISTIC c_lgrd_tqi_pos_inh_etcu "Incrementation step for TQ_ETCU_INTER at inhibit" VALUE 0x85beba _REC_VAL_20_u2 1023.96875 _CNV_A_R_LINEAR_____92_CM 0. 1023.96875 DISPLAY_IDENTIFIER C_LGRD_TQI_POS_INH_ETCU FORMAT "%6.2" /end CHARACTERISTIC
/begin CHARACTERISTIC c_tq_dif_tol_etcu "max. allowed torque for differerential torque intervention" VALUE 0x85c1c6 _REC_VAL_20_u2 1023.96875 _CNV_A_R_LINEAR_____62_CM 0. 1023.96875 DISPLAY_IDENTIFIER C_TQ_DIF_TOL_ETCU FORMAT "%6.2" /end CHARACTERISTIC
/begin CHARACTERISTIC c_tq_dif_bol_etcu "min. allowed torque for differential torque intervention" VALUE 0x85c1c4 _REC_VAL_20_s2 1024. _CNV_A_R_LINEAR_____62_CM -1024. 0. DISPLAY_IDENTIFIER C_TQ_DIF_BOL_ETCU FORMAT "%3.2" /end CHARACTERISTIC
/begin CHARACTERISTIC c_t_max_tq_inc_etcu "C_T_MAX_TQ_INC_ETCU" VALUE 0x85c0f6 _REC_VAL_20_u2 655.35 _CNV_A_R_LINEAR_____59_CM 0. 655.35 DISPLAY_IDENTIFIER C_T_MAX_TQ_INC_ETCU FORMAT "%5.2" /end CHARACTERISTIC
/begin CHARACTERISTIC lc_t_max_etcu_rst "switch shifting process timer reset" VALUE 0x85c364 _REC_VAL_20_u1 1. _CNV_A_R_LINEAR_____0_CM 0. 1. DISPLAY_IDENTIFIER LC_T_MAX_ETCU_RST FORMAT "%1.0" /end CHARACTERISTIC
/begin CHARACTERISTIC id_t_max_dri__dri_old__dri_new "TQETCU: ID_T_MAX_DRI" MAP 0x848eaa _REC_MAP_20_u2_u1_u1 655.35 _CNV_A_R_LINEAR_____59_CM 0. 655.35 DISPLAY_IDENTIFIER ID_T_MAX_DRI__DRI_OLD__DRI_NEW FORMAT "%5.2"
 /begin AXIS_DESCR COM_AXIS dri_old_etcu _CNV_A_R_LINEAR_____0_CM 7 0. 6. FORMAT "%1.0" AXIS_PTS_REF ldp_dri_old_etcu_id_t_max_dri /end AXIS_DESCR
 /begin AXIS_DESCR COM_AXIS dri_new_etcu _CNV_A_R_LINEAR_____0_CM 7 0. 6. FORMAT "%1.0" AXIS_PTS_REF ldp_dri_new_etcu_id_t_max_dri /end AXIS_DESCR
/end CHARACTERISTIC
/begin AXIS_PTS ldp_dri_old_etcu_id_t_max_dri "" 0x8415fa dri_old_etcu _REC_AXS_20_u1 6. _CNV_A_R_LINEAR_____0_CM 7 0. 6. FORMAT "%1.0" /end AXIS_PTS
/begin AXIS_PTS ldp_dri_new_etcu_id_t_max_dri "" 0x8415f2 dri_new_etcu _REC_AXS_20_u1 6. _CNV_A_R_LINEAR_____0_CM 7 0. 6. FORMAT "%1.0" /end AXIS_PTS
/begin MEASUREMENT tq_dif_aj "o v" SWORD _CNV_A_R_LINEAR_____62_CM 1 0. -1024. 1023.96875 DISPLAY_IDENTIFIER TQ_DIF_AJ ECU_ADDRESS 0x7f9712 BYTE_ORDER MSB_LAST FORMAT "%6.2" /end MEASUREMENT
/begin MEASUREMENT lv_req_aj "o v" UBYTE _CNV_S_2_RANGE______11_CM 1 0. 0. 1. DISPLAY_IDENTIFIER LV_REQ_AJ ECU_ADDRESS 0x7fb313 /end MEASUREMENT
/begin MEASUREMENT lv_act_aj "o v" UBYTE _CNV_S_2_RANGE______11_CM 1 0. 0. 1. DISPLAY_IDENTIFIER LV_ACT_AJ ECU_ADDRESS 0x7fb314 /end MEASUREMENT
/begin CHARACTERISTIC lc_lpf_2_aj_off "" VALUE 0x85c331 _REC_VAL_20_u1 1. _CNV_A_R_LINEAR_____0_CM 0. 1. DISPLAY_IDENTIFIER LC_LPF_2_AJ_OFF FORMAT "%1.0" /end CHARACTERISTIC
/begin CHARACTERISTIC lc_lpf_aj_on "" VALUE 0x85c333 _REC_VAL_20_u1 1. _CNV_A_R_LINEAR_____0_CM 0. 1. DISPLAY_IDENTIFIER LC_LPF_AJ_ON FORMAT "%1.0" /end CHARACTERISTIC
/begin CHARACTERISTIC lc_lpf_3_aj_off "" VALUE 0x85c332 _REC_VAL_20_u1 1. _CNV_A_R_LINEAR_____0_CM 0. 1. DISPLAY_IDENTIFIER LC_LPF_3_AJ_OFF FORMAT "%1.0" /end CHARACTERISTIC
/begin CHARACTERISTIC c_n_min_aj "" VALUE 0x85bfb8 _REC_VAL_20_u2 6375. _CNV_A_R_LINEAR_____5_CM 0. 6375. DISPLAY_IDENTIFIER C_N_MIN_AJ FORMAT "%4.0" /end CHARACTERISTIC
/begin CHARACTERISTIC c_n_max_aj "" VALUE 0x85bf98 _REC_VAL_20_u2 6375. _CNV_A_R_LINEAR_____5_CM 0. 6375. DISPLAY_IDENTIFIER C_N_MAX_AJ FORMAT "%4.0" /end CHARACTERISTIC
/begin CHARACTERISTIC lc_aj_on "" VALUE 0x85c2f1 _REC_VAL_20_u1 1. _CNV_A_R_LINEAR_____0_CM 0. 1. DISPLAY_IDENTIFIER LC_AJ_ON FORMAT "%1.0" /end CHARACTERISTIC
/begin CHARACTERISTIC lc_aj_is_ovs "" VALUE 0x85c2f0 _REC_VAL_20_u1 1. _CNV_A_R_LINEAR_____0_CM 0. 1. DISPLAY_IDENTIFIER LC_AJ_IS_OVS FORMAT "%1.0" /end CHARACTERISTIC
/begin CHARACTERISTIC c_t_act_max_aj "" VALUE 0x85c07a _REC_VAL_20_u2 4.19424 _CNV_A_R_LINEAR_____67_CM 0. 4.19424 DISPLAY_IDENTIFIER C_T_ACT_MAX_AJ FORMAT "%6.5" /end CHARACTERISTIC
/begin CHARACTERISTIC id_frq_cut_aj__dri "TQ_AJ: cut-off frequency of the low pass filter" CURVE 0x84898a _REC_CUR_20_u2_u1 65.535 _CNV_A_R_LINEAR_____94_CM 0. 65.535 DISPLAY_IDENTIFIER ID_FRQ_CUT_AJ__DRI FORMAT "%5.3"
 /begin AXIS_DESCR COM_AXIS dri _CNV_A_R_LINEAR_____0_CM 7 0. 6. FORMAT "%1.0" AXIS_PTS_REF ldpm_dri_aj /end AXIS_DESCR
/end CHARACTERISTIC
/begin AXIS_PTS ldpm_dri_aj "" 0x84344c dri _REC_AXS_20_u1 6. _CNV_A_R_LINEAR_____0_CM 7 0. 6. FORMAT "%1.0" /end AXIS_PTS
/begin MEASUREMENT tq_dif "torque intervention of anti jerk or shifting in process" SWORD _CNV_A_R_LINEAR_____62_CM 1 0. -1024. 1023.96875 DISPLAY_IDENTIFIER TQ_DIF ECU_ADDRESS 0x7fb116 BYTE_ORDER MSB_LAST FORMAT "%6.2" /end MEASUREMENT
/begin MEASUREMENT lv_gs_dif_act "logical variable for active torque reduction for shifting in process" UBYTE _CNV_S_2_RANGE______11_CM 1 0. 0. 1. DISPLAY_IDENTIFIER LV_GS_DIF_ACT ECU_ADDRESS 0x7fb7f3 /end MEASUREMENT
/begin MEASUREMENT tqi_sp "Setpoint indicated engine torque" SWORD _CNV_A_R_LINEAR_____62_CM 1 0. -1024. 1023.96875 DISPLAY_IDENTIFIER TQI_SP ECU_ADDRESS 0x7fa246 BYTE_ORDER MSB_LAST FORMAT "%6.2" /end MEASUREMENT
/begin MEASUREMENT tq_sp_clu "torque at clutch setpoint" SWORD _CNV_A_R_LINEAR_____62_CM 1 0. -1024. 1023.96875 DISPLAY_IDENTIFIER TQ_SP_CLU ECU_ADDRESS 0x7fa248 BYTE_ORDER MSB_LAST FORMAT "%6.2" /end MEASUREMENT
/begin MEASUREMENT tqi_sp_grd "Gradient setpoint torque" SWORD _CNV_A_R_LINEAR_____95_CM 1 0. -1024. 1023.96875 DISPLAY_IDENTIFIER TQI_SP_GRD ECU_ADDRESS 0x7fa24a BYTE_ORDER MSB_LAST FORMAT "%6.2" /end MEASUREMENT
/begin CHARACTERISTIC c_t_egs_dly "delay for shifting in torque reduction" VALUE 0x85c0cc _REC_VAL_20_u1 2550. _CNV_A_R_LINEAR_____96_CM 0. 2550. DISPLAY_IDENTIFIER C_T_EGS_DLY FORMAT "%4.0" /end CHARACTERISTIC
/begin CHARACTERISTIC lc_tqi_slm_act "switch for high priority smoke limitation" VALUE 0x85c379 _REC_VAL_20_u1 1. _CNV_A_R_LINEAR_____0_CM 0. 1. DISPLAY_IDENTIFIER LC_TQI_SLM_ACT FORMAT "%1.0" /end CHARACTERISTIC
/begin CHARACTERISTIC lc_tqi_max_act "switch for high priority torque limitation" VALUE 0x85c378 _REC_VAL_20_u1 1. _CNV_A_R_LINEAR_____0_CM 0. 1. DISPLAY_IDENTIFIER LC_TQI_MAX_ACT FORMAT "%1.0" /end CHARACTERISTIC
/begin CHARACTERISTIC ip_tq_add_lim2__n "TQI_SP: torque offset for anti jerk limitation" CURVE 0x85b102 _REC_CUR_20_u2_u2 2047.96875 _CNV_A_R_LINEAR_____89_CM -1024. 1023.96875 DISPLAY_IDENTIFIER IP_TQ_ADD_LIM2__N FORMAT "%6.2"
 /begin AXIS_DESCR COM_AXIS n _CNV_A_R_LINEAR_____5_CM 6 0. 6375. FORMAT "%4.0" AXIS_PTS_REF ldp_n_ip_tq_add_lim2 /end AXIS_DESCR
/end CHARACTERISTIC
/begin AXIS_PTS ldp_n_ip_tq_add_lim2 "" 0x842340 n _REC_AXS_20_u2 6375. _CNV_A_R_LINEAR_____5_CM 6 0. 6375. FORMAT "%4.0" /end AXIS_PTS
/begin MEASUREMENT tqi_tar "Target indicated torque without LTC and AJ" SWORD _CNV_A_R_LINEAR_____62_CM 1 0. -1024. 1023.96875 DISPLAY_IDENTIFIER TQI_TAR ECU_ADDRESS 0x7fa234 BYTE_ORDER MSB_LAST FORMAT "%6.2" /end MEASUREMENT
/begin MEASUREMENT tqi_req_egr "Driver request without LTC, AJ and smoke limitation" SWORD _CNV_A_R_LINEAR_____62_CM 1 0. -1024. 1023.96875 DISPLAY_IDENTIFIER TQI_REQ_EGR ECU_ADDRESS 0x7fa236 BYTE_ORDER MSB_LAST FORMAT "%6.2" /end MEASUREMENT
/begin MEASUREMENT tqi_grd_tar "Target indicated torque without LTC and AJ gradient" SWORD _CNV_A_R_LINEAR_____97_CM 1 0. -32768. 32767. DISPLAY_IDENTIFIER TQI_GRD_TAR ECU_ADDRESS 0x7fa238 BYTE_ORDER MSB_LAST FORMAT "%5.0" /end MEASUREMENT
/begin MEASUREMENT tqi_grd_req_egr "Driver request without LTC, AJ and smoke limitation gradient" SWORD _CNV_A_R_LINEAR_____97_CM 1 0. -32768. 32767. DISPLAY_IDENTIFIER TQI_GRD_REQ_EGR ECU_ADDRESS 0x7fa23a BYTE_ORDER MSB_LAST FORMAT "%5.0" /end MEASUREMENT
/begin MEASUREMENT tqi_lim_min "TQI_LIM_MIN" SWORD _CNV_A_R_LINEAR_____62_CM 1 0. -1024. 1023.96875 DISPLAY_IDENTIFIER TQI_LIM_MIN ECU_ADDRESS 0x7fa23c BYTE_ORDER MSB_LAST FORMAT "%6.2" /end MEASUREMENT
/begin MEASUREMENT tqi_lim_min1 "TQI_LIM_MIN" SWORD _CNV_A_R_LINEAR_____62_CM 1 0. -1024. 1023.96875 DISPLAY_IDENTIFIER TQI_LIM_MIN1 ECU_ADDRESS 0x7fa23e BYTE_ORDER MSB_LAST FORMAT "%6.2" /end MEASUREMENT
/begin MEASUREMENT tqi_req_fast "Indicated Torque Request" SWORD _CNV_A_R_LINEAR_____62_CM 1 0. -1024. 1023.96875 DISPLAY_IDENTIFIER TQI_REQ_FAST ECU_ADDRESS 0x7fa240 BYTE_ORDER MSB_LAST FORMAT "%6.2" /end MEASUREMENT
/begin MEASUREMENT lv_tqi_lim_act "logical variable for limitation intervention" UBYTE _CNV_S_2_RANGE______11_CM 1 0. 0. 1. DISPLAY_IDENTIFIER LV_TQI_LIM_ACT ECU_ADDRESS 0x7fb7f2 /end MEASUREMENT
/begin MEASUREMENT tq_req_fast "Torque Request at clutch" SWORD _CNV_A_R_LINEAR_____62_CM 1 0. -1024. 1023.96875 DISPLAY_IDENTIFIER TQ_REQ_FAST ECU_ADDRESS 0x7fa242 BYTE_ORDER MSB_LAST FORMAT "%6.2" /end MEASUREMENT
/begin MEASUREMENT tq_lim_min "Maximum limitation torque at clutch" SWORD _CNV_A_R_LINEAR_____62_CM 1 0. -1024. 1023.96875 DISPLAY_IDENTIFIER TQ_LIM_MIN ECU_ADDRESS 0x7fa244 BYTE_ORDER MSB_LAST FORMAT "%6.2" /end MEASUREMENT
/begin MEASUREMENT mf_tot "total fuel mass" UWORD _CNV_A_R_LINEAR_____43_CM 1 0. 0. 262.14 DISPLAY_IDENTIFIER MF_TOT ECU_ADDRESS 0x7fa1f4 BYTE_ORDER MSB_LAST /end MEASUREMENT
/begin MEASUREMENT mf_tot_grd "difference between mf_tot_new and mf_tot_old" SWORD _CNV_A_R_LINEAR_____43_CM 1 0. -131.072 131.068 DISPLAY_IDENTIFIER MF_TOT_GRD ECU_ADDRESS 0x7fa1f6 BYTE_ORDER MSB_LAST /end MEASUREMENT
/begin MEASUREMENT tqi_tql "Torque for torque limitation" SWORD _CNV_A_R_LINEAR_____62_CM 1 0. -1024. 1023.96875 DISPLAY_IDENTIFIER TQI_TQL ECU_ADDRESS 0x7f9c34 BYTE_ORDER MSB_LAST FORMAT "%6.2" /end MEASUREMENT
/begin MEASUREMENT tqi_tql_bas "Basic torque for torque limitation" SWORD _CNV_A_R_LINEAR_____62_CM 1 0. -1024. 1023.96875 DISPLAY_IDENTIFIER TQI_TQL_BAS ECU_ADDRESS 0x7fa918 BYTE_ORDER MSB_LAST FORMAT "%6.2" /end MEASUREMENT
/begin MEASUREMENT tqi_add_tql "TQL increase at start" SWORD _CNV_A_R_LINEAR_____62_CM 1 0. -1024. 1023.96875 DISPLAY_IDENTIFIER TQI_ADD_TQL ECU_ADDRESS 0x7fa91a BYTE_ORDER MSB_LAST FORMAT "%6.2" /end MEASUREMENT
/begin MEASUREMENT tqi_tql_bpr "Torque for boiling protection" SWORD _CNV_A_R_LINEAR_____62_CM 1 0. -1024. 1023.96875 DISPLAY_IDENTIFIER TQI_TQL_BPR ECU_ADDRESS 0x7fa91c BYTE_ORDER MSB_LAST FORMAT "%6.2" /end MEASUREMENT
/begin MEASUREMENT tqi_tql_amp "Torque for torque limitation from AMP" SWORD _CNV_A_R_LINEAR_____62_CM 1 0. -1024. 1023.96875 DISPLAY_IDENTIFIER TQI_TQL_AMP ECU_ADDRESS 0x7fa91e BYTE_ORDER MSB_LAST FORMAT "%6.2" /end MEASUREMENT
/begin CHARACTERISTIC lc_swi_temp_tql "switch for torque limitation temperature selection" VALUE 0x85c362 _REC_VAL_20_u1 1. _CNV_A_R_LINEAR_____0_CM 0. 1. DISPLAY_IDENTIFIER LC_SWI_TEMP_TQL FORMAT "%1.0" /end CHARACTERISTIC
/begin CHARACTERISTIC ip_tqi_tql_bas "MFTQLM: Basic torque for torque limitation" CURVE 0x85b80e _REC_CUR_20_u2_u2 2047.96875 _CNV_A_R_LINEAR_____89_CM -1024. 1023.96875 DISPLAY_IDENTIFIER IP_TQI_TQL_BAS FORMAT "%6.2"
 /begin AXIS_DESCR COM_AXIS n _CNV_A_R_LINEAR_____5_CM 20 0. 6375. FORMAT "%4.0" AXIS_PTS_REF ldpm_n_ip_tqi_bas /end AXIS_DESCR
/end CHARACTERISTIC
/begin AXIS_PTS ldpm_n_ip_tqi_bas "" 0x843d04 n _REC_AXS_20_u2 6375. _CNV_A_R_LINEAR_____5_CM 20 0. 6375. FORMAT "%4.0" /end AXIS_PTS
/begin CHARACTERISTIC ip_fac_tqi_add_tql "MFTQLM: TQL increase factor on T_AST" CURVE 0x84c86c _REC_CUR_20_u2_u2 1. _CNV_A_R_LINEAR_____80_CM 0. 1. DISPLAY_IDENTIFIER IP_FAC_TQI_ADD_TQL FORMAT "%6.5"
 /begin AXIS_DESCR COM_AXIS t_ast _CNV_A_R_LINEAR_____19_CM 4 0. 6553.5 FORMAT "%5.1" AXIS_PTS_REF ldp_t_ast_ip_fac_tqi_add_tql /end AXIS_DESCR
/end CHARACTERISTIC
/begin AXIS_PTS ldp_t_ast_ip_fac_tqi_add_tql "" 0x842612 t_ast _REC_AXS_20_u2 6553.5 _CNV_A_R_LINEAR_____19_CM 4 0. 6553.5 FORMAT "%5.1" /end AXIS_PTS
/begin CHARACTERISTIC ip_fac_tqi_tql_bpr "MFTQLM: vehicle speed correction boiling protection" CURVE 0x84c87c _REC_CUR_20_u1_u1 3.984375 _CNV_A_R_LINEAR_____98_CM 0. 3.984375 DISPLAY_IDENTIFIER IP_FAC_TQI_TQL_BPR FORMAT "%3.2"
 /begin AXIS_DESCR COM_AXIS vs _CNV_A_R_LINEAR_____39_CM 6 0. 255. FORMAT "%3.0" AXIS_PTS_REF ldp_vs_ip_fac_tqi_tql_bpr /end AXIS_DESCR
/end CHARACTERISTIC
/begin AXIS_PTS ldp_vs_ip_fac_tqi_tql_bpr "" 0x8433be vs _REC_AXS_20_u1 255. _CNV_A_R_LINEAR_____39_CM 6 0. 255. FORMAT "%3.0" /end AXIS_PTS
/begin CHARACTERISTIC ip_fac_tqi_tql_amp "MFTQLM: TIA correction for ambient pressure torque limitation" CURVE 0x84c874 _REC_CUR_20_u1_u1 3.984375 _CNV_A_R_LINEAR_____98_CM 0. 3.984375 DISPLAY_IDENTIFIER IP_FAC_TQI_TQL_AMP FORMAT "%3.2"
 /begin AXIS_DESCR COM_AXIS tia _CNV_A_R_LINEAR_____18_CM 8 -50. 205. FORMAT "%3.0" AXIS_PTS_REF ldp_tia_ip_fac_tqi_tql_amp /end AXIS_DESCR
/end CHARACTERISTIC
/begin AXIS_PTS ldp_tia_ip_fac_tqi_tql_amp "" 0x842a25 tia _REC_AXS_20_u1 255. _CNV_A_R_LINEAR_____18_CM 8 -50. 205. FORMAT "%3.0" /end AXIS_PTS
/begin CHARACTERISTIC ip_tqi_add_tql_st "MFTQLM: TQL increase for start" MAP 0x85b4d6 _REC_MAP_20_u2_u2_u1 2047.96875 _CNV_A_R_LINEAR_____89_CM -1024. 1023.96875 DISPLAY_IDENTIFIER IP_TQI_ADD_TQL_ST FORMAT "%6.2"
 /begin AXIS_DESCR COM_AXIS n _CNV_A_R_LINEAR_____5_CM 6 0. 6375. FORMAT "%4.0" AXIS_PTS_REF ldp_n_ip_tqi_add_tql /end AXIS_DESCR
 /begin AXIS_DESCR COM_AXIS tco _CNV_A_R_LINEAR_____18_CM 8 -50. 205. FORMAT "%3.0" AXIS_PTS_REF ldp_tco_ip_tqi_tql /end AXIS_DESCR
/end CHARACTERISTIC
/begin AXIS_PTS ldp_n_ip_tqi_add_tql "" 0x84234e n _REC_AXS_20_u2 6375. _CNV_A_R_LINEAR_____5_CM 6 0. 6375. FORMAT "%4.0" /end AXIS_PTS
/begin AXIS_PTS ldp_tco_ip_tqi_tql "" 0x84286c tco _REC_AXS_20_u1 255. _CNV_A_R_LINEAR_____18_CM 8 -50. 205. FORMAT "%3.0" /end AXIS_PTS
/begin CHARACTERISTIC ip_tqi_tql_bpr "MFTQLM: boiling protection map" MAP 0x85b836 _REC_MAP_20_u2_u2_u1 2047.96875 _CNV_A_R_LINEAR_____89_CM -1024. 1023.96875 DISPLAY_IDENTIFIER IP_TQI_TQL_BPR FORMAT "%6.2"
 /begin AXIS_DESCR COM_AXIS n _CNV_A_R_LINEAR_____5_CM 6 0. 6375. FORMAT "%4.0" AXIS_PTS_REF ldp_n_ip_tqi_tql_bpr /end AXIS_DESCR
 /begin AXIS_DESCR COM_AXIS tco _CNV_A_R_LINEAR_____18_CM 8 -50. 205. FORMAT "%3.0" AXIS_PTS_REF ldp_tco_ip_tqi_tql /end AXIS_DESCR
/end CHARACTERISTIC
/begin AXIS_PTS ldp_n_ip_tqi_tql_bpr "" 0x842398 n _REC_AXS_20_u2 6375. _CNV_A_R_LINEAR_____5_CM 6 0. 6375. FORMAT "%4.0" /end AXIS_PTS
/begin CHARACTERISTIC ip_tqi_tql_amp "MFTQLM: Ambient pressure torque limitation map" MAP 0x85b7c6 _REC_MAP_20_u2_u2_u2 2047.96875 _CNV_A_R_LINEAR_____89_CM -1024. 1023.96875 DISPLAY_IDENTIFIER IP_TQI_TQL_AMP FORMAT "%6.2"
 /begin AXIS_DESCR COM_AXIS n _CNV_A_R_LINEAR_____5_CM 6 0. 6375. FORMAT "%4.0" AXIS_PTS_REF ldpm_n_ip_tqi_tql /end AXIS_DESCR
 /begin AXIS_DESCR COM_AXIS amp _CNV_A_R_LINEAR_____21_CM 6 0. 5434. FORMAT "%6.2" AXIS_PTS_REF ldp_amp_ip_tqi_tql_amp /end AXIS_DESCR
/end CHARACTERISTIC
/begin AXIS_PTS ldpm_n_ip_tqi_tql "" 0x843dfa n _REC_AXS_20_u2 6375. _CNV_A_R_LINEAR_____5_CM 6 0. 6375. FORMAT "%4.0" /end AXIS_PTS
/begin AXIS_PTS ldp_amp_ip_tqi_tql_amp "" 0x84130e amp _REC_AXS_20_u2 5434. _CNV_A_R_LINEAR_____21_CM 6 0. 5434. FORMAT "%6.2" /end AXIS_PTS
/begin MEASUREMENT t1_dt1_aj "o v" UWORD _CNV_A_R_LINEAR_____67_CM 1 0. 0. 4.19424 DISPLAY_IDENTIFIER T1_DT1_AJ ECU_ADDRESS 0x7f9714 BYTE_ORDER MSB_LAST FORMAT "%6.5" /end MEASUREMENT
/begin MEASUREMENT kr_dt1_aj "o v" SWORD _CNV_A_R_LINEAR_____134_CM 1 0. -32. 31.99902344 DISPLAY_IDENTIFIER KR_DT1_AJ ECU_ADDRESS 0x7f9716 BYTE_ORDER MSB_LAST FORMAT "%6.4" /end MEASUREMENT
/begin MEASUREMENT n_aj "o v" UWORD _CNV_A_R_LINEAR_____5_CM 1 0. 0. 6375. DISPLAY_IDENTIFIER N_AJ ECU_ADDRESS 0x7f9718 BYTE_ORDER MSB_LAST FORMAT "%4.0" /end MEASUREMENT
/begin MEASUREMENT pv_av_grd_aj "o v" UWORD _CNV_A_R_LINEAR_____81_CM 1 0. 0. 100. DISPLAY_IDENTIFIER PV_AV_GRD_AJ ECU_ADDRESS 0x7f971a BYTE_ORDER MSB_LAST FORMAT "%4.2" /end MEASUREMENT
/begin CHARACTERISTIC lc_n_pred_on_aj "" VALUE 0x85c34c _REC_VAL_20_u1 1. _CNV_A_R_LINEAR_____0_CM 0. 1. DISPLAY_IDENTIFIER LC_N_PRED_ON_AJ FORMAT "%1.0" /end CHARACTERISTIC
/begin CHARACTERISTIC c_t1_pv_av_grd_aj "" VALUE 0x85c068 _REC_VAL_20_u2 4.19424 _CNV_A_R_LINEAR_____67_CM 0. 4.19424 DISPLAY_IDENTIFIER C_T1_PV_AV_GRD_AJ FORMAT "%6.5" /end CHARACTERISTIC
/begin CHARACTERISTIC ip_fac_aj__pv_av "TQ_AJPA: reduction of anti-jerk at low pedalvalue" CURVE 0x84b912 _REC_CUR_20_u1_u2 0.99609375 _CNV_A_R_LINEAR_____34_CM 0. 0.99609375 DISPLAY_IDENTIFIER IP_FAC_AJ__PV_AV FORMAT "%4.3"
 /begin AXIS_DESCR COM_AXIS pv_av_grd_aj _CNV_A_R_LINEAR_____81_CM 3 0. 100. FORMAT "%4.2" AXIS_PTS_REF ldp_pv_av_ip_fac_aj /end AXIS_DESCR
/end CHARACTERISTIC
/begin AXIS_PTS ldp_pv_av_ip_fac_aj "" 0x8424fa pv_av_grd_aj _REC_AXS_20_u2 100. _CNV_A_R_LINEAR_____81_CM 3 0. 100. FORMAT "%4.2" /end AXIS_PTS
/begin CHARACTERISTIC ip_fac_tq_dif_aj__dri__n "TQ_AJPA: intensity of anti-jerk intervention" MAP 0x84c2bc _REC_MAP_20_u2_u1_u2 63.9990234375 _CNV_A_R_LINEAR_____135_CM -32. 31.9990234375 DISPLAY_IDENTIFIER IP_FAC_TQ_DIF_AJ__DRI__N FORMAT "%6.4"
 /begin AXIS_DESCR COM_AXIS dri _CNV_A_R_LINEAR_____0_CM 7 0. 6. FORMAT "%1.0" AXIS_PTS_REF ldpm_dri_aj /end AXIS_DESCR
 /begin AXIS_DESCR COM_AXIS n_aj _CNV_A_R_LINEAR_____5_CM 6 0. 6375. FORMAT "%4.0" AXIS_PTS_REF ldpm_n_ip_fac_aj /end AXIS_DESCR
/end CHARACTERISTIC
/begin AXIS_PTS ldpm_n_ip_fac_aj "" 0x843a40 n_aj _REC_AXS_20_u2 6375. _CNV_A_R_LINEAR_____5_CM 6 0. 6375. FORMAT "%4.0" /end AXIS_PTS
/begin CHARACTERISTIC ip_fac_tq_dif_aj_is__dri__n "TQ_AJPA: intensity of anti-jerk intervention at idle" MAP 0x84c310 _REC_MAP_20_u2_u1_u2 63.9990234375 _CNV_A_R_LINEAR_____135_CM -32. 31.9990234375 DISPLAY_IDENTIFIER IP_FAC_TQ_DIF_AJ_IS__DRI__N FORMAT "%6.4"
 /begin AXIS_DESCR COM_AXIS dri _CNV_A_R_LINEAR_____0_CM 7 0. 6. FORMAT "%1.0" AXIS_PTS_REF ldpm_dri_aj /end AXIS_DESCR
 /begin AXIS_DESCR COM_AXIS n_aj _CNV_A_R_LINEAR_____5_CM 6 0. 6375. FORMAT "%4.0" AXIS_PTS_REF ldpm_n_ip_fac_aj_is /end AXIS_DESCR
/end CHARACTERISTIC
/begin AXIS_PTS ldpm_n_ip_fac_aj_is "" 0x843a4e n_aj _REC_AXS_20_u2 6375. _CNV_A_R_LINEAR_____5_CM 6 0. 6375. FORMAT "%4.0" /end AXIS_PTS
/begin CHARACTERISTIC ip_t1_aj__dri__n "TQ_AJPA: timeconstant for both DT1-filter" MAP 0x85a98c _REC_MAP_20_u2_u1_u2 4.19424 _CNV_A_R_LINEAR_____67_CM 0. 4.19424 DISPLAY_IDENTIFIER IP_T1_AJ__DRI__N FORMAT "%6.5"
 /begin AXIS_DESCR COM_AXIS dri _CNV_A_R_LINEAR_____0_CM 7 0. 6. FORMAT "%1.0" AXIS_PTS_REF ldpm_dri_aj /end AXIS_DESCR
 /begin AXIS_DESCR COM_AXIS n_aj _CNV_A_R_LINEAR_____5_CM 6 0. 6375. FORMAT "%4.0" AXIS_PTS_REF ldpm_n_ip_fac_aj /end AXIS_DESCR
/end CHARACTERISTIC
/begin CHARACTERISTIC ip_t1_aj_is__dri__n "TQ_AJPA: timeconstant for both DT1-filter at idle" MAP 0x85a9e0 _REC_MAP_20_u2_u1_u2 4.19424 _CNV_A_R_LINEAR_____67_CM 0. 4.19424 DISPLAY_IDENTIFIER IP_T1_AJ_IS__DRI__N FORMAT "%6.5"
 /begin AXIS_DESCR COM_AXIS dri _CNV_A_R_LINEAR_____0_CM 7 0. 6. FORMAT "%1.0" AXIS_PTS_REF ldpm_dri_aj /end AXIS_DESCR
 /begin AXIS_DESCR COM_AXIS n_aj _CNV_A_R_LINEAR_____5_CM 6 0. 6375. FORMAT "%4.0" AXIS_PTS_REF ldpm_n_ip_fac_aj_is /end AXIS_DESCR
/end CHARACTERISTIC
/begin CHARACTERISTIC c_abc_inc_acp_mes_rng "" VALUE 0x8481e9 _REC_VAL_20_u1 255. _CNV_A_R_LINEAR_____0_CM 0. 255. DISPLAY_IDENTIFIER C_ABC_INC_ACP_MES_RNG FORMAT "%3.0" /end CHARACTERISTIC
/begin CHARACTERISTIC c_abc_max_acp_mes_rng "" VALUE 0x84826b _REC_VAL_20_u1 255. _CNV_A_R_LINEAR_____0_CM 0. 255. DISPLAY_IDENTIFIER C_ABC_MAX_ACP_MES_RNG FORMAT "%3.0" /end CHARACTERISTIC
/begin CHARACTERISTIC c_abc_inc_acp_mes_grd "" VALUE 0x8481e8 _REC_VAL_20_u1 255. _CNV_A_R_LINEAR_____0_CM 0. 255. DISPLAY_IDENTIFIER C_ABC_INC_ACP_MES_GRD FORMAT "%3.0" /end CHARACTERISTIC
/begin CHARACTERISTIC c_abc_max_acp_mes_grd "" VALUE 0x84826a _REC_VAL_20_u1 255. _CNV_A_R_LINEAR_____0_CM 0. 255. DISPLAY_IDENTIFIER C_ABC_MAX_ACP_MES_GRD FORMAT "%3.0" /end CHARACTERISTIC
/begin MEASUREMENT lv_err_acp_mes "Global error flag for ACP_MES" UBYTE _CNV_S_2_RANGE______11_CM 1 0. 0. 1. DISPLAY_IDENTIFIER LV_ERR_ACP_MES ECU_ADDRESS 0x7fb466 /end MEASUREMENT
/begin CHARACTERISTIC c_abc_inc_ducy_alter_pwm_rng "" VALUE 0x848209 _REC_VAL_20_u1 255. _CNV_A_R_LINEAR_____0_CM 0. 255. DISPLAY_IDENTIFIER C_ABC_INC_DUCY_ALTER_PWM_RNG FORMAT "%3.0" /end CHARACTERISTIC
/begin CHARACTERISTIC c_abc_max_ducy_alter_pwm_rng "" VALUE 0x84828b _REC_VAL_20_u1 255. _CNV_A_R_LINEAR_____0_CM 0. 255. DISPLAY_IDENTIFIER C_ABC_MAX_DUCY_ALTER_PWM_RNG FORMAT "%3.0" /end CHARACTERISTIC
/begin CHARACTERISTIC c_abc_inc_ducy_alter_pwm_grd "" VALUE 0x848208 _REC_VAL_20_u1 255. _CNV_A_R_LINEAR_____0_CM 0. 255. DISPLAY_IDENTIFIER C_ABC_INC_DUCY_ALTER_PWM_GRD FORMAT "%3.0" /end CHARACTERISTIC
/begin CHARACTERISTIC c_abc_max_ducy_alter_pwm_grd "" VALUE 0x84828a _REC_VAL_20_u1 255. _CNV_A_R_LINEAR_____0_CM 0. 255. DISPLAY_IDENTIFIER C_ABC_MAX_DUCY_ALTER_PWM_GRD FORMAT "%3.0" /end CHARACTERISTIC
/begin CHARACTERISTIC c_ducy_alter_pwm_max_diag "generator load signal maximum value" VALUE 0x85bdd6 _REC_VAL_20_u2 100. _CNV_A_R_LINEAR_____136_CM 0. 100. DISPLAY_IDENTIFIER C_DUCY_ALTER_PWM_MAX_DIAG FORMAT "%4.0" /end CHARACTERISTIC
/begin CHARACTERISTIC c_ducy_alter_pwm_min_diag "generator load signal minimum value" VALUE 0x85bdd8 _REC_VAL_20_u2 100. _CNV_A_R_LINEAR_____136_CM 0. 100. DISPLAY_IDENTIFIER C_DUCY_ALTER_PWM_MIN_DIAG FORMAT "%4.0" /end CHARACTERISTIC
/begin CHARACTERISTIC c_ducy_alter_pwm_grd_diag "threshold for error detection" VALUE 0x85bdd4 _REC_VAL_20_u2 100. _CNV_A_R_LINEAR_____136_CM 0. 100. DISPLAY_IDENTIFIER C_DUCY_ALTER_PWM_GRD_DIAG FORMAT "%4.0" /end CHARACTERISTIC
/begin MEASUREMENT lv_err_ducy_alter_pwm "" UBYTE _CNV_S_2_RANGE______28_CM 1 0. 0. 1. DISPLAY_IDENTIFIER LV_ERR_DUCY_ALTER_PWM ECU_ADDRESS 0x7fb468 /end MEASUREMENT
/begin MEASUREMENT lv_err_altpwm_mes "" UBYTE _CNV_S_2_RANGE______28_CM 1 0. 0. 1. DISPLAY_IDENTIFIER LV_ERR_ALTPWM_MES ECU_ADDRESS 0x7fb469 /end MEASUREMENT
/begin MEASUREMENT lv_err_tia_mes "Global error flag for ACP_MES" UBYTE _CNV_S_2_RANGE______11_CM 1 0. 0. 1. DISPLAY_IDENTIFIER LV_ERR_TIA_MES ECU_ADDRESS 0x7fb46b /end MEASUREMENT
/begin MEASUREMENT tqe_dif_raw "v" SWORD _CNV_A_R_LINEAR_____62_CM 1 0. -1024. 1023.96875 DISPLAY_IDENTIFIER TQE_DIF_RAW ECU_ADDRESS 0x7fb120 BYTE_ORDER MSB_LAST FORMAT "%6.2" /end MEASUREMENT
/begin MEASUREMENT tqe_fil_dif "v" SWORD _CNV_A_R_LINEAR_____62_CM 1 0. -1024. 1023.96875 DISPLAY_IDENTIFIER TQE_FIL_DIF ECU_ADDRESS 0x7fb122 BYTE_ORDER MSB_LAST FORMAT "%6.2" /end MEASUREMENT
/begin MEASUREMENT tqe_sp_raw "v" SWORD _CNV_A_R_LINEAR_____62_CM 1 0. -1024. 1023.96875 DISPLAY_IDENTIFIER TQE_SP_RAW ECU_ADDRESS 0x7fb124 BYTE_ORDER MSB_LAST FORMAT "%6.2" /end MEASUREMENT
/begin MEASUREMENT tqe_sp_clc "v" SWORD _CNV_A_R_LINEAR_____62_CM 1 0. -1024. 1023.96875 DISPLAY_IDENTIFIER TQE_SP_CLC ECU_ADDRESS 0x7fb126 BYTE_ORDER MSB_LAST FORMAT "%6.2" /end MEASUREMENT
/begin MEASUREMENT tqe_sp "o v" SWORD _CNV_A_R_LINEAR_____62_CM 1 0. -1024. 1023.96875 DISPLAY_IDENTIFIER TQE_SP ECU_ADDRESS 0x7fa258 BYTE_ORDER MSB_LAST FORMAT "%6.2" /end MEASUREMENT
/begin MEASUREMENT tqe_dif "o v" SWORD _CNV_A_R_LINEAR_____62_CM 1 0. -1024. 1023.96875 DISPLAY_IDENTIFIER TQE_DIF ECU_ADDRESS 0x7fa25a BYTE_ORDER MSB_LAST FORMAT "%6.2" /end MEASUREMENT
/begin CHARACTERISTIC lc_tqe_clc_act "" VALUE 0x85c375 _REC_VAL_20_u1 1. _CNV_A_R_LINEAR_____0_CM 0. 1. DISPLAY_IDENTIFIER LC_TQE_CLC_ACT FORMAT "%1.0" /end CHARACTERISTIC
/begin CHARACTERISTIC c_fac_tqe "" VALUE 0x85be88 _REC_VAL_20_u1 0.255 _CNV_A_R_LINEAR_____315_CM 0. 0.255 DISPLAY_IDENTIFIER C_FAC_TQE FORMAT "%4.3" /end CHARACTERISTIC
/begin CHARACTERISTIC ip_crlc_tqe_sp__tqe_fil_dif "TQE: correlation constant for filtering of the effective engine torque" CURVE 0x84a3f6 _REC_CUR_20_u2_u2 0.9999847412109381 _CNV_A_R_LINEAR_____300_CM 0. 0.9999847412109381 DISPLAY_IDENTIFIER IP_CRLC_TQE_SP__TQE_FIL_DIF FORMAT "%6.5"
 /begin AXIS_DESCR COM_AXIS tqe_fil_dif _CNV_A_R_LINEAR_____89_CM 8 -1024. 1023.96875 FORMAT "%6.2" AXIS_PTS_REF ldp_tqe_fil_dif_ip_crlc_tqe_sp /end AXIS_DESCR
/end CHARACTERISTIC
/begin AXIS_PTS ldp_tqe_fil_dif_ip_crlc_tqe_sp "" 0x842a5c tqe_fil_dif _REC_AXS_20_u2 2047.96875 _CNV_A_R_LINEAR_____89_CM 8 -1024. 1023.96875 FORMAT "%6.2" /end AXIS_PTS
/begin CHARACTERISTIC c_t_dly_diag_gs "delay time for activation of ramp function" VALUE 0x84862c _REC_VAL_20_u1 2.55 _CNV_A_R_LINEAR_____223_CM 0. 2.55 DISPLAY_IDENTIFIER C_T_DLY_DIAG_GS FORMAT "%4.2" /end CHARACTERISTIC
/begin CHARACTERISTIC c_tqi_gs_slow_hys "additional hysteresis for TQI_GS_REQ to use TQI_GS_SLOW_DEC" VALUE 0x848712 _REC_VAL_20_u1 0.498046875 _CNV_A_R_LINEAR_____334_CM 0. 0.498046875 DISPLAY_IDENTIFIER C_TQI_GS_SLOW_HYS FORMAT "%5.3" /end CHARACTERISTIC
/begin MEASUREMENT lv_tcu_disable "logical variable for disabling GS intervention due to EMS error" UBYTE _CNV_S_2_RANGE__0___88_CM 1 0. 0. 1. DISPLAY_IDENTIFIER LV_TCU_DISABLE ECU_ADDRESS 0x7fb7fd BIT_MASK 0x1 /end MEASUREMENT
/begin MEASUREMENT lv_gs_ena "logical variable for GS intervention enabling" UBYTE _CNV_S_2_RANGE__0___88_CM 1 0. 0. 1. DISPLAY_IDENTIFIER LV_GS_ENA ECU_ADDRESS 0x7fb7fe BIT_MASK 0x1 /end MEASUREMENT
/begin MEASUREMENT tqi_gs_fast_inc "torque increment for fast torque intervention during gear shift" UWORD _CNV_A_R_LINEAR_____62_CM 1 0. 0. 1023.96875 DISPLAY_IDENTIFIER TQI_GS_FAST_INC ECU_ADDRESS 0x7fa25e BYTE_ORDER MSB_LAST FORMAT "%7.2" /end MEASUREMENT
/begin MEASUREMENT tqi_gs_slow_dec "torque decrement for slow torque intervention during gear shift" UWORD _CNV_A_R_LINEAR_____62_CM 1 0. 0. 1023.96875 DISPLAY_IDENTIFIER TQI_GS_SLOW_DEC ECU_ADDRESS 0x7fa260 BYTE_ORDER MSB_LAST FORMAT "%7.2" /end MEASUREMENT
/begin MEASUREMENT tqi_gs_slow_inc "torque increment for slow torque intervention during gear shift" UWORD _CNV_A_R_LINEAR_____62_CM 1 0. 0. 1023.96875 DISPLAY_IDENTIFIER TQI_GS_SLOW_INC ECU_ADDRESS 0x7fa262 BYTE_ORDER MSB_LAST FORMAT "%7.2" /end MEASUREMENT
/begin MEASUREMENT lv_gs_dec_act "logical variable for torque intervention due to gear shift" UBYTE _CNV_S_2_RANGE__0___88_CM 1 0. 0. 1. DISPLAY_IDENTIFIER LV_GS_DEC_ACT ECU_ADDRESS 0x7fb7ff BIT_MASK 0x1 /end MEASUREMENT
/begin MEASUREMENT tqi_gs_fast_dec "torque decrement for fast torque intervention during gear shift" UWORD _CNV_A_R_LINEAR_____62_CM 1 0. 0. 1023.96875 DISPLAY_IDENTIFIER TQI_GS_FAST_DEC ECU_ADDRESS 0x7fa25c BYTE_ORDER MSB_LAST FORMAT "%7.2" /end MEASUREMENT
/begin MEASUREMENT tqi_gs_bol "Bottom limit for GS torque request to avoid engine stall" UWORD _CNV_A_R_LINEAR_____62_CM 1 0. 0. 1023.96875 DISPLAY_IDENTIFIER TQI_GS_BOL ECU_ADDRESS 0x7fa264 BYTE_ORDER MSB_LAST FORMAT "%7.2" /end MEASUREMENT
/begin CHARACTERISTIC c_lgrd_tqi_inc_diag_gs "limitation gradient for controlled reset in case of emergency operation" VALUE 0x8484a2 _REC_VAL_20_u2 1023.96875 _CNV_A_R_LINEAR_____335_CM 0. 1023.96875 DISPLAY_IDENTIFIER C_LGRD_TQI_INC_DIAG_GS FORMAT "%7.2" /end CHARACTERISTIC
/begin CHARACTERISTIC c_n_sp_is_ratio_max_gs_lim "Maximum threshold for N / N_SP_IS relation to activate TQI_GS_REQ limitation( to avoid engine stall by GS intervention)" VALUE 0x848510 _REC_VAL_20_u2 7.9998779296875 _CNV_A_R_LINEAR_____336_CM 0. 7.9998779296875 DISPLAY_IDENTIFIER C_N_SP_IS_RATIO_MAX_GS_LIM FORMAT "%6.4" /end CHARACTERISTIC
/begin AXIS_PTS ldp_n__lgrd_tqi_gs_bol "" 0x8445e2 n _REC_AXS_20_u2 8160. _CNV_A_R_LINEAR_____257_CM 4 0. 8160. FORMAT "%4.0" /end AXIS_PTS
/begin CHARACTERISTIC ip_lgrd_tqi_gs_bol "Change limitation to avoid torque jumps after activation of TQI_GS_REQ limitation" CURVE 0x846d74 _REC_CUR_20_u2_u2 1023.96875 _CNV_A_R_LINEAR_____62_CM 0. 1023.96875 DISPLAY_IDENTIFIER IP_LGRD_TQI_GS_BOL FORMAT "%7.2"
 /begin AXIS_DESCR COM_AXIS n _CNV_A_R_LINEAR_____257_CM 4 0. 8160. FORMAT "%4.0" AXIS_PTS_REF ldp_n__lgrd_tqi_gs_bol /end AXIS_DESCR
/end CHARACTERISTIC
/begin MEASUREMENT lv_msr_ena "Logical variable for MSR intervention enabling" UBYTE _CNV_S_2_RANGE__0___88_CM 1 0. 0. 1. DISPLAY_IDENTIFIER LV_MSR_ENA ECU_ADDRESS 0x7fb7dc BIT_MASK 0x1 /end MEASUREMENT
/begin CHARACTERISTIC c_vs_min_msr "Minimum vehicle speed for MSR activation (default 10 km/h)" VALUE 0x848784 _REC_VAL_20_u1 255. _CNV_A_R_LINEAR_____239_CM 0. 255. DISPLAY_IDENTIFIER C_VS_MIN_MSR FORMAT "%3.0" /end CHARACTERISTIC
/begin MEASUREMENT tqi_msr_fast "Value for fast torque intervention due to MSR" SWORD _CNV_A_R_LINEAR_____62_CM 1 0. 0. 1023.96875 DISPLAY_IDENTIFIER TQI_MSR_FAST ECU_ADDRESS 0x7fa1ec BYTE_ORDER MSB_LAST FORMAT "%7.2" /end MEASUREMENT
/begin MEASUREMENT tqi_msr_slow "Value for slow torque intervention due to MSR" SWORD _CNV_A_R_LINEAR_____62_CM 1 0. 0. 1023.96875 DISPLAY_IDENTIFIER TQI_MSR_SLOW ECU_ADDRESS 0x7fa1ee BYTE_ORDER MSB_LAST FORMAT "%7.2" /end MEASUREMENT
/begin MEASUREMENT lv_msr "Logical variable for torque intervention due to MSR" UBYTE _CNV_S_2_RANGE__0___88_CM 1 0. 0. 1. DISPLAY_IDENTIFIER LV_MSR ECU_ADDRESS 0x7fb7dd BIT_MASK 0x1 /end MEASUREMENT
/begin MEASUREMENT tq_msr_int "MSR requested torque x zeit" UWORD _CNV_A_R_LINEAR_____337_CM 1 0. 0. 655.35 DISPLAY_IDENTIFIER TQ_MSR_INT ECU_ADDRESS 0x7fa1ea BYTE_ORDER MSB_LAST FORMAT "%6.2" /end MEASUREMENT
/begin MEASUREMENT lv_msr_nplau "Bool for non plausible MSR torque request" UBYTE _CNV_S_2_RANGE__0___88_CM 1 0. 0. 1. DISPLAY_IDENTIFIER LV_MSR_NPLAU ECU_ADDRESS 0x7fb7df BIT_MASK 0x1 /end MEASUREMENT
/begin CHARACTERISTIC c_tq_msr_int_max "Theshold for MSR intervention is not plausible (default 100 Nms)" VALUE 0x848708 _REC_VAL_20_u2 655.35 _CNV_A_R_LINEAR_____337_CM 0. 655.35 DISPLAY_IDENTIFIER C_TQ_MSR_INT_MAX FORMAT "%6.2" /end CHARACTERISTIC
/begin MEASUREMENT lv_msr_ena_can_cnt "Flag for MSR CAN-counter (1= o.k.; 0 = failure)" UBYTE _CNV_S_2_RANGE__0___88_CM 1 0. 0. 1. DISPLAY_IDENTIFIER LV_MSR_ENA_CAN_CNT ECU_ADDRESS 0x7fb7e0 BIT_MASK 0x1 /end MEASUREMENT
/begin CHARACTERISTIC c_t_max_tcs1_miss "Maximum time for missing TCS1 CAN-counter message" VALUE 0x848682 _REC_VAL_20_u1 2.55 _CNV_A_R_LINEAR_____223_CM 0. 2.55 DISPLAY_IDENTIFIER C_T_MAX_TCS1_MISS FORMAT "%4.2" /end CHARACTERISTIC
/begin MEASUREMENT lv_msr_act "Logical variable for torque intervention due to MSR" UBYTE _CNV_S_2_RANGE__0___88_CM 1 0. 0. 1. DISPLAY_IDENTIFIER LV_MSR_ACT ECU_ADDRESS 0x7fb7de BIT_MASK 0x1 /end MEASUREMENT
/begin MEASUREMENT lv_tcs_disable "Logical variable for disabling TCS/MSR intervention due to EMS error" UBYTE _CNV_S_2_RANGE__0___88_CM 1 0. 0. 1. DISPLAY_IDENTIFIER LV_TCS_DISABLE ECU_ADDRESS 0x7fb7e1 BIT_MASK 0x1 /end MEASUREMENT
/begin MEASUREMENT lv_asr_ena "Logical variable for TCS intervention enabling" UBYTE _CNV_S_2_RANGE__0___88_CM 1 0. 0. 1. DISPLAY_IDENTIFIER LV_ASR_ENA ECU_ADDRESS 0x7fb7e2 BIT_MASK 0x1 /end MEASUREMENT
/begin MEASUREMENT tqi_asr_fast "Value for fast torque intervention due to ASR" SWORD _CNV_A_R_LINEAR_____62_CM 1 0. 0. 1023.96875 DISPLAY_IDENTIFIER TQI_ASR_FAST ECU_ADDRESS 0x7fa1f0 BYTE_ORDER MSB_LAST FORMAT "%7.2" /end MEASUREMENT
/begin MEASUREMENT tqi_asr_slow "Value for slow torque intervention due to ASR" SWORD _CNV_A_R_LINEAR_____62_CM 1 0. 0. 1023.96875 DISPLAY_IDENTIFIER TQI_ASR_SLOW ECU_ADDRESS 0x7fa1f2 BYTE_ORDER MSB_LAST FORMAT "%7.2" /end MEASUREMENT
/begin MEASUREMENT lv_asr "Logical variable for torque intervention due to ASR" UBYTE _CNV_S_2_RANGE__0___88_CM 1 0. 0. 1. DISPLAY_IDENTIFIER LV_ASR ECU_ADDRESS 0x7fb7e3 BIT_MASK 0x1 /end MEASUREMENT
/begin MEASUREMENT lv_asr_act "Logical variable for torque intervention due to ASR" UBYTE _CNV_S_2_RANGE__0___88_CM 1 0. 0. 1. DISPLAY_IDENTIFIER LV_ASR_ACT ECU_ADDRESS 0x7fb7e4 BIT_MASK 0x1 /end MEASUREMENT
/begin CHARACTERISTIC c_lgrd_tqi_inc_diag_asr "Limiting gradient for ASR emergency ramp function (default  1,2 Nm/20ms)" VALUE 0x8484a0 _REC_VAL_20_s2 1023.96875 _CNV_A_R_LINEAR_____338_CM 0. 1023.96875 DISPLAY_IDENTIFIER C_LGRD_TQI_INC_DIAG_ASR FORMAT "%7.2" /end CHARACTERISTIC
/begin CHARACTERISTIC c_t_dly_diag_asr "Delay time for activation of ASR emergency ramp function (default 0s)" VALUE 0x84862b _REC_VAL_20_u1 2.55 _CNV_A_R_LINEAR_____223_CM 0. 2.55 DISPLAY_IDENTIFIER C_T_DLY_DIAG_ASR FORMAT "%4.2" /end CHARACTERISTIC
/begin CHARACTERISTIC c_n_sp_is_ratio_max_asr_lim "Maximum threshold for N/N_SP_IS relation to activate TQI_ASR_REQ_ ... limitation ( To avoid engine stall by ASR)" VALUE 0x84850e _REC_VAL_20_u2 7.9998779296875 _CNV_A_R_LINEAR_____336_CM 0. 7.9998779296875 DISPLAY_IDENTIFIER C_N_SP_IS_RATIO_MAX_ASR_LIM FORMAT "%6.4" /end CHARACTERISTIC
/begin CHARACTERISTIC ip_lgrd_tqi_asr_bol "Change limitation to avoid torque jumps after activation of TQI_ASR_REQ_ ... limitation" CURVE 0x846d6c _REC_CUR_20_u2_u2 1023.96875 _CNV_A_R_LINEAR_____62_CM 0. 1023.96875 DISPLAY_IDENTIFIER IP_LGRD_TQI_ASR_BOL FORMAT "%7.2"
 /begin AXIS_DESCR COM_AXIS n _CNV_A_R_LINEAR_____257_CM 4 0. 8160. FORMAT "%4.0" AXIS_PTS_REF ldp_n__lgrd_tqi_asr_bol /end AXIS_DESCR
/end CHARACTERISTIC
/begin AXIS_PTS ldp_n__lgrd_tqi_asr_bol "" 0x8445d8 n _REC_AXS_20_u2 8160. _CNV_A_R_LINEAR_____257_CM 4 0. 8160. FORMAT "%4.0" /end AXIS_PTS
/begin MEASUREMENT lv_slm_bol_act "Flag indicating if the blue smoke limitation is active" UBYTE _CNV_S_2_RANGE______11_CM 1 0. 0. 1. DISPLAY_IDENTIFIER LV_SLM_BOL_ACT ECU_ADDRESS 0x7fb7f1 /end MEASUREMENT
/begin MEASUREMENT tqi_min "Indicated Engine Torque of Idle Speed Controller" SWORD _CNV_A_R_LINEAR_____62_CM 1 0. -1024. 1023.96875 DISPLAY_IDENTIFIER TQI_MIN ECU_ADDRESS 0x7fa220 BYTE_ORDER MSB_LAST FORMAT "%6.2" /end MEASUREMENT
/begin MEASUREMENT t_acc "Timer for duration of transient TQ_LOSS_ACC correction " UWORD _CNV_A_R_LINEAR_____223_CM 1 0. 0. 655.35 DISPLAY_IDENTIFIER T_ACC ECU_ADDRESS 0x7fb0ec BYTE_ORDER MSB_LAST FORMAT "%6.2" /end MEASUREMENT
/begin MEASUREMENT tq_add_acc "Torque reserve for switching on air conditioning compressor" SWORD _CNV_A_R_LINEAR_____62_CM 1 0. 0. 1023.96875 DISPLAY_IDENTIFIER TQ_ADD_ACC ECU_ADDRESS 0x7fa21c BYTE_ORDER MSB_LAST FORMAT "%7.2" /end MEASUREMENT
/begin MEASUREMENT tq_loss_acc "Engine torque losses air conditioning compressor" SWORD _CNV_A_R_LINEAR_____62_CM 1 0. -1024. 0. DISPLAY_IDENTIFIER TQ_LOSS_ACC ECU_ADDRESS 0x7fa21e BYTE_ORDER MSB_LAST FORMAT "%8.2" /end MEASUREMENT
/begin CHARACTERISTIC c_tq_loss_acc_sub "Substitute value in case of error CAN_ACP or CAN_TQ_LOSS_ACC_INP" VALUE 0x848704 _REC_VAL_20_s2 40.96 _CNV_A_R_LINEAR_____62_CM -1024. 0. DISPLAY_IDENTIFIER C_TQ_LOSS_ACC_SUB FORMAT "%8.2" /end CHARACTERISTIC
/begin CHARACTERISTIC ip_fac_tq_loss_acc_on "TQ_LOSS_ACC weighting factor at ACC activation" CURVE 0x846cf4 _REC_CUR_20_u1_u2 1.9921875 _CNV_A_R_LINEAR_____240_CM 0. 1.9921875 DISPLAY_IDENTIFIER IP_FAC_TQ_LOSS_ACC_ON FORMAT "%5.3"
 /begin AXIS_DESCR COM_AXIS t_acc _CNV_A_R_LINEAR_____223_CM 8 0. 655.35 FORMAT "%6.2" AXIS_PTS_REF ldp_t_acc__fac_tq_loss_acc_on /end AXIS_DESCR
/end CHARACTERISTIC
/begin CHARACTERISTIC ip_fac_tq_loss_acc_off "TQ_LOSS_ACC weighting factor at ACC deactivation" CURVE 0x846cec _REC_CUR_20_u1_u2 1.9921875 _CNV_A_R_LINEAR_____240_CM 0. 1.9921875 DISPLAY_IDENTIFIER IP_FAC_TQ_LOSS_ACC_OFF FORMAT "%5.3"
 /begin AXIS_DESCR COM_AXIS t_acc _CNV_A_R_LINEAR_____223_CM 8 0. 655.35 FORMAT "%6.2" AXIS_PTS_REF ldp_t_acc__fac_tq_loss_acc_off /end AXIS_DESCR
/end CHARACTERISTIC
/begin AXIS_PTS ldp_n__tq_loss_acc "" 0x8445fe n_32 _REC_AXS_20_u1 8160. _CNV_A_R_LINEAR_____84_CM 6 0. 8160. FORMAT "%4.0" /end AXIS_PTS
/begin AXIS_PTS ldp_acp__tq_loss_acc "" 0x8444b2 acp _REC_AXS_20_u1 127.5 _CNV_A_R_LINEAR_____250_CM 6 0. 127.5 FORMAT "%5.1" /end AXIS_PTS
/begin AXIS_PTS ldp_t_acc__fac_tq_loss_acc_on "" 0x8446ac t_acc _REC_AXS_20_u2 655.35 _CNV_A_R_LINEAR_____223_CM 8 0. 655.35 FORMAT "%6.2" /end AXIS_PTS
/begin AXIS_PTS ldp_t_acc__fac_tq_loss_acc_off "" 0x84469a t_acc _REC_AXS_20_u2 655.35 _CNV_A_R_LINEAR_____223_CM 8 0. 655.35 FORMAT "%6.2" /end AXIS_PTS
/begin CHARACTERISTIC ip_tq_loss_acc "ACC torque loss due to engine-speed and ACC fluid-pressure" MAP 0x847f82 _REC_MAP_20_u2_u1_u1 2047.97875 _CNV_A_R_LINEAR_____83_CM -1024. 1023.97875 DISPLAY_IDENTIFIER IP_TQ_LOSS_ACC FORMAT "%8.2"
 /begin AXIS_DESCR COM_AXIS n_32 _CNV_A_R_LINEAR_____84_CM 6 0. 8160. FORMAT "%4.0" AXIS_PTS_REF ldp_n__tq_loss_acc /end AXIS_DESCR
 /begin AXIS_DESCR COM_AXIS acp _CNV_A_R_LINEAR_____250_CM 6 0. 127.5 FORMAT "%5.1" AXIS_PTS_REF ldp_acp__tq_loss_acc /end AXIS_DESCR
/end CHARACTERISTIC
/begin MEASUREMENT tq_ltc_dif_up "torque increment during positive transient" SWORD _CNV_A_R_LINEAR_____62_CM 1 0. -1024. 1023.96875 DISPLAY_IDENTIFIER TQ_LTC_DIF_UP ECU_ADDRESS 0x7f9720 BYTE_ORDER MSB_LAST FORMAT "%6.2" /end MEASUREMENT
/begin MEASUREMENT tq_ltc_thd_up "torque threshold for positive transient" SWORD _CNV_A_R_LINEAR_____62_CM 1 0. -1024. 1023.96875 DISPLAY_IDENTIFIER TQ_LTC_THD_UP ECU_ADDRESS 0x7f9722 BYTE_ORDER MSB_LAST FORMAT "%6.2" /end MEASUREMENT
/begin MEASUREMENT tq_ltc_dif_down "torque decrement during negative transient" SWORD _CNV_A_R_LINEAR_____62_CM 1 0. -1024. 1023.96875 DISPLAY_IDENTIFIER TQ_LTC_DIF_DOWN ECU_ADDRESS 0x7f9724 BYTE_ORDER MSB_LAST FORMAT "%6.2" /end MEASUREMENT
/begin MEASUREMENT tq_ltc_thd_down_1 "upper torque threshold for negative transient" SWORD _CNV_A_R_LINEAR_____62_CM 1 0. -1024. 1023.96875 DISPLAY_IDENTIFIER TQ_LTC_THD_DOWN_1 ECU_ADDRESS 0x7f9726 BYTE_ORDER MSB_LAST FORMAT "%6.2" /end MEASUREMENT
/begin CHARACTERISTIC c_ctr_dri_up_dly_ltc "number of calculations (10ms) to delay the gear detection" VALUE 0x85bd9e _REC_VAL_20_u1 255. _CNV_A_R_LINEAR_____0_CM 0. 255. DISPLAY_IDENTIFIER C_CTR_DRI_UP_DLY_LTC FORMAT "%3.0" /end CHARACTERISTIC
/begin CHARACTERISTIC ip_tq_ltc_thd_down_1__n__dri "TQ_LTCP: threshold LTC down 1" MAP 0x85b27e _REC_MAP_20_u2_u2_u1 2047.96875 _CNV_A_R_LINEAR_____89_CM -1024. 1023.96875 DISPLAY_IDENTIFIER IP_TQ_LTC_THD_DOWN_1__N__DRI FORMAT "%6.2"
 /begin AXIS_DESCR COM_AXIS n _CNV_A_R_LINEAR_____5_CM 6 0. 6375. FORMAT "%4.0" AXIS_PTS_REF ldpm_n_ip_tq_ltc /end AXIS_DESCR
 /begin AXIS_DESCR COM_AXIS dri _CNV_A_R_LINEAR_____0_CM 7 0. 6. FORMAT "%1.0" AXIS_PTS_REF ldpm_dri_ip_tq_ltc /end AXIS_DESCR
/end CHARACTERISTIC
/begin AXIS_PTS ldpm_n_ip_tq_ltc "threshold LTC down 1" 0x843cdc n _REC_AXS_20_u2 6375. _CNV_A_R_LINEAR_____5_CM 6 0. 6375. FORMAT "%4.0" /end AXIS_PTS
/begin AXIS_PTS ldpm_dri_ip_tq_ltc "threshold LTC down 1" 0x84345c dri _REC_AXS_20_u1 6. _CNV_A_R_LINEAR_____0_CM 7 0. 6. FORMAT "%1.0" /end AXIS_PTS
/begin CHARACTERISTIC ip_tq_ltc_thd_up__n__dri "TQ_LTCP: threshold LTC up" MAP 0x85b2d2 _REC_MAP_20_u2_u2_u1 2047.96875 _CNV_A_R_LINEAR_____89_CM -1024. 1023.96875 DISPLAY_IDENTIFIER IP_TQ_LTC_THD_UP__N__DRI FORMAT "%6.2"
 /begin AXIS_DESCR COM_AXIS n _CNV_A_R_LINEAR_____5_CM 6 0. 6375. FORMAT "%4.0" AXIS_PTS_REF ldpm_n_ip_tq_ltc /end AXIS_DESCR
 /begin AXIS_DESCR COM_AXIS dri _CNV_A_R_LINEAR_____0_CM 7 0. 6. FORMAT "%1.0" AXIS_PTS_REF ldpm_dri_ip_tq_ltc /end AXIS_DESCR
/end CHARACTERISTIC
/begin CHARACTERISTIC ip_fac_tq_up__n__dri "TQ_LTCP: scaling factor for torque limitation at low N and torque increase" MAP 0x84c818 _REC_MAP_20_u2_u2_u1 1.9999696 _CNV_A_R_LINEAR_____53_CM 0. 1.9999696 DISPLAY_IDENTIFIER IP_FAC_TQ_UP__N__DRI FORMAT "%6.5"
 /begin AXIS_DESCR COM_AXIS n _CNV_A_R_LINEAR_____5_CM 6 0. 6375. FORMAT "%4.0" AXIS_PTS_REF ldpm_n_ip_tq_ltc /end AXIS_DESCR
 /begin AXIS_DESCR COM_AXIS dri _CNV_A_R_LINEAR_____0_CM 7 0. 6. FORMAT "%1.0" AXIS_PTS_REF ldpm_dri_ip_tq_ltc /end AXIS_DESCR
/end CHARACTERISTIC
/begin CHARACTERISTIC ip_tq_dif_up__tq_sp_clu__dri "TQ_LTCP: torque increment for transient up" MAP 0x85b162 _REC_MAP_20_u2_u2_u1 1023.96875 _CNV_A_R_LINEAR_____62_CM 0. 1023.96875 DISPLAY_IDENTIFIER IP_TQ_DIF_UP__TQ_SP_CLU__DRI FORMAT "%6.2"
 /begin AXIS_DESCR COM_AXIS tq_sp_clu _CNV_A_R_LINEAR_____89_CM 6 -1024. 1023.96875 FORMAT "%6.2" AXIS_PTS_REF ldpm_tq_sp_clu_ip_tq_dif_up /end AXIS_DESCR
 /begin AXIS_DESCR COM_AXIS dri _CNV_A_R_LINEAR_____0_CM 7 0. 6. FORMAT "%1.0" AXIS_PTS_REF ldpm_dri_ip_tq_ltc /end AXIS_DESCR
/end CHARACTERISTIC
/begin AXIS_PTS ldpm_tq_sp_clu_ip_tq_dif_up "torque increment for transient up" 0x843f1a tq_sp_clu _REC_AXS_20_u2 2047.96875 _CNV_A_R_LINEAR_____89_CM 6 -1024. 1023.96875 FORMAT "%6.2" /end AXIS_PTS
/begin CHARACTERISTIC ip_fac_tq_dif_up__pv_av__n "TQ_LTCP: scaling factor for the torque gradient up" MAP 0x84c394 _REC_MAP_20_u2_u2_u2 3.99998471 _CNV_A_R_LINEAR_____63_CM 0. 3.99998471 DISPLAY_IDENTIFIER IP_FAC_TQ_DIF_UP__PV_AV__N FORMAT "%6.5"
 /begin AXIS_DESCR COM_AXIS pv_av _CNV_A_R_LINEAR_____81_CM 4 0. 100. FORMAT "%4.2" AXIS_PTS_REF ldpm_pv_av_ip_fac_tq_dif /end AXIS_DESCR
 /begin AXIS_DESCR COM_AXIS n _CNV_A_R_LINEAR_____5_CM 6 0. 6375. FORMAT "%4.0" AXIS_PTS_REF ldpm_n_ip_tq_ltc /end AXIS_DESCR
/end CHARACTERISTIC
/begin AXIS_PTS ldpm_pv_av_ip_fac_tq_dif "scaling factor for the torque gradient up" 0x843e2e pv_av _REC_AXS_20_u2 100. _CNV_A_R_LINEAR_____81_CM 4 0. 100. FORMAT "%4.2" /end AXIS_PTS
/begin CHARACTERISTIC ip_fac_tq_down__n__dri "TQ_LTCP: scaling factor for torque limitation at low N and torque decrease" MAP 0x84c3c4 _REC_MAP_20_u2_u2_u1 1.9999696 _CNV_A_R_LINEAR_____53_CM 0. 1.9999696 DISPLAY_IDENTIFIER IP_FAC_TQ_DOWN__N__DRI FORMAT "%6.5"
 /begin AXIS_DESCR COM_AXIS n _CNV_A_R_LINEAR_____5_CM 6 0. 6375. FORMAT "%4.0" AXIS_PTS_REF ldpm_n_ip_tq_ltc /end AXIS_DESCR
 /begin AXIS_DESCR COM_AXIS dri _CNV_A_R_LINEAR_____0_CM 7 0. 6. FORMAT "%1.0" AXIS_PTS_REF ldpm_dri_ip_tq_ltc /end AXIS_DESCR
/end CHARACTERISTIC
/begin CHARACTERISTIC ip_tq_dif_down__tq_sp_clu__dri "TQ_LTCP: torque decrement for transient down" MAP 0x85b10e _REC_MAP_20_u2_u2_u1 1023.96875 _CNV_A_R_LINEAR_____62_CM 0. 1023.96875 DISPLAY_IDENTIFIER IP_TQ_DIF_DOWN__TQ_SP_CLU__DRI FORMAT "%6.2"
 /begin AXIS_DESCR COM_AXIS tq_sp_clu _CNV_A_R_LINEAR_____89_CM 6 -1024. 1023.96875 FORMAT "%6.2" AXIS_PTS_REF ldpm_tq_sp_clu_ip_tq_dif_down /end AXIS_DESCR
 /begin AXIS_DESCR COM_AXIS dri _CNV_A_R_LINEAR_____0_CM 7 0. 6. FORMAT "%1.0" AXIS_PTS_REF ldpm_dri_ip_tq_ltc /end AXIS_DESCR
/end CHARACTERISTIC
/begin AXIS_PTS ldpm_tq_sp_clu_ip_tq_dif_down "torque decrement for transient down" 0x843f0c tq_sp_clu _REC_AXS_20_u2 2047.96875 _CNV_A_R_LINEAR_____89_CM 6 -1024. 1023.96875 FORMAT "%6.2" /end AXIS_PTS
/begin CHARACTERISTIC ip_fac_tq_dif_down__pv_av__n "TQ_LTCP: scaling factor for the torque gradient down" MAP 0x84c364 _REC_MAP_20_u2_u2_u2 3.99998471 _CNV_A_R_LINEAR_____63_CM 0. 3.99998471 DISPLAY_IDENTIFIER IP_FAC_TQ_DIF_DOWN__PV_AV__N FORMAT "%6.5"
 /begin AXIS_DESCR COM_AXIS pv_av _CNV_A_R_LINEAR_____81_CM 4 0. 100. FORMAT "%4.2" AXIS_PTS_REF ldpm_pv_av_ip_fac_tq_dif /end AXIS_DESCR
 /begin AXIS_DESCR COM_AXIS n _CNV_A_R_LINEAR_____5_CM 6 0. 6375. FORMAT "%4.0" AXIS_PTS_REF ldpm_n_ip_tq_ltc /end AXIS_DESCR
/end CHARACTERISTIC
/begin CHARACTERISTIC c_vb_min_vb_diag "Minimale Batteriespannung zur diagnose" VALUE 0x848777 _REC_VAL_20_u1 25.8984375 _CNV_A_R_LINEAR_____346_CM 0. 25.8984375 DISPLAY_IDENTIFIER C_VB_MIN_VB_DIAG FORMAT "%9.6" /end CHARACTERISTIC
/begin CHARACTERISTIC c_n_min_vb_diag "Minimale Drehzahl zur diagnose der Batteriespannung" VALUE 0x8484e8 _REC_VAL_20_u1 8160. _CNV_A_R_LINEAR_____84_CM 0. 8160. DISPLAY_IDENTIFIER C_N_MIN_VB_DIAG FORMAT "%4.0" /end CHARACTERISTIC
/begin CHARACTERISTIC c_abc_inc_vb "Inkrement Entprellzaehler" VALUE 0x848266 _REC_VAL_20_u1 255. _CNV_A_R_LINEAR_____1_CM 0. 255. DISPLAY_IDENTIFIER C_ABC_INC_VB FORMAT "%3.0" /end CHARACTERISTIC
/begin CHARACTERISTIC c_abc_max_vb "Maximum Entprellzaehler" VALUE 0x8482e8 _REC_VAL_20_u1 254. _CNV_A_R_LINEAR_____1_CM 1. 255. DISPLAY_IDENTIFIER C_ABC_MAX_VB FORMAT "%3.0" /end CHARACTERISTIC
/begin MEASUREMENT lv_err_vb "Fehler Batteriespannung entprellt" UBYTE _CNV_S_2_RANGE__0___88_CM 1 0. 0. 1. DISPLAY_IDENTIFIER LV_ERR_VB ECU_ADDRESS 0x7fb553 BIT_MASK 0x1 /end MEASUREMENT
/begin CHARACTERISTIC c_abc_inc_tco_1_2_plaus "anti bounce counter increment for diagnosis instance TCO_1_2_PLAUS" VALUE 0x848246 _REC_VAL_20_u1 255. _CNV_A_R_LINEAR_____0_CM 0. 255. DISPLAY_IDENTIFIER C_ABC_INC_TCO_1_2_PLAUS FORMAT "%3.0" /end CHARACTERISTIC
/begin CHARACTERISTIC c_abc_max_tco_1_2_plaus "maximum value of anti bounce counter for diagnosis instance TCO_1_2_PLAUS" VALUE 0x8482c8 _REC_VAL_20_u1 255. _CNV_A_R_LINEAR_____0_CM 0. 255. DISPLAY_IDENTIFIER C_ABC_MAX_TCO_1_2_PLAUS FORMAT "%3.0" /end CHARACTERISTIC
/begin MEASUREMENT sf_rng_tco_1_2_plaus "Status flag used to select the allowed range of the difference of TCO_1_MES and TCO_2_MES" UBYTE _CNV_S_3_TCO_range_347_CM 1 0. 0. 2. DISPLAY_IDENTIFIER SF_RNG_TCO_1_2_PLAUS ECU_ADDRESS 0x7fba01 /end MEASUREMENT
/begin CHARACTERISTIC c_temp_1_2_tco_1_2_plaus_cold "c_temp_1_2_tco_1_2_plaus_cold" VALUE 0x85c160 _REC_VAL_20_u1 255. _CNV_A_R_LINEAR_____18_CM -50. 205. DISPLAY_IDENTIFIER C_TEMP_1_2_TCO_1_2_PLAUS_COLD FORMAT "%3.0" /end CHARACTERISTIC
/begin CHARACTERISTIC c_temp_1_2_tco_1_2_plaus_wup "c_temp_1_2_tco_1_2_plaus_wup" VALUE 0x85c162 _REC_VAL_20_u1 255. _CNV_A_R_LINEAR_____18_CM -50. 205. DISPLAY_IDENTIFIER C_TEMP_1_2_TCO_1_2_PLAUS_WUP FORMAT "%3.0" /end CHARACTERISTIC
/begin CHARACTERISTIC c_temp_1_2_tco_1_2_plaus_hot "Maximal difference TCO_1_MES - TCO_2_MES" VALUE 0x85c161 _REC_VAL_20_u1 255. _CNV_A_R_LINEAR_____18_CM -50. 205. DISPLAY_IDENTIFIER C_TEMP_1_2_TCO_1_2_PLAUS_HOT FORMAT "%3.0" /end CHARACTERISTIC
/begin CHARACTERISTIC c_temp_2_1_tco_1_2_plaus_cold "c_temp_2_1_tco_1_2_plaus_cold" VALUE 0x85c163 _REC_VAL_20_u1 255. _CNV_A_R_LINEAR_____18_CM -50. 205. DISPLAY_IDENTIFIER C_TEMP_2_1_TCO_1_2_PLAUS_COLD FORMAT "%3.0" /end CHARACTERISTIC
/begin CHARACTERISTIC c_temp_2_1_tco_1_2_plaus_wup "c_temp_2_1_tco_1_2_plaus_wup" VALUE 0x85c165 _REC_VAL_20_u1 255. _CNV_A_R_LINEAR_____18_CM -50. 205. DISPLAY_IDENTIFIER C_TEMP_2_1_TCO_1_2_PLAUS_WUP FORMAT "%3.0" /end CHARACTERISTIC
/begin CHARACTERISTIC c_temp_2_1_tco_1_2_plaus_hot "Maximal difference TCO_2_MES - TCO_1_MES" VALUE 0x85c164 _REC_VAL_20_u1 255. _CNV_A_R_LINEAR_____18_CM -50. 205. DISPLAY_IDENTIFIER C_TEMP_2_1_TCO_1_2_PLAUS_HOT FORMAT "%3.0" /end CHARACTERISTIC
/begin CHARACTERISTIC c_temp_cold_max_tco_1_2_plaus "Temperature threshold to use range COLD" VALUE 0x85c166 _REC_VAL_20_u1 255. _CNV_A_R_LINEAR_____18_CM -50. 205. DISPLAY_IDENTIFIER C_TEMP_COLD_MAX_TCO_1_2_PLAUS FORMAT "%3.0" /end CHARACTERISTIC
/begin CHARACTERISTIC c_temp_hot_min_tco_1_2_plaus "Temperature threshold to use range HOT" VALUE 0x85c170 _REC_VAL_20_u1 255. _CNV_A_R_LINEAR_____18_CM -50. 205. DISPLAY_IDENTIFIER C_TEMP_HOT_MIN_TCO_1_2_PLAUS FORMAT "%3.0" /end CHARACTERISTIC
/begin CHARACTERISTIC c_abc_inc_rly_main "anti bounce counter increment for diagnosis instance RLY_MAIN" VALUE 0x84823e _REC_VAL_20_u1 255. _CNV_A_R_LINEAR_____0_CM 0. 255. DISPLAY_IDENTIFIER C_ABC_INC_RLY_MAIN FORMAT "%3.0" /end CHARACTERISTIC
/begin CHARACTERISTIC c_abc_max_rly_main "maximum value of anti bounce counter for diagnosis instance RLY_MAIN" VALUE 0x8482c0 _REC_VAL_20_u1 255. _CNV_A_R_LINEAR_____0_CM 0. 255. DISPLAY_IDENTIFIER C_ABC_MAX_RLY_MAIN FORMAT "%3.0" /end CHARACTERISTIC
/begin CHARACTERISTIC c_abc_inc_rly_power "anti bounce counter increment for diagnosis instance RLY_POWER" VALUE 0x84823f _REC_VAL_20_u1 255. _CNV_A_R_LINEAR_____0_CM 0. 255. DISPLAY_IDENTIFIER C_ABC_INC_RLY_POWER FORMAT "%3.0" /end CHARACTERISTIC
/begin CHARACTERISTIC c_abc_max_rly_power "maximum value of anti bounce counter for diagnosis instance RLY_POWER" VALUE 0x8482c1 _REC_VAL_20_u1 255. _CNV_A_R_LINEAR_____0_CM 0. 255. DISPLAY_IDENTIFIER C_ABC_MAX_RLY_POWER FORMAT "%3.0" /end CHARACTERISTIC
/begin CHARACTERISTIC c_vb_min_rly_diag "inhibition threshold for Main- / Powerrelay diagnosis" VALUE 0x85c2bb _REC_VAL_20_u1 28.8 _CNV_A_R_LINEAR_____48_CM 0. 28.8 DISPLAY_IDENTIFIER C_VB_MIN_RLY_DIAG FORMAT "%3.1" /end CHARACTERISTIC
/begin MEASUREMENT lv_scg_rly_main "diagnosis bit from SPI bus" UBYTE _CNV_A_R_LINEAR_____0_CM 1 0. 0. 1. DISPLAY_IDENTIFIER LV_SCG_RLY_MAIN ECU_ADDRESS 0x7fba05 FORMAT "%1.0" /end MEASUREMENT
/begin MEASUREMENT lv_scg_vld_rly_main "diagnosis bit from SPI bus" UBYTE _CNV_A_R_LINEAR_____0_CM 1 0. 0. 1. DISPLAY_IDENTIFIER LV_SCG_VLD_RLY_MAIN ECU_ADDRESS 0x7fba08 FORMAT "%1.0" /end MEASUREMENT
/begin MEASUREMENT lv_scb_rly_main "diagnosis bit from SPI bus" UBYTE _CNV_A_R_LINEAR_____0_CM 1 0. 0. 1. DISPLAY_IDENTIFIER LV_SCB_RLY_MAIN ECU_ADDRESS 0x7fba04 FORMAT "%1.0" /end MEASUREMENT
/begin MEASUREMENT lv_scb_vld_rly_main "diagnosis bit from SPI bus" UBYTE _CNV_A_R_LINEAR_____0_CM 1 0. 0. 1. DISPLAY_IDENTIFIER LV_SCB_VLD_RLY_MAIN ECU_ADDRESS 0x7fba07 FORMAT "%1.0" /end MEASUREMENT
/begin MEASUREMENT lv_ol_rly_main "diagnosis bit from SPI bus" UBYTE _CNV_A_R_LINEAR_____0_CM 1 0. 0. 1. DISPLAY_IDENTIFIER LV_OL_RLY_MAIN ECU_ADDRESS 0x7fba06 FORMAT "%1.0" /end MEASUREMENT
/begin MEASUREMENT lv_ol_vld_rly_main "diagnosis bit from SPI bus" UBYTE _CNV_A_R_LINEAR_____0_CM 1 0. 0. 1. DISPLAY_IDENTIFIER LV_OL_VLD_RLY_MAIN ECU_ADDRESS 0x7fba09 FORMAT "%1.0" /end MEASUREMENT
/begin MEASUREMENT lv_scg_rly_power "diagnosis bit from SPI bus" UBYTE _CNV_A_R_LINEAR_____0_CM 1 0. 0. 1. DISPLAY_IDENTIFIER LV_SCG_RLY_POWER ECU_ADDRESS 0x7fba0b FORMAT "%1.0" /end MEASUREMENT
/begin MEASUREMENT lv_scg_vld_rly_power "diagnosis bit from SPI bus" UBYTE _CNV_A_R_LINEAR_____0_CM 1 0. 0. 1. DISPLAY_IDENTIFIER LV_SCG_VLD_RLY_POWER ECU_ADDRESS 0x7fba0e FORMAT "%1.0" /end MEASUREMENT
/begin MEASUREMENT lv_scb_rly_power "diagnosis bit from SPI bus" UBYTE _CNV_A_R_LINEAR_____0_CM 1 0. 0. 1. DISPLAY_IDENTIFIER LV_SCB_RLY_POWER ECU_ADDRESS 0x7fba0a FORMAT "%1.0" /end MEASUREMENT
/begin MEASUREMENT lv_scb_vld_rly_power "diagnosis bit from SPI bus" UBYTE _CNV_A_R_LINEAR_____0_CM 1 0. 0. 1. DISPLAY_IDENTIFIER LV_SCB_VLD_RLY_POWER ECU_ADDRESS 0x7fba0d FORMAT "%1.0" /end MEASUREMENT
/begin MEASUREMENT lv_ol_rly_power "diagnosis bit from SPI bus" UBYTE _CNV_A_R_LINEAR_____0_CM 1 0. 0. 1. DISPLAY_IDENTIFIER LV_OL_RLY_POWER ECU_ADDRESS 0x7fba0c FORMAT "%1.0" /end MEASUREMENT
/begin MEASUREMENT lv_ol_vld_rly_power "diagnosis bit from SPI bus" UBYTE _CNV_A_R_LINEAR_____0_CM 1 0. 0. 1. DISPLAY_IDENTIFIER LV_OL_VLD_RLY_POWER ECU_ADDRESS 0x7fba0f FORMAT "%1.0" /end MEASUREMENT
/begin MEASUREMENT err_sym_mem_rly_main "memorized symptom of the diagnosis instance RLY_MAIN " UBYTE _CNV_S_6_CONV_ERRM__27_CM 1 0. 0. 15. DISPLAY_IDENTIFIER ERR_SYM_MEM_RLY_MAIN ECU_ADDRESS 0x7fba02 /end MEASUREMENT
/begin MEASUREMENT err_sym_mem_rly_power "memorized symptom of the diagnosis instance RLY_POWER " UBYTE _CNV_S_6_CONV_ERRM__27_CM 1 0. 0. 15. DISPLAY_IDENTIFIER ERR_SYM_MEM_RLY_POWER ECU_ADDRESS 0x7fba03 /end MEASUREMENT
/begin CHARACTERISTIC c_abc_inc_maf_0_rng "anti bounce counter increment for diagnosis instance MAF_0_RNG" VALUE 0x848216 _REC_VAL_20_u1 255. _CNV_A_R_LINEAR_____0_CM 0. 255. DISPLAY_IDENTIFIER C_ABC_INC_MAF_0_RNG FORMAT "%3.0" /end CHARACTERISTIC
/begin CHARACTERISTIC c_abc_max_maf_0_rng "maximum value of anti bounce counter for diagnosis instance MAF_0_RNG" VALUE 0x848298 _REC_VAL_20_u1 255. _CNV_A_R_LINEAR_____0_CM 0. 255. DISPLAY_IDENTIFIER C_ABC_MAX_MAF_0_RNG FORMAT "%3.0" /end CHARACTERISTIC
/begin CHARACTERISTIC c_maf_kgh_mes_max_diag "maximum threshold for range check of MAF" VALUE 0x85bf06 _REC_VAL_20_u2 153.59765625 _CNV_A_R_LINEAR_____112_CM 0. 1023.984375 DISPLAY_IDENTIFIER C_MAF_KGH_MES_MAX_DIAG FORMAT "%7.2" /end CHARACTERISTIC
/begin CHARACTERISTIC c_maf_kgh_mes_min_diag "minimum threshold for range check of MAF" VALUE 0x85bf08 _REC_VAL_20_u2 153.59765625 _CNV_A_R_LINEAR_____112_CM 0. 1023.984375 DISPLAY_IDENTIFIER C_MAF_KGH_MES_MIN_DIAG FORMAT "%7.2" /end CHARACTERISTIC
/begin CHARACTERISTIC c_n_min_maf_kgh_mes_diag "minimal  engine speed threshold for MAF_KGH_MES_MAX check" VALUE 0x85bfbe _REC_VAL_20_u2 6375. _CNV_A_R_LINEAR_____5_CM 0. 6375. DISPLAY_IDENTIFIER C_N_MIN_MAF_KGH_MES_DIAG FORMAT "%4.0" /end CHARACTERISTIC
/begin CHARACTERISTIC c_abc_inc_maf_kgh_plaus "" VALUE 0x84821a _REC_VAL_20_u1 255. _CNV_A_R_LINEAR_____0_CM 0. 255. DISPLAY_IDENTIFIER C_ABC_INC_MAF_KGH_PLAUS FORMAT "%3.0" /end CHARACTERISTIC
/begin CHARACTERISTIC c_abc_max_maf_kgh_plaus "" VALUE 0x84829c _REC_VAL_20_u1 255. _CNV_A_R_LINEAR_____0_CM 0. 255. DISPLAY_IDENTIFIER C_ABC_MAX_MAF_KGH_PLAUS FORMAT "%3.0" /end CHARACTERISTIC
/begin MEASUREMENT t_dly_maf_kgh_plaus "" UWORD _CNV_A_R_LINEAR_____59_CM 1 0. 0. 655.35 DISPLAY_IDENTIFIER T_DLY_MAF_KGH_PLAUS ECU_ADDRESS 0x7fa59c BYTE_ORDER MSB_LAST FORMAT "%5.2" /end MEASUREMENT
/begin MEASUREMENT ctr_maf_kgh_plaus "" UBYTE _CNV_A_R_LINEAR_____0_CM 1 0. 0. 255. DISPLAY_IDENTIFIER CTR_MAF_KGH_PLAUS ECU_ADDRESS 0x7fb9f7 FORMAT "%3.0" /end MEASUREMENT
/begin CHARACTERISTIC c_tqi_sp_maf_plaus "" VALUE 0x85c1de _REC_VAL_20_s2 2047.96875 _CNV_A_R_LINEAR_____62_CM -1024. 1023.96875 DISPLAY_IDENTIFIER C_TQI_SP_MAF_PLAUS FORMAT "%6.2" /end CHARACTERISTIC
/begin CHARACTERISTIC c_ctl_lim_egrv_maf_plaus "" VALUE 0x85bd8e _REC_VAL_20_s2 199.996948242 _CNV_A_R_LINEAR_____12_CM -100. 99.996948242 DISPLAY_IDENTIFIER C_CTL_LIM_EGRV_MAF_PLAUS FORMAT "%5.3" /end CHARACTERISTIC
/begin CHARACTERISTIC c_tia_min_maf_plaus "" VALUE 0x85c1b9 _REC_VAL_20_u1 255. _CNV_A_R_LINEAR_____18_CM -50. 205. DISPLAY_IDENTIFIER C_TIA_MIN_MAF_PLAUS FORMAT "%3.0" /end CHARACTERISTIC
/begin CHARACTERISTIC c_tia_max_maf_plaus "" VALUE 0x85c1b8 _REC_VAL_20_u1 255. _CNV_A_R_LINEAR_____18_CM -50. 205. DISPLAY_IDENTIFIER C_TIA_MAX_MAF_PLAUS FORMAT "%3.0" /end CHARACTERISTIC
/begin CHARACTERISTIC c_n_min_maf_plaus "" VALUE 0x85bfc0 _REC_VAL_20_u2 6375. _CNV_A_R_LINEAR_____5_CM 0. 6375. DISPLAY_IDENTIFIER C_N_MIN_MAF_PLAUS FORMAT "%4.0" /end CHARACTERISTIC
/begin CHARACTERISTIC c_n_max_maf_plaus "" VALUE 0x85bfaa _REC_VAL_20_u2 6375. _CNV_A_R_LINEAR_____5_CM 0. 6375. DISPLAY_IDENTIFIER C_N_MAX_MAF_PLAUS FORMAT "%4.0" /end CHARACTERISTIC
/begin CHARACTERISTIC c_ratio_mf_tot_grd_maf_plaus "" VALUE 0x85c00e _REC_VAL_20_u2 99.972117 _CNV_A_R_LINEAR_____201_CM 0. 99.972117 DISPLAY_IDENTIFIER C_RATIO_MF_TOT_GRD_MAF_PLAUS FORMAT "%5.3" /end CHARACTERISTIC
/begin CHARACTERISTIC c_maf_kgh_min_maf_plaus "" VALUE 0x85bf0a _REC_VAL_20_s2 512. _CNV_A_R_LINEAR_____348_CM -512. 0. DISPLAY_IDENTIFIER C_MAF_KGH_MIN_MAF_PLAUS FORMAT "%3.2" /end CHARACTERISTIC
/begin CHARACTERISTIC c_maf_kgh_max_maf_plaus "" VALUE 0x85bf04 _REC_VAL_20_s2 511.984 _CNV_A_R_LINEAR_____349_CM 0. 511.984 DISPLAY_IDENTIFIER C_MAF_KGH_MAX_MAF_PLAUS FORMAT "%5.2" /end CHARACTERISTIC
/begin CHARACTERISTIC c_fac_maf_kgh_plaus_diag "" VALUE 0x85be4e _REC_VAL_20_u1 3.984375 _CNV_A_R_LINEAR_____98_CM 0. 3.984375 DISPLAY_IDENTIFIER C_FAC_MAF_KGH_PLAUS_DIAG FORMAT "%3.2" /end CHARACTERISTIC
/begin CHARACTERISTIC c_t_dly_maf_kgh_plaus_diag "" VALUE 0x85c0ba _REC_VAL_20_u2 655.35 _CNV_A_R_LINEAR_____59_CM 0. 655.35 DISPLAY_IDENTIFIER C_T_DLY_MAF_KGH_PLAUS_DIAG FORMAT "%5.2" /end CHARACTERISTIC
/begin CHARACTERISTIC c_ctr_maf_kgh_plaus_diag "" VALUE 0x85bdac _REC_VAL_20_u1 255. _CNV_A_R_LINEAR_____0_CM 0. 255. DISPLAY_IDENTIFIER C_CTR_MAF_KGH_PLAUS_DIAG FORMAT "%3.0" /end CHARACTERISTIC
/begin CHARACTERISTIC c_n_grd_h_res_maf_plaus "" VALUE 0x85bf90 _REC_VAL_20_s2 8191. _CNV_A_R_LINEAR_____350_CM -4096. 4095. DISPLAY_IDENTIFIER C_N_GRD_H_RES_MAF_PLAUS FORMAT "%4.0" /end CHARACTERISTIC
/begin MEASUREMENT lv_can_mon "v o" UBYTE _CNV_S_2_RANGE__0___88_CM 1 0. 0. 1. DISPLAY_IDENTIFIER LV_CAN_MON ECU_ADDRESS 0x7fb834 /end MEASUREMENT
/begin MEASUREMENT lv_can_inh_mon "v o" UBYTE _CNV_S_2_RANGE__0___88_CM 1 0. 0. 1. DISPLAY_IDENTIFIER LV_CAN_INH_MON ECU_ADDRESS 0x7fb835 /end MEASUREMENT
/begin MEASUREMENT lv_can_tcs_mon "v" UBYTE _CNV_S_2_RANGE__0___88_CM 1 0. 0. 1. DISPLAY_IDENTIFIER LV_CAN_TCS_MON ECU_ADDRESS 0x7fbc31 /end MEASUREMENT
/begin MEASUREMENT lv_can_tcs_inh_mon "v" UBYTE _CNV_S_2_RANGE__0___88_CM 1 0. 0. 1. DISPLAY_IDENTIFIER LV_CAN_TCS_INH_MON ECU_ADDRESS 0x7fbc32 /end MEASUREMENT
/begin MEASUREMENT t_can_tcs_inh_mon "v" UBYTE _CNV_A_R_LINEAR_____357_CM 1 0. 0. 10.2 DISPLAY_IDENTIFIER T_CAN_TCS_INH_MON ECU_ADDRESS 0x7fbc28 FORMAT "%4.2" /end MEASUREMENT
/begin MEASUREMENT lv_can_tcs_tout_det_mon "v" UBYTE _CNV_S_2_RANGE__0___88_CM 1 0. 0. 1. DISPLAY_IDENTIFIER LV_CAN_TCS_TOUT_DET_MON ECU_ADDRESS 0x7fbc30 /end MEASUREMENT
/begin MEASUREMENT abc_can_tcs_mon "v" UBYTE _CNV_A_R_LINEAR_____1_CM 1 0. 0. 255. DISPLAY_IDENTIFIER ABC_CAN_TCS_MON ECU_ADDRESS 0x7fbc2a FORMAT "%3.0" /end MEASUREMENT
/begin CHARACTERISTIC c_abc_inc_can_tcs_mon "" VALUE 0x85bc85 _REC_VAL_20_u1 255. _CNV_A_R_LINEAR_____1_CM 0. 255. DISPLAY_IDENTIFIER C_ABC_INC_CAN_TCS_MON FORMAT "%3.0" /end CHARACTERISTIC
/begin CHARACTERISTIC c_abc_max_can_tcs_mon "" VALUE 0x85bc9a _REC_VAL_20_u1 254. _CNV_A_R_LINEAR_____1_CM 1. 255. DISPLAY_IDENTIFIER C_ABC_MAX_CAN_TCS_MON FORMAT "%3.0" /end CHARACTERISTIC
/begin CHARACTERISTIC c_vb_min_can_mon "" VALUE 0x85c2b5 _REC_VAL_20_u1 28.8 _CNV_A_R_LINEAR_____48_CM 0. 28.8 DISPLAY_IDENTIFIER C_VB_MIN_CAN_MON FORMAT "%3.1" /end CHARACTERISTIC
/begin CHARACTERISTIC c_t_max_tcs1_miss_mon "" VALUE 0x85c0f4 _REC_VAL_20_u1 10.2 _CNV_A_R_LINEAR_____357_CM 0. 10.2 DISPLAY_IDENTIFIER C_T_MAX_TCS1_MISS_MON FORMAT "%4.2" /end CHARACTERISTIC
/begin CHARACTERISTIC c_t_can_tcs_inh_mon "" VALUE 0x85c0a0 _REC_VAL_20_u1 10.2 _CNV_A_R_LINEAR_____357_CM 0. 10.2 DISPLAY_IDENTIFIER C_T_CAN_TCS_INH_MON FORMAT "%4.2" /end CHARACTERISTIC
/begin MEASUREMENT lv_tq_cru_act_mon "logical variable for activation of cruise control" UBYTE _CNV_S_2_RANGE______11_CM 1 0. 0. 1. DISPLAY_IDENTIFIER LV_TQ_CRU_ACT_MON ECU_ADDRESS 0x7fb839 /end MEASUREMENT
/begin MEASUREMENT lv_cru_inh_mon "logical variable for inhibition of cruise control" UBYTE _CNV_S_2_RANGE______11_CM 1 0. 0. 1. DISPLAY_IDENTIFIER LV_CRU_INH_MON ECU_ADDRESS 0x7fb838 /end MEASUREMENT
/begin MEASUREMENT t_cru_inh_mon "timer for inhibit of cruise control demand in monitoring level" UBYTE _CNV_A_R_LINEAR_____357_CM 1 0. 0. 10.2 DISPLAY_IDENTIFIER T_CRU_INH_MON ECU_ADDRESS 0x7fbc62 FORMAT "%4.2" /end MEASUREMENT
/begin MEASUREMENT abc_cru_mon "anti bounce counter for fault in cruise control conditions present" UBYTE _CNV_A_R_LINEAR_____0_CM 1 0. 0. 255. DISPLAY_IDENTIFIER ABC_CRU_MON ECU_ADDRESS 0x7fbc64 FORMAT "%3.0" /end MEASUREMENT
/begin CHARACTERISTIC c_abc_inc_cru_mon "anti bounce counter increment" VALUE 0x85bc87 _REC_VAL_20_u1 255. _CNV_A_R_LINEAR_____0_CM 0. 255. DISPLAY_IDENTIFIER C_ABC_INC_CRU_MON FORMAT "%3.0" /end CHARACTERISTIC
/begin CHARACTERISTIC c_abc_max_cru_mon "maximum value of anti bounce counter" VALUE 0x85bc9c _REC_VAL_20_u1 254. _CNV_A_R_LINEAR_____0_CM 1. 255. DISPLAY_IDENTIFIER C_ABC_MAX_CRU_MON FORMAT "%3.0" /end CHARACTERISTIC
/begin CHARACTERISTIC c_t_cru_inh_mon "delay time for disable of cruise control in monitoring level" VALUE 0x85c0a1 _REC_VAL_20_u1 10.2 _CNV_A_R_LINEAR_____357_CM 0. 10.2 DISPLAY_IDENTIFIER C_T_CRU_INH_MON FORMAT "%4.2" /end CHARACTERISTIC
/begin CHARACTERISTIC c_vs_min_cru_mon "minimum threshold for vehicle speed control active" VALUE 0x85c2dc _REC_VAL_20_u2 655.35 _CNV_A_R_LINEAR_____74_CM 0. 655.35 DISPLAY_IDENTIFIER C_VS_MIN_CRU_MON FORMAT "%5.2" /end CHARACTERISTIC
/begin CHARACTERISTIC c_abc_inc_conv_mon_1 "anti bounce counter increment for diagnosis instance CONV_MON_1" VALUE 0x8481ff _REC_VAL_20_u1 255. _CNV_A_R_LINEAR_____0_CM 0. 255. DISPLAY_IDENTIFIER C_ABC_INC_CONV_MON_1 FORMAT "%3.0" /end CHARACTERISTIC
/begin CHARACTERISTIC c_abc_max_conv_mon_1 "maximum value of anti bounce counter for diagnosis instance CONV_MON_1" VALUE 0x848281 _REC_VAL_20_u1 255. _CNV_A_R_LINEAR_____0_CM 0. 255. DISPLAY_IDENTIFIER C_ABC_MAX_CONV_MON_1 FORMAT "%3.0" /end CHARACTERISTIC
/begin CHARACTERISTIC c_abc_inc_n_32_mon_1 "anti bounce counter increment for diagnosis instance N_32_MON_1" VALUE 0x848223 _REC_VAL_20_u1 255. _CNV_A_R_LINEAR_____0_CM 0. 255. DISPLAY_IDENTIFIER C_ABC_INC_N_32_MON_1 FORMAT "%3.0" /end CHARACTERISTIC
/begin CHARACTERISTIC c_abc_max_n_32_mon_1 "maximum value of anti bounce counter for diagnosis instance N_32_MON_1" VALUE 0x8482a5 _REC_VAL_20_u1 255. _CNV_A_R_LINEAR_____0_CM 0. 255. DISPLAY_IDENTIFIER C_ABC_MAX_N_32_MON_1 FORMAT "%3.0" /end CHARACTERISTIC
/begin CHARACTERISTIC c_abc_inc_pvs_mon_1 "anti bounce counter increment for diagnosis instance PVS_MON_1" VALUE 0x84823b _REC_VAL_20_u1 255. _CNV_A_R_LINEAR_____0_CM 0. 255. DISPLAY_IDENTIFIER C_ABC_INC_PVS_MON_1 FORMAT "%3.0" /end CHARACTERISTIC
/begin CHARACTERISTIC c_abc_max_pvs_mon_1 "maximum value of anti bounce counter for diagnosis instance PVS_MON_1" VALUE 0x8482bd _REC_VAL_20_u1 255. _CNV_A_R_LINEAR_____0_CM 0. 255. DISPLAY_IDENTIFIER C_ABC_MAX_PVS_MON_1 FORMAT "%3.0" /end CHARACTERISTIC
/begin CHARACTERISTIC c_abc_inc_fcut_mon_1 "anti bounce counter increment for diagnosis instance FCUT_MON_1" VALUE 0x848213 _REC_VAL_20_u1 255. _CNV_A_R_LINEAR_____0_CM 0. 255. DISPLAY_IDENTIFIER C_ABC_INC_FCUT_MON_1 FORMAT "%3.0" /end CHARACTERISTIC
/begin CHARACTERISTIC c_abc_max_fcut_mon_1 "maximum value of anti bounce counter for diagnosis instance FCUT_MON_1" VALUE 0x848295 _REC_VAL_20_u1 255. _CNV_A_R_LINEAR_____0_CM 0. 255. DISPLAY_IDENTIFIER C_ABC_MAX_FCUT_MON_1 FORMAT "%3.0" /end CHARACTERISTIC
/begin CHARACTERISTIC c_abc_inc_tqi_n_max_mon_1 "anti bounce counter increment for diagnosis instance TQI_N_MAX_MON_1" VALUE 0x848250 _REC_VAL_20_u1 255. _CNV_A_R_LINEAR_____0_CM 0. 255. DISPLAY_IDENTIFIER C_ABC_INC_TQI_N_MAX_MON_1 FORMAT "%3.0" /end CHARACTERISTIC
/begin CHARACTERISTIC c_abc_max_tqi_n_max_mon_1 "maximum value of anti bounce counter for diagnosis instance TQI_N_MAX_MON_1" VALUE 0x8482d2 _REC_VAL_20_u1 255. _CNV_A_R_LINEAR_____0_CM 0. 255. DISPLAY_IDENTIFIER C_ABC_MAX_TQI_N_MAX_MON_1 FORMAT "%3.0" /end CHARACTERISTIC
/begin CHARACTERISTIC c_abc_inc_can_inh_mon "anti bounce counter increment for diagnosis instance CAN_INH_MON" VALUE 0x8481f9 _REC_VAL_20_u1 255. _CNV_A_R_LINEAR_____0_CM 0. 255. DISPLAY_IDENTIFIER C_ABC_INC_CAN_INH_MON FORMAT "%3.0" /end CHARACTERISTIC
/begin CHARACTERISTIC c_abc_max_can_inh_mon "maximum value of anti bounce counter for diagnosis instance CAN_INH_MON" VALUE 0x84827b _REC_VAL_20_u1 254. _CNV_A_R_LINEAR_____0_CM 1. 255. DISPLAY_IDENTIFIER C_ABC_MAX_CAN_INH_MON FORMAT "%3.0" /end CHARACTERISTIC
/begin CHARACTERISTIC c_abc_inc_post_inh_mon "anti bounce counter increment for diagnosis instance POST_INH_MON" VALUE 0x848224 _REC_VAL_20_u1 255. _CNV_A_R_LINEAR_____0_CM 0. 255. DISPLAY_IDENTIFIER C_ABC_INC_POST_INH_MON FORMAT "%3.0" /end CHARACTERISTIC
/begin CHARACTERISTIC c_abc_max_post_inh_mon "maximum value of anti bounce counter for diagnosis instance POST_INH_MON" VALUE 0x8482a6 _REC_VAL_20_u1 254. _CNV_A_R_LINEAR_____0_CM 1. 255. DISPLAY_IDENTIFIER C_ABC_MAX_POST_INH_MON FORMAT "%3.0" /end CHARACTERISTIC
/begin CHARACTERISTIC c_abc_inc_cru_inh_mon "anti bounce counter increment for diagnosis instance CRU_INH_MON" VALUE 0x848200 _REC_VAL_20_u1 255. _CNV_A_R_LINEAR_____0_CM 0. 255. DISPLAY_IDENTIFIER C_ABC_INC_CRU_INH_MON FORMAT "%3.0" /end CHARACTERISTIC
/begin CHARACTERISTIC c_abc_max_cru_inh_mon "maximum value of anti bounce counter for diagnosis instance CRU_INH_MON" VALUE 0x848282 _REC_VAL_20_u1 254. _CNV_A_R_LINEAR_____0_CM 1. 255. DISPLAY_IDENTIFIER C_ABC_MAX_CRU_INH_MON FORMAT "%3.0" /end CHARACTERISTIC
/begin CHARACTERISTIC c_abc_inc_serv_mon_1 "anti bounce counter increment for diagnosis instance SERV_MON_1" VALUE 0x848240 _REC_VAL_20_u1 255. _CNV_A_R_LINEAR_____0_CM 0. 255. DISPLAY_IDENTIFIER C_ABC_INC_SERV_MON_1 FORMAT "%3.0" /end CHARACTERISTIC
/begin CHARACTERISTIC c_abc_max_serv_mon_1 "maximum value of anti bounce counter for diagnosis instance SERV_MON_1" VALUE 0x8482c2 _REC_VAL_20_u1 255. _CNV_A_R_LINEAR_____0_CM 0. 255. DISPLAY_IDENTIFIER C_ABC_MAX_SERV_MON_1 FORMAT "%3.0" /end CHARACTERISTIC
/begin MEASUREMENT lv_n_lim_req_mon "v" UBYTE _CNV_S_2_RANGE__0___88_CM 1 0. 0. 1. DISPLAY_IDENTIFIER LV_N_LIM_REQ_MON ECU_ADDRESS 0x7fb83a /end MEASUREMENT
/begin MEASUREMENT lv_off_mtc_mon "v" UBYTE _CNV_S_2_RANGE__0___88_CM 1 0. 0. 1. DISPLAY_IDENTIFIER LV_OFF_MTC_MON ECU_ADDRESS 0x7fb83b /end MEASUREMENT
/begin MEASUREMENT lv_off_iv_mon "v" UBYTE _CNV_S_2_RANGE__0___88_CM 1 0. 0. 1. DISPLAY_IDENTIFIER LV_OFF_IV_MON ECU_ADDRESS 0x7fb83c /end MEASUREMENT
/begin MEASUREMENT t_fcut_inh_mon "" UBYTE _CNV_A_R_LINEAR_____357_CM 1 0. 0. 10.2 DISPLAY_IDENTIFIER T_FCUT_INH_MON ECU_ADDRESS 0x7fb83e FORMAT "%4.2" /end MEASUREMENT
/begin MEASUREMENT abc_fcut_mon "" UBYTE _CNV_A_R_LINEAR_____0_CM 1 0. 0. 255. DISPLAY_IDENTIFIER ABC_FCUT_MON ECU_ADDRESS 0x7fbc6d FORMAT "%3.0" /end MEASUREMENT
/begin CHARACTERISTIC c_t_fcut_inh_mon "" VALUE 0x85c0cf _REC_VAL_20_u1 10.2 _CNV_A_R_LINEAR_____357_CM 0. 10.2 DISPLAY_IDENTIFIER C_T_FCUT_INH_MON FORMAT "%4.2" /end CHARACTERISTIC
/begin CHARACTERISTIC c_abc_inc_fcut_mon "" VALUE 0x85bc88 _REC_VAL_20_u1 255. _CNV_A_R_LINEAR_____0_CM 0. 255. DISPLAY_IDENTIFIER C_ABC_INC_FCUT_MON FORMAT "%3.0" /end CHARACTERISTIC
/begin CHARACTERISTIC c_abc_max_fcut_mon "" VALUE 0x85bc9d _REC_VAL_20_u1 254. _CNV_A_R_LINEAR_____0_CM 1. 255. DISPLAY_IDENTIFIER C_ABC_MAX_FCUT_MON FORMAT "%3.0" /end CHARACTERISTIC
/begin MEASUREMENT lv_err_fcut_mon "" UBYTE _CNV_S_2_RANGE______11_CM 1 0. 0. 1. DISPLAY_IDENTIFIER LV_ERR_FCUT_MON ECU_ADDRESS 0x7fb83d /end MEASUREMENT
/begin MEASUREMENT lv_brake_mon "brake active or brake fault present" UBYTE _CNV_S_2_RANGE______11_CM 1 0. 0. 1. DISPLAY_IDENTIFIER LV_BRAKE_MON ECU_ADDRESS 0x7fb83f /end MEASUREMENT
/begin MEASUREMENT lv_err_vcc_pvs_1_mon "fault in power supply for PVS_1 present" UBYTE _CNV_S_2_RANGE______11_CM 1 0. 0. 1. DISPLAY_IDENTIFIER LV_ERR_VCC_PVS_1_MON ECU_ADDRESS 0x7fb840 /end MEASUREMENT
/begin MEASUREMENT lv_err_vcc_pvs_2_mon "fault in power supply for PVS_2 present" UBYTE _CNV_S_2_RANGE______11_CM 1 0. 0. 1. DISPLAY_IDENTIFIER LV_ERR_VCC_PVS_2_MON ECU_ADDRESS 0x7fb841 /end MEASUREMENT
/begin MEASUREMENT lv_err_vcc_pvs_mon "fault in power supply for PVS present" UBYTE _CNV_S_2_RANGE______11_CM 1 0. 0. 1. DISPLAY_IDENTIFIER LV_ERR_VCC_PVS_MON ECU_ADDRESS 0x7fb842 /end MEASUREMENT
/begin MEASUREMENT vcc_pvs_mon "supply voltage pedal value" UWORD _CNV_A_R_LINEAR_____40_CM 1 0. 0. 9.99023 DISPLAY_IDENTIFIER VCC_PVS_MON ECU_ADDRESS 0x7fb19e BYTE_ORDER MSB_LAST FORMAT "%3.2" /end MEASUREMENT
/begin MEASUREMENT abc_vcc_pvs_mon "anti bounce counter VCC error" UBYTE _CNV_A_R_LINEAR_____0_CM 1 0. 0. 255. DISPLAY_IDENTIFIER ABC_VCC_PVS_MON ECU_ADDRESS 0x7fbc72 FORMAT "%3.0" /end MEASUREMENT
/begin CHARACTERISTIC c_vcc_pvs_max_mon "upper  threshold for monitoring supply voltage" VALUE 0x85c2c2 _REC_VAL_20_u2 9.99023 _CNV_A_R_LINEAR_____40_CM 0. 9.99023 DISPLAY_IDENTIFIER C_VCC_PVS_MAX_MON FORMAT "%4.3" /end CHARACTERISTIC
/begin CHARACTERISTIC c_vcc_pvs_min_mon "lower threshold for monitoring supply voltage" VALUE 0x85c2c4 _REC_VAL_20_u2 9.99023 _CNV_A_R_LINEAR_____40_CM 0. 9.99023 DISPLAY_IDENTIFIER C_VCC_PVS_MIN_MON FORMAT "%4.3" /end CHARACTERISTIC
/begin CHARACTERISTIC c_v_pvs_max_mon "upper threshold for monitoring pedal voltage" VALUE 0x85c246 _REC_VAL_20_u2 4.9951171875 _CNV_A_R_LINEAR_____33_CM 0. 4.9951171875 DISPLAY_IDENTIFIER C_V_PVS_MAX_MON FORMAT "%4.3" /end CHARACTERISTIC
/begin CHARACTERISTIC c_abc_inc_vcc_pvs_mon "anti bounce counter increment monitoring referents voltage" VALUE 0x85bc95 _REC_VAL_20_u1 255. _CNV_A_R_LINEAR_____0_CM 0. 255. DISPLAY_IDENTIFIER C_ABC_INC_VCC_PVS_MON FORMAT "%3.0" /end CHARACTERISTIC
/begin CHARACTERISTIC c_abc_max_vcc_pvs_mon "value at which VCC error is recognizef, when reached" VALUE 0x85bcab _REC_VAL_20_u1 254. _CNV_A_R_LINEAR_____0_CM 1. 255. DISPLAY_IDENTIFIER C_ABC_MAX_VCC_PVS_MON FORMAT "%3.0" /end CHARACTERISTIC
/begin MEASUREMENT lv_fcut_mon_act_mon "logical variable for process monitoring" UBYTE _CNV_S_2_RANGE______11_CM 1 0. 0. 1. DISPLAY_IDENTIFIER LV_FCUT_MON_ACT_MON ECU_ADDRESS 0x7fb843 /end MEASUREMENT
/begin MEASUREMENT lv_tqi_mon_act_mon "logical variable for process monitoring" UBYTE _CNV_S_2_RANGE______11_CM 1 0. 0. 1. DISPLAY_IDENTIFIER LV_TQI_MON_ACT_MON ECU_ADDRESS 0x7fb844 /end MEASUREMENT
/begin MEASUREMENT lv_n_lim_etc_mon "Logical variable for activation of engine speed limitation monitoring" UBYTE _CNV_S_2_RANGE______11_CM 1 0. 0. 1. DISPLAY_IDENTIFIER LV_N_LIM_ETC_MON ECU_ADDRESS 0x7fb845 /end MEASUREMENT
/begin MEASUREMENT lv_igk_mon "logical variable for ignition key on" UBYTE _CNV_S_2_RANGE______11_CM 1 0. 0. 1. DISPLAY_IDENTIFIER LV_IGK_MON ECU_ADDRESS 0x7fb846 /end MEASUREMENT
/begin MEASUREMENT lv_igk_act_n_lim_mon "Logical variable for of engine speed limitation monitoring during key off" UBYTE _CNV_S_2_RANGE______11_CM 1 0. 0. 1. DISPLAY_IDENTIFIER LV_IGK_ACT_N_LIM_MON ECU_ADDRESS 0x7fb847 /end MEASUREMENT
/begin MEASUREMENT t_prep_es_mon "Timer for engine speed limitation monitoring activation after key off" UBYTE _CNV_A_R_LINEAR_____357_CM 1 0. 0. 10.2 DISPLAY_IDENTIFIER T_PREP_ES_MON ECU_ADDRESS 0x7fb848 FORMAT "%4.2" /end MEASUREMENT
/begin CHARACTERISTIC c_n_min_fcut_mon "minimal engine speed monitoring fuel cut off condition" VALUE 0x85bfbc _REC_VAL_20_u1 8160. _CNV_A_R_LINEAR_____58_CM 0. 8160. DISPLAY_IDENTIFIER C_N_MIN_FCUT_MON FORMAT "%4.0" /end CHARACTERISTIC
/begin CHARACTERISTIC c_t_prep_es_mon "Minimal time for engine stop after key off" VALUE 0x85c104 _REC_VAL_20_u1 10.2 _CNV_A_R_LINEAR_____357_CM 0. 10.2 DISPLAY_IDENTIFIER C_T_PREP_ES_MON FORMAT "%4.2" /end CHARACTERISTIC
/begin MEASUREMENT state_iv "status word disable injectors" UBYTE _CNV_A_R_LINEAR_____0_CM 1 0. 0. 255. DISPLAY_IDENTIFIER STATE_IV ECU_ADDRESS 0x7fb849 FORMAT "%3.0" /end MEASUREMENT
/begin MEASUREMENT prev_state_iv "status word disable injectors" UBYTE _CNV_A_R_LINEAR_____0_CM 1 0. 0. 255. DISPLAY_IDENTIFIER PREV_STATE_IV ECU_ADDRESS 0x7fb84a FORMAT "%3.0" /end MEASUREMENT
/begin MEASUREMENT lv_err_tqi_n_max_mon "" UBYTE _CNV_S_2_RANGE______28_CM 1 0. 0. 1. DISPLAY_IDENTIFIER LV_ERR_TQI_N_MAX_MON ECU_ADDRESS 0x7fb84b /end MEASUREMENT
/begin MEASUREMENT abc_tqi_n_max_mon "" UBYTE _CNV_A_R_LINEAR_____0_CM 1 0. 0. 255. DISPLAY_IDENTIFIER ABC_TQI_N_MAX_MON ECU_ADDRESS 0x7fbc80 FORMAT "%3.0" /end MEASUREMENT
/begin CHARACTERISTIC c_n_max_mtc_lih_thd_mon "" VALUE 0x85bfb0 _REC_VAL_20_u1 8160. _CNV_A_R_LINEAR_____58_CM 0. 8160. DISPLAY_IDENTIFIER C_N_MAX_MTC_LIH_THD_MON FORMAT "%4.0" /end CHARACTERISTIC
/begin CHARACTERISTIC c_abc_inc_tqi_n_max_mon "" VALUE 0x85bc93 _REC_VAL_20_u1 255. _CNV_A_R_LINEAR_____0_CM 0. 255. DISPLAY_IDENTIFIER C_ABC_INC_TQI_N_MAX_MON FORMAT "%3.0" /end CHARACTERISTIC
/begin CHARACTERISTIC c_abc_max_tqi_n_max_mon "" VALUE 0x85bca8 _REC_VAL_20_u1 254. _CNV_A_R_LINEAR_____0_CM 1. 255. DISPLAY_IDENTIFIER C_ABC_MAX_TQI_N_MAX_MON FORMAT "%3.0" /end CHARACTERISTIC
/begin MEASUREMENT abc_n_32_mon "" UBYTE _CNV_A_R_LINEAR_____0_CM 1 0. 0. 255. DISPLAY_IDENTIFIER ABC_N_32_MON ECU_ADDRESS 0x7fbc84 FORMAT "%3.0" /end MEASUREMENT
/begin MEASUREMENT lv_err_n_32_mon "" UBYTE _CNV_S_2_RANGE______28_CM 1 0. 0. 1. DISPLAY_IDENTIFIER LV_ERR_N_32_MON ECU_ADDRESS 0x7fb84c /end MEASUREMENT
/begin MEASUREMENT n_32_sub_mon "" UBYTE _CNV_A_R_LINEAR_____58_CM 1 0. 0. 8160. DISPLAY_IDENTIFIER N_32_SUB_MON ECU_ADDRESS 0x7fbc86 FORMAT "%4.0" /end MEASUREMENT
/begin MEASUREMENT n_32_dif_rel_mon "v" UWORD _CNV_A_R_LINEAR_____362_CM 1 0. 0. 255. DISPLAY_IDENTIFIER N_32_DIF_REL_MON ECU_ADDRESS 0x7fb1a0 BYTE_ORDER MSB_LAST /end MEASUREMENT
/begin MEASUREMENT n_32_mon "" UBYTE _CNV_A_R_LINEAR_____58_CM 1 0. 0. 8160. DISPLAY_IDENTIFIER N_32_MON ECU_ADDRESS 0x7fb84d FORMAT "%4.0" /end MEASUREMENT
/begin CHARACTERISTIC c_abc_inc_n_32_mon "" VALUE 0x85bc8b _REC_VAL_20_u1 255. _CNV_A_R_LINEAR_____0_CM 0. 255. DISPLAY_IDENTIFIER C_ABC_INC_N_32_MON FORMAT "%3.0" /end CHARACTERISTIC
/begin CHARACTERISTIC c_abc_max_n_32_mon "" VALUE 0x85bca0 _REC_VAL_20_u1 254. _CNV_A_R_LINEAR_____0_CM 1. 255. DISPLAY_IDENTIFIER C_ABC_MAX_N_32_MON FORMAT "%3.0" /end CHARACTERISTIC
/begin CHARACTERISTIC c_n_32_dif_rel_max_mon "" VALUE 0x85bf7a _REC_VAL_20_u2 255. _CNV_A_R_LINEAR_____362_CM 0. 255. DISPLAY_IDENTIFIER C_N_32_DIF_REL_MAX_MON /end CHARACTERISTIC
/begin CHARACTERISTIC c_n_32_lim_mon "" VALUE 0x85bf7e _REC_VAL_20_u1 8128. _CNV_A_R_LINEAR_____58_CM 32. 8160. DISPLAY_IDENTIFIER C_N_32_LIM_MON FORMAT "%4.0" /end CHARACTERISTIC
/begin CHARACTERISTIC c_n_32_min_mon "" VALUE 0x85bf87 _REC_VAL_20_u1 8160. _CNV_A_R_LINEAR_____58_CM 0. 8160. DISPLAY_IDENTIFIER C_N_32_MIN_MON FORMAT "%4.0" /end CHARACTERISTIC
/begin CHARACTERISTIC c_acq_conv_hys_mon "" VALUE 0x85bcb6 _REC_VAL_20_u1 4.98046875 _CNV_A_R_LINEAR_____365_CM 0. 4.98046875 DISPLAY_IDENTIFIER C_ACQ_CONV_HYS_MON FORMAT "%3.2" /end CHARACTERISTIC
/begin CHARACTERISTIC c_abc_inc_conv_mon "" VALUE 0x85bc86 _REC_VAL_20_u1 255. _CNV_A_R_LINEAR_____0_CM 0. 255. DISPLAY_IDENTIFIER C_ABC_INC_CONV_MON FORMAT "%3.0" /end CHARACTERISTIC
/begin CHARACTERISTIC c_abc_max_conv_mon "" VALUE 0x85bc9b _REC_VAL_20_u1 254. _CNV_A_R_LINEAR_____0_CM 1. 255. DISPLAY_IDENTIFIER C_ABC_MAX_CONV_MON FORMAT "%3.0" /end CHARACTERISTIC
/begin MEASUREMENT abc_conv_mon "" UBYTE _CNV_A_R_LINEAR_____0_CM 1 0. 0. 255. DISPLAY_IDENTIFIER ABC_CONV_MON ECU_ADDRESS 0x7fbc25 FORMAT "%3.0" /end MEASUREMENT
/begin MEASUREMENT lv_err_conv_mon "" UBYTE _CNV_S_2_RANGE______28_CM 1 0. 0. 1. DISPLAY_IDENTIFIER LV_ERR_CONV_MON ECU_ADDRESS 0x7fb833 /end MEASUREMENT
/begin CHARACTERISTIC c_cfb_pcv_mes_max_diag "" VALUE 0x85bd2c _REC_VAL_20_u4 3.25 _CNV_A_R_LINEAR_____377_CM 0. 3.25 DISPLAY_IDENTIFIER C_CFB_PCV_MES_MAX_DIAG /end CHARACTERISTIC
/begin CHARACTERISTIC c_cfb_vcv_mes_max_diag "" VALUE 0x85bd30 _REC_VAL_20_u4 3.25 _CNV_A_R_LINEAR_____377_CM 0. 3.25 DISPLAY_IDENTIFIER C_CFB_VCV_MES_MAX_DIAG /end CHARACTERISTIC
/begin CHARACTERISTIC c_v_cfb_pcv_max_diag "" VALUE 0x85c1fe _REC_VAL_20_u2 4.9951171875 _CNV_A_R_LINEAR_____33_CM 0. 4.9951171875 DISPLAY_IDENTIFIER C_V_CFB_PCV_MAX_DIAG FORMAT "%3.2" /end CHARACTERISTIC
/begin CHARACTERISTIC c_v_cfb_pcv_min_diag "" VALUE 0x85c200 _REC_VAL_20_u2 4.9951171875 _CNV_A_R_LINEAR_____33_CM 0. 4.9951171875 DISPLAY_IDENTIFIER C_V_CFB_PCV_MIN_DIAG FORMAT "%3.2" /end CHARACTERISTIC
/begin CHARACTERISTIC c_v_cfb_vcv_max_diag "" VALUE 0x85c202 _REC_VAL_20_u2 4.9951171875 _CNV_A_R_LINEAR_____33_CM 0. 4.9951171875 DISPLAY_IDENTIFIER C_V_CFB_VCV_MAX_DIAG FORMAT "%3.2" /end CHARACTERISTIC
/begin CHARACTERISTIC c_v_cfb_vcv_min_diag "" VALUE 0x85c204 _REC_VAL_20_u2 4.9951171875 _CNV_A_R_LINEAR_____33_CM 0. 4.9951171875 DISPLAY_IDENTIFIER C_V_CFB_VCV_MIN_DIAG FORMAT "%3.2" /end CHARACTERISTIC
/begin MEASUREMENT cfb_vcv_mes "" UWORD _CNV_A_R_LINEAR_____377_CM 1 0. 0. 3.25 DISPLAY_IDENTIFIER CFB_VCV_MES ECU_ADDRESS 0x7fa278 BYTE_ORDER MSB_LAST FORMAT "%3.2" /end MEASUREMENT
/begin MEASUREMENT v_cfb_pcv "" UWORD _CNV_A_R_LINEAR_____33_CM 1 0. 0. 4.9951171875 DISPLAY_IDENTIFIER V_CFB_PCV ECU_ADDRESS 0x7fb12c BYTE_ORDER MSB_LAST FORMAT "%3.2" /end MEASUREMENT
/begin MEASUREMENT v_cfb_vcv "" UWORD _CNV_A_R_LINEAR_____33_CM 1 0. 0. 4.9951171875 DISPLAY_IDENTIFIER V_CFB_VCV ECU_ADDRESS 0x7fb12a BYTE_ORDER MSB_LAST FORMAT "%3.2" /end MEASUREMENT
/begin AXIS_PTS ldp_vb_ip_pcv_min_diag "" 0x843389 vb _REC_AXS_20_u1 28.8 _CNV_A_R_LINEAR_____48_CM 4 0. 28.8 FORMAT "%4.2" /end AXIS_PTS
/begin CHARACTERISTIC ip_pcv_min_diag__vb "DIAG_PCV:threshold for inhibition of OL detection" CURVE 0x8557cc _REC_CUR_20_u2_u1 99.99847412109381 _CNV_A_R_LINEAR_____8_CM 0. 99.99847412109381 DISPLAY_IDENTIFIER IP_PCV_MIN_DIAG__VB
 /begin AXIS_DESCR COM_AXIS vb _CNV_A_R_LINEAR_____48_CM 4 0. 28.8 FORMAT "%4.2" AXIS_PTS_REF ldp_vb_ip_pcv_min_diag /end AXIS_DESCR
/end CHARACTERISTIC
/begin CHARACTERISTIC c_abc_inc_bpa "" VALUE 0x85bc84 _REC_VAL_20_u1 255. _CNV_A_R_LINEAR_____0_CM 0. 255. DISPLAY_IDENTIFIER C_ABC_INC_BPA FORMAT "%3.0" /end CHARACTERISTIC
/begin CHARACTERISTIC c_abc_inc_gl_rly_dps "" VALUE 0x85bc8a _REC_VAL_20_u1 255. _CNV_A_R_LINEAR_____0_CM 0. 255. DISPLAY_IDENTIFIER C_ABC_INC_GL_RLY_DPS FORMAT "%3.0" /end CHARACTERISTIC
/begin CHARACTERISTIC c_abc_inc_pcv_1 "" VALUE 0x85bc8d _REC_VAL_20_u1 255. _CNV_A_R_LINEAR_____0_CM 0. 255. DISPLAY_IDENTIFIER C_ABC_INC_PCV_1 FORMAT "%3.0" /end CHARACTERISTIC
/begin CHARACTERISTIC c_abc_inc_pcv_2 "" VALUE 0x85bc8e _REC_VAL_20_u1 255. _CNV_A_R_LINEAR_____0_CM 0. 255. DISPLAY_IDENTIFIER C_ABC_INC_PCV_2 FORMAT "%3.0" /end CHARACTERISTIC
/begin CHARACTERISTIC c_abc_inc_pcv_3 "" VALUE 0x85bc8f _REC_VAL_20_u1 255. _CNV_A_R_LINEAR_____0_CM 0. 255. DISPLAY_IDENTIFIER C_ABC_INC_PCV_3 FORMAT "%3.0" /end CHARACTERISTIC
/begin CHARACTERISTIC c_abc_inc_vcv_1 "" VALUE 0x85bc96 _REC_VAL_20_u1 255. _CNV_A_R_LINEAR_____0_CM 0. 255. DISPLAY_IDENTIFIER C_ABC_INC_VCV_1 FORMAT "%3.0" /end CHARACTERISTIC
/begin CHARACTERISTIC c_abc_inc_vcv_2 "" VALUE 0x85bc97 _REC_VAL_20_u1 255. _CNV_A_R_LINEAR_____0_CM 0. 255. DISPLAY_IDENTIFIER C_ABC_INC_VCV_2 FORMAT "%3.0" /end CHARACTERISTIC
/begin CHARACTERISTIC c_abc_inc_vcv_3 "" VALUE 0x85bc98 _REC_VAL_20_u1 255. _CNV_A_R_LINEAR_____0_CM 0. 255. DISPLAY_IDENTIFIER C_ABC_INC_VCV_3 FORMAT "%3.0" /end CHARACTERISTIC
/begin CHARACTERISTIC c_abc_max_bpa "" VALUE 0x85bc99 _REC_VAL_20_u1 255. _CNV_A_R_LINEAR_____0_CM 0. 255. DISPLAY_IDENTIFIER C_ABC_MAX_BPA FORMAT "%3.0" /end CHARACTERISTIC
/begin CHARACTERISTIC c_abc_max_gl_rly_dps "" VALUE 0x85bc9f _REC_VAL_20_u1 255. _CNV_A_R_LINEAR_____0_CM 0. 255. DISPLAY_IDENTIFIER C_ABC_MAX_GL_RLY_DPS FORMAT "%3.0" /end CHARACTERISTIC
/begin CHARACTERISTIC c_abc_max_pcv_1 "" VALUE 0x85bca2 _REC_VAL_20_u1 255. _CNV_A_R_LINEAR_____0_CM 0. 255. DISPLAY_IDENTIFIER C_ABC_MAX_PCV_1 FORMAT "%3.0" /end CHARACTERISTIC
/begin CHARACTERISTIC c_abc_max_pcv_2 "" VALUE 0x85bca3 _REC_VAL_20_u1 255. _CNV_A_R_LINEAR_____0_CM 0. 255. DISPLAY_IDENTIFIER C_ABC_MAX_PCV_2 FORMAT "%3.0" /end CHARACTERISTIC
/begin CHARACTERISTIC c_abc_max_pcv_3 "" VALUE 0x85bca4 _REC_VAL_20_u1 255. _CNV_A_R_LINEAR_____0_CM 0. 255. DISPLAY_IDENTIFIER C_ABC_MAX_PCV_3 FORMAT "%3.0" /end CHARACTERISTIC
/begin CHARACTERISTIC c_abc_max_vcv_1 "" VALUE 0x85bcac _REC_VAL_20_u1 255. _CNV_A_R_LINEAR_____0_CM 0. 255. DISPLAY_IDENTIFIER C_ABC_MAX_VCV_1 FORMAT "%3.0" /end CHARACTERISTIC
/begin CHARACTERISTIC c_abc_max_vcv_2 "" VALUE 0x85bcad _REC_VAL_20_u1 255. _CNV_A_R_LINEAR_____0_CM 0. 255. DISPLAY_IDENTIFIER C_ABC_MAX_VCV_2 FORMAT "%3.0" /end CHARACTERISTIC
/begin CHARACTERISTIC c_abc_max_vcv_3 "" VALUE 0x85bcae _REC_VAL_20_u1 255. _CNV_A_R_LINEAR_____0_CM 0. 255. DISPLAY_IDENTIFIER C_ABC_MAX_VCV_3 FORMAT "%3.0" /end CHARACTERISTIC
/begin MEASUREMENT lv_fuel_warn "" UBYTE _CNV_S_2_RANGE______11_CM 1 0. 0. 1. DISPLAY_IDENTIFIER LV_FUEL_WARN ECU_ADDRESS 0x7fb81b /end MEASUREMENT
/begin CHARACTERISTIC c_vb_nom "" VALUE 0x85c2bc _REC_VAL_20_u1 28.8 _CNV_A_R_LINEAR_____48_CM 0. 28.8 DISPLAY_IDENTIFIER C_VB_NOM FORMAT "%4.2" /end CHARACTERISTIC
/begin AXIS_PTS ldp_frq_maf_id_maf_x "" 0x8416c3 v_maf_x _REC_AXS_20_u1 15. _CNV_A_R_LINEAR_____0_CM 16 0. 15. FORMAT "%2.0" /end AXIS_PTS
/begin AXIS_PTS ldp_frq_maf_id_maf_y "" 0x8416d4 v_maf_y _REC_AXS_20_u1 15. _CNV_A_R_LINEAR_____0_CM 16 0. 15. FORMAT "%2.0" /end AXIS_PTS
/begin CHARACTERISTIC id_maf_frq_tab "mass air flow" MAP 0x848998 _REC_MAP_20_u2_u1_u1 1023.984375 _CNV_A_R_LINEAR_____112_CM 0. 1023.984375 DISPLAY_IDENTIFIER ID_MAF_FRQ_TAB FORMAT "%7.2"
 /begin AXIS_DESCR COM_AXIS v_maf_x _CNV_A_R_LINEAR_____0_CM 16 0. 15. FORMAT "%2.0" AXIS_PTS_REF ldp_frq_maf_id_maf_x /end AXIS_DESCR
 /begin AXIS_DESCR COM_AXIS v_maf_y _CNV_A_R_LINEAR_____0_CM 16 0. 15. FORMAT "%2.0" AXIS_PTS_REF ldp_frq_maf_id_maf_y /end AXIS_DESCR
/end CHARACTERISTIC
/begin CHARACTERISTIC c_t_low_maf_frq_0_min "" VALUE 0x85c0e6 _REC_VAL_20_u2 262143. _CNV_A_R_LINEAR_____381_CM 0. 262143. DISPLAY_IDENTIFIER C_T_LOW_MAF_FRQ_0_MIN FORMAT "%6.0" /end CHARACTERISTIC
/begin CHARACTERISTIC c_t_low_maf_frq_0_max "" VALUE 0x85c0e4 _REC_VAL_20_u2 262143. _CNV_A_R_LINEAR_____381_CM 0. 262143. DISPLAY_IDENTIFIER C_T_LOW_MAF_FRQ_0_MAX FORMAT "%6.0" /end CHARACTERISTIC
/begin CHARACTERISTIC c_maf_frq_0_bas_max "" VALUE 0x85befc _REC_VAL_20_u2 65535. _CNV_A_R_LINEAR_____382_CM 0. 65535. DISPLAY_IDENTIFIER C_MAF_FRQ_0_BAS_MAX FORMAT "%5.0" /end CHARACTERISTIC
/begin CHARACTERISTIC c_maf_frq_0_bas_min "" VALUE 0x85befe _REC_VAL_20_u2 65535. _CNV_A_R_LINEAR_____382_CM 0. 65535. DISPLAY_IDENTIFIER C_MAF_FRQ_0_BAS_MIN FORMAT "%5.0" /end CHARACTERISTIC
/begin CHARACTERISTIC c_maf_frq_bas_max_ip "" VALUE 0x85bf00 _REC_VAL_20_u2 65535. _CNV_A_R_LINEAR_____382_CM 0. 65535. DISPLAY_IDENTIFIER C_MAF_FRQ_BAS_MAX_IP FORMAT "%5.0" /end CHARACTERISTIC
/begin MEASUREMENT lv_err_frq_maf_frq_0 "" UBYTE _CNV_S_2_RANGE______28_CM 1 0. 0. 1. DISPLAY_IDENTIFIER LV_ERR_FRQ_MAF_FRQ_0 ECU_ADDRESS 0x7fca68 /end MEASUREMENT
/begin AXIS_PTS ldp_v_t_atic20_ip_t_atic20 "" 0x8432fa v_t_atic20 _REC_AXS_20_u1 4.482421875 _CNV_A_R_LINEAR_____365_CM 16 0. 4.98046875 FORMAT "%4.2" /end AXIS_PTS
/begin AXIS_PTS ldp_v_t_lc_ip_t_lc "" 0x84330b v_t_lc _REC_AXS_20_u1 4.482421875 _CNV_A_R_LINEAR_____365_CM 16 0. 4.98046875 FORMAT "%4.2" /end AXIS_PTS
/begin CHARACTERISTIC ip_t_atic20__v_t_atic20 "TECU temperature atic20" CURVE 0x85aa6a _REC_CUR_20_u1_u1 255. _CNV_A_R_LINEAR_____18_CM -50. 205. DISPLAY_IDENTIFIER IP_T_ATIC20__V_T_ATIC20 FORMAT "%5.1"
 /begin AXIS_DESCR COM_AXIS v_t_atic20 _CNV_A_R_LINEAR_____365_CM 16 0. 4.98046875 FORMAT "%4.2" AXIS_PTS_REF ldp_v_t_atic20_ip_t_atic20 /end AXIS_DESCR
/end CHARACTERISTIC
/begin CHARACTERISTIC ip_t_lc__v_t_lc "TECU temperature lc" CURVE 0x85aad8 _REC_CUR_20_u1_u1 255. _CNV_A_R_LINEAR_____18_CM -50. 205. DISPLAY_IDENTIFIER IP_T_LC__V_T_LC FORMAT "%5.1"
 /begin AXIS_DESCR COM_AXIS v_t_lc _CNV_A_R_LINEAR_____365_CM 16 0. 4.98046875 FORMAT "%4.2" AXIS_PTS_REF ldp_v_t_lc_ip_t_lc /end AXIS_DESCR
/end CHARACTERISTIC
/begin CHARACTERISTIC c_vb_max_diag "Maximum threshold for battery voltage fault detection. Typical value: 17,5V" VALUE 0x85c2b1 _REC_VAL_20_u1 28.8 _CNV_A_R_LINEAR_____48_CM 0. 28.8 DISPLAY_IDENTIFIER C_VB_MAX_DIAG FORMAT "%3.1" /end CHARACTERISTIC
/begin CHARACTERISTIC c_vb_min_diag "Minimum threshold for battery voltage fault detection. Typical value: 7V" VALUE 0x85c2b6 _REC_VAL_20_u1 28.8 _CNV_A_R_LINEAR_____48_CM 0. 28.8 DISPLAY_IDENTIFIER C_VB_MIN_DIAG FORMAT "%3.1" /end CHARACTERISTIC
/begin CHARACTERISTIC c_vb_min_jump "threshold voltage for jump start recognition" VALUE 0x85c2b7 _REC_VAL_20_u1 28.8 _CNV_A_R_LINEAR_____48_CM 0. 28.8 DISPLAY_IDENTIFIER C_VB_MIN_JUMP FORMAT "%3.1" /end CHARACTERISTIC
/begin CHARACTERISTIC c_vb_min_obd1 "threshold voltage for deactivation of OBD1 diagnostic" VALUE 0x85c2b9 _REC_VAL_20_u1 28.8 _CNV_A_R_LINEAR_____48_CM 0. 28.8 DISPLAY_IDENTIFIER C_VB_MIN_OBD1 FORMAT "%3.1" /end CHARACTERISTIC
/begin CHARACTERISTIC c_vb_min_obd2 "threshold voltage for deactivation of OBD2 diagnostic" VALUE 0x85c2ba _REC_VAL_20_u1 28.8 _CNV_A_R_LINEAR_____48_CM 0. 28.8 DISPLAY_IDENTIFIER C_VB_MIN_OBD2 FORMAT "%3.1" /end CHARACTERISTIC
/begin MEASUREMENT lv_cdn_vb_obd1 "status of diagnostics release" UBYTE _CNV_S_2_RANGE______28_CM 1 0. 0. 1. DISPLAY_IDENTIFIER LV_CDN_VB_OBD1 ECU_ADDRESS 0x7fb75a /end MEASUREMENT
/begin MEASUREMENT lv_cdn_vb_obd2 "status of diagnostics release" UBYTE _CNV_S_2_RANGE______28_CM 1 0. 0. 1. DISPLAY_IDENTIFIER LV_CDN_VB_OBD2 ECU_ADDRESS 0x7fb75b /end MEASUREMENT
/begin MEASUREMENT lv_igk "Main wake-up detection" UBYTE _CNV_S_2_RANGE______28_CM 1 0. 0. 1. DISPLAY_IDENTIFIER LV_IGK ECU_ADDRESS 0x7fb758 /end MEASUREMENT
/begin MEASUREMENT vb "computed battery voltage" UBYTE _CNV_A_R_LINEAR_____48_CM 1 0. 0. 28.8 DISPLAY_IDENTIFIER VB ECU_ADDRESS 0x7fb756 FORMAT "%3.1" /end MEASUREMENT
/begin MEASUREMENT v_igk "computed battery voltage" UBYTE _CNV_A_R_LINEAR_____48_CM 1 0. 0. 28.8 DISPLAY_IDENTIFIER V_IGK ECU_ADDRESS 0x7fb757 FORMAT "%3.1" /end MEASUREMENT
/begin MEASUREMENT pcv "" UWORD _CNV_A_R_LINEAR_____8_CM 1 0. 0. 99.99847412109381 DISPLAY_IDENTIFIER PCV ECU_ADDRESS 0x7fa056 BYTE_ORDER MSB_LAST FORMAT "%7.3" /end MEASUREMENT
/begin CHARACTERISTIC c_abc_inc_spi_qps "anti bounce counter increment for diagnosis instance SPI_QPS" VALUE 0x848243 _REC_VAL_20_u1 255. _CNV_A_R_LINEAR_____0_CM 0. 255. DISPLAY_IDENTIFIER C_ABC_INC_SPI_QPS FORMAT "%3.0" /end CHARACTERISTIC
/begin CHARACTERISTIC c_abc_max_spi_qps "maximum value of anti bounce counter for diagnosis instance SPI_QPS" VALUE 0x8482c5 _REC_VAL_20_u1 255. _CNV_A_R_LINEAR_____0_CM 0. 255. DISPLAY_IDENTIFIER C_ABC_MAX_SPI_QPS FORMAT "%3.0" /end CHARACTERISTIC
/begin CHARACTERISTIC c_abc_inc_spi_oct "anti bounce counter increment for diagnosis instance SPI_OCT" VALUE 0x848242 _REC_VAL_20_u1 255. _CNV_A_R_LINEAR_____0_CM 0. 255. DISPLAY_IDENTIFIER C_ABC_INC_SPI_OCT FORMAT "%3.0" /end CHARACTERISTIC
/begin CHARACTERISTIC c_abc_max_spi_oct "maximum value of anti bounce counter for diagnosis instance SPI_OCT" VALUE 0x8482c4 _REC_VAL_20_u1 255. _CNV_A_R_LINEAR_____0_CM 0. 255. DISPLAY_IDENTIFIER C_ABC_MAX_SPI_OCT FORMAT "%3.0" /end CHARACTERISTIC
/begin CHARACTERISTIC c_abc_inc_spi_mps "anti bounce counter increment for diagnosis instance SPI_MPS" VALUE 0x848241 _REC_VAL_20_u1 255. _CNV_A_R_LINEAR_____0_CM 0. 255. DISPLAY_IDENTIFIER C_ABC_INC_SPI_MPS FORMAT "%3.0" /end CHARACTERISTIC
/begin CHARACTERISTIC c_abc_max_spi_mps "maximum value of anti bounce counter for diagnosis instance SPI_MPS" VALUE 0x8482c3 _REC_VAL_20_u1 255. _CNV_A_R_LINEAR_____0_CM 0. 255. DISPLAY_IDENTIFIER C_ABC_MAX_SPI_MPS FORMAT "%3.0" /end CHARACTERISTIC
/begin MEASUREMENT lv_spi_err_qps "daisy chain failure information QPS" UBYTE _CNV_S_2_RANGE______28_CM 1 0. 0. 1. DISPLAY_IDENTIFIER LV_SPI_ERR_QPS ECU_ADDRESS 0x7fba10 /end MEASUREMENT
/begin MEASUREMENT lv_spi_err_oct "daisy chain failure information OCT" UBYTE _CNV_S_2_RANGE______28_CM 1 0. 0. 1. DISPLAY_IDENTIFIER LV_SPI_ERR_OCT ECU_ADDRESS 0x7fba11 /end MEASUREMENT
/begin MEASUREMENT lv_spi_err_mps "daisy chain failure information MPS" UBYTE _CNV_S_2_RANGE______28_CM 1 0. 0. 1. DISPLAY_IDENTIFIER LV_SPI_ERR_MPS ECU_ADDRESS 0x7fba12 /end MEASUREMENT
/begin CHARACTERISTIC c_egrvpwm_min_diag "minimal duty cycle of the PWM signal" VALUE 0x85bdfc _REC_VAL_20_s2 199.996948242 _CNV_A_R_LINEAR_____12_CM -100. 99.996948242 DISPLAY_IDENTIFIER C_EGRVPWM_MIN_DIAG FORMAT "%5.3" /end CHARACTERISTIC
/begin CHARACTERISTIC c_egrvpwm_max_diag "maximal duty cycle of the PWM signal" VALUE 0x85bdfa _REC_VAL_20_s2 199.996948242 _CNV_A_R_LINEAR_____12_CM -100. 99.996948242 DISPLAY_IDENTIFIER C_EGRVPWM_MAX_DIAG FORMAT "%5.3" /end CHARACTERISTIC
/begin MEASUREMENT lv_err_det_spi_dps_egrv "SPI error detected for the diagnostic power stage of the EGR valve(s)" UBYTE _CNV_S_2_RANGE______11_CM 1 0. 0. 1. DISPLAY_IDENTIFIER LV_ERR_DET_SPI_DPS_EGRV ECU_ADDRESS 0x7fb473 /end MEASUREMENT
/begin CHARACTERISTIC c_abc_inc_egrv_0 "anti bounce counter increment for diagnosis instance EGRV_0" VALUE 0x848210 _REC_VAL_20_u1 255. _CNV_A_R_LINEAR_____0_CM 0. 255. DISPLAY_IDENTIFIER C_ABC_INC_EGRV_0 FORMAT "%3.0" /end CHARACTERISTIC
/begin CHARACTERISTIC c_abc_max_egrv_0 "maximum value of anti bounce counter for diagnosis instance EGRV_0" VALUE 0x848292 _REC_VAL_20_u1 255. _CNV_A_R_LINEAR_____0_CM 0. 255. DISPLAY_IDENTIFIER C_ABC_MAX_EGRV_0 FORMAT "%3.0" /end CHARACTERISTIC
/begin MEASUREMENT lv_err_pps_cyl[0] "electrical fault on one cylinder - debounced" UBYTE _CNV_S_2_RANGE______28_CM 1 0. 0. 1. DISPLAY_IDENTIFIER LV_ERR_PPS_CYL_0_ ECU_ADDRESS 0x7fb43e /end MEASUREMENT
/begin MEASUREMENT lv_err_pps_cyl[1] "electrical fault on one cylinder - debounced" UBYTE _CNV_S_2_RANGE______28_CM 1 0. 0. 1. DISPLAY_IDENTIFIER LV_ERR_PPS_CYL_1_ ECU_ADDRESS 0x7fb43f /end MEASUREMENT
/begin MEASUREMENT lv_err_pps_cyl[2] "electrical fault on one cylinder - debounced" UBYTE _CNV_S_2_RANGE______28_CM 1 0. 0. 1. DISPLAY_IDENTIFIER LV_ERR_PPS_CYL_2_ ECU_ADDRESS 0x7fb440 /end MEASUREMENT
/begin MEASUREMENT lv_err_pps_cyl[3] "electrical fault on one cylinder - debounced" UBYTE _CNV_S_2_RANGE______28_CM 1 0. 0. 1. DISPLAY_IDENTIFIER LV_ERR_PPS_CYL_3_ ECU_ADDRESS 0x7fb441 /end MEASUREMENT
/begin MEASUREMENT lv_err_det_pps_cyl[0] "electrical fault on one cylinder - status of this diagnosis cycle" UBYTE _CNV_S_2_RANGE______28_CM 1 0. 0. 1. DISPLAY_IDENTIFIER LV_ERR_DET_PPS_CYL_0_ ECU_ADDRESS 0x7fb442 /end MEASUREMENT
/begin MEASUREMENT lv_err_det_pps_cyl[1] "electrical fault on one cylinder - status of this diagnosis cycle" UBYTE _CNV_S_2_RANGE______28_CM 1 0. 0. 1. DISPLAY_IDENTIFIER LV_ERR_DET_PPS_CYL_1_ ECU_ADDRESS 0x7fb443 /end MEASUREMENT
/begin MEASUREMENT lv_err_det_pps_cyl[2] "electrical fault on one cylinder - status of this diagnosis cycle" UBYTE _CNV_S_2_RANGE______28_CM 1 0. 0. 1. DISPLAY_IDENTIFIER LV_ERR_DET_PPS_CYL_2_ ECU_ADDRESS 0x7fb444 /end MEASUREMENT
/begin MEASUREMENT lv_err_det_pps_cyl[3] "electrical fault on one cylinder - status of this diagnosis cycle" UBYTE _CNV_S_2_RANGE______28_CM 1 0. 0. 1. DISPLAY_IDENTIFIER LV_ERR_DET_PPS_CYL_3_ ECU_ADDRESS 0x7fb445 /end MEASUREMENT
/begin MEASUREMENT lv_err_pps_cbk[0] "electrical fault on one bank - debounced" UBYTE _CNV_S_2_RANGE______28_CM 1 0. 0. 1. DISPLAY_IDENTIFIER LV_ERR_PPS_CBK_0_ ECU_ADDRESS 0x7fb446 /end MEASUREMENT
/begin MEASUREMENT lv_err_det_pps_cbk[0] "electrical fault on one bank - status of this diagnosis cycle" UBYTE _CNV_S_2_RANGE______28_CM 1 0. 0. 1. DISPLAY_IDENTIFIER LV_ERR_DET_PPS_CBK_0_ ECU_ADDRESS 0x7fb447 /end MEASUREMENT
/begin MEASUREMENT lv_err_pps "general electrical fault debounced" UBYTE _CNV_S_2_RANGE______28_CM 1 0. 0. 1. DISPLAY_IDENTIFIER LV_ERR_PPS ECU_ADDRESS 0x7fb448 /end MEASUREMENT
/begin MEASUREMENT lv_err_det_pps "general electrical fault status of the last diagnosis cycle" UBYTE _CNV_S_2_RANGE______28_CM 1 0. 0. 1. DISPLAY_IDENTIFIER LV_ERR_DET_PPS ECU_ADDRESS 0x7fb449 /end MEASUREMENT
/begin MEASUREMENT t_ini_tout_pps[0] "Timer for PPS initialisation timeout" UBYTE _CNV_A_R_LINEAR_____59_CM 1 0. 0. 2.55 DISPLAY_IDENTIFIER T_INI_TOUT_PPS_0_ ECU_ADDRESS 0x7fb9e3 FORMAT "%3.2" /end MEASUREMENT
/begin MEASUREMENT lv_inh_diag_pps_oc "Inhibition of PPS_OC Diagnostic while warmup" UBYTE _CNV_S_2_RANGE______28_CM 1 0. 0. 1. DISPLAY_IDENTIFIER LV_INH_DIAG_PPS_OC ECU_ADDRESS 0x7fb9e6 /end MEASUREMENT
/begin MEASUREMENT lv_ini_pps[0] "PPS[NC_GRP_NR] flag for initialisation done" UBYTE _CNV_S_2_RANGE______28_CM 1 0. 0. 1. DISPLAY_IDENTIFIER LV_INI_PPS_0_ ECU_ADDRESS 0x7fb44a /end MEASUREMENT
/begin MEASUREMENT state_pps_diag_ini[0] "Initialisation diagnostic information from ATIC63" UBYTE _CNV_S_12_STATE_PPS__527_CM 1 0. 0. 11. DISPLAY_IDENTIFIER STATE_PPS_DIAG_INI_0_ ECU_ADDRESS 0x7fb9e4 /end MEASUREMENT
/begin MEASUREMENT cyl_nr_pps_diag "Number of cylinder, for which current diagnosis is done" UBYTE _CNV_A_R_LINEAR_____0_CM 1 0. 0. 255. DISPLAY_IDENTIFIER CYL_NR_PPS_DIAG ECU_ADDRESS 0x7fb9e5 FORMAT "%3.0" /end MEASUREMENT
/begin MEASUREMENT lv_v_cha_rng_l "Underrun of lower threshold for V_CHA range" UBYTE _CNV_S_2_RANGE______28_CM 1 0. 0. 1. DISPLAY_IDENTIFIER LV_V_CHA_RNG_L ECU_ADDRESS 0x7fb9e7 /end MEASUREMENT
/begin MEASUREMENT lv_v_cha_rng_h "Exeeding of upper threshold for V_CHA range" UBYTE _CNV_S_2_RANGE______28_CM 1 0. 0. 1. DISPLAY_IDENTIFIER LV_V_CHA_RNG_H ECU_ADDRESS 0x7fb9e8 /end MEASUREMENT
/begin MEASUREMENT lv_v_inj_rng_l "Underrun of lower threshold for V_INJ range" UBYTE _CNV_S_2_RANGE______28_CM 1 0. 0. 1. DISPLAY_IDENTIFIER LV_V_INJ_RNG_L ECU_ADDRESS 0x7fb9e9 /end MEASUREMENT
/begin MEASUREMENT lv_v_inj_rng_h "Exeeding of upper threshold for V_INJ range" UBYTE _CNV_S_2_RANGE______28_CM 1 0. 0. 1. DISPLAY_IDENTIFIER LV_V_INJ_RNG_H ECU_ADDRESS 0x7fb9ea /end MEASUREMENT
/begin MEASUREMENT lv_pps_prot_swi_act[0] "Protection switch" UBYTE _CNV_S_2_RANGE______28_CM 1 0. 0. 1. DISPLAY_IDENTIFIER LV_PPS_PROT_SWI_ACT_0_ ECU_ADDRESS 0x7fb9eb /end MEASUREMENT
/begin CHARACTERISTIC c_v_cha_min "Lower limit for range check of charge" VALUE 0x848728 _REC_VAL_20_u2 5. _CNV_A_R_LINEAR_____358_CM 0. 5. DISPLAY_IDENTIFIER C_V_CHA_MIN FORMAT "%4.1" /end CHARACTERISTIC
/begin CHARACTERISTIC c_v_cha_max "Upper limit for range check of charge" VALUE 0x848726 _REC_VAL_20_u2 5. _CNV_A_R_LINEAR_____358_CM 0. 5. DISPLAY_IDENTIFIER C_V_CHA_MAX FORMAT "%4.1" /end CHARACTERISTIC
/begin CHARACTERISTIC c_v_inj_min "Lower limit for range check of voltage" VALUE 0x848744 _REC_VAL_20_u2 255. _CNV_A_R_LINEAR_____123_CM 0. 255. DISPLAY_IDENTIFIER C_V_INJ_MIN FORMAT "%4.1" /end CHARACTERISTIC
/begin CHARACTERISTIC c_v_inj_max "Upper limit for range check of voltage" VALUE 0x848742 _REC_VAL_20_u2 255. _CNV_A_R_LINEAR_____123_CM 0. 255. DISPLAY_IDENTIFIER C_V_INJ_MAX FORMAT "%4.1" /end CHARACTERISTIC
/begin CHARACTERISTIC c_t_ini_pps_max "maximum time for initialisation timeout" VALUE 0x848660 _REC_VAL_20_u1 2.55 _CNV_A_R_LINEAR_____59_CM 0. 2.55 DISPLAY_IDENTIFIER C_T_INI_PPS_MAX FORMAT "%3.2" /end CHARACTERISTIC
/begin CHARACTERISTIC c_t_pps_wup "minimal warmup time" VALUE 0x84869e _REC_VAL_20_u1 25.5 _CNV_A_R_LINEAR_____19_CM 0. 25.5 DISPLAY_IDENTIFIER C_T_PPS_WUP FORMAT "%3.1" /end CHARACTERISTIC
/begin CHARACTERISTIC c_tco_min_hot "Minimum coolant temperature for warm injector recognition" VALUE 0x8486d5 _REC_VAL_20_u1 255. _CNV_A_R_LINEAR_____18_CM -50. 205. DISPLAY_IDENTIFIER C_TCO_MIN_HOT FORMAT "%3.0" /end CHARACTERISTIC
/begin CHARACTERISTIC c_v_inj_f_max "Max. injector voltage in phase F" VALUE 0x848740 _REC_VAL_20_u1 255. _CNV_A_R_LINEAR_____528_CM 0. 255. DISPLAY_IDENTIFIER C_V_INJ_F_MAX FORMAT "%4.1" /end CHARACTERISTIC
/begin CHARACTERISTIC c_v_cha_cal_thd_0 "First threshold for calibration mode" VALUE 0x84871e _REC_VAL_20_u2 5. _CNV_A_R_LINEAR_____358_CM 0. 5. DISPLAY_IDENTIFIER C_V_CHA_CAL_THD_0 FORMAT "%3.2" /end CHARACTERISTIC
/begin CHARACTERISTIC c_v_cha_cal_thd_1 "Second threshold for calibration mode" VALUE 0x848720 _REC_VAL_20_u2 5. _CNV_A_R_LINEAR_____358_CM 0. 5. DISPLAY_IDENTIFIER C_V_CHA_CAL_THD_1 FORMAT "%3.2" /end CHARACTERISTIC
/begin CHARACTERISTIC c_v_cha_cal_thd_2 "Third threshold for calibration mode" VALUE 0x848722 _REC_VAL_20_u2 5. _CNV_A_R_LINEAR_____358_CM 0. 5. DISPLAY_IDENTIFIER C_V_CHA_CAL_THD_2 FORMAT "%3.2" /end CHARACTERISTIC
/begin CHARACTERISTIC c_v_cha_cal_thd_3 "Fourth threshold for calibration mode" VALUE 0x848724 _REC_VAL_20_u2 5. _CNV_A_R_LINEAR_____358_CM 0. 5. DISPLAY_IDENTIFIER C_V_CHA_CAL_THD_3 FORMAT "%3.2" /end CHARACTERISTIC
/begin CHARACTERISTIC c_v_inj_min_scg "Threshold for SCG recognition" VALUE 0x848748 _REC_VAL_20_u2 255. _CNV_A_R_LINEAR_____123_CM 0. 255. DISPLAY_IDENTIFIER C_V_INJ_MIN_SCG FORMAT "%4.1" /end CHARACTERISTIC
/begin CHARACTERISTIC c_v_inj_min_scb "threshold for SCB recognition" VALUE 0x848746 _REC_VAL_20_u2 255. _CNV_A_R_LINEAR_____123_CM 0. 255. DISPLAY_IDENTIFIER C_V_INJ_MIN_SCB FORMAT "%4.1" /end CHARACTERISTIC
/begin CHARACTERISTIC c_pps_spi_diag_mask "bitwise enable of SPI diagnostic information (enable = 1)" VALUE 0x848590 _REC_VAL_20_u1 255. _CNV_A_R_LINEAR_____0_CM 0. 255. DISPLAY_IDENTIFIER C_PPS_SPI_DIAG_MASK FORMAT "%3.0" /end CHARACTERISTIC
/begin CHARACTERISTIC c_pps_spi_prog_mask "bitwise enable of SPI program status information (enable = 1)" VALUE 0x848591 _REC_VAL_20_u1 255. _CNV_A_R_LINEAR_____0_CM 0. 255. DISPLAY_IDENTIFIER C_PPS_SPI_PROG_MASK FORMAT "%3.0" /end CHARACTERISTIC
/begin MEASUREMENT lf_inj_act[0] "Injection state (cylinder individual)" UWORD _CNV_A_R_LINEAR_____0_CM 1 0. 0. 65535. DISPLAY_IDENTIFIER LF_INJ_ACT_0_ ECU_ADDRESS 0x7fa584 BYTE_ORDER MSB_LAST FORMAT "%5.0" /end MEASUREMENT
/begin MEASUREMENT lf_inj_act[1] "Injection state (cylinder individual)" UWORD _CNV_A_R_LINEAR_____0_CM 1 0. 0. 65535. DISPLAY_IDENTIFIER LF_INJ_ACT_1_ ECU_ADDRESS 0x7fa586 BYTE_ORDER MSB_LAST FORMAT "%5.0" /end MEASUREMENT
/begin MEASUREMENT lf_inj_act[2] "Injection state (cylinder individual)" UWORD _CNV_A_R_LINEAR_____0_CM 1 0. 0. 65535. DISPLAY_IDENTIFIER LF_INJ_ACT_2_ ECU_ADDRESS 0x7fa588 BYTE_ORDER MSB_LAST FORMAT "%5.0" /end MEASUREMENT
/begin MEASUREMENT lf_inj_act[3] "Injection state (cylinder individual)" UWORD _CNV_A_R_LINEAR_____0_CM 1 0. 0. 65535. DISPLAY_IDENTIFIER LF_INJ_ACT_3_ ECU_ADDRESS 0x7fa58a BYTE_ORDER MSB_LAST FORMAT "%5.0" /end MEASUREMENT
/begin MEASUREMENT lf_seq_act[0] "Sequence state (cylinder individual)" UWORD _CNV_A_R_LINEAR_____0_CM 1 0. 0. 65535. DISPLAY_IDENTIFIER LF_SEQ_ACT_0_ ECU_ADDRESS 0x7fa58c BYTE_ORDER MSB_LAST FORMAT "%5.0" /end MEASUREMENT
/begin MEASUREMENT lf_seq_act[1] "Sequence state (cylinder individual)" UWORD _CNV_A_R_LINEAR_____0_CM 1 0. 0. 65535. DISPLAY_IDENTIFIER LF_SEQ_ACT_1_ ECU_ADDRESS 0x7fa58e BYTE_ORDER MSB_LAST FORMAT "%5.0" /end MEASUREMENT
/begin MEASUREMENT lf_seq_act[2] "Sequence state (cylinder individual)" UWORD _CNV_A_R_LINEAR_____0_CM 1 0. 0. 65535. DISPLAY_IDENTIFIER LF_SEQ_ACT_2_ ECU_ADDRESS 0x7fa590 BYTE_ORDER MSB_LAST FORMAT "%5.0" /end MEASUREMENT
/begin MEASUREMENT lf_seq_act[3] "Sequence state (cylinder individual)" UWORD _CNV_A_R_LINEAR_____0_CM 1 0. 0. 65535. DISPLAY_IDENTIFIER LF_SEQ_ACT_3_ ECU_ADDRESS 0x7fa592 BYTE_ORDER MSB_LAST FORMAT "%5.0" /end MEASUREMENT
/begin CHARACTERISTIC c_abc_inc_pps_ini_0 "anti bounce counter increment for diagnosis instance PPS_INI_0" VALUE 0x848227 _REC_VAL_20_u1 255. _CNV_A_R_LINEAR_____0_CM 0. 255. DISPLAY_IDENTIFIER C_ABC_INC_PPS_INI_0 FORMAT "%3.0" /end CHARACTERISTIC
/begin CHARACTERISTIC c_abc_max_pps_ini_0 "maximum value of anti bounce counter for diagnosis instance PPS_INI_0" VALUE 0x8482a9 _REC_VAL_20_u1 255. _CNV_A_R_LINEAR_____0_CM 0. 255. DISPLAY_IDENTIFIER C_ABC_MAX_PPS_INI_0 FORMAT "%3.0" /end CHARACTERISTIC
/begin CHARACTERISTIC c_abc_inc_pps_ini_tout_0 "anti bounce counter increment for diagnosis instance PPS_INI_TOUT_0" VALUE 0x848228 _REC_VAL_20_u1 255. _CNV_A_R_LINEAR_____0_CM 0. 255. DISPLAY_IDENTIFIER C_ABC_INC_PPS_INI_TOUT_0 FORMAT "%3.0" /end CHARACTERISTIC
/begin CHARACTERISTIC c_abc_max_pps_ini_tout_0 "maximum value of anti bounce counter for diagnosis instance PPS_INI_TOUT_0" VALUE 0x8482aa _REC_VAL_20_u1 255. _CNV_A_R_LINEAR_____0_CM 0. 255. DISPLAY_IDENTIFIER C_ABC_MAX_PPS_INI_TOUT_0 FORMAT "%3.0" /end CHARACTERISTIC
/begin CHARACTERISTIC c_abc_inc_pps_plaus_0 "anti bounce counter increment for diagnosis instance PPS_PLAUS_0" VALUE 0x84822d _REC_VAL_20_u1 255. _CNV_A_R_LINEAR_____0_CM 0. 255. DISPLAY_IDENTIFIER C_ABC_INC_PPS_PLAUS_0 FORMAT "%3.0" /end CHARACTERISTIC
/begin CHARACTERISTIC c_abc_max_pps_plaus_0 "maximum value of anti bounce counter for diagnosis instance PPS_PLAUS_0" VALUE 0x8482af _REC_VAL_20_u1 255. _CNV_A_R_LINEAR_____0_CM 0. 255. DISPLAY_IDENTIFIER C_ABC_MAX_PPS_PLAUS_0 FORMAT "%3.0" /end CHARACTERISTIC
/begin CHARACTERISTIC c_abc_inc_pps_cal_0 "anti bounce counter increment for diagnosis instance PPS_CAL_0" VALUE 0x848225 _REC_VAL_20_u1 255. _CNV_A_R_LINEAR_____0_CM 0. 255. DISPLAY_IDENTIFIER C_ABC_INC_PPS_CAL_0 FORMAT "%3.0" /end CHARACTERISTIC
/begin CHARACTERISTIC c_abc_max_pps_cal_0 "maximum value of anti bounce counter for diagnosis instance PPS_CAL_0" VALUE 0x8482a7 _REC_VAL_20_u1 255. _CNV_A_R_LINEAR_____0_CM 0. 255. DISPLAY_IDENTIFIER C_ABC_MAX_PPS_CAL_0 FORMAT "%3.0" /end CHARACTERISTIC
/begin CHARACTERISTIC c_abc_inc_pps_v_inj_0 "anti bounce counter increment for diagnosis instance PPS_V_INJ_0" VALUE 0x848234 _REC_VAL_20_u1 255. _CNV_A_R_LINEAR_____0_CM 0. 255. DISPLAY_IDENTIFIER C_ABC_INC_PPS_V_INJ_0 FORMAT "%3.0" /end CHARACTERISTIC
/begin CHARACTERISTIC c_abc_max_pps_v_inj_0 "maximum value of anti bounce counter for diagnosis instance PPS_V_INJ_0" VALUE 0x8482b6 _REC_VAL_20_u1 255. _CNV_A_R_LINEAR_____0_CM 0. 255. DISPLAY_IDENTIFIER C_ABC_MAX_PPS_V_INJ_0 FORMAT "%3.0" /end CHARACTERISTIC
/begin CHARACTERISTIC c_abc_inc_pps_wdt_0 "anti bounce counter increment for diagnosis instance PPS_WDT_0" VALUE 0x848235 _REC_VAL_20_u1 255. _CNV_A_R_LINEAR_____0_CM 0. 255. DISPLAY_IDENTIFIER C_ABC_INC_PPS_WDT_0 FORMAT "%3.0" /end CHARACTERISTIC
/begin CHARACTERISTIC c_abc_max_pps_wdt_0 "maximum value of anti bounce counter for diagnosis instance PPS_WDT_0" VALUE 0x8482b7 _REC_VAL_20_u1 255. _CNV_A_R_LINEAR_____0_CM 0. 255. DISPLAY_IDENTIFIER C_ABC_MAX_PPS_WDT_0 FORMAT "%3.0" /end CHARACTERISTIC
/begin CHARACTERISTIC c_abc_inc_pps_fsm_0 "anti bounce counter increment for diagnosis instance PPS_FSM_0" VALUE 0x848226 _REC_VAL_20_u1 255. _CNV_A_R_LINEAR_____0_CM 0. 255. DISPLAY_IDENTIFIER C_ABC_INC_PPS_FSM_0 FORMAT "%3.0" /end CHARACTERISTIC
/begin CHARACTERISTIC c_abc_max_pps_fsm_0 "maximum value of anti bounce counter for diagnosis instance PPS_FSM_0" VALUE 0x8482a8 _REC_VAL_20_u1 255. _CNV_A_R_LINEAR_____0_CM 0. 255. DISPLAY_IDENTIFIER C_ABC_MAX_PPS_FSM_0 FORMAT "%3.0" /end CHARACTERISTIC
/begin CHARACTERISTIC c_abc_inc_pps_oc_0 "anti bounce counter increment for diagnosis instance PPS_OC_0" VALUE 0x848229 _REC_VAL_20_u1 255. _CNV_A_R_LINEAR_____0_CM 0. 255. DISPLAY_IDENTIFIER C_ABC_INC_PPS_OC_0 FORMAT "%3.0" /end CHARACTERISTIC
/begin CHARACTERISTIC c_abc_max_pps_oc_0 "maximum value of anti bounce counter for diagnosis instance PPS_OC_0" VALUE 0x8482ab _REC_VAL_20_u1 255. _CNV_A_R_LINEAR_____0_CM 0. 255. DISPLAY_IDENTIFIER C_ABC_MAX_PPS_OC_0 FORMAT "%3.0" /end CHARACTERISTIC
/begin CHARACTERISTIC c_abc_inc_pps_oc_1 "anti bounce counter increment for diagnosis instance PPS_OC_0" VALUE 0x84822a _REC_VAL_20_u1 255. _CNV_A_R_LINEAR_____0_CM 0. 255. DISPLAY_IDENTIFIER C_ABC_INC_PPS_OC_1 FORMAT "%3.0" /end CHARACTERISTIC
/begin CHARACTERISTIC c_abc_max_pps_oc_1 "maximum value of anti bounce counter for diagnosis instance PPS_OC_0" VALUE 0x8482ac _REC_VAL_20_u1 255. _CNV_A_R_LINEAR_____0_CM 0. 255. DISPLAY_IDENTIFIER C_ABC_MAX_PPS_OC_1 FORMAT "%3.0" /end CHARACTERISTIC
/begin CHARACTERISTIC c_abc_inc_pps_oc_2 "anti bounce counter increment for diagnosis instance PPS_OC_0" VALUE 0x84822b _REC_VAL_20_u1 255. _CNV_A_R_LINEAR_____0_CM 0. 255. DISPLAY_IDENTIFIER C_ABC_INC_PPS_OC_2 FORMAT "%3.0" /end CHARACTERISTIC
/begin CHARACTERISTIC c_abc_max_pps_oc_2 "maximum value of anti bounce counter for diagnosis instance PPS_OC_0" VALUE 0x8482ad _REC_VAL_20_u1 255. _CNV_A_R_LINEAR_____0_CM 0. 255. DISPLAY_IDENTIFIER C_ABC_MAX_PPS_OC_2 FORMAT "%3.0" /end CHARACTERISTIC
/begin CHARACTERISTIC c_abc_inc_pps_oc_3 "anti bounce counter increment for diagnosis instance PPS_OC_0" VALUE 0x84822c _REC_VAL_20_u1 255. _CNV_A_R_LINEAR_____0_CM 0. 255. DISPLAY_IDENTIFIER C_ABC_INC_PPS_OC_3 FORMAT "%3.0" /end CHARACTERISTIC
/begin CHARACTERISTIC c_abc_max_pps_oc_3 "maximum value of anti bounce counter for diagnosis instance PPS_OC_0" VALUE 0x8482ae _REC_VAL_20_u1 255. _CNV_A_R_LINEAR_____0_CM 0. 255. DISPLAY_IDENTIFIER C_ABC_MAX_PPS_OC_3 FORMAT "%3.0" /end CHARACTERISTIC
/begin CHARACTERISTIC c_abc_inc_pps_sc_h_l_0 "anti bounce counter increment for diagnosis instance PPS_SC_H_L_1" VALUE 0x84822f _REC_VAL_20_u1 255. _CNV_A_R_LINEAR_____0_CM 0. 255. DISPLAY_IDENTIFIER C_ABC_INC_PPS_SC_H_L_0 FORMAT "%3.0" /end CHARACTERISTIC
/begin CHARACTERISTIC c_abc_max_pps_sc_h_l_0 "maximum value of anti bounce counter for diagnosis instance PPS_SC_H_L_1" VALUE 0x8482b1 _REC_VAL_20_u1 255. _CNV_A_R_LINEAR_____0_CM 0. 255. DISPLAY_IDENTIFIER C_ABC_MAX_PPS_SC_H_L_0 FORMAT "%3.0" /end CHARACTERISTIC
/begin CHARACTERISTIC c_abc_inc_pps_sc_h_l_1 "anti bounce counter increment for diagnosis instance PPS_SC_H_L_1" VALUE 0x848230 _REC_VAL_20_u1 255. _CNV_A_R_LINEAR_____0_CM 0. 255. DISPLAY_IDENTIFIER C_ABC_INC_PPS_SC_H_L_1 FORMAT "%3.0" /end CHARACTERISTIC
/begin CHARACTERISTIC c_abc_max_pps_sc_h_l_1 "maximum value of anti bounce counter for diagnosis instance PPS_SC_H_L_1" VALUE 0x8482b2 _REC_VAL_20_u1 255. _CNV_A_R_LINEAR_____0_CM 0. 255. DISPLAY_IDENTIFIER C_ABC_MAX_PPS_SC_H_L_1 FORMAT "%3.0" /end CHARACTERISTIC
/begin CHARACTERISTIC c_abc_inc_pps_sc_h_l_2 "anti bounce counter increment for diagnosis instance PPS_SC_H_L_1" VALUE 0x848231 _REC_VAL_20_u1 255. _CNV_A_R_LINEAR_____0_CM 0. 255. DISPLAY_IDENTIFIER C_ABC_INC_PPS_SC_H_L_2 FORMAT "%3.0" /end CHARACTERISTIC
/begin CHARACTERISTIC c_abc_max_pps_sc_h_l_2 "maximum value of anti bounce counter for diagnosis instance PPS_SC_H_L_1" VALUE 0x8482b3 _REC_VAL_20_u1 255. _CNV_A_R_LINEAR_____0_CM 0. 255. DISPLAY_IDENTIFIER C_ABC_MAX_PPS_SC_H_L_2 FORMAT "%3.0" /end CHARACTERISTIC
/begin CHARACTERISTIC c_abc_inc_pps_sc_h_l_3 "anti bounce counter increment for diagnosis instance PPS_SC_H_L_1" VALUE 0x848232 _REC_VAL_20_u1 255. _CNV_A_R_LINEAR_____0_CM 0. 255. DISPLAY_IDENTIFIER C_ABC_INC_PPS_SC_H_L_3 FORMAT "%3.0" /end CHARACTERISTIC
/begin CHARACTERISTIC c_abc_max_pps_sc_h_l_3 "maximum value of anti bounce counter for diagnosis instance PPS_SC_H_L_1" VALUE 0x8482b4 _REC_VAL_20_u1 255. _CNV_A_R_LINEAR_____0_CM 0. 255. DISPLAY_IDENTIFIER C_ABC_MAX_PPS_SC_H_L_3 FORMAT "%3.0" /end CHARACTERISTIC
/begin CHARACTERISTIC c_abc_inc_pps_sc_h_0 "anti bounce counter increment for diagnosis instance PPS_SC_H_0" VALUE 0x84822e _REC_VAL_20_u1 255. _CNV_A_R_LINEAR_____0_CM 0. 255. DISPLAY_IDENTIFIER C_ABC_INC_PPS_SC_H_0 FORMAT "%3.0" /end CHARACTERISTIC
/begin CHARACTERISTIC c_abc_max_pps_sc_h_0 "maximum value of anti bounce counter for diagnosis instance PPS_SC_H_0" VALUE 0x8482b0 _REC_VAL_20_u1 255. _CNV_A_R_LINEAR_____0_CM 0. 255. DISPLAY_IDENTIFIER C_ABC_MAX_PPS_SC_H_0 FORMAT "%3.0" /end CHARACTERISTIC
/begin CHARACTERISTIC c_abc_inc_pps_sc_l_0 "anti bounce counter increment for diagnosis instance PPS_SC_L_0" VALUE 0x848233 _REC_VAL_20_u1 255. _CNV_A_R_LINEAR_____0_CM 0. 255. DISPLAY_IDENTIFIER C_ABC_INC_PPS_SC_L_0 FORMAT "%3.0" /end CHARACTERISTIC
/begin CHARACTERISTIC c_abc_max_pps_sc_l_0 "maximum value of anti bounce counter for diagnosis instance PPS_SC_L_0" VALUE 0x8482b5 _REC_VAL_20_u1 255. _CNV_A_R_LINEAR_____0_CM 0. 255. DISPLAY_IDENTIFIER C_ABC_MAX_PPS_SC_L_0 FORMAT "%3.0" /end CHARACTERISTIC
/begin COMPU_METHOD _CNV_A_R_LINEAR_____0_CM "" RAT_FUNC "%6.3" "[-]" COEFFS 0 1. 0. 0 0 1 /end COMPU_METHOD
/begin COMPU_METHOD _CNV_A_R_LINEAR_____1_CM "" RAT_FUNC "%6.3" "-" COEFFS 0 1. 0. 0 0 1 /end COMPU_METHOD
/begin COMPU_METHOD _CNV_A_R_LINEAR_____5_CM "" RAT_FUNC "%6.3" "[rpm]" COEFFS 0 1. 0. 0 0 1 /end COMPU_METHOD
/begin COMPU_METHOD _CNV_A_R_LINEAR_____8_CM "" RAT_FUNC "%6.3" "[%]" COEFFS 0 655.3599999999997 0. 0 0 1 /end COMPU_METHOD
/begin COMPU_METHOD _CNV_S_2_RANGE______11_CM "" TAB_VERB "%6.3" "[-]" COMPU_TAB_REF _CNV_S_2_RANGE______11 /end COMPU_METHOD
/begin COMPU_VTAB _CNV_S_2_RANGE______11 "" TAB_VERB 2 0 "0" 1 "1" /end COMPU_VTAB
/begin COMPU_METHOD _CNV_A_R_LINEAR_____12_CM "" RAT_FUNC "%6.3" "[%]" COEFFS 0 327.6800000003072 3.071909304708242e-008 0 0 1 /end COMPU_METHOD
/begin COMPU_METHOD _CNV_A_R_LINEAR_____16_CM "" RAT_FUNC "%6.3" "[s]" COEFFS 0 1. 0. 0 0 1 /end COMPU_METHOD
/begin COMPU_METHOD _CNV_A_R_LINEAR_____18_CM "" RAT_FUNC "%6.3" "[°C]" COEFFS 0 1. 50. 0 0 1 /end COMPU_METHOD
/begin COMPU_METHOD _CNV_A_R_LINEAR_____19_CM "" RAT_FUNC "%6.3" "[s]" COEFFS 0 10. 0. 0 0 1 /end COMPU_METHOD
/begin COMPU_METHOD _CNV_A_R_LINEAR_____20_CM "" RAT_FUNC "%6.3" "[°C]" COEFFS 0 1. 0. 0 0 1 /end COMPU_METHOD
/begin COMPU_METHOD _CNV_A_R_LINEAR_____21_CM "" RAT_FUNC "%6.3" "[hPa]" COEFFS 0 12.06017666543982 0. 0 0 1 /end COMPU_METHOD
/begin COMPU_METHOD _CNV_A_R_LINEAR_____23_CM "" RAT_FUNC "%6.3" "[mg/stk]" COEFFS 0 47.18142548596112 0. 0 0 1 /end COMPU_METHOD
/begin COMPU_METHOD _CNV_S_6_CONV_ERRM__27_CM "" TAB_VERB "%6.3" "[-]" COMPU_TAB_REF _CNV_S_6_CONV_ERRM__27 /end COMPU_METHOD
/begin COMPU_VTAB _CNV_S_6_CONV_ERRM__27 "" TAB_VERB 6 0 "NO_SYM" 1 "SYM_0" 2 "SYM_1" 4 "SYM_2" 8 "SYM_3" 15 "BENCH_MODE" /end COMPU_VTAB
/begin COMPU_METHOD _CNV_S_2_RANGE______28_CM "" TAB_VERB "%6.3" "[-]" COMPU_TAB_REF _CNV_S_2_RANGE______28 /end COMPU_METHOD
/begin COMPU_VTAB _CNV_S_2_RANGE______28 "" TAB_VERB 2 0 "passive" 1 "active" /end COMPU_VTAB
/begin COMPU_METHOD _CNV_A_R_LINEAR_____33_CM "" RAT_FUNC "%6.3" "[V]" COEFFS 0 204.8 0. 0 0 1 /end COMPU_METHOD
/begin COMPU_METHOD _CNV_A_R_LINEAR_____34_CM "" RAT_FUNC "%6.3" "[-]" COEFFS 0 256. 0. 0 0 1 /end COMPU_METHOD
/begin COMPU_METHOD _CNV_A_R_LINEAR_____39_CM "" RAT_FUNC "%6.3" "[km/h]" COEFFS 0 1. 0. 0 0 1 /end COMPU_METHOD
/begin COMPU_METHOD _CNV_A_R_LINEAR_____40_CM "" RAT_FUNC "%6.3" "[V]" COEFFS 0 102.4000448438124 0. 0 0 1 /end COMPU_METHOD
/begin COMPU_METHOD _CNV_A_R_LINEAR_____42_CM "" RAT_FUNC "%6.3" "[%]" COEFFS 0 2.550102004080163 0. 0 0 1 /end COMPU_METHOD
/begin COMPU_METHOD _CNV_A_R_LINEAR_____43_CM "" RAT_FUNC "%6.3" "[mg/stk]" COEFFS 0 250. 0. 0 0 1 /end COMPU_METHOD
/begin COMPU_METHOD _CNV_A_R_LINEAR_____48_CM "" RAT_FUNC "%6.3" "[V]" COEFFS 0 8.854166666666666 0. 0 0 1 /end COMPU_METHOD
/begin COMPU_METHOD _CNV_A_R_LINEAR_____50_CM "" RAT_FUNC "%6.3" "[%]" COEFFS 0 327.6800000003072 3.071967512372036e-008 0 0 1 /end COMPU_METHOD
/begin COMPU_METHOD _CNV_A_R_LINEAR_____53_CM "" RAT_FUNC "%6.3" "[-]" COEFFS 0 32767.99807357072 0. 0 0 1 /end COMPU_METHOD
/begin COMPU_METHOD _CNV_A_R_LINEAR_____55_CM "" RAT_FUNC "%6.3" "[mg/stk]" COEFFS 0 1000. 0. 0 0 1 /end COMPU_METHOD
/begin COMPU_METHOD _CNV_A_R_LINEAR_____56_CM "" RAT_FUNC "%6.3" "[°C]" COEFFS 0 63.9990234375 0. 0 0 1 /end COMPU_METHOD
/begin COMPU_METHOD _CNV_A_R_LINEAR_____57_CM "" RAT_FUNC "%6.3" "[s]" COEFFS 0 1562.5 0. 0 0 1 /end COMPU_METHOD
/begin COMPU_METHOD _CNV_A_R_LINEAR_____58_CM "" RAT_FUNC "%6.3" "[rpm]" COEFFS 0 3.125e-002 0. 0 0 1 /end COMPU_METHOD
/begin COMPU_METHOD _CNV_A_R_LINEAR_____59_CM "" RAT_FUNC "%6.3" "[s]" COEFFS 0 100. 0. 0 0 1 /end COMPU_METHOD
/begin COMPU_METHOD _CNV_A_R_LINEAR_____62_CM "" RAT_FUNC "%6.3" "[Nm]" COEFFS 0 32. 0. 0 0 1 /end COMPU_METHOD
/begin COMPU_METHOD _CNV_A_R_LINEAR_____63_CM "" RAT_FUNC "%6.3" "[-]" COEFFS 0 16383.81262712377 0. 0 0 1 /end COMPU_METHOD
/begin COMPU_METHOD _CNV_A_R_LINEAR_____67_CM "" RAT_FUNC "%6.3" "[s]" COEFFS 0 15625. 0. 0 0 1 /end COMPU_METHOD
/begin COMPU_METHOD _CNV_A_R_LINEAR_____74_CM "" RAT_FUNC "%6.3" "[km/h]" COEFFS 0 100. 0. 0 0 1 /end COMPU_METHOD
/begin COMPU_METHOD _CNV_A_R_LINEAR_____80_CM "" RAT_FUNC "%6.3" "[-]" COEFFS 0 32768. 0. 0 0 1 /end COMPU_METHOD
/begin COMPU_METHOD _CNV_A_R_LINEAR_____81_CM "" RAT_FUNC "%6.3" "[%]" COEFFS 0 10.23 0. 0 0 1 /end COMPU_METHOD
/begin COMPU_METHOD _CNV_A_R_LINEAR_____82_CM "" RAT_FUNC "%6.3" "[%]" COEFFS 0 2.56 0. 0 0 1 /end COMPU_METHOD
/begin COMPU_METHOD _CNV_A_R_LINEAR_____83_CM "" RAT_FUNC "%6.3" "[Nm]" COEFFS 0 31.99984374837874 32767.83999833983 0 0 1 /end COMPU_METHOD
/begin COMPU_METHOD _CNV_A_R_LINEAR_____84_CM "" RAT_FUNC "%6.3" "rpm" COEFFS 0 3.125e-002 0. 0 0 1 /end COMPU_METHOD
/begin COMPU_METHOD _CNV_A_R_LINEAR_____85_CM "" RAT_FUNC "%6.3" "Nm" COEFFS 0 32. 0. 0 0 1 /end COMPU_METHOD
/begin COMPU_METHOD _CNV_A_R_LINEAR_____86_CM "" RAT_FUNC "%6.3" "Nm/10ms" COEFFS 0 32. 0. 0 0 1 /end COMPU_METHOD
/begin COMPU_METHOD _CNV_A_R_LINEAR_____87_CM "" RAT_FUNC "%6.3" "Nm" COEFFS 0 32. 32768. 0 0 1 /end COMPU_METHOD
/begin COMPU_METHOD _CNV_S_2_RANGE__0___88_CM "" TAB_VERB "%6.3" "-" COMPU_TAB_REF _CNV_S_2_RANGE__0___88 /end COMPU_METHOD
/begin COMPU_VTAB _CNV_S_2_RANGE__0___88 "" TAB_VERB 2 0 "0" 1 "1" /end COMPU_VTAB
/begin COMPU_METHOD _CNV_A_R_LINEAR_____89_CM "" RAT_FUNC "%6.3" "[Nm]" COEFFS 0 32. 32768. 0 0 1 /end COMPU_METHOD
/begin COMPU_METHOD _CNV_A_R_LINEAR_____90_CM "" RAT_FUNC "%6.3" "[-]" COEFFS 0 65535.82575140447 0. 0 0 1 /end COMPU_METHOD
/begin COMPU_METHOD _CNV_A_R_LINEAR_____92_CM "" RAT_FUNC "%6.3" "[Nm/10ms]" COEFFS 0 32. 0. 0 0 1 /end COMPU_METHOD
/begin COMPU_METHOD _CNV_A_R_LINEAR_____93_CM "" RAT_FUNC "%6.3" "[Nm]" COEFFS 0 4. 0. 0 0 1 /end COMPU_METHOD
/begin COMPU_METHOD _CNV_A_R_LINEAR_____94_CM "" RAT_FUNC "%6.3" "[Hz]" COEFFS 0 1000. 0. 0 0 1 /end COMPU_METHOD
/begin COMPU_METHOD _CNV_A_R_LINEAR_____95_CM "" RAT_FUNC "%6.3" "[Nm/s]" COEFFS 0 32. 0. 0 0 1 /end COMPU_METHOD
/begin COMPU_METHOD _CNV_A_R_LINEAR_____96_CM "" RAT_FUNC "%6.3" "[ms]" COEFFS 0 0.1 0. 0 0 1 /end COMPU_METHOD
/begin COMPU_METHOD _CNV_A_R_LINEAR_____97_CM "" RAT_FUNC "%6.3" "[Nm/s]" COEFFS 0 1. 0. 0 0 1 /end COMPU_METHOD
/begin COMPU_METHOD _CNV_A_R_LINEAR_____98_CM "" RAT_FUNC "%6.3" "[-]" COEFFS 0 64. 0. 0 0 1 /end COMPU_METHOD
/begin COMPU_METHOD _CNV_A_R_LINEAR_____112_CM "" RAT_FUNC "%6.3" "[kg/h]" COEFFS 0 64. 0. 0 0 1 /end COMPU_METHOD
/begin COMPU_METHOD _CNV_A_R_LINEAR_____123_CM "" RAT_FUNC "%6.3" "[V]" COEFFS 0 4.011764705882353 0. 0 0 1 /end COMPU_METHOD
/begin COMPU_METHOD _CNV_A_R_LINEAR_____134_CM "" RAT_FUNC "%6.3" "[-]" COEFFS 0 1023.999999959999 -1.280019205296412e-006 0 0 1 /end COMPU_METHOD
/begin COMPU_METHOD _CNV_A_R_LINEAR_____135_CM "" RAT_FUNC "%6.3" "[-]" COEFFS 0 1024. 32768. 0 0 1 /end COMPU_METHOD
/begin COMPU_METHOD _CNV_A_R_LINEAR_____136_CM "" RAT_FUNC "%6.3" "[%]" COEFFS 0 655.35 0. 0 0 1 /end COMPU_METHOD
/begin COMPU_METHOD _CNV_A_R_LINEAR_____201_CM "" RAT_FUNC "%6.3" "[%]" COEFFS 0 327.7613897082924 0. 0 0 1 /end COMPU_METHOD
/begin COMPU_METHOD _CNV_A_R_LINEAR_____223_CM "" RAT_FUNC "%6.3" "s" COEFFS 0 100. 0. 0 0 1 /end COMPU_METHOD
/begin COMPU_METHOD _CNV_A_R_LINEAR_____239_CM "" RAT_FUNC "%6.3" "km/h" COEFFS 0 1. 0. 0 0 1 /end COMPU_METHOD
/begin COMPU_METHOD _CNV_A_R_LINEAR_____240_CM "" RAT_FUNC "%6.3" "-" COEFFS 0 128. 0. 0 0 1 /end COMPU_METHOD
/begin COMPU_METHOD _CNV_A_R_LINEAR_____250_CM "" RAT_FUNC "%6.3" "[bar]" COEFFS 0 2. 0. 0 0 1 /end COMPU_METHOD
/begin COMPU_METHOD _CNV_A_R_LINEAR_____257_CM "" RAT_FUNC "%6.3" "rpm" COEFFS 0 1. 0. 0 0 1 /end COMPU_METHOD
/begin COMPU_METHOD _CNV_A_R_LINEAR_____300_CM "" RAT_FUNC "%6.3" "-" COEFFS 0 65535.99999999996 0. 0 0 1 /end COMPU_METHOD
/begin COMPU_METHOD _CNV_A_R_LINEAR_____315_CM "" RAT_FUNC "%6.3" "[kg*m^2*min]" COEFFS 0 1000. 0. 0 0 1 /end COMPU_METHOD
/begin COMPU_METHOD _CNV_A_R_LINEAR_____334_CM "" RAT_FUNC "%6.3" "-" COEFFS 0 512. 0. 0 0 1 /end COMPU_METHOD
/begin COMPU_METHOD _CNV_A_R_LINEAR_____335_CM "" RAT_FUNC "%6.3" "[Nm/20ms]" COEFFS 0 32. 0. 0 0 1 /end COMPU_METHOD
/begin COMPU_METHOD _CNV_A_R_LINEAR_____336_CM "" RAT_FUNC "%6.3" "-" COEFFS 0 8192. 0. 0 0 1 /end COMPU_METHOD
/begin COMPU_METHOD _CNV_A_R_LINEAR_____337_CM "" RAT_FUNC "%6.3" "Nms" COEFFS 0 100. 0. 0 0 1 /end COMPU_METHOD
/begin COMPU_METHOD _CNV_A_R_LINEAR_____338_CM "" RAT_FUNC "%6.3" "Nm/20ms" COEFFS 0 32. 0. 0 0 1 /end COMPU_METHOD
/begin COMPU_METHOD _CNV_A_R_LINEAR_____346_CM "Battery voltage" RAT_FUNC "%6.3" "V" COEFFS 0 9.846153846153847 0. 0 0 1 /end COMPU_METHOD
/begin COMPU_METHOD _CNV_S_3_TCO_range_347_CM "" TAB_VERB "%6.3" "[-]" COMPU_TAB_REF _CNV_S_3_TCO_range_347 /end COMPU_METHOD
/begin COMPU_VTAB _CNV_S_3_TCO_range_347 "" TAB_VERB 3 0 "COLD" 1 "WUP" 2 "HOT" /end COMPU_VTAB
/begin COMPU_METHOD _CNV_A_R_LINEAR_____348_CM "" RAT_FUNC "%6.3" "[kg/h]" COEFFS 0 64.00002343786623 1.20001875111484e-002 0 0 1 /end COMPU_METHOD
/begin COMPU_METHOD _CNV_A_R_LINEAR_____349_CM "" RAT_FUNC "%6.3" "[kg/h]" COEFFS 0 64.00002343786622 1.200018750386101e-002 0 0 1 /end COMPU_METHOD
/begin COMPU_METHOD _CNV_A_R_LINEAR_____350_CM "" RAT_FUNC "%6.3" "[rpm/s]" COEFFS 0 1. 0. 0 0 1 /end COMPU_METHOD
/begin COMPU_METHOD _CNV_A_R_LINEAR_____357_CM "" RAT_FUNC "%6.3" "[s]" COEFFS 0 25. 0. 0 0 1 /end COMPU_METHOD
/begin COMPU_METHOD _CNV_A_R_LINEAR_____358_CM "" RAT_FUNC "%6.3" "[V]" COEFFS 0 204.6 0. 0 0 1 /end COMPU_METHOD
/begin COMPU_METHOD _CNV_A_R_LINEAR_____362_CM "" RAT_FUNC "%6.3" "-" COEFFS 0 257. 0. 0 0 1 /end COMPU_METHOD
/begin COMPU_METHOD _CNV_A_R_LINEAR_____365_CM "" RAT_FUNC "%6.3" "[V]" COEFFS 0 51.2 0. 0 0 1 /end COMPU_METHOD
/begin COMPU_METHOD _CNV_A_R_LINEAR_____377_CM "" RAT_FUNC "%6.3" "[A]" COEFFS 0 314.7692307692308 0. 0 0 1 /end COMPU_METHOD
/begin COMPU_METHOD _CNV_A_R_LINEAR_____381_CM "" RAT_FUNC "%6.3" "[us]" COEFFS 0 0.2499971389661368 0. 0 0 1 /end COMPU_METHOD
/begin COMPU_METHOD _CNV_A_R_LINEAR_____382_CM "" RAT_FUNC "%6.3" "[Hz]" COEFFS 0 1. 0. 0 0 1 /end COMPU_METHOD
/begin COMPU_METHOD _CNV_S_12_STATE_PPS__527_CM "" TAB_VERB "%6.3" "[-]" COMPU_TAB_REF _CNV_S_12_STATE_PPS__527 /end COMPU_METHOD
/begin COMPU_VTAB _CNV_S_12_STATE_PPS__527 "" TAB_VERB 12 0 "INI_PRDR" 1 "INI_RST" 2 "reserved" 3 "INI_SPI" 4 "reserved" 5 "INI_BOOST" 6 "reserved" 7 "INI_PLS_TEST" 8 "reserved" 9 "reserved" 10 "reserved" 11 "INI_DONE" /end COMPU_VTAB
/begin COMPU_METHOD _CNV_A_R_LINEAR_____528_CM "" RAT_FUNC "%6.3" "[V]" COEFFS 0 1. 0. 0 0 1 /end COMPU_METHOD
/begin RECORD_LAYOUT _REC_VAL_20_u1 FNC_VALUES 1 UBYTE COLUMN_DIR DIRECT /end RECORD_LAYOUT
/begin RECORD_LAYOUT _REC_AXS_20_u2 NO_AXIS_PTS_X 1 UWORD AXIS_PTS_X 2 UWORD INDEX_INCR DIRECT /end RECORD_LAYOUT
/begin RECORD_LAYOUT _REC_CUR_20_u1_u2 FNC_VALUES 1 UBYTE COLUMN_DIR DIRECT /end RECORD_LAYOUT
/begin RECORD_LAYOUT _REC_MAP_20_u2_u2_u2 FNC_VALUES 1 UWORD COLUMN_DIR DIRECT /end RECORD_LAYOUT
/begin RECORD_LAYOUT _REC_VAL_20_u2 FNC_VALUES 1 UWORD COLUMN_DIR DIRECT /end RECORD_LAYOUT
/begin RECORD_LAYOUT _REC_VAL_20_s2 FNC_VALUES 1 SWORD COLUMN_DIR DIRECT /end RECORD_LAYOUT
/begin RECORD_LAYOUT _REC_AXS_20_u1 NO_AXIS_PTS_X 1 UBYTE AXIS_PTS_X 2 UBYTE INDEX_INCR DIRECT /end RECORD_LAYOUT
/begin RECORD_LAYOUT _REC_CUR_20_u2_u2 FNC_VALUES 1 UWORD COLUMN_DIR DIRECT /end RECORD_LAYOUT
/begin RECORD_LAYOUT _REC_CUR_20_u2_u1 FNC_VALUES 1 UWORD COLUMN_DIR DIRECT /end RECORD_LAYOUT
/begin RECORD_LAYOUT _REC_MAP_20_u2_u1_u1 FNC_VALUES 1 UWORD COLUMN_DIR DIRECT /end RECORD_LAYOUT
/begin RECORD_LAYOUT _REC_MAP_20_u2_u2_u1 FNC_VALUES 1 UWORD COLUMN_DIR DIRECT /end RECORD_LAYOUT
/begin RECORD_LAYOUT _REC_CUR_20_u1_u1 FNC_VALUES 1 UBYTE COLUMN_DIR DIRECT /end RECORD_LAYOUT
/begin RECORD_LAYOUT _REC_MAP_20_u2_u1_u2 FNC_VALUES 1 UWORD COLUMN_DIR DIRECT /end RECORD_LAYOUT
/begin RECORD_LAYOUT _REC_VAL_20_u4 FNC_VALUES 1 ULONG COLUMN_DIR DIRECT /end RECORD_LAYOUT
/begin FUNCTION DIAG_ARLYDIAG ""
 /begin DEF_CHARACTERISTIC c_abc_inc_rly_main c_abc_max_rly_main c_abc_inc_rly_power c_abc_max_rly_power c_vb_min_rly_diag /end DEF_CHARACTERISTIC
 /begin OUT_MEASUREMENT lv_scg_rly_main lv_scg_vld_rly_main lv_scb_rly_main lv_scb_vld_rly_main lv_ol_rly_main lv_ol_vld_rly_main lv_scg_rly_power lv_scg_vld_rly_power lv_scb_rly_power lv_scb_vld_rly_power lv_ol_rly_power lv_ol_vld_rly_power err_sym_mem_rly_main err_sym_mem_rly_power /end OUT_MEASUREMENT
/end FUNCTION
/begin FUNCTION DIAG_MAF_0 ""
 /begin DEF_CHARACTERISTIC c_abc_inc_maf_0_rng c_abc_max_maf_0_rng c_maf_kgh_mes_max_diag c_maf_kgh_mes_min_diag c_n_min_maf_kgh_mes_diag /end DEF_CHARACTERISTIC
/end FUNCTION
/begin FUNCTION DIAG_MAF_PLAD ""
 /begin DEF_CHARACTERISTIC c_abc_inc_maf_kgh_plaus c_abc_max_maf_kgh_plaus c_tqi_sp_maf_plaus c_ctl_lim_egrv_maf_plaus c_tia_min_maf_plaus c_tia_max_maf_plaus c_n_min_maf_plaus c_n_max_maf_plaus c_ratio_mf_tot_grd_maf_plaus c_maf_kgh_min_maf_plaus c_maf_kgh_max_maf_plaus c_fac_maf_kgh_plaus_diag c_t_dly_maf_kgh_plaus_diag c_ctr_maf_kgh_plaus_diag c_n_grd_h_res_maf_plaus /end DEF_CHARACTERISTIC
 /begin OUT_MEASUREMENT t_dly_maf_kgh_plaus ctr_maf_kgh_plaus /end OUT_MEASUREMENT
/end FUNCTION
/begin FUNCTION DIAG_AEGRCTLD_0 "EGR Control Diagnosis"
 /begin DEF_CHARACTERISTIC c_abc_inc_egr_ctl_min c_abc_max_egr_ctl_min c_abc_inc_egr_ctl_max c_abc_max_egr_ctl_max c_egr_dif_min_diag c_egr_dif_max_diag ip_ctr_max_egr_ctl_min__n ip_ctr_max_egr_ctl_max__n ldpm_n_ip_ctr_max_egr_ctl_diag /end DEF_CHARACTERISTIC
 /begin OUT_MEASUREMENT ctr_egr_ctl_min ctr_egr_ctl_max /end OUT_MEASUREMENT
/end FUNCTION
/begin FUNCTION DIAG_ALTER "" /end FUNCTION
/begin FUNCTION DIAG_AALTDIAG "Generator Load Signal Diagnostics"
 /begin DEF_CHARACTERISTIC c_abc_inc_ducy_alter_pwm_rng c_abc_max_ducy_alter_pwm_rng c_abc_inc_ducy_alter_pwm_grd c_abc_max_ducy_alter_pwm_grd c_ducy_alter_pwm_max_diag c_ducy_alter_pwm_min_diag c_ducy_alter_pwm_grd_diag /end DEF_CHARACTERISTIC
 /begin OUT_MEASUREMENT lv_err_ducy_alter_pwm lv_err_altpwm_mes /end OUT_MEASUREMENT
/end FUNCTION
/begin FUNCTION DIAG_AAC_INPDIAG "Air Conditioning Pressure (ACP) Diagnostics" /begin OUT_MEASUREMENT lv_err_acp_mes lv_err_tia_mes /end OUT_MEASUREMENT /end FUNCTION
/begin FUNCTION DIAG_ACP "Air Conditioning Pressure (ACP) Diagnostics (Appl. Inc.)"
 /begin DEF_CHARACTERISTIC c_abc_inc_acp_mes_rng c_abc_max_acp_mes_rng c_abc_inc_acp_mes_grd c_abc_max_acp_mes_grd /end DEF_CHARACTERISTIC
/end FUNCTION
/begin FUNCTION DIAG_ZZZ "" /end FUNCTION
/begin FUNCTION DIAG_AINJDIAG "Piezo Power Stage Diagnosis"
 /begin DEF_CHARACTERISTIC c_v_cha_min c_v_cha_max c_v_inj_min c_v_inj_max c_t_ini_pps_max c_t_pps_wup c_tco_min_hot c_v_inj_f_max c_v_cha_cal_thd_0 c_v_cha_cal_thd_1 c_v_cha_cal_thd_2 c_v_cha_cal_thd_3 c_v_inj_min_scg c_v_inj_min_scb c_pps_spi_diag_mask c_pps_spi_prog_mask /end DEF_CHARACTERISTIC
 /begin OUT_MEASUREMENT lv_err_pps_cyl[0] lv_err_pps_cyl[1] lv_err_pps_cyl[2] lv_err_pps_cyl[3] lv_err_det_pps_cyl[0] lv_err_det_pps_cyl[1] lv_err_det_pps_cyl[2] lv_err_det_pps_cyl[3] lv_err_pps_cbk[0] lv_err_det_pps_cbk[0] lv_err_pps lv_err_det_pps t_ini_tout_pps[0] lv_inh_diag_pps_oc lv_ini_pps[0] state_pps_diag_ini[0] cyl_nr_pps_diag lv_v_cha_rng_l lv_v_cha_rng_h lv_v_inj_rng_l lv_v_inj_rng_h lv_pps_prot_swi_act[0] /end OUT_MEASUREMENT
/end FUNCTION
/begin FUNCTION DIAG_AINJDIAG_I "Application Incidences for Piezo Power Stage Diagnosis"
 /begin DEF_CHARACTERISTIC c_abc_inc_pps_ini_0 c_abc_max_pps_ini_0 c_abc_inc_pps_ini_tout_0 c_abc_max_pps_ini_tout_0 c_abc_inc_pps_plaus_0 c_abc_max_pps_plaus_0 c_abc_inc_pps_cal_0 c_abc_max_pps_cal_0 c_abc_inc_pps_v_inj_0 c_abc_max_pps_v_inj_0 c_abc_inc_pps_wdt_0 c_abc_max_pps_wdt_0 c_abc_inc_pps_fsm_0 c_abc_max_pps_fsm_0 c_abc_inc_pps_oc_0 c_abc_max_pps_oc_0 c_abc_inc_pps_oc_1 c_abc_max_pps_oc_1 c_abc_inc_pps_oc_2 c_abc_max_pps_oc_2 c_abc_inc_pps_oc_3 c_abc_max_pps_oc_3 c_abc_inc_pps_sc_h_l_0 c_abc_max_pps_sc_h_l_0 c_abc_inc_pps_sc_h_l_1 c_abc_max_pps_sc_h_l_1 c_abc_inc_pps_sc_h_l_2 c_abc_max_pps_sc_h_l_2 c_abc_inc_pps_sc_h_l_3 c_abc_max_pps_sc_h_l_3 c_abc_inc_pps_sc_h_0 c_abc_max_pps_sc_h_0 c_abc_inc_pps_sc_l_0 c_abc_max_pps_sc_l_0 /end DEF_CHARACTERISTIC
 /begin OUT_MEASUREMENT lf_inj_act[0] lf_inj_act[1] lf_inj_act[2] lf_inj_act[3] lf_seq_act[0] lf_seq_act[1] lf_seq_act[2] lf_seq_act[3] /end OUT_MEASUREMENT
/end FUNCTION
/begin FUNCTION DIAG_AVB "Battery Voltage Diagnosis"
 /begin DEF_CHARACTERISTIC c_vb_max_diag c_vb_min_diag c_vb_min_jump c_vb_min_obd1 c_vb_min_obd2 /end DEF_CHARACTERISTIC
 /begin OUT_MEASUREMENT lv_cdn_vb_obd1 lv_cdn_vb_obd2 lv_igk vb v_igk /end OUT_MEASUREMENT
/end FUNCTION
/begin FUNCTION DIAG_ASPIDIAG "SPI - Bus Diagnosis"
 /begin DEF_CHARACTERISTIC c_abc_inc_spi_qps c_abc_max_spi_qps c_abc_inc_spi_oct c_abc_max_spi_oct c_abc_inc_spi_mps c_abc_max_spi_mps /end DEF_CHARACTERISTIC
 /begin OUT_MEASUREMENT lv_spi_err_qps lv_spi_err_oct lv_spi_err_mps /end OUT_MEASUREMENT
/end FUNCTION
/begin FUNCTION DIAG_AEGRVDHB "EGR Valve Diagnostics"
 /begin DEF_CHARACTERISTIC c_egrvpwm_min_diag c_egrvpwm_max_diag c_abc_inc_egrv_0 c_abc_max_egrv_0 /end DEF_CHARACTERISTIC
 /begin OUT_MEASUREMENT lv_err_det_spi_dps_egrv /end OUT_MEASUREMENT
/end FUNCTION
/begin FUNCTION C_A_TQ "" /begin SUB_FUNCTION TQ_LTC TQ_AJPA TQ_AJ /end SUB_FUNCTION /end FUNCTION
/begin FUNCTION TQ_LTC "" /end FUNCTION
/begin FUNCTION TQ_AJPA ""
 /begin DEF_CHARACTERISTIC lc_n_pred_on_aj c_t1_pv_av_grd_aj ip_fac_aj__pv_av ldp_pv_av_ip_fac_aj ip_fac_tq_dif_aj__dri__n ldpm_n_ip_fac_aj ip_fac_tq_dif_aj_is__dri__n ldpm_n_ip_fac_aj_is ip_t1_aj__dri__n ip_t1_aj_is__dri__n /end DEF_CHARACTERISTIC
 /begin OUT_MEASUREMENT t1_dt1_aj kr_dt1_aj n_aj pv_av_grd_aj /end OUT_MEASUREMENT
/end FUNCTION
/begin FUNCTION TQ_AJ ""
 /begin DEF_CHARACTERISTIC lc_lpf_2_aj_off lc_lpf_aj_on lc_lpf_3_aj_off c_n_min_aj c_n_max_aj lc_aj_on lc_aj_is_ovs c_t_act_max_aj id_frq_cut_aj__dri /end DEF_CHARACTERISTIC
 /begin OUT_MEASUREMENT tq_dif_aj lv_req_aj lv_act_aj /end OUT_MEASUREMENT
/end FUNCTION
/begin FUNCTION VW_Hidden ""
 /begin DEF_CHARACTERISTIC c_abc_max_var_cod c_abc_inc_v_tpc_rng c_abc_max_v_tpc_rng c_abc_inc_tpc_mes_plaus c_abc_max_tpc_mes_plaus c_v_tpc_max_diag c_v_tpc_min_diag c_n_v_tpc_rng_diag c_mf_tot_v_tpc_rng_diag c_t_max_v_tpc_rng_diag c_tco_tpc_mes_plaus_diag c_tpc_mes_plaus_diag c_abc_inc_v_tac_rng c_abc_max_v_tac_rng c_abc_inc_tac_mes_plaus c_abc_max_tac_mes_plaus c_v_tac_max_diag c_v_tac_min_diag c_n_v_tac_rng_diag c_n_tac_mes_plaus_diag c_mf_tot_v_tac_rng_diag c_mf_tot_tac_mes_plaus_diag c_tco_tac_mes_plaus_diag c_t_max_v_tac_rng_diag c_t_ast_tac_mes_plaus_diag c_absv_tpc_tac_dif_diag c_n_thd_byp_ect c_pwm_byp_ect_min c_tco_hys_byp_ect_warm c_tco_hys_byp_ect_hot c_tco_add_ect ip_tco_ect__pwm_ect ldp_pwm_ect_ip_tco_ect c_t_per_exv_cold c_t_act_exv_cold c_t_act_exv_warm c_cfb_pcv_mes_max_diag c_cfb_vcv_mes_max_diag c_v_cfb_pcv_max_diag c_v_cfb_pcv_min_diag c_v_cfb_vcv_max_diag c_v_cfb_vcv_min_diag ldp_vb_ip_pcv_min_diag ip_pcv_min_diag__vb c_abc_inc_bpa c_abc_inc_gl_rly_dps c_abc_inc_pcv_1 c_abc_inc_pcv_2 c_abc_inc_pcv_3 c_abc_inc_vcv_1 c_abc_inc_vcv_2 c_abc_inc_vcv_3 c_abc_max_bpa c_abc_max_gl_rly_dps c_abc_max_pcv_1 c_abc_max_pcv_2 c_abc_max_pcv_3 c_abc_max_vcv_1 c_abc_max_vcv_2 c_abc_max_vcv_3 c_vb_nom ldp_frq_maf_id_maf_x ldp_frq_maf_id_maf_y id_maf_frq_tab c_t_low_maf_frq_0_min c_t_low_maf_frq_0_max c_maf_frq_0_bas_max c_maf_frq_0_bas_min c_maf_frq_bas_max_ip ldp_v_t_atic20_ip_t_atic20 ldp_v_t_lc_ip_t_lc ip_t_atic20__v_t_atic20 ip_t_lc__v_t_lc /end DEF_CHARACTERISTIC
 /begin OUT_MEASUREMENT lv_err_tpc_mes t_v_tpc_rng_diag lv_err_tac_mes t_v_tac_rng_diag pwm_byp_ect lv_exv pwm_ect_ctl cfb_vcv_mes v_cfb_pcv v_cfb_vcv lv_fuel_warn lv_err_frq_maf_frq_0 pcv /end OUT_MEASUREMENT
/end FUNCTION
/begin FUNCTION C_B_OBD ""
 /begin SUB_FUNCTION OBD_AOBDFSD OBD_AOBDEGR OBD_ATCOPLAD OBD_Battery_Voltage_Diag /end SUB_FUNCTION
/end FUNCTION
/begin FUNCTION OBD_AOBDFSD ""
 /begin DEF_CHARACTERISTIC c_abc_inc_mf_is_obd c_abc_max_mf_is_obd lc_mf_is_obd_rst c_t_dly_mf_is_obd c_ctr_mf_is_obd c_mf_is_max_obd c_mf_is_min_obd /end DEF_CHARACTERISTIC
 /begin OUT_MEASUREMENT t_dly_mf_is_obd ctr_mf_is_max_obd ctr_mf_is_min_obd mf_is_max_obd mf_is_min_obd /end OUT_MEASUREMENT
/end FUNCTION
/begin FUNCTION OBD_AOBDEGR ""
 /begin DEF_CHARACTERISTIC c_abc_inc_maf_egr_thr_obd c_abc_max_maf_egr_thr_obd c_abc_inc_maf_dif_egr_thr_obd c_abc_max_maf_dif_egr_thr_obd c_abc_inc_map_dif_egr_thr_obd c_abc_max_map_dif_egr_thr_obd c_t_egr_thr_obd_1 c_egrvpwm_egr_thr_obd_1 c_thrpwm_egr_thr_obd_1 c_byppwm_egr_thr_obd_1 c_bpapwm_egr_thr_obd_1 c_t_dly_egr_thr_obd c_maf_max_egr_thr_obd c_maf_min_egr_thr_obd c_t_egr_thr_obd_2 c_egrvpwm_egr_thr_obd_2 c_thrpwm_egr_thr_obd_2 c_byppwm_egr_thr_obd_2 c_bpapwm_egr_thr_obd_2 c_maf_dif_max_egr_thr_obd c_maf_dif_min_egr_thr_obd c_ctr_maf_egr_thr_obd c_ctr_maf_dif_egr_thr_obd c_t_egr_thr_obd_3 c_egrvpwm_egr_thr_obd_3 c_thrpwm_egr_thr_obd_3 c_byppwm_egr_thr_obd_3 c_bpapwm_egr_thr_obd_3 c_map_mes_dif_max_egr_thr_obd c_map_mes_dif_min_egr_thr_obd c_ctr_map_dif_egr_thr_obd lc_rst_diag_egr_thr_obd ip_fac_map_cor_egr_thr_obd__n ldp_n__ip_fac_map_egr_thr_obd ip_fac_maf_egr_thr_obd ldpm_amp__ip_fac_egr_thr_obd ldpm_tia__ip_fac_egr_thr_obd ip_fac_map_egr_thr_obd c_tco_min_egr_thr_obd /end DEF_CHARACTERISTIC
 /begin OUT_MEASUREMENT t_egr_thr_obd lv_egr_thr_obd egrvpwm_obd thrpwm_obd byppwm_obd bpapwm_obd ctr_maf_egr_thr_obd ctr_maf_dif_egr_thr_obd ctr_map_dif_egr_thr_obd maf_egr_thr_obd map_mes_egr_thr_obd lv_rst_diag_egr_thr_obd lv_inh_egr_thr_obd /end OUT_MEASUREMENT
/end FUNCTION
/begin FUNCTION OBD_ATCOPLAD "Coolant Temperature Plausibility of two Sensors"
 /begin DEF_CHARACTERISTIC c_abc_inc_tco_1_2_plaus c_abc_max_tco_1_2_plaus c_temp_1_2_tco_1_2_plaus_cold c_temp_1_2_tco_1_2_plaus_wup c_temp_1_2_tco_1_2_plaus_hot c_temp_2_1_tco_1_2_plaus_cold c_temp_2_1_tco_1_2_plaus_wup c_temp_2_1_tco_1_2_plaus_hot c_temp_cold_max_tco_1_2_plaus c_temp_hot_min_tco_1_2_plaus /end DEF_CHARACTERISTIC
 /begin OUT_MEASUREMENT sf_rng_tco_1_2_plaus /end OUT_MEASUREMENT
/end FUNCTION
/begin FUNCTION OBD_Battery_Voltage_Diag "Batteriespannung (VB)" /begin DEF_CHARACTERISTIC c_vb_min_vb_diag c_n_min_vb_diag c_abc_inc_vb c_abc_max_vb /end DEF_CHARACTERISTIC /begin OUT_MEASUREMENT lv_err_vb /end OUT_MEASUREMENT /end FUNCTION
/begin FUNCTION C_D_TQ ""
 /begin SUB_FUNCTION TQ_ATQCLFAC TQ_ATQ_ESPI TQ_ATQ_LTCP TQ_ATQIMIN TQ_ATQ2MF TQ_ATQI_SP /end SUB_FUNCTION
/end FUNCTION
/begin FUNCTION TQ_ATQCLFAC ""
 /begin DEF_CHARACTERISTIC c_dri_fac_tq_req c_crlc_n ip_fac_tq_req_dri_h__n__pv_av ldpm_n_ip_fac_tq_req ldpm_pv_av_ip_fac_tq_req ip_fac_tq_req_dri_l__n__pv_av /end DEF_CHARACTERISTIC
 /begin OUT_MEASUREMENT fac_tq_req_driv lv_fac_tq_req_dri_low n_fil /end OUT_MEASUREMENT
/end FUNCTION
/begin FUNCTION TQ_ATQ_ESPI "" /begin DEF_CHARACTERISTIC c_lgrd_tq_neg_diag_tcs c_lgrd_tq_pos_diag_tcs /end DEF_CHARACTERISTIC
 /begin OUT_MEASUREMENT tq_tcs_req lv_tcs_plaus lv_tq_tcs_req_dec tq_lgrd_neg_diag_tcs tq_lgrd_pos_diag_tcs lv_req_tcs lv_tq_tcs_req_inc /end OUT_MEASUREMENT
/end FUNCTION
/begin FUNCTION TQ_ATQ_LTCP ""
 /begin DEF_CHARACTERISTIC c_ctr_dri_up_dly_ltc ip_tq_ltc_thd_down_1__n__dri ldpm_n_ip_tq_ltc ldpm_dri_ip_tq_ltc ip_tq_ltc_thd_up__n__dri ip_fac_tq_up__n__dri ip_tq_dif_up__tq_sp_clu__dri ldpm_tq_sp_clu_ip_tq_dif_up ip_fac_tq_dif_up__pv_av__n ldpm_pv_av_ip_fac_tq_dif ip_fac_tq_down__n__dri ip_tq_dif_down__tq_sp_clu__dri ldpm_tq_sp_clu_ip_tq_dif_down ip_fac_tq_dif_down__pv_av__n /end DEF_CHARACTERISTIC
 /begin OUT_MEASUREMENT tq_ltc_dif_up tq_ltc_thd_up tq_ltc_dif_down tq_ltc_thd_down_1 /end OUT_MEASUREMENT
/end FUNCTION
/begin FUNCTION TQ_ATQIMIN "Minimum Indicated Torque" /begin OUT_MEASUREMENT lv_slm_bol_act tqi_min /end OUT_MEASUREMENT /end FUNCTION
/begin FUNCTION TQ_ATQ2MF "" /begin OUT_MEASUREMENT mf_tot mf_tot_grd /end OUT_MEASUREMENT /end FUNCTION
/begin FUNCTION TQ_ATQI_SP "Coordination of Torque Setpoint"
 /begin DEF_CHARACTERISTIC c_t_egs_dly lc_tqi_slm_act lc_tqi_max_act ip_tq_add_lim2__n ldp_n_ip_tq_add_lim2 /end DEF_CHARACTERISTIC
 /begin OUT_MEASUREMENT tq_dif lv_gs_dif_act tqi_sp tq_sp_clu tqi_sp_grd /end OUT_MEASUREMENT
/end FUNCTION
/begin FUNCTION C_D_TORQUE ""
 /begin SUB_FUNCTION TORQUE_ATQ_ALT TORQUE_ATQFRADD TORQUE_ATQE TORQUE_ATQALTAI TORQUE_ATQETCU TORQUE_ATQ_LTC TORQUE_ATQI_REQ TORQUE_AMFTQLM /end SUB_FUNCTION
/end FUNCTION
/begin FUNCTION TORQUE_ATQ_ALT "" /end FUNCTION
/begin FUNCTION TORQUE_ATQFRADD "" /begin DEF_CHARACTERISTIC c_tq_add_conf ip_fac_tq_add__pv_av /end DEF_CHARACTERISTIC /begin OUT_MEASUREMENT tq_loss_add tq_add_req /end OUT_MEASUREMENT /end FUNCTION
/begin FUNCTION TORQUE_ATQE ""
 /begin DEF_CHARACTERISTIC lc_tqe_clc_act c_fac_tqe ip_crlc_tqe_sp__tqe_fil_dif ldp_tqe_fil_dif_ip_crlc_tqe_sp /end DEF_CHARACTERISTIC
 /begin OUT_MEASUREMENT tqe_dif_raw tqe_fil_dif tqe_sp_raw tqe_sp_clc tqe_sp tqe_dif /end OUT_MEASUREMENT
/end FUNCTION
/begin FUNCTION TORQUE_ATQALTAI "" /begin OUT_MEASUREMENT gen_load /end OUT_MEASUREMENT /end FUNCTION
/begin FUNCTION TORQUE_ATQETCU "Torque Request for Gear Shift Intervention"
 /begin DEF_CHARACTERISTIC lc_etcu_di_is lc_t_max_inh_etcu c_tq_inc_sum_max_etcu c_t_dly_diag_etcu_dec c_lgrd_tqi_neg_diag_etcu c_lgrd_tqi_pos_diag_etcu c_lgrd_tqi_neg_inh_etcu c_lgrd_tqi_pos_inh_etcu c_tq_dif_tol_etcu c_tq_dif_bol_etcu c_t_max_tq_inc_etcu lc_t_max_etcu_rst id_t_max_dri__dri_old__dri_new ldp_dri_old_etcu_id_t_max_dri ldp_dri_new_etcu_id_t_max_dri /end DEF_CHARACTERISTIC
 /begin OUT_MEASUREMENT lv_etcu_ena lv_t_lim_etcu lv_tq_inc_sum_etcu tq_inc_sum_etcu lv_tq_etcu_req_dec lv_tq_etcu_req_inc lv_etcu_inc_lih lv_etcu_dec_lih tq_req_etcu_lih lv_etcu_hold lv_etcu_ramp t_etcu_hold tq_etcu_inter tq_etcu_dif n_sp_amt lv_amt_act lv_tq_etcu_act lv_tq_etcu_req_min lv_tq_etcu_req_max lv_etcu_inc lv_etcu_ena_lih lv_etcu_ramp_end tqi_egs_sub tq_egs_sub lv_t_etcu_max t_etcu lv_t_etcu_inc_max lv_etcu_inc_inh lv_tq_inc_shift t_etcu_inc lv_cmd_inh_etcu lv_req_shift dri_old_etcu dri_new_etcu t_max_etcu /end OUT_MEASUREMENT
/end FUNCTION
/begin FUNCTION TORQUE_ATQ_LTC "Torque Loss Adaption"
 /begin DEF_CHARACTERISTIC c_tq_ltc_thd_add_down_2 c_tq_ltc_thd_down_2 c_n_32_ltc_min lc_ltc_on lc_ltc_dri_di lc_ltc_clu_di lc_ltc_is_ovs c_n_32_ltc_max /end DEF_CHARACTERISTIC
 /begin OUT_MEASUREMENT tq_ltc_sub tqi_ltc_sub lv_act_ltc /end OUT_MEASUREMENT
/end FUNCTION
/begin FUNCTION TORQUE_ATQI_REQ "Minimal-Maximal Torque Request Selection"
 /begin OUT_MEASUREMENT tqi_tar tqi_req_egr tqi_grd_tar tqi_grd_req_egr tqi_lim_min tqi_lim_min1 tqi_req_fast lv_tqi_lim_act tq_req_fast tq_lim_min /end OUT_MEASUREMENT
/end FUNCTION
/begin FUNCTION TORQUE_AMFTQLM "Torque Limitation"
 /begin DEF_CHARACTERISTIC lc_swi_temp_tql ip_tqi_tql_bas ldpm_n_ip_tqi_bas ip_fac_tqi_add_tql ldp_t_ast_ip_fac_tqi_add_tql ip_fac_tqi_tql_bpr ldp_vs_ip_fac_tqi_tql_bpr ip_fac_tqi_tql_amp ldp_tia_ip_fac_tqi_tql_amp ip_tqi_add_tql_st ldp_n_ip_tqi_add_tql ldp_tco_ip_tqi_tql ip_tqi_tql_bpr ldp_n_ip_tqi_tql_bpr ip_tqi_tql_amp ldpm_n_ip_tqi_tql ldp_amp_ip_tqi_tql_amp /end DEF_CHARACTERISTIC
 /begin OUT_MEASUREMENT tqi_tql tqi_tql_bas tqi_add_tql tqi_tql_bpr tqi_tql_amp /end OUT_MEASUREMENT
/end FUNCTION
/begin FUNCTION C_D_TQM ""
 /begin SUB_FUNCTION TQM_Torque_Request_For_Gear_Shif TQM_Torque_Request_for_Traction_ TQM_TQ_Loss_And_Reserve_ACC TQM_TQ_Loss_Alternator /end SUB_FUNCTION
/end FUNCTION
/begin FUNCTION TQM_Torque_Request_For_Gear_Shift ""
 /begin DEF_CHARACTERISTIC c_t_dly_diag_gs c_tqi_gs_slow_hys c_lgrd_tqi_inc_diag_gs c_n_sp_is_ratio_max_gs_lim ldp_n__lgrd_tqi_gs_bol ip_lgrd_tqi_gs_bol /end DEF_CHARACTERISTIC
 /begin OUT_MEASUREMENT lv_tcu_disable lv_gs_ena tqi_gs_fast_inc tqi_gs_slow_dec tqi_gs_slow_inc lv_gs_dec_act tqi_gs_fast_dec tqi_gs_bol /end OUT_MEASUREMENT
/end FUNCTION
/begin FUNCTION TQM_Torque_Request_for_Traction_Control_TCS ""
 /begin DEF_CHARACTERISTIC c_vs_min_msr c_tq_msr_int_max c_t_max_tcs1_miss c_lgrd_tqi_inc_diag_asr c_t_dly_diag_asr c_n_sp_is_ratio_max_asr_lim ip_lgrd_tqi_asr_bol ldp_n__lgrd_tqi_asr_bol /end DEF_CHARACTERISTIC
 /begin OUT_MEASUREMENT lv_msr_ena tqi_msr_fast tqi_msr_slow lv_msr tq_msr_int lv_msr_nplau lv_msr_ena_can_cnt lv_msr_act lv_tcs_disable lv_asr_ena tqi_asr_fast tqi_asr_slow lv_asr lv_asr_act /end OUT_MEASUREMENT
/end FUNCTION
/begin FUNCTION TQM_TQ_Loss_And_Reserve_ACC ""
 /begin DEF_CHARACTERISTIC c_tq_loss_acc_sub ip_fac_tq_loss_acc_on ip_fac_tq_loss_acc_off ldp_n__tq_loss_acc ldp_acp__tq_loss_acc ldp_t_acc__fac_tq_loss_acc_on ldp_t_acc__fac_tq_loss_acc_off ip_tq_loss_acc /end DEF_CHARACTERISTIC
 /begin OUT_MEASUREMENT t_acc tq_add_acc tq_loss_acc /end OUT_MEASUREMENT
/end FUNCTION
/begin FUNCTION TQM_TQ_Loss_Alternator ""
 /begin DEF_CHARACTERISTIC ldp_gen_load__tq_loss_alter ip_tq_loss_alter c_lgrd_tq_loss_alter c_tq_loss_alter_sub lc_use_tq_loss_alter_can ldp_n32_tq_loss_alter /end DEF_CHARACTERISTIC
 /begin OUT_MEASUREMENT tq_loss_alter /end OUT_MEASUREMENT
/end FUNCTION
/begin FUNCTION C_E_MON ""
 /begin SUB_FUNCTION MON_AERRMON MON_AMONINCI MON_AADCMON MON_ACANMON MON_ACRUMON MON_AFCUTMON MON_ANMON MON_ANMAXMON MON_APOINMON MON_APPSMON MON_APVSMON MON_ASERVMON MON_ACOPPRMON /end SUB_FUNCTION
/end FUNCTION
/begin FUNCTION MON_AERRMON ""
 /begin DEF_CHARACTERISTIC c_abc_inc_conv_mon_1 c_abc_max_conv_mon_1 c_abc_inc_n_32_mon_1 c_abc_max_n_32_mon_1 c_abc_inc_pvs_mon_1 c_abc_max_pvs_mon_1 c_abc_inc_fcut_mon_1 c_abc_max_fcut_mon_1 c_abc_inc_tqi_n_max_mon_1 c_abc_max_tqi_n_max_mon_1 c_abc_inc_can_inh_mon c_abc_max_can_inh_mon c_abc_inc_post_inh_mon c_abc_max_post_inh_mon c_abc_inc_cru_inh_mon c_abc_max_cru_inh_mon c_abc_inc_serv_mon_1 c_abc_max_serv_mon_1 /end DEF_CHARACTERISTIC
 /begin OUT_MEASUREMENT lv_n_lim_req_mon lv_off_mtc_mon lv_off_iv_mon /end OUT_MEASUREMENT
/end FUNCTION
/begin FUNCTION MON_AMONINCI ""
 /begin DEF_CHARACTERISTIC c_vcc_pvs_max_mon c_vcc_pvs_min_mon c_v_pvs_max_mon c_abc_inc_vcc_pvs_mon c_abc_max_vcc_pvs_mon c_n_min_fcut_mon c_t_prep_es_mon /end DEF_CHARACTERISTIC
 /begin OUT_MEASUREMENT lv_brake_mon lv_err_vcc_pvs_1_mon lv_err_vcc_pvs_2_mon lv_err_vcc_pvs_mon vcc_pvs_mon abc_vcc_pvs_mon lv_fcut_mon_act_mon lv_tqi_mon_act_mon lv_n_lim_etc_mon lv_igk_mon lv_igk_act_n_lim_mon t_prep_es_mon state_iv prev_state_iv /end OUT_MEASUREMENT
/end FUNCTION
/begin FUNCTION MON_AADCMON "" /begin DEF_CHARACTERISTIC c_acq_conv_hys_mon c_abc_inc_conv_mon c_abc_max_conv_mon /end DEF_CHARACTERISTIC /begin OUT_MEASUREMENT abc_conv_mon lv_err_conv_mon /end OUT_MEASUREMENT /end FUNCTION
/begin FUNCTION MON_ACANMON ""
 /begin DEF_CHARACTERISTIC c_abc_inc_can_tcs_mon c_abc_max_can_tcs_mon c_vb_min_can_mon c_t_max_tcs1_miss_mon c_t_can_tcs_inh_mon /end DEF_CHARACTERISTIC
 /begin OUT_MEASUREMENT lv_can_mon lv_can_inh_mon lv_can_tcs_mon lv_can_tcs_inh_mon t_can_tcs_inh_mon lv_can_tcs_tout_det_mon abc_can_tcs_mon /end OUT_MEASUREMENT
/end FUNCTION
/begin FUNCTION MON_ACRUMON ""
 /begin DEF_CHARACTERISTIC c_abc_inc_cru_mon c_abc_max_cru_mon c_t_cru_inh_mon c_vs_min_cru_mon /end DEF_CHARACTERISTIC
 /begin OUT_MEASUREMENT lv_tq_cru_act_mon lv_cru_inh_mon t_cru_inh_mon abc_cru_mon /end OUT_MEASUREMENT
/end FUNCTION
/begin FUNCTION MON_AFCUTMON "" /begin DEF_CHARACTERISTIC c_t_fcut_inh_mon c_abc_inc_fcut_mon c_abc_max_fcut_mon /end DEF_CHARACTERISTIC /begin OUT_MEASUREMENT t_fcut_inh_mon abc_fcut_mon lv_err_fcut_mon /end OUT_MEASUREMENT /end FUNCTION
/begin FUNCTION MON_ANMON ""
 /begin DEF_CHARACTERISTIC c_abc_inc_n_32_mon c_abc_max_n_32_mon c_n_32_dif_rel_max_mon c_n_32_lim_mon c_n_32_min_mon /end DEF_CHARACTERISTIC
 /begin OUT_MEASUREMENT abc_n_32_mon lv_err_n_32_mon n_32_sub_mon n_32_dif_rel_mon n_32_mon /end OUT_MEASUREMENT
/end FUNCTION
/begin FUNCTION MON_ANMAXMON ""
 /begin DEF_CHARACTERISTIC c_n_max_mtc_lih_thd_mon c_abc_inc_tqi_n_max_mon c_abc_max_tqi_n_max_mon /end DEF_CHARACTERISTIC
 /begin OUT_MEASUREMENT lv_err_tqi_n_max_mon abc_tqi_n_max_mon /end OUT_MEASUREMENT
/end FUNCTION
/end MODULE
/end PROJECT
