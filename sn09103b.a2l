ASAP2_VERSION 1 41
/begin PROJECT SN0 "SIMOS PPD"
/begin HEADER "_default_HeaderComment" PROJECT_NO PRJ_NUM /end HEADER
/begin MODULE _default_ModuleName "_default_ModuleLongIdentifier"
/begin MOD_COMMON "_default_ModCommonComment" DEPOSIT ABSOLUTE BYTE_ORDER MSB_FIRST ALIGNMENT_BYTE 1 ALIGNMENT_WORD 2 ALIGNMENT_LONG 4 ALIGNMENT_FLOAT32_IEEE 4 ALIGNMENT_FLOAT64_IEEE 8 /end MOD_COMMON
/begin CHARACTERISTIC c_ctr_max_wup_cyc "Initialization value for the warm-up cycle of diagnostics" VALUE 0x848360 _REC_VAL_20_u1 255. _CNV_A_R_LINEAR_____1_CM 0. 255. DISPLAY_IDENTIFIER C_CTR_MAX_WUP_CYC FORMAT "%3.0" /end CHARACTERISTIC
/begin AXIS_PTS ldp_fmy_dtc "" 0x8416ac online_dummy _REC_AXS_20_u2 5. _CNV_A_R_LINEAR_____0_CM 6 0. 5. FORMAT "%2.0" /end AXIS_PTS
/begin CHARACTERISTIC lc_abc_bench "logical constant to manage the anti-bounce bench mode" VALUE 0x84878b _REC_VAL_20_u1 1. _CNV_A_R_LINEAR_____0_CM 0. 1. DISPLAY_IDENTIFIER LC_ABC_BENCH FORMAT "%2.0" /end CHARACTERISTIC
/begin CHARACTERISTIC id_clas_a_fmt "" CURVE 0x8449ce _REC_CUR_20_u1_u2 255. _CNV_A_R_LINEAR_____1_CM 0. 255. DISPLAY_IDENTIFIER ID_CLAS_A_FMT FORMAT "%3.0"
 /begin AXIS_DESCR COM_AXIS online_dummy _CNV_A_R_LINEAR_____1_CM 16 0. 65535. FORMAT "%5.0" AXIS_PTS_REF ldpm_clas_a_id_clas_fmy /end AXIS_DESCR
/end CHARACTERISTIC
/begin AXIS_PTS ldpm_clas_a_id_clas_fmy "" 0x84342a online_dummy _REC_AXS_20_u2 65535. _CNV_A_R_LINEAR_____1_CM 16 0. 65535. FORMAT "%5.0" /end AXIS_PTS
/begin CHARACTERISTIC id_clas_b_fmt "" MAP 0x8449de _REC_MAP_20_u1_u2_u2 255. _CNV_A_R_LINEAR_____1_CM 0. 255. DISPLAY_IDENTIFIER ID_CLAS_B_FMT FORMAT "%3.0"
 /begin AXIS_DESCR COM_AXIS online_dummy _CNV_A_R_LINEAR_____1_CM 16 0. 65535. FORMAT "%5.0" AXIS_PTS_REF ldpm_clas_a_id_clas_fmy /end AXIS_DESCR
 /begin AXIS_DESCR COM_AXIS online_dummy _CNV_A_R_LINEAR_____1_CM 4 0. 65535. FORMAT "%5.0" AXIS_PTS_REF ldp_clas_b_id_clas_fmy /end AXIS_DESCR
/end CHARACTERISTIC
/begin AXIS_PTS ldp_clas_b_id_clas_fmy "" 0x84145e online_dummy _REC_AXS_20_u2 65535. _CNV_A_R_LINEAR_____1_CM 4 0. 65535. FORMAT "%5.0" /end AXIS_PTS
/begin CHARACTERISTIC id_err_dtc_mis "DTC table declaration for diagnosis misfiring" MAP 0x844a1e _REC_MAP_20_u2_u2_u2 65535. _CNV_A_R_LINEAR_____1_CM 0. 65535. DISPLAY_IDENTIFIER ID_ERR_DTC_MIS FORMAT "%5.0"
 /begin AXIS_DESCR COM_AXIS online_dummy _CNV_A_R_LINEAR_____1_CM 2 0. 65535. FORMAT "%5.0" AXIS_PTS_REF ldp_1_id_err_dtc_mis /end AXIS_DESCR
 /begin AXIS_DESCR COM_AXIS online_dummy _CNV_A_R_LINEAR_____1_CM 7 0. 65535. FORMAT "%5.0" AXIS_PTS_REF ldp_2_id_err_dtc_mis /end AXIS_DESCR
/end CHARACTERISTIC
/begin AXIS_PTS ldp_1_id_err_dtc_mis "" 0x84106c online_dummy _REC_AXS_20_u2 65535. _CNV_A_R_LINEAR_____1_CM 2 0. 65535. FORMAT "%5.0" /end AXIS_PTS
/begin AXIS_PTS ldp_2_id_err_dtc_mis "" 0x841072 online_dummy _REC_AXS_20_u2 65535. _CNV_A_R_LINEAR_____1_CM 7 0. 65535. FORMAT "%5.0" /end AXIS_PTS
/begin CHARACTERISTIC c_obd_state_1 "" VALUE 0x848584 _REC_VAL_20_u1 7. _CNV_A_R_LINEAR_____0_CM 0. 7. DISPLAY_IDENTIFIER C_OBD_STATE_1 FORMAT "%2.0" /end CHARACTERISTIC
/begin CHARACTERISTIC c_obd_state_2 "" VALUE 0x848585 _REC_VAL_20_u1 255. _CNV_A_R_LINEAR_____1_CM 0. 255. DISPLAY_IDENTIFIER C_OBD_STATE_2 FORMAT "%3.0" /end CHARACTERISTIC
/begin CHARACTERISTIC lc_ena_scdn "Boolean to indicate iof similar conditions are inhibited (0) or (1)" VALUE 0x8487a5 _REC_VAL_20_u1 1. _CNV_A_R_LINEAR_____0_CM 0. 1. DISPLAY_IDENTIFIER LC_ENA_SCDN FORMAT "%2.0" /end CHARACTERISTIC
/begin CHARACTERISTIC lc_clr_fmy "Boolean to clear failure memory when set to 1" VALUE 0x848790 _REC_VAL_20_u1 1. _CNV_A_R_LINEAR_____0_CM 0. 1. DISPLAY_IDENTIFIER LC_CLR_FMY FORMAT "%2.0" /end CHARACTERISTIC
/begin CHARACTERISTIC lc_clr_his_fmy "Clearing the history memory" VALUE 0x848791 _REC_VAL_20_u1 1. _CNV_A_R_LINEAR_____0_CM 0. 1. DISPLAY_IDENTIFIER LC_CLR_HIS_FMY FORMAT "%2.0" /end CHARACTERISTIC
/begin CHARACTERISTIC c_conf_mil "" VALUE 0x84834e _REC_VAL_20_u1 7. _CNV_A_R_LINEAR_____0_CM 0. 7. DISPLAY_IDENTIFIER C_CONF_MIL FORMAT "%1.0" /end CHARACTERISTIC
/begin CHARACTERISTIC c_conf_wal_1 "" VALUE 0x84834f _REC_VAL_20_u1 7. _CNV_A_R_LINEAR_____0_CM 0. 7. DISPLAY_IDENTIFIER C_CONF_WAL_1 FORMAT "%1.0" /end CHARACTERISTIC
/begin CHARACTERISTIC c_conf_wal_2 "" VALUE 0x848350 _REC_VAL_20_u1 7. _CNV_A_R_LINEAR_____0_CM 0. 7. DISPLAY_IDENTIFIER C_CONF_WAL_2 FORMAT "%1.0" /end CHARACTERISTIC
/begin CHARACTERISTIC lc_inh_wal_st "" VALUE 0x8487aa _REC_VAL_20_u1 1. _CNV_A_R_LINEAR_____0_CM 0. 1. DISPLAY_IDENTIFIER LC_INH_WAL_ST FORMAT "%2.0" /end CHARACTERISTIC
/begin CHARACTERISTIC c_dly_inh_iv_mis "Delay for MIL blinking in case of misfiring present failure with cylinder cut off" VALUE 0x848368 _REC_VAL_20_u1 255. _CNV_A_R_LINEAR_____4_CM 0. 255. DISPLAY_IDENTIFIER C_DLY_INH_IV_MIS FORMAT "%3.0" /end CHARACTERISTIC
/begin CHARACTERISTIC lc_ad_clr "" VALUE 0x84878d _REC_VAL_20_u1 1. _CNV_A_R_LINEAR_____0_CM 0. 1. DISPLAY_IDENTIFIER LC_AD_CLR FORMAT "%1.0" /end CHARACTERISTIC
/begin CHARACTERISTIC c_nvmy_inst_chk "" VALUE 0x848583 _REC_VAL_20_u1 255. _CNV_A_R_LINEAR_____0_CM 0. 255. DISPLAY_IDENTIFIER C_NVMY_INST_CHK FORMAT "%3.0" /end CHARACTERISTIC
/begin AXIS_PTS ldpm_n_ip_mf_pf "" 0x843bf8 n _REC_AXS_20_u2 6375. _CNV_A_R_LINEAR_____5_CM 24 0. 6375. FORMAT "%4.0" /end AXIS_PTS
/begin CHARACTERISTIC c_dly_mil_ready_1 "Delay to start MIL blinking for readiness display during pre-drive check." VALUE 0x848369 _REC_VAL_20_u1 127500. _CNV_A_R_LINEAR_____6_CM 0. 127500. DISPLAY_IDENTIFIER C_DLY_MIL_READY_1 FORMAT "%6.0" /end CHARACTERISTIC
/begin CHARACTERISTIC c_dly_mil_ready_2 "MIL blinking duration for readiness display during pre-drive check" VALUE 0x84836a _REC_VAL_20_u1 127500. _CNV_A_R_LINEAR_____6_CM 0. 127500. DISPLAY_IDENTIFIER C_DLY_MIL_READY_2 FORMAT "%6.0" /end CHARACTERISTIC
/begin CHARACTERISTIC lc_egrv_pctl_on "" VALUE 0x85c320 _REC_VAL_20_u1 1. _CNV_A_R_LINEAR_____0_CM 0. 1. DISPLAY_IDENTIFIER LC_EGRV_PCTL_ON FORMAT "%1.0" /end CHARACTERISTIC
/begin CHARACTERISTIC c_bpapwm_min_diag "" VALUE 0x85bd18 _REC_VAL_20_u2 99.99847412109381 _CNV_A_R_LINEAR_____8_CM 0. 99.99847412109381 DISPLAY_IDENTIFIER C_BPAPWM_MIN_DIAG FORMAT "%5.3" /end CHARACTERISTIC
/begin CHARACTERISTIC c_bpapwm_max_diag "" VALUE 0x85bd16 _REC_VAL_20_u2 99.99847412109381 _CNV_A_R_LINEAR_____8_CM 0. 99.99847412109381 DISPLAY_IDENTIFIER C_BPAPWM_MAX_DIAG FORMAT "%5.3" /end CHARACTERISTIC
/begin CHARACTERISTIC c_fac_ar_egrv_pctl_fil "" VALUE 0x85be00 _REC_VAL_20_u2 0.9999847412109381 _CNV_A_R_LINEAR_____14_CM 0. 0.9999847412109381 DISPLAY_IDENTIFIER C_FAC_AR_EGRV_PCTL_FIL FORMAT "%6.5" /end CHARACTERISTIC
/begin CHARACTERISTIC c_thrpwm_min_diag "" VALUE 0x85c1b0 _REC_VAL_20_u2 99.99847412109381 _CNV_A_R_LINEAR_____8_CM 0. 99.99847412109381 DISPLAY_IDENTIFIER C_THRPWM_MIN_DIAG FORMAT "%5.3" /end CHARACTERISTIC
/begin CHARACTERISTIC c_thrpwm_max_diag "" VALUE 0x85c1ac _REC_VAL_20_u2 99.99847412109381 _CNV_A_R_LINEAR_____8_CM 0. 99.99847412109381 DISPLAY_IDENTIFIER C_THRPWM_MAX_DIAG FORMAT "%5.3" /end CHARACTERISTIC
/begin CHARACTERISTIC c_ctr_inh_temp_diag "" VALUE 0x85bda8 _REC_VAL_20_u2 65535. _CNV_A_R_LINEAR_____16_CM 0. 65535. DISPLAY_IDENTIFIER C_CTR_INH_TEMP_DIAG FORMAT "%5.0" /end CHARACTERISTIC
/begin CHARACTERISTIC c_tco_mes_grd_diag "" VALUE 0x85c14f _REC_VAL_20_u1 255. _CNV_A_R_LINEAR_____17_CM 0. 255. DISPLAY_IDENTIFIER C_TCO_MES_GRD_DIAG FORMAT "%3.0" /end CHARACTERISTIC
/begin CHARACTERISTIC c_tco_mes_st_diag "" VALUE 0x85c150 _REC_VAL_20_u1 255. _CNV_A_R_LINEAR_____18_CM -50. 205. DISPLAY_IDENTIFIER C_TCO_MES_ST_DIAG FORMAT "%3.0" /end CHARACTERISTIC
/begin CHARACTERISTIC c_t_ast_tco_diag "" VALUE 0x85c09e _REC_VAL_20_u2 6553.5 _CNV_A_R_LINEAR_____19_CM 0. 6553.5 DISPLAY_IDENTIFIER C_T_AST_TCO_DIAG FORMAT "%5.1" /end CHARACTERISTIC
/begin CHARACTERISTIC c_tco_plaus_inc_diag "" VALUE 0x85c152 _REC_VAL_20_u1 255. _CNV_A_R_LINEAR_____20_CM 0. 255. DISPLAY_IDENTIFIER C_TCO_PLAUS_INC_DIAG FORMAT "%3.0" /end CHARACTERISTIC
/begin AXIS_PTS ldp_amp_ip_load_clc_amp "" 0x8412ba amp _REC_AXS_20_u2 5434. _CNV_A_R_LINEAR_____21_CM 6 0. 5434. FORMAT "%4.3" /end AXIS_PTS
/begin AXIS_PTS ldp_n_32_ip_load_clc "" 0x8418f1 n_32 _REC_AXS_20_u1 6375. _CNV_A_R_LINEAR_____22_CM 8 0. 6375. FORMAT "%4.0" /end AXIS_PTS
/begin AXIS_PTS ldp_maf_ip_load_clc "" 0x84171a maf _REC_AXS_20_u2 1389. _CNV_A_R_LINEAR_____23_CM 8 0. 1389. FORMAT "%4.0" /end AXIS_PTS
/begin AXIS_PTS ldp_fmy_envd "" 0x8416ba online_dummy _REC_AXS_20_u1 7. _CNV_A_R_LINEAR_____0_CM 8 0. 7. READ_ONLY FORMAT "%2.0" /end AXIS_PTS
/begin CHARACTERISTIC ip_load_clc_amp__amp "Diagnosis load_clc , amp" CURVE 0x84cf84 _REC_CUR_20_u1_u2 1.9921875 _CNV_A_R_LINEAR_____24_CM 0. 1.9921875 DISPLAY_IDENTIFIER IP_LOAD_CLC_AMP__AMP FORMAT "%4.3"
 /begin AXIS_DESCR COM_AXIS amp _CNV_A_R_LINEAR_____21_CM 6 0. 5434. FORMAT "%4.3" AXIS_PTS_REF ldp_amp_ip_load_clc_amp /end AXIS_DESCR
/end CHARACTERISTIC
/begin CHARACTERISTIC ip_load_clc__n_32__maf "Diagnosis load_clc , n_32 , maf" MAP 0x84cf44 _REC_MAP_20_u1_u1_u2 1. _CNV_A_R_LINEAR_____25_CM 0. 1. DISPLAY_IDENTIFIER IP_LOAD_CLC__N_32__MAF FORMAT "%4.3"
 /begin AXIS_DESCR COM_AXIS n_32 _CNV_A_R_LINEAR_____22_CM 8 0. 6375. FORMAT "%4.0" AXIS_PTS_REF ldp_n_32_ip_load_clc /end AXIS_DESCR
 /begin AXIS_DESCR COM_AXIS maf _CNV_A_R_LINEAR_____23_CM 8 0. 1389. FORMAT "%4.0" AXIS_PTS_REF ldp_maf_ip_load_clc /end AXIS_DESCR
/end CHARACTERISTIC
/begin CHARACTERISTIC c_tco_wup_thd "OBD II required at least 72 °C for GS and 60 °C for DS engines EOBD required at least 70 °C for DS and GS engines" VALUE 0x8486df _REC_VAL_20_u1 255. _CNV_A_R_LINEAR_____18_CM -50. 205. DISPLAY_IDENTIFIER C_TCO_WUP_THD FORMAT "%3.0" /end CHARACTERISTIC
/begin CHARACTERISTIC c_tco_wup_inc "OBDII required at least 23 °C for GS and DS engines EOBD required at least 22 °C for GS and DS engines" VALUE 0x8486de _REC_VAL_20_u1 255. _CNV_A_R_LINEAR_____18_CM -50. 205. DISPLAY_IDENTIFIER C_TCO_WUP_INC FORMAT "%3.0" /end CHARACTERISTIC
/begin CHARACTERISTIC c_abc_inc_pvs_l_1 "" VALUE 0x848239 _REC_VAL_20_u1 255. _CNV_A_R_LINEAR_____0_CM 0. 255. DISPLAY_IDENTIFIER C_ABC_INC_PVS_L_1 FORMAT "%3.0" /end CHARACTERISTIC
/begin CHARACTERISTIC c_abc_max_pvs_l_1 "" VALUE 0x8482bb _REC_VAL_20_u1 255. _CNV_A_R_LINEAR_____0_CM 0. 255. DISPLAY_IDENTIFIER C_ABC_MAX_PVS_L_1 FORMAT "%3.0" /end CHARACTERISTIC
/begin CHARACTERISTIC c_abc_inc_pvs_l_2 "" VALUE 0x84823a _REC_VAL_20_u1 255. _CNV_A_R_LINEAR_____0_CM 0. 255. DISPLAY_IDENTIFIER C_ABC_INC_PVS_L_2 FORMAT "%3.0" /end CHARACTERISTIC
/begin CHARACTERISTIC c_abc_max_pvs_l_2 "" VALUE 0x8482bc _REC_VAL_20_u1 255. _CNV_A_R_LINEAR_____0_CM 0. 255. DISPLAY_IDENTIFIER C_ABC_MAX_PVS_L_2 FORMAT "%3.0" /end CHARACTERISTIC
/begin CHARACTERISTIC c_abc_inc_pvs_h_1 "" VALUE 0x848237 _REC_VAL_20_u1 255. _CNV_A_R_LINEAR_____0_CM 0. 255. DISPLAY_IDENTIFIER C_ABC_INC_PVS_H_1 FORMAT "%3.0" /end CHARACTERISTIC
/begin CHARACTERISTIC c_abc_max_pvs_h_1 "" VALUE 0x8482b9 _REC_VAL_20_u1 255. _CNV_A_R_LINEAR_____0_CM 0. 255. DISPLAY_IDENTIFIER C_ABC_MAX_PVS_H_1 FORMAT "%3.0" /end CHARACTERISTIC
/begin CHARACTERISTIC c_abc_inc_pvs_h_2 "" VALUE 0x848238 _REC_VAL_20_u1 255. _CNV_A_R_LINEAR_____0_CM 0. 255. DISPLAY_IDENTIFIER C_ABC_INC_PVS_H_2 FORMAT "%3.0" /end CHARACTERISTIC
/begin CHARACTERISTIC c_abc_max_pvs_h_2 "" VALUE 0x8482ba _REC_VAL_20_u1 255. _CNV_A_R_LINEAR_____0_CM 0. 255. DISPLAY_IDENTIFIER C_ABC_MAX_PVS_H_2 FORMAT "%3.0" /end CHARACTERISTIC
/begin CHARACTERISTIC c_abc_inc_pvs_ratio "" VALUE 0x84823d _REC_VAL_20_u1 255. _CNV_A_R_LINEAR_____0_CM 0. 255. DISPLAY_IDENTIFIER C_ABC_INC_PVS_RATIO FORMAT "%3.0" /end CHARACTERISTIC
/begin CHARACTERISTIC c_abc_max_pvs_ratio "" VALUE 0x8482bf _REC_VAL_20_u1 255. _CNV_A_R_LINEAR_____0_CM 0. 255. DISPLAY_IDENTIFIER C_ABC_MAX_PVS_RATIO FORMAT "%3.0" /end CHARACTERISTIC
/begin CHARACTERISTIC c_abc_inc_pvs_bls_bts "" VALUE 0x848236 _REC_VAL_20_u1 255. _CNV_A_R_LINEAR_____0_CM 0. 255. DISPLAY_IDENTIFIER C_ABC_INC_PVS_BLS_BTS FORMAT "%3.0" /end CHARACTERISTIC
/begin CHARACTERISTIC c_abc_max_pvs_bls_bts "" VALUE 0x8482b8 _REC_VAL_20_u1 255. _CNV_A_R_LINEAR_____0_CM 0. 255. DISPLAY_IDENTIFIER C_ABC_MAX_PVS_BLS_BTS FORMAT "%3.0" /end CHARACTERISTIC
/begin CHARACTERISTIC c_abc_inc_pvs_move "" VALUE 0x84823c _REC_VAL_20_u1 255. _CNV_A_R_LINEAR_____0_CM 0. 255. DISPLAY_IDENTIFIER C_ABC_INC_PVS_MOVE FORMAT "%3.0" /end CHARACTERISTIC
/begin CHARACTERISTIC c_abc_max_pvs_move "" VALUE 0x8482be _REC_VAL_20_u1 255. _CNV_A_R_LINEAR_____0_CM 0. 255. DISPLAY_IDENTIFIER C_ABC_MAX_PVS_MOVE FORMAT "%3.0" /end CHARACTERISTIC
/begin CHARACTERISTIC c_crlc_pvs_1_move "" VALUE 0x85bd52 _REC_VAL_20_u1 0.99609375 _CNV_A_R_LINEAR_____34_CM 0. 0.99609375 DISPLAY_IDENTIFIER C_CRLC_PVS_1_MOVE FORMAT "%3.2" /end CHARACTERISTIC
/begin CHARACTERISTIC c_crlc_pvs_2_move "" VALUE 0x85bd53 _REC_VAL_20_u1 0.99609375 _CNV_A_R_LINEAR_____34_CM 0. 0.99609375 DISPLAY_IDENTIFIER C_CRLC_PVS_2_MOVE FORMAT "%3.2" /end CHARACTERISTIC
/begin CHARACTERISTIC c_ctr_max_pv_av_con "" VALUE 0x85bdb4 _REC_VAL_20_u1 255. _CNV_A_R_LINEAR_____0_CM 0. 255. DISPLAY_IDENTIFIER C_CTR_MAX_PV_AV_CON FORMAT "%3.0" /end CHARACTERISTIC
/begin CHARACTERISTIC c_ctr_max_pvs_bls_bts_plaus "" VALUE 0x85bdb5 _REC_VAL_20_u1 255. _CNV_A_R_LINEAR_____0_CM 0. 255. DISPLAY_IDENTIFIER C_CTR_MAX_PVS_BLS_BTS_PLAUS FORMAT "%3.0" /end CHARACTERISTIC
/begin CHARACTERISTIC c_ctr_max_pvs_h_r_1 "" VALUE 0x85bdb6 _REC_VAL_20_u1 255. _CNV_A_R_LINEAR_____0_CM 0. 255. DISPLAY_IDENTIFIER C_CTR_MAX_PVS_H_R_1 FORMAT "%3.0" /end CHARACTERISTIC
/begin CHARACTERISTIC c_ctr_max_pvs_h_r_2 "" VALUE 0x85bdb7 _REC_VAL_20_u1 255. _CNV_A_R_LINEAR_____0_CM 0. 255. DISPLAY_IDENTIFIER C_CTR_MAX_PVS_H_R_2 FORMAT "%3.0" /end CHARACTERISTIC
/begin CHARACTERISTIC c_ctr_max_pvs_is_rng "" VALUE 0x85bdb8 _REC_VAL_20_u1 255. _CNV_A_R_LINEAR_____0_CM 0. 255. DISPLAY_IDENTIFIER C_CTR_MAX_PVS_IS_RNG FORMAT "%3.0" /end CHARACTERISTIC
/begin CHARACTERISTIC c_ctr_max_pvs_move "" VALUE 0x85bdbb _REC_VAL_20_u1 255. _CNV_A_R_LINEAR_____0_CM 0. 255. DISPLAY_IDENTIFIER C_CTR_MAX_PVS_MOVE FORMAT "%3.0" /end CHARACTERISTIC
/begin CHARACTERISTIC c_ctr_max_pvs_move_err "" VALUE 0x85bdbc _REC_VAL_20_u1 255. _CNV_A_R_LINEAR_____0_CM 0. 255. DISPLAY_IDENTIFIER C_CTR_MAX_PVS_MOVE_ERR FORMAT "%3.0" /end CHARACTERISTIC
/begin CHARACTERISTIC c_n_pvs_bls_bts_plaus "" VALUE 0x85bfc5 _REC_VAL_20_u1 8160. _CNV_A_R_LINEAR_____35_CM 0. 8160. DISPLAY_IDENTIFIER C_N_PVS_BLS_BTS_PLAUS FORMAT "%4.0" /end CHARACTERISTIC
/begin CHARACTERISTIC c_pv_av_hys_bls_bts_plaus "" VALUE 0x85bfee _REC_VAL_20_u2 99.90234375 _CNV_A_R_LINEAR_____36_CM 0. 99.90234375 DISPLAY_IDENTIFIER C_PV_AV_HYS_BLS_BTS_PLAUS FORMAT "%3.1" /end CHARACTERISTIC
/begin CHARACTERISTIC c_pv_av_pvs_bls_bts_plaus "" VALUE 0x85bff4 _REC_VAL_20_u2 99.90234375 _CNV_A_R_LINEAR_____36_CM 0. 99.90234375 DISPLAY_IDENTIFIER C_PV_AV_PVS_BLS_BTS_PLAUS FORMAT "%3.1" /end CHARACTERISTIC
/begin CHARACTERISTIC c_pvs_ratio_fac "" VALUE 0x85c000 _REC_VAL_20_u2 7.9998779296875 _CNV_A_R_LINEAR_____37_CM 0. 7.9998779296875 DISPLAY_IDENTIFIER C_PVS_RATIO_FAC FORMAT "%3.2" /end CHARACTERISTIC
/begin CHARACTERISTIC c_v_pvs_max_diag_1 "" VALUE 0x85c242 _REC_VAL_20_u2 4.9951171875 _CNV_A_R_LINEAR_____33_CM 0. 4.9951171875 DISPLAY_IDENTIFIER C_V_PVS_MAX_DIAG_1 FORMAT "%3.2" /end CHARACTERISTIC
/begin CHARACTERISTIC c_v_pvs_max_diag_2 "" VALUE 0x85c244 _REC_VAL_20_u2 4.9951171875 _CNV_A_R_LINEAR_____33_CM 0. 4.9951171875 DISPLAY_IDENTIFIER C_V_PVS_MAX_DIAG_2 FORMAT "%3.2" /end CHARACTERISTIC
/begin CHARACTERISTIC c_v_pvs_min_diag_1 "" VALUE 0x85c248 _REC_VAL_20_u2 4.9951171875 _CNV_A_R_LINEAR_____33_CM 0. 4.9951171875 DISPLAY_IDENTIFIER C_V_PVS_MIN_DIAG_1 FORMAT "%3.2" /end CHARACTERISTIC
/begin CHARACTERISTIC c_v_pvs_min_diag_2 "" VALUE 0x85c24a _REC_VAL_20_u2 4.9951171875 _CNV_A_R_LINEAR_____33_CM 0. 4.9951171875 DISPLAY_IDENTIFIER C_V_PVS_MIN_DIAG_2 FORMAT "%3.2" /end CHARACTERISTIC
/begin CHARACTERISTIC c_v_pvs_min_diag_min_1 "" VALUE 0x85c24c _REC_VAL_20_u2 4.9951171875 _CNV_A_R_LINEAR_____33_CM 0. 4.9951171875 DISPLAY_IDENTIFIER C_V_PVS_MIN_DIAG_MIN_1 FORMAT "%3.2" /end CHARACTERISTIC
/begin CHARACTERISTIC c_v_pvs_min_diag_min_2 "" VALUE 0x85c24e _REC_VAL_20_u2 4.9951171875 _CNV_A_R_LINEAR_____33_CM 0. 4.9951171875 DISPLAY_IDENTIFIER C_V_PVS_MIN_DIAG_MIN_2 FORMAT "%3.2" /end CHARACTERISTIC
/begin CHARACTERISTIC c_v_pvs_move_hys_1 "" VALUE 0x85c250 _REC_VAL_20_u2 4.9951171875 _CNV_A_R_LINEAR_____33_CM 0. 4.9951171875 DISPLAY_IDENTIFIER C_V_PVS_MOVE_HYS_1 FORMAT "%3.2" /end CHARACTERISTIC
/begin CHARACTERISTIC c_v_pvs_move_hys_2 "" VALUE 0x85c252 _REC_VAL_20_u2 4.9951171875 _CNV_A_R_LINEAR_____33_CM 0. 4.9951171875 DISPLAY_IDENTIFIER C_V_PVS_MOVE_HYS_2 FORMAT "%3.2" /end CHARACTERISTIC
/begin CHARACTERISTIC c_v_pvs_ratio_ofs "" VALUE 0x85c254 _REC_VAL_20_s2 4.995117000000001 _CNV_A_R_LINEAR_____38_CM -2.5 2.495117 DISPLAY_IDENTIFIER C_V_PVS_RATIO_OFS FORMAT "%4.2" /end CHARACTERISTIC
/begin CHARACTERISTIC c_v_pvs_thd_move_1 "" VALUE 0x85c272 _REC_VAL_20_u2 4.9951171875 _CNV_A_R_LINEAR_____33_CM 0. 4.9951171875 DISPLAY_IDENTIFIER C_V_PVS_THD_MOVE_1 FORMAT "%3.2" /end CHARACTERISTIC
/begin CHARACTERISTIC c_vs_pvs_bls_bts_plaus "" VALUE 0x85c2e7 _REC_VAL_20_u1 255. _CNV_A_R_LINEAR_____39_CM 0. 255. DISPLAY_IDENTIFIER C_VS_PVS_BLS_BTS_PLAUS FORMAT "%3.0" /end CHARACTERISTIC
/begin CHARACTERISTIC lc_poti "" VALUE 0x85c356 _REC_VAL_20_u1 1. _CNV_A_R_LINEAR_____0_CM 0. 1. DISPLAY_IDENTIFIER LC_POTI FORMAT "%1.0" /end CHARACTERISTIC
/begin CHARACTERISTIC lc_pvs_bls_bts_plaus_ena "" VALUE 0x85c357 _REC_VAL_20_u1 1. _CNV_A_R_LINEAR_____0_CM 0. 1. DISPLAY_IDENTIFIER LC_PVS_BLS_BTS_PLAUS_ENA FORMAT "%1.0" /end CHARACTERISTIC
/begin AXIS_PTS ldp_v_pvs_min_ip_pvs_ratio_hys "" 0x8432ec v_pvs_min _REC_AXS_20_u2 4.9951171875 _CNV_A_R_LINEAR_____33_CM 6 0. 4.9951171875 FORMAT "%3.2" /end AXIS_PTS
/begin CHARACTERISTIC ip_pvs_ratio_hys__v_pvs_min "PVS: Maximum PVS ratio hystheresis" CURVE 0x8558ea _REC_CUR_20_u2_u2 4.9951171875 _CNV_A_R_LINEAR_____33_CM 0. 4.9951171875 DISPLAY_IDENTIFIER IP_PVS_RATIO_HYS__V_PVS_MIN FORMAT "%3.2"
 /begin AXIS_DESCR COM_AXIS v_pvs_min _CNV_A_R_LINEAR_____33_CM 6 0. 4.9951171875 FORMAT "%3.2" AXIS_PTS_REF ldp_v_pvs_min_ip_pvs_ratio_hys /end AXIS_DESCR
/end CHARACTERISTIC
/begin CHARACTERISTIC c_abc_inc_vcc_1 "" VALUE 0x848267 _REC_VAL_20_u1 255. _CNV_A_R_LINEAR_____0_CM 0. 255. DISPLAY_IDENTIFIER C_ABC_INC_VCC_1 FORMAT "%3.0" /end CHARACTERISTIC
/begin CHARACTERISTIC c_abc_max_vcc_1 "" VALUE 0x8482e9 _REC_VAL_20_u1 255. _CNV_A_R_LINEAR_____0_CM 0. 255. DISPLAY_IDENTIFIER C_ABC_MAX_VCC_1 FORMAT "%3.0" /end CHARACTERISTIC
/begin CHARACTERISTIC c_abc_inc_vcc_2 "" VALUE 0x848268 _REC_VAL_20_u1 255. _CNV_A_R_LINEAR_____0_CM 0. 255. DISPLAY_IDENTIFIER C_ABC_INC_VCC_2 FORMAT "%3.0" /end CHARACTERISTIC
/begin CHARACTERISTIC c_abc_max_vcc_2 "" VALUE 0x8482ea _REC_VAL_20_u1 255. _CNV_A_R_LINEAR_____0_CM 0. 255. DISPLAY_IDENTIFIER C_ABC_MAX_VCC_2 FORMAT "%3.0" /end CHARACTERISTIC
/begin CHARACTERISTIC c_vcc_min_diag "" VALUE 0x85c2c0 _REC_VAL_20_u2 9.99023 _CNV_A_R_LINEAR_____40_CM 0. 9.99023 DISPLAY_IDENTIFIER C_VCC_MIN_DIAG FORMAT "%5.3" /end CHARACTERISTIC
/begin CHARACTERISTIC c_vcc_max_diag "" VALUE 0x85c2be _REC_VAL_20_u2 9.99023 _CNV_A_R_LINEAR_____40_CM 0. 9.99023 DISPLAY_IDENTIFIER C_VCC_MAX_DIAG FORMAT "%5.3" /end CHARACTERISTIC
/begin CHARACTERISTIC c_amp_sub_diag "" VALUE 0x85bcca _REC_VAL_20_u2 5434. _CNV_A_R_LINEAR_____21_CM 0. 5434. DISPLAY_IDENTIFIER C_AMP_SUB_DIAG FORMAT "%4.3" /end CHARACTERISTIC
/begin CHARACTERISTIC ip_amp_mes__v_amp "Ambient pressure" CURVE 0x849042 _REC_CUR_20_u2_u2 5434. _CNV_A_R_LINEAR_____21_CM 0. 5434. DISPLAY_IDENTIFIER IP_AMP_MES__V_AMP FORMAT "%4.3"
 /begin AXIS_DESCR COM_AXIS v_amp _CNV_A_R_LINEAR_____33_CM 2 0. 4.9951171875 FORMAT "%3.2" AXIS_PTS_REF ldp_v_amp_ip_amp_mes /end AXIS_DESCR
/end CHARACTERISTIC
/begin AXIS_PTS ldp_v_amp_ip_amp_mes "" 0x8432a0 v_amp _REC_AXS_20_u2 4.9951171875 _CNV_A_R_LINEAR_____33_CM 2 0. 4.9951171875 FORMAT "%3.2" /end AXIS_PTS
/begin CHARACTERISTIC c_tfu_mes_grd_diag "" VALUE 0x85c190 _REC_VAL_20_u1 255. _CNV_A_R_LINEAR_____51_CM 0. 255. DISPLAY_IDENTIFIER C_TFU_MES_GRD_DIAG FORMAT "%3.0" /end CHARACTERISTIC
/begin CHARACTERISTIC c_abc_inc_v_tfu_rng "" VALUE 0x848261 _REC_VAL_20_u1 255. _CNV_A_R_LINEAR_____0_CM 0. 255. DISPLAY_IDENTIFIER C_ABC_INC_V_TFU_RNG FORMAT "%3.0" /end CHARACTERISTIC
/begin CHARACTERISTIC c_abc_max_v_tfu_rng "" VALUE 0x8482e3 _REC_VAL_20_u1 255. _CNV_A_R_LINEAR_____0_CM 0. 255. DISPLAY_IDENTIFIER C_ABC_MAX_V_TFU_RNG FORMAT "%3.0" /end CHARACTERISTIC
/begin CHARACTERISTIC c_abc_inc_tfu_mes_grd "" VALUE 0x84824a _REC_VAL_20_u1 255. _CNV_A_R_LINEAR_____0_CM 0. 255. DISPLAY_IDENTIFIER C_ABC_INC_TFU_MES_GRD FORMAT "%3.0" /end CHARACTERISTIC
/begin CHARACTERISTIC c_abc_max_tfu_mes_grd "" VALUE 0x8482cc _REC_VAL_20_u1 255. _CNV_A_R_LINEAR_____0_CM 0. 255. DISPLAY_IDENTIFIER C_ABC_MAX_TFU_MES_GRD FORMAT "%3.0" /end CHARACTERISTIC
/begin CHARACTERISTIC c_v_tfu_max_diag "" VALUE 0x85c280 _REC_VAL_20_u2 4.9951171875 _CNV_A_R_LINEAR_____33_CM 0. 4.9951171875 DISPLAY_IDENTIFIER C_V_TFU_MAX_DIAG FORMAT "%3.2" /end CHARACTERISTIC
/begin CHARACTERISTIC c_v_tfu_min_diag "" VALUE 0x85c282 _REC_VAL_20_u2 4.9951171875 _CNV_A_R_LINEAR_____33_CM 0. 4.9951171875 DISPLAY_IDENTIFIER C_V_TFU_MIN_DIAG FORMAT "%3.2" /end CHARACTERISTIC
/begin CHARACTERISTIC c_tfu_sub_diag "" VALUE 0x85c192 _REC_VAL_20_u1 255. _CNV_A_R_LINEAR_____18_CM -50. 205. DISPLAY_IDENTIFIER C_TFU_SUB_DIAG FORMAT "%3.0" /end CHARACTERISTIC
/begin AXIS_PTS ldp_v_tfu_ip_tfu_mes "" 0x843360 v_tfu _REC_AXS_20_u2 4.9951171875 _CNV_A_R_LINEAR_____33_CM 16 0. 4.9951171875 FORMAT "%3.2" /end AXIS_PTS
/begin CHARACTERISTIC ip_tfu_mes__v_tfu "Fuel temperature" CURVE 0x85abf6 _REC_CUR_20_u1_u2 255. _CNV_A_R_LINEAR_____18_CM -50. 205. DISPLAY_IDENTIFIER IP_TFU_MES__V_TFU FORMAT "%3.0"
 /begin AXIS_DESCR COM_AXIS v_tfu _CNV_A_R_LINEAR_____33_CM 16 0. 4.9951171875 FORMAT "%3.2" AXIS_PTS_REF ldp_v_tfu_ip_tfu_mes /end AXIS_DESCR
/end CHARACTERISTIC
/begin CHARACTERISTIC c_abc_inc_cyl_bal_0 "" VALUE 0x848202 _REC_VAL_20_u1 255. _CNV_A_R_LINEAR_____0_CM 0. 255. DISPLAY_IDENTIFIER C_ABC_INC_CYL_BAL_0 FORMAT "%3.0" /end CHARACTERISTIC
/begin CHARACTERISTIC c_abc_max_cyl_bal_0 "" VALUE 0x848284 _REC_VAL_20_u1 255. _CNV_A_R_LINEAR_____0_CM 0. 255. DISPLAY_IDENTIFIER C_ABC_MAX_CYL_BAL_0 FORMAT "%3.0" /end CHARACTERISTIC
/begin CHARACTERISTIC c_abc_inc_cyl_bal_1 "" VALUE 0x848203 _REC_VAL_20_u1 255. _CNV_A_R_LINEAR_____0_CM 0. 255. DISPLAY_IDENTIFIER C_ABC_INC_CYL_BAL_1 FORMAT "%3.0" /end CHARACTERISTIC
/begin CHARACTERISTIC c_abc_max_cyl_bal_1 "" VALUE 0x848285 _REC_VAL_20_u1 255. _CNV_A_R_LINEAR_____0_CM 0. 255. DISPLAY_IDENTIFIER C_ABC_MAX_CYL_BAL_1 FORMAT "%3.0" /end CHARACTERISTIC
/begin CHARACTERISTIC c_abc_inc_cyl_bal_2 "" VALUE 0x848204 _REC_VAL_20_u1 255. _CNV_A_R_LINEAR_____0_CM 0. 255. DISPLAY_IDENTIFIER C_ABC_INC_CYL_BAL_2 FORMAT "%3.0" /end CHARACTERISTIC
/begin CHARACTERISTIC c_abc_max_cyl_bal_2 "" VALUE 0x848286 _REC_VAL_20_u1 255. _CNV_A_R_LINEAR_____0_CM 0. 255. DISPLAY_IDENTIFIER C_ABC_MAX_CYL_BAL_2 FORMAT "%3.0" /end CHARACTERISTIC
/begin CHARACTERISTIC c_abc_inc_cyl_bal_3 "" VALUE 0x848205 _REC_VAL_20_u1 255. _CNV_A_R_LINEAR_____0_CM 0. 255. DISPLAY_IDENTIFIER C_ABC_INC_CYL_BAL_3 FORMAT "%3.0" /end CHARACTERISTIC
/begin CHARACTERISTIC c_abc_max_cyl_bal_3 "" VALUE 0x848287 _REC_VAL_20_u1 255. _CNV_A_R_LINEAR_____0_CM 0. 255. DISPLAY_IDENTIFIER C_ABC_MAX_CYL_BAL_3 FORMAT "%3.0" /end CHARACTERISTIC
/begin MEASUREMENT ctr_bas_cyl_bal[3] "" UBYTE _CNV_A_R_LINEAR_____0_CM 1 0. 0. 255. DISPLAY_IDENTIFIER CTR_BAS_CYL_BAL_3_ ECU_ADDRESS 0x7fb459 FORMAT "%3.0" /end MEASUREMENT
/begin MEASUREMENT ctr_eve_cyl_bal[3] "" UBYTE _CNV_A_R_LINEAR_____0_CM 1 0. 0. 255. DISPLAY_IDENTIFIER CTR_EVE_CYL_BAL_3_ ECU_ADDRESS 0x7fb45d FORMAT "%3.0" /end MEASUREMENT
/begin CHARACTERISTIC c_ctr_eve_cyl_bal_max "" VALUE 0x85bda2 _REC_VAL_20_u1 255. _CNV_A_R_LINEAR_____0_CM 0. 255. DISPLAY_IDENTIFIER C_CTR_EVE_CYL_BAL_MAX FORMAT "%3.0" /end CHARACTERISTIC
/begin CHARACTERISTIC c_ctr_bas_cyl_bal_max "" VALUE 0x85bd99 _REC_VAL_20_u1 255. _CNV_A_R_LINEAR_____0_CM 0. 255. DISPLAY_IDENTIFIER C_CTR_BAS_CYL_BAL_MAX FORMAT "%3.0" /end CHARACTERISTIC
/begin CHARACTERISTIC c_fac_is_fil_neg "" VALUE 0x85be42 _REC_VAL_20_u2 0.9999847412109381 _CNV_A_R_LINEAR_____14_CM 0. 0.9999847412109381 DISPLAY_IDENTIFIER C_FAC_IS_FIL_NEG FORMAT "%5.4" /end CHARACTERISTIC
/begin CHARACTERISTIC c_fac_is_fil_pos "" VALUE 0x85be44 _REC_VAL_20_u2 0.9999847412109381 _CNV_A_R_LINEAR_____14_CM 0. 0.9999847412109381 DISPLAY_IDENTIFIER C_FAC_IS_FIL_POS FORMAT "%5.4" /end CHARACTERISTIC
/begin CHARACTERISTIC c_t_is_fil_ais_req "" VALUE 0x85c0de _REC_VAL_20_u2 6553.5 _CNV_A_R_LINEAR_____19_CM 0. 6553.5 DISPLAY_IDENTIFIER C_T_IS_FIL_AIS_REQ FORMAT "%5.1" /end CHARACTERISTIC
/begin AXIS_PTS ldp_dri_id_fac_pl_is "" 0x8415ea dri _REC_AXS_20_u1 15. _CNV_P_8_TABLE_______71_CM 7 0. 15. FORMAT "%2.0" /end AXIS_PTS
/begin AXIS_PTS ldp_tco_ip_fac_fil_pl_is "" 0x8426be tco _REC_AXS_20_u1 255. _CNV_A_R_LINEAR_____18_CM 8 -50. 205. FORMAT "%4.0" /end AXIS_PTS
/begin AXIS_PTS ldp_tco_ip_fac_fil_st_is "" 0x8426c7 tco _REC_AXS_20_u1 255. _CNV_A_R_LINEAR_____18_CM 8 -50. 205. FORMAT "%4.0" /end AXIS_PTS
/begin CHARACTERISTIC id_fac_pl_is__dri "IS: setpoint filter factor transition PL -> IS for gear" CURVE 0x84897c _REC_CUR_20_u2_u1 0.9999847412109381 _CNV_A_R_LINEAR_____14_CM 0. 0.9999847412109381 DISPLAY_IDENTIFIER ID_FAC_PL_IS__DRI FORMAT "%4.3"
 /begin AXIS_DESCR COM_AXIS dri _CNV_P_8_TABLE_______71_CM 7 0. 15. FORMAT "%2.0" AXIS_PTS_REF ldp_dri_id_fac_pl_is /end AXIS_DESCR
/end CHARACTERISTIC
/begin CHARACTERISTIC ip_fac_fil_pl_is__tco "IS: setpoint filter factor transition PL -> IS for TCO" CURVE 0x84b9b4 _REC_CUR_20_u2_u1 0.9999847412109381 _CNV_A_R_LINEAR_____14_CM 0. 0.9999847412109381 DISPLAY_IDENTIFIER IP_FAC_FIL_PL_IS__TCO FORMAT "%4.3"
 /begin AXIS_DESCR COM_AXIS tco _CNV_A_R_LINEAR_____18_CM 8 -50. 205. FORMAT "%4.0" AXIS_PTS_REF ldp_tco_ip_fac_fil_pl_is /end AXIS_DESCR
/end CHARACTERISTIC
/begin CHARACTERISTIC ip_fac_fil_st_is__tco "IS: setpoint filter factor transition ST -> IS" CURVE 0x84b9c4 _REC_CUR_20_u2_u1 0.9999847412109381 _CNV_A_R_LINEAR_____14_CM 0. 0.9999847412109381 DISPLAY_IDENTIFIER IP_FAC_FIL_ST_IS__TCO FORMAT "%4.3"
 /begin AXIS_DESCR COM_AXIS tco _CNV_A_R_LINEAR_____18_CM 8 -50. 205. FORMAT "%4.0" AXIS_PTS_REF ldp_tco_ip_fac_fil_st_is /end AXIS_DESCR
/end CHARACTERISTIC
/begin CHARACTERISTIC id_dri__vs_n "Drive detection map" CURVE 0x848938 _REC_CUR_20_u1_u2 6. _CNV_A_R_LINEAR_____0_CM 0. 6. DISPLAY_IDENTIFIER ID_DRI__VS_N FORMAT "%2.0"
 /begin AXIS_DESCR COM_AXIS vs_n _CNV_A_R_LINEAR_____73_CM 13 0. 0.1 FORMAT "%7.6" AXIS_PTS_REF ldp_vs_n_id_dri /end AXIS_DESCR
/end CHARACTERISTIC
/begin AXIS_PTS ldp_vs_n_id_dri "" 0x8433d2 vs_n _REC_AXS_20_u2 9.e-002 _CNV_A_R_LINEAR_____73_CM 13 0. 0.1 FORMAT "%7.6" /end AXIS_PTS
/begin CHARACTERISTIC c_vs_n_grd_fil_thd "" VALUE 0x85c2e0 _REC_VAL_20_s2 9.9998474e-002 _CNV_A_R_LINEAR_____72_CM -5.e-002 4.9998474e-002 DISPLAY_IDENTIFIER C_VS_N_GRD_FIL_THD FORMAT "%7.6" /end CHARACTERISTIC
/begin CHARACTERISTIC lc_dri "" VALUE 0x85c310 _REC_VAL_20_u1 255. _CNV_A_R_LINEAR_____0_CM 0. 255. DISPLAY_IDENTIFIER LC_DRI FORMAT "%3.0" /end CHARACTERISTIC
/begin CHARACTERISTIC c_fac_fil_vs_n_grd "" VALUE 0x85be40 _REC_VAL_20_u2 0.9999847412109381 _CNV_A_R_LINEAR_____14_CM 0. 0.9999847412109381 DISPLAY_IDENTIFIER C_FAC_FIL_VS_N_GRD FORMAT "%6.5" /end CHARACTERISTIC
/begin CHARACTERISTIC lc_dri_sub "" VALUE 0x85c311 _REC_VAL_20_u1 1. _CNV_S_2_RANGE______11_CM 0. 1. DISPLAY_IDENTIFIER LC_DRI_SUB /end CHARACTERISTIC
/begin CHARACTERISTIC c_dri_sub "" VALUE 0x85bdd2 _REC_VAL_20_u1 6. _CNV_A_R_LINEAR_____0_CM 0. 6. DISPLAY_IDENTIFIER C_DRI_SUB FORMAT "%1.0" /end CHARACTERISTIC
/begin CHARACTERISTIC c_t_max_vs_n "" VALUE 0x85c0fe _REC_VAL_20_u2 655.35 _CNV_A_R_LINEAR_____59_CM 0. 655.35 DISPLAY_IDENTIFIER C_T_MAX_VS_N FORMAT "%5.2" /end CHARACTERISTIC
/begin CHARACTERISTIC c_vs_n_hys "" VALUE 0x85c2e2 _REC_VAL_20_u2 0.1 _CNV_A_R_LINEAR_____73_CM 0. 0.1 DISPLAY_IDENTIFIER C_VS_N_HYS FORMAT "%5.4" /end CHARACTERISTIC
/begin CHARACTERISTIC c_t_max_vs_n_diag "" VALUE 0x85c100 _REC_VAL_20_u2 655.35 _CNV_A_R_LINEAR_____59_CM 0. 655.35 DISPLAY_IDENTIFIER C_T_MAX_VS_N_DIAG FORMAT "%5.2" /end CHARACTERISTIC
/begin CHARACTERISTIC c_vs_n_hys_diag "" VALUE 0x85c2e4 _REC_VAL_20_u2 0.1 _CNV_A_R_LINEAR_____73_CM 0. 0.1 DISPLAY_IDENTIFIER C_VS_N_HYS_DIAG FORMAT "%5.4" /end CHARACTERISTIC
/begin CHARACTERISTIC c_t_upd_vs_abs "" VALUE 0x85c134 _REC_VAL_20_u2 1.024 _CNV_A_R_LINEAR_____76_CM 0. 1.024 DISPLAY_IDENTIFIER C_T_UPD_VS_ABS FORMAT "%4.3" /end CHARACTERISTIC
/begin CHARACTERISTIC c_vs_lih_grd "" VALUE 0x85c2d8 _REC_VAL_20_u2 655.35 _CNV_A_R_LINEAR_____74_CM 0. 655.35 DISPLAY_IDENTIFIER C_VS_LIH_GRD FORMAT "%5.2" /end CHARACTERISTIC
/begin CHARACTERISTIC c_vs_lih "" VALUE 0x85c2d6 _REC_VAL_20_u2 655.35 _CNV_A_R_LINEAR_____74_CM 0. 655.35 DISPLAY_IDENTIFIER C_VS_LIH FORMAT "%5.2" /end CHARACTERISTIC
/begin CHARACTERISTIC c_fac_vs_fil "" VALUE 0x85be92 _REC_VAL_20_u2 0.9999847412109381 _CNV_A_R_LINEAR_____14_CM 0. 0.9999847412109381 DISPLAY_IDENTIFIER C_FAC_VS_FIL FORMAT "%6.5" /end CHARACTERISTIC
/begin CHARACTERISTIC lc_ac_fil "" VALUE 0x85c2e8 _REC_VAL_20_u1 1. _CNV_A_R_LINEAR_____0_CM 0. 1. DISPLAY_IDENTIFIER LC_AC_FIL FORMAT "%2.0" /end CHARACTERISTIC
/begin CHARACTERISTIC c_vs_det_min "" VALUE 0x85c2d4 _REC_VAL_20_u1 25.5 _CNV_A_R_LINEAR_____77_CM 0. 25.5 DISPLAY_IDENTIFIER C_VS_DET_MIN FORMAT "%3.1" /end CHARACTERISTIC
/begin CHARACTERISTIC c_vs_puls_div "" VALUE 0x85c2e6 _REC_VAL_20_u1 255. _CNV_A_R_LINEAR_____0_CM 0. 255. DISPLAY_IDENTIFIER C_VS_PULS_DIV FORMAT "%3.0" /end CHARACTERISTIC
/begin CHARACTERISTIC c_buf_size_vs "" VALUE 0x85bd20 _REC_VAL_20_u1 16. _CNV_A_R_LINEAR_____0_CM 0. 16. DISPLAY_IDENTIFIER C_BUF_SIZE_VS FORMAT "%3.0" /end CHARACTERISTIC
/begin CHARACTERISTIC c_abc_inc_vs "" VALUE 0x848269 _REC_VAL_20_u1 255. _CNV_A_R_LINEAR_____0_CM 0. 255. DISPLAY_IDENTIFIER C_ABC_INC_VS FORMAT "%3.0" /end CHARACTERISTIC
/begin CHARACTERISTIC c_abc_max_vs "" VALUE 0x8482eb _REC_VAL_20_u1 255. _CNV_A_R_LINEAR_____0_CM 0. 255. DISPLAY_IDENTIFIER C_ABC_MAX_VS FORMAT "%3.0" /end CHARACTERISTIC
/begin CHARACTERISTIC c_mf_tot_vs_cor_diag "" VALUE 0x85bf76 _REC_VAL_20_u2 262.14 _CNV_A_R_LINEAR_____43_CM 0. 262.14 DISPLAY_IDENTIFIER C_MF_TOT_VS_COR_DIAG FORMAT "%5.2" /end CHARACTERISTIC
/begin CHARACTERISTIC c_vs_max_diag "" VALUE 0x85c2da _REC_VAL_20_u1 255. _CNV_A_R_LINEAR_____39_CM 0. 255. DISPLAY_IDENTIFIER C_VS_MAX_DIAG FORMAT "%3.0" /end CHARACTERISTIC
/begin CHARACTERISTIC c_vs_min_diag "" VALUE 0x85c2de _REC_VAL_20_u1 255. _CNV_A_R_LINEAR_____39_CM 0. 255. DISPLAY_IDENTIFIER C_VS_MIN_DIAG FORMAT "%3.0" /end CHARACTERISTIC
/begin CHARACTERISTIC c_n_vs_cor_diag "" VALUE 0x85bfdc _REC_VAL_20_u2 6375. _CNV_A_R_LINEAR_____5_CM 0. 6375. DISPLAY_IDENTIFIER C_N_VS_COR_DIAG FORMAT "%4.0" /end CHARACTERISTIC
/begin CHARACTERISTIC c_n_dif_vs_cor_diag "" VALUE 0x85bf8c _REC_VAL_20_u2 6375. _CNV_A_R_LINEAR_____78_CM 0. 6375. DISPLAY_IDENTIFIER C_N_DIF_VS_COR_DIAG FORMAT "%4.0" /end CHARACTERISTIC
/begin CHARACTERISTIC c_tco_vs_cor_diag "" VALUE 0x85c15c _REC_VAL_20_u1 255. _CNV_A_R_LINEAR_____18_CM -50. 205. DISPLAY_IDENTIFIER C_TCO_VS_COR_DIAG FORMAT "%3.2" /end CHARACTERISTIC
/begin CHARACTERISTIC c_t_max_vs_cor_diag "" VALUE 0x85c0fc _REC_VAL_20_u2 6553.5 _CNV_A_R_LINEAR_____19_CM 0. 6553.5 DISPLAY_IDENTIFIER C_T_MAX_VS_COR_DIAG FORMAT "%5.1" /end CHARACTERISTIC
/begin CHARACTERISTIC c_fac_vs "" VALUE 0x85be90 _REC_VAL_20_u2 65535. _CNV_A_R_LINEAR_____79_CM 0. 65535. DISPLAY_IDENTIFIER C_FAC_VS FORMAT "%5.0" /end CHARACTERISTIC
/begin CHARACTERISTIC lc_can_vs_abs "" VALUE 0x85c301 _REC_VAL_20_u1 1. _CNV_A_R_LINEAR_____0_CM 0. 1. DISPLAY_IDENTIFIER LC_CAN_VS_ABS FORMAT "%1.0" /end CHARACTERISTIC
/begin CHARACTERISTIC lc_can_ac_abs "" VALUE 0x85c2ff _REC_VAL_20_u1 1. _CNV_A_R_LINEAR_____0_CM 0. 1. DISPLAY_IDENTIFIER LC_CAN_AC_ABS FORMAT "%1.0" /end CHARACTERISTIC
/begin CHARACTERISTIC lc_can_dist_abs "" VALUE 0x85c300 _REC_VAL_20_u1 1. _CNV_A_R_LINEAR_____0_CM 0. 1. DISPLAY_IDENTIFIER LC_CAN_DIST_ABS FORMAT "%1.0" /end CHARACTERISTIC
/begin AXIS_PTS ldpm_n_ip_tqfr "" 0x843cea n _REC_AXS_20_u2 6375. _CNV_A_R_LINEAR_____5_CM 12 0. 6375. FORMAT "%4.0" /end AXIS_PTS
/begin CHARACTERISTIC lc_efp_ctl_on "" VALUE 0x85c315 _REC_VAL_20_u1 1. _CNV_A_R_LINEAR_____0_CM 0. 1. DISPLAY_IDENTIFIER LC_EFP_CTL_ON FORMAT "%1.0" /end CHARACTERISTIC
/begin CHARACTERISTIC lc_efp_rly_man_on "" VALUE 0x85c316 _REC_VAL_20_u1 1. _CNV_A_R_LINEAR_____0_CM 0. 1. DISPLAY_IDENTIFIER LC_EFP_RLY_MAN_ON FORMAT "%1.0" /end CHARACTERISTIC
/begin CHARACTERISTIC c_t_efp_reset_st "" VALUE 0x85c0c2 _REC_VAL_20_u2 6553.5 _CNV_A_R_LINEAR_____19_CM 0. 6553.5 DISPLAY_IDENTIFIER C_T_EFP_RESET_ST FORMAT "%5.4" /end CHARACTERISTIC
/begin CHARACTERISTIC c_t_efp_reset_es "" VALUE 0x85c0c0 _REC_VAL_20_u2 6553.5 _CNV_A_R_LINEAR_____19_CM 0. 6553.5 DISPLAY_IDENTIFIER C_T_EFP_RESET_ES FORMAT "%5.4" /end CHARACTERISTIC
/begin CHARACTERISTIC c_crlc_tqfr "" VALUE 0x85bd58 _REC_VAL_20_u2 0.9999847412109381 _CNV_A_R_LINEAR_____14_CM 0. 0.9999847412109381 DISPLAY_IDENTIFIER C_CRLC_TQFR FORMAT "%5.4" /end CHARACTERISTIC
/begin CHARACTERISTIC ip_tqfr_add__n_mmv__toil "TQ: LOSS TOIL correction" MAP 0x85b416 _REC_MAP_20_u2_u2_u1 2047.96875 _CNV_A_R_LINEAR_____89_CM -1024. 1023.96875 DISPLAY_IDENTIFIER IP_TQFR_ADD__N_MMV__TOIL FORMAT "%7.2"
 /begin AXIS_DESCR COM_AXIS n_mmv _CNV_A_R_LINEAR_____5_CM 12 0. 6375. FORMAT "%4.0" AXIS_PTS_REF ldpm_n_mmv_ip_tqfr_add /end AXIS_DESCR
 /begin AXIS_DESCR COM_AXIS toil _CNV_A_R_LINEAR_____18_CM 8 -50. 205. FORMAT "%3.0" AXIS_PTS_REF ldp_toil_ip_tqfr_add /end AXIS_DESCR
/end CHARACTERISTIC
/begin CHARACTERISTIC ip_tqfr_add__n_mmv__tco "TQ: LOSS TCO correction" MAP 0x85b356 _REC_MAP_20_u2_u2_u1 2047.96875 _CNV_A_R_LINEAR_____89_CM -1024. 1023.96875 DISPLAY_IDENTIFIER IP_TQFR_ADD__N_MMV__TCO FORMAT "%7.2"
 /begin AXIS_DESCR COM_AXIS n_mmv _CNV_A_R_LINEAR_____5_CM 12 0. 6375. FORMAT "%4.0" AXIS_PTS_REF ldpm_n_mmv_ip_tqfr_add /end AXIS_DESCR
 /begin AXIS_DESCR COM_AXIS tco _CNV_A_R_LINEAR_____18_CM 8 -50. 205. FORMAT "%3.0" AXIS_PTS_REF ldp_tco_ip_tqfr_add /end AXIS_DESCR
/end CHARACTERISTIC
/begin CHARACTERISTIC ip_tqfr__n "TQ: LOSS warm engine" CURVE 0x85b33e _REC_CUR_20_u2_u2 2047.96875 _CNV_A_R_LINEAR_____89_CM -1024. 1023.96875 DISPLAY_IDENTIFIER IP_TQFR__N FORMAT "%7.2"
 /begin AXIS_DESCR COM_AXIS n _CNV_A_R_LINEAR_____5_CM 12 0. 6375. FORMAT "%4.0" AXIS_PTS_REF ldpm_n_ip_tqfr /end AXIS_DESCR
/end CHARACTERISTIC
/begin AXIS_PTS ldpm_n_mmv_ip_tqfr_add "" 0x843e14 n_mmv _REC_AXS_20_u2 6375. _CNV_A_R_LINEAR_____5_CM 12 0. 6375. FORMAT "%4.0" /end AXIS_PTS
/begin AXIS_PTS ldp_toil_ip_tqfr_add "" 0x842a2e toil _REC_AXS_20_u1 255. _CNV_A_R_LINEAR_____18_CM 8 -50. 205. FORMAT "%3.0" /end AXIS_PTS
/begin AXIS_PTS ldp_tco_ip_tqfr_add "" 0x842852 tco _REC_AXS_20_u1 255. _CNV_A_R_LINEAR_____18_CM 8 -50. 205. FORMAT "%3.0" /end AXIS_PTS
/begin CHARACTERISTIC c_tq_max_sca "" VALUE 0x85c1ce _REC_VAL_20_s2 2047.96875 _CNV_A_R_LINEAR_____62_CM -1024. 1023.96875 DISPLAY_IDENTIFIER C_TQ_MAX_SCA FORMAT "%5.1" /end CHARACTERISTIC
/begin CHARACTERISTIC lc_tq_tra_act "" VALUE 0x85c372 _REC_VAL_20_u1 1. _CNV_A_R_LINEAR_____0_CM 0. 1. DISPLAY_IDENTIFIER LC_TQ_TRA_ACT FORMAT "%1.0" /end CHARACTERISTIC
/begin CHARACTERISTIC c_fac_pv_av_dif_tra "" VALUE 0x85be6a _REC_VAL_20_u2 1. _CNV_A_R_LINEAR_____91_CM 0. 1. DISPLAY_IDENTIFIER C_FAC_PV_AV_DIF_TRA FORMAT "%6.5" /end CHARACTERISTIC
/begin CHARACTERISTIC c_pv_av_max "" VALUE 0x85bff0 _REC_VAL_20_u2 100. _CNV_A_R_LINEAR_____81_CM 0. 100. DISPLAY_IDENTIFIER C_PV_AV_MAX FORMAT "%4.2" /end CHARACTERISTIC
/begin CHARACTERISTIC lc_tq_tra_pv_av_lim "" VALUE 0x85c374 _REC_VAL_20_u1 1. _CNV_A_R_LINEAR_____0_CM 0. 1. DISPLAY_IDENTIFIER LC_TQ_TRA_PV_AV_LIM FORMAT "%1.0" /end CHARACTERISTIC
/begin CHARACTERISTIC c_n_dif_max "" VALUE 0x85bf8a _REC_VAL_20_u2 6375. _CNV_A_R_LINEAR_____5_CM 0. 6375. DISPLAY_IDENTIFIER C_N_DIF_MAX FORMAT "%4.0" /end CHARACTERISTIC
/begin CHARACTERISTIC c_fac_n_dif_tra "" VALUE 0x85be68 _REC_VAL_20_u2 1. _CNV_A_R_LINEAR_____91_CM 0. 1. DISPLAY_IDENTIFIER C_FAC_N_DIF_TRA FORMAT "%6.5" /end CHARACTERISTIC
/begin CHARACTERISTIC lc_n_mmv_tra_act "" VALUE 0x85c34b _REC_VAL_20_u1 1. _CNV_A_R_LINEAR_____0_CM 0. 1. DISPLAY_IDENTIFIER LC_N_MMV_TRA_ACT FORMAT "%1.0" /end CHARACTERISTIC
/begin CHARACTERISTIC lc_tq_tra_n_lim "" VALUE 0x85c373 _REC_VAL_20_u1 1. _CNV_A_R_LINEAR_____0_CM 0. 1. DISPLAY_IDENTIFIER LC_TQ_TRA_N_LIM FORMAT "%1.0" /end CHARACTERISTIC
/begin MEASUREMENT lv_tcs_inc "" UBYTE _CNV_S_2_RANGE______11_CM 1 0. 0. 1. DISPLAY_IDENTIFIER LV_TCS_INC ECU_ADDRESS 0x7fb7fa /end MEASUREMENT
/begin MEASUREMENT tq_tcs_inter "" SWORD _CNV_A_R_LINEAR_____62_CM 1 0. -1024. 1023.96875 DISPLAY_IDENTIFIER TQ_TCS_INTER ECU_ADDRESS 0x7fb11a BYTE_ORDER MSB_LAST FORMAT "%7.2" /end MEASUREMENT
/begin MEASUREMENT lv_tcs_ramp_end "" UBYTE _CNV_S_2_RANGE______11_CM 1 0. 0. 1. DISPLAY_IDENTIFIER LV_TCS_RAMP_END ECU_ADDRESS 0x7fbbd0 /end MEASUREMENT
/begin MEASUREMENT lv_tcs_ramp "" UBYTE _CNV_S_2_RANGE______11_CM 1 0. 0. 1. DISPLAY_IDENTIFIER LV_TCS_RAMP ECU_ADDRESS 0x7fb7fb /end MEASUREMENT
/begin MEASUREMENT lv_cmd_tcs_ramp_end "" UBYTE _CNV_S_2_RANGE______11_CM 1 0. 0. 1. DISPLAY_IDENTIFIER LV_CMD_TCS_RAMP_END ECU_ADDRESS 0x7fbbd1 /end MEASUREMENT
/begin MEASUREMENT lv_tcs_ramp_lih "" UBYTE _CNV_S_2_RANGE______11_CM 1 0. 0. 1. DISPLAY_IDENTIFIER LV_TCS_RAMP_LIH ECU_ADDRESS 0x7fbbd2 /end MEASUREMENT
/begin MEASUREMENT lv_tcs_ramp_tq_lim "" UBYTE _CNV_S_2_RANGE______11_CM 1 0. 0. 1. DISPLAY_IDENTIFIER LV_TCS_RAMP_TQ_LIM ECU_ADDRESS 0x7fbbd5 /end MEASUREMENT
/begin MEASUREMENT lv_tcs_ramp_t_lim "" UBYTE _CNV_S_2_RANGE______11_CM 1 0. 0. 1. DISPLAY_IDENTIFIER LV_TCS_RAMP_T_LIM ECU_ADDRESS 0x7fbbd3 /end MEASUREMENT
/begin MEASUREMENT t_tcs_ramp "" UBYTE _CNV_A_R_LINEAR_____59_CM 1 0. 0. 2.55 DISPLAY_IDENTIFIER T_TCS_RAMP ECU_ADDRESS 0x7fbbcc FORMAT "%3.2" /end MEASUREMENT
/begin MEASUREMENT t_tcs_inc "" UWORD _CNV_A_R_LINEAR_____59_CM 1 0. 0. 655.35 DISPLAY_IDENTIFIER T_TCS_INC ECU_ADDRESS 0x7fb11e BYTE_ORDER MSB_LAST FORMAT "%5.2" /end MEASUREMENT
/begin MEASUREMENT lv_cmd_tcs_ramp_tq_lim "" UBYTE _CNV_S_2_RANGE______11_CM 1 0. 0. 1. DISPLAY_IDENTIFIER LV_CMD_TCS_RAMP_TQ_LIM ECU_ADDRESS 0x7fbbd6 /end MEASUREMENT
/begin MEASUREMENT lv_cmd_tcs_ramp_t_lim "" UBYTE _CNV_S_2_RANGE______11_CM 1 0. 0. 1. DISPLAY_IDENTIFIER LV_CMD_TCS_RAMP_T_LIM ECU_ADDRESS 0x7fbbd4 /end MEASUREMENT
/begin MEASUREMENT tq_inc_sum_tcs "" UWORD _CNV_A_R_LINEAR_____93_CM 1 0. 0. 16383.75 DISPLAY_IDENTIFIER TQ_INC_SUM_TCS ECU_ADDRESS 0x7fa256 BYTE_ORDER MSB_LAST FORMAT "%7.2" /end MEASUREMENT
/begin MEASUREMENT tq_tcs_req_inter "" SWORD _CNV_A_R_LINEAR_____62_CM 1 0. -1024. 1023.96875 DISPLAY_IDENTIFIER TQ_TCS_REQ_INTER ECU_ADDRESS 0x7fb11c BYTE_ORDER MSB_LAST FORMAT "%7.2" /end MEASUREMENT
/begin CHARACTERISTIC c_t_dly_diag_tcs_dec "" VALUE 0x84862d _REC_VAL_20_u1 2.55 _CNV_A_R_LINEAR_____59_CM 0. 2.55 DISPLAY_IDENTIFIER C_T_DLY_DIAG_TCS_DEC FORMAT "%3.2" /end CHARACTERISTIC
/begin CHARACTERISTIC c_t_max_tcs_inc "" VALUE 0x848684 _REC_VAL_20_u2 655.35 _CNV_A_R_LINEAR_____59_CM 0. 655.35 DISPLAY_IDENTIFIER C_T_MAX_TCS_INC FORMAT "%5.2" /end CHARACTERISTIC
/begin CHARACTERISTIC c_tq_inc_sum_max_tcs "" VALUE 0x848702 _REC_VAL_20_u2 16383.75 _CNV_A_R_LINEAR_____93_CM 0. 16383.75 DISPLAY_IDENTIFIER C_TQ_INC_SUM_MAX_TCS FORMAT "%7.2" /end CHARACTERISTIC
/begin CHARACTERISTIC c_vs_min_tcs_inc "" VALUE 0x848785 _REC_VAL_20_u1 255. _CNV_A_R_LINEAR_____39_CM 0. 255. DISPLAY_IDENTIFIER C_VS_MIN_TCS_INC FORMAT "%3.0" /end CHARACTERISTIC
/begin CHARACTERISTIC lc_tcs_dec_act "" VALUE 0x8487da _REC_VAL_20_u1 1. _CNV_A_R_LINEAR_____0_CM 0. 1. DISPLAY_IDENTIFIER LC_TCS_DEC_ACT FORMAT "%1.0" /end CHARACTERISTIC
/begin CHARACTERISTIC lc_tcs_inc_act "" VALUE 0x8487db _REC_VAL_20_u1 1. _CNV_A_R_LINEAR_____0_CM 0. 1. DISPLAY_IDENTIFIER LC_TCS_INC_ACT FORMAT "%1.0" /end CHARACTERISTIC
/begin CHARACTERISTIC lc_tcs_inc_di_clu "" VALUE 0x8487dc _REC_VAL_20_u1 1. _CNV_A_R_LINEAR_____0_CM 0. 1. DISPLAY_IDENTIFIER LC_TCS_INC_DI_CLU FORMAT "%1.0" /end CHARACTERISTIC
/begin MEASUREMENT tq_req_etcu "" SWORD _CNV_A_R_LINEAR_____62_CM 1 0. -1024. 1023.96875 DISPLAY_IDENTIFIER TQ_REQ_ETCU ECU_ADDRESS 0x7fa20c BYTE_ORDER MSB_LAST FORMAT "%7.2" /end MEASUREMENT
/begin MEASUREMENT n_sp_etcu_inter "" UWORD _CNV_A_R_LINEAR_____5_CM 1 0. 0. 6375. DISPLAY_IDENTIFIER N_SP_ETCU_INTER ECU_ADDRESS 0x7fa20e BYTE_ORDER MSB_LAST FORMAT "%4.0" /end MEASUREMENT
/begin MEASUREMENT lv_req_n_ctl_etcu "" UBYTE _CNV_S_2_RANGE______11_CM 1 0. 0. 1. DISPLAY_IDENTIFIER LV_REQ_N_CTL_ETCU ECU_ADDRESS 0x7fb7e8 /end MEASUREMENT
/begin MEASUREMENT lv_etcu_dec_req "" UBYTE _CNV_S_2_RANGE______11_CM 1 0. 0. 1. DISPLAY_IDENTIFIER LV_ETCU_DEC_REQ ECU_ADDRESS 0x7fb7e7 /end MEASUREMENT
/begin MEASUREMENT lv_etcu_inc_req "" UBYTE _CNV_S_2_RANGE______11_CM 1 0. 0. 1. DISPLAY_IDENTIFIER LV_ETCU_INC_REQ ECU_ADDRESS 0x7fb7e6 /end MEASUREMENT
/begin MEASUREMENT sum_tqi_lih "" UWORD _CNV_A_R_LINEAR_____0_CM 1 0. 0. 65535. DISPLAY_IDENTIFIER SUM_TQI_LIH ECU_ADDRESS 0x7fc9e0 BYTE_ORDER MSB_LAST FORMAT "%7.2" /end MEASUREMENT
/begin MEASUREMENT tqi_lih_1 "" SWORD _CNV_A_R_LINEAR_____62_CM 1 0. -1024. 1023.96875 DISPLAY_IDENTIFIER TQI_LIH_1 ECU_ADDRESS 0x7fc9e4 BYTE_ORDER MSB_LAST FORMAT "%6.1" /end MEASUREMENT
/begin MEASUREMENT tqi_lih "" SWORD _CNV_A_R_LINEAR_____62_CM 1 0. -1024. 1023.96875 DISPLAY_IDENTIFIER TQI_LIH ECU_ADDRESS 0x7fc9e2 BYTE_ORDER MSB_LAST FORMAT "%7.2" /end MEASUREMENT
/begin MEASUREMENT lv_tqi_lih_intv_act "" UBYTE _CNV_S_2_RANGE______11_CM 1 0. 0. 1. DISPLAY_IDENTIFIER LV_TQI_LIH_INTV_ACT ECU_ADDRESS 0x7fca98 /end MEASUREMENT
/begin MEASUREMENT lv_tqi_lih_grd_lim "" UBYTE _CNV_S_2_RANGE______11_CM 1 0. 0. 1. DISPLAY_IDENTIFIER LV_TQI_LIH_GRD_LIM ECU_ADDRESS 0x7fca99 /end MEASUREMENT
/begin CHARACTERISTIC c_tqi_lih_grd_dec "" VALUE 0x85c1d6 _REC_VAL_20_s2 1023.96875 _CNV_A_R_LINEAR_____62_CM 0. 1023.96875 DISPLAY_IDENTIFIER C_TQI_LIH_GRD_DEC FORMAT "%7.2" /end CHARACTERISTIC
/begin CHARACTERISTIC c_tqi_lih_grd_inc "" VALUE 0x85c1d8 _REC_VAL_20_s2 1023.96875 _CNV_A_R_LINEAR_____62_CM 0. 1023.96875 DISPLAY_IDENTIFIER C_TQI_LIH_GRD_INC FORMAT "%7.2" /end CHARACTERISTIC
/begin CHARACTERISTIC c_tqi_lih_pas "" VALUE 0x85c1da _REC_VAL_20_s2 1023.96875 _CNV_A_R_LINEAR_____62_CM 0. 1023.96875 DISPLAY_IDENTIFIER C_TQI_LIH_PAS FORMAT "%7.2" /end CHARACTERISTIC
/begin CHARACTERISTIC lc_clr_sum_tqi_lih "" VALUE 0x85c303 _REC_VAL_20_u1 1. _CNV_A_R_LINEAR_____0_CM 0. 1. DISPLAY_IDENTIFIER LC_CLR_SUM_TQI_LIH FORMAT "%1.0" /end CHARACTERISTIC
/begin CHARACTERISTIC lc_tqi_lih_inh "" VALUE 0x85c377 _REC_VAL_20_u1 1. _CNV_A_R_LINEAR_____0_CM 0. 1. DISPLAY_IDENTIFIER LC_TQI_LIH_INH FORMAT "%1.0" /end CHARACTERISTIC
/begin CHARACTERISTIC ip_tqi_lih__n "TQ: Torque limitation request for limp home" CURVE 0x85b6fe _REC_CUR_20_u2_u2 2047.96875 _CNV_A_R_LINEAR_____89_CM -1024. 1023.96875 DISPLAY_IDENTIFIER IP_TQI_LIH__N FORMAT "%7.2"
 /begin AXIS_DESCR COM_AXIS n _CNV_A_R_LINEAR_____5_CM 16 0. 6375. FORMAT "%4.0" AXIS_PTS_REF ldp_n_ip_tqi_lih /end AXIS_DESCR
/end CHARACTERISTIC
/begin AXIS_PTS ldp_n_ip_tqi_lih "" 0x84235c n _REC_AXS_20_u2 6375. _CNV_A_R_LINEAR_____5_CM 16 0. 6375. FORMAT "%4.0" /end AXIS_PTS
/begin MEASUREMENT sf_conf_gb "" UBYTE _CNV_S_8_gearbox_ty_114_CM 1 0. 1. 128. DISPLAY_IDENTIFIER SF_CONF_GB ECU_ADDRESS 0x7fb68c /end MEASUREMENT
/begin MEASUREMENT sf_conf_acc "Air conditioning system" UBYTE _CNV_A_R_LINEAR_____0_CM 1 0. 0. 7. DISPLAY_IDENTIFIER SF_CONF_ACC ECU_ADDRESS 0x7fb68d FORMAT "%1.0" /end MEASUREMENT
/begin MEASUREMENT sf_conf_heat "" UBYTE _CNV_A_R_LINEAR_____0_CM 1 0. 0. 3. DISPLAY_IDENTIFIER SF_CONF_HEAT ECU_ADDRESS 0x7fb68e FORMAT "%1.0" /end MEASUREMENT
/begin MEASUREMENT lv_var_can_cs "Switch of clutch integrated" UBYTE _CNV_S_2_RANGE______11_CM 1 0. 0. 1. DISPLAY_IDENTIFIER LV_VAR_CAN_CS ECU_ADDRESS 0x7fb68f /end MEASUREMENT
/begin MEASUREMENT lv_acc_is_can_aut_ena "increase of idle speed, requirement of full automatic air conditioning system allowed" UBYTE _CNV_S_2_RANGE______11_CM 1 0. 0. 1. DISPLAY_IDENTIFIER LV_ACC_IS_CAN_AUT_ENA ECU_ADDRESS 0x7fb690 /end MEASUREMENT
/begin MEASUREMENT lv_acc_is_can_req_ena "increase of idle speed, requirement by A/C switch of semi automatic air conditioning system allowed" UBYTE _CNV_S_2_RANGE______11_CM 1 0. 0. 1. DISPLAY_IDENTIFIER LV_ACC_IS_CAN_REQ_ENA ECU_ADDRESS 0x7fb692 /end MEASUREMENT
/begin MEASUREMENT lv_egr_conf "" UBYTE _CNV_S_2_RANGE______11_CM 1 0. 0. 1. DISPLAY_IDENTIFIER LV_EGR_CONF ECU_ADDRESS 0x7fb698 /end MEASUREMENT
/begin CHARACTERISTIC c_conf_gb "" VALUE 0x85bd36 _REC_VAL_20_u1 127. _CNV_S_8_gearbox_ty_114_CM 1. 128. DISPLAY_IDENTIFIER C_CONF_GB /end CHARACTERISTIC
/begin CHARACTERISTIC c_conf_heat "Development value for: Coding of heating elements" VALUE 0x85bd37 _REC_VAL_20_u1 3. _CNV_A_R_LINEAR_____0_CM 0. 3. DISPLAY_IDENTIFIER C_CONF_HEAT FORMAT "%1.0" /end CHARACTERISTIC
/begin CHARACTERISTIC lc_acc_is_can_aut_ena "increase of idle speed, requirement of full automatic air conditioning system allowed" VALUE 0x85c2e9 _REC_VAL_20_u1 1. _CNV_A_R_LINEAR_____0_CM 0. 1. DISPLAY_IDENTIFIER LC_ACC_IS_CAN_AUT_ENA FORMAT "%1.0" /end CHARACTERISTIC
/begin CHARACTERISTIC lc_acc_is_can_state_ena "increase of idle speed, requirement because of air conditioning system compressor state allowed" VALUE 0x85c2eb _REC_VAL_20_u1 1. _CNV_A_R_LINEAR_____0_CM 0. 1. DISPLAY_IDENTIFIER LC_ACC_IS_CAN_STATE_ENA FORMAT "%1.0" /end CHARACTERISTIC
/begin CHARACTERISTIC lc_acc_is_can_req_ena "increase of idle speed, requirement by A/C switch of semi automatic air conditioning system allowed" VALUE 0x85c2ea _REC_VAL_20_u1 1. _CNV_A_R_LINEAR_____0_CM 0. 1. DISPLAY_IDENTIFIER LC_ACC_IS_CAN_REQ_ENA FORMAT "%1.0" /end CHARACTERISTIC
/begin CHARACTERISTIC lc_egr_conf "" VALUE 0x85c317 _REC_VAL_20_u1 1. _CNV_A_R_LINEAR_____0_CM 0. 1. DISPLAY_IDENTIFIER LC_EGR_CONF FORMAT "%1.0" /end CHARACTERISTIC
/begin MEASUREMENT lv_acc_is_driv_req_ena "increase of idle speed, requirement by A/C switch of manual air conditioning system allowed" UBYTE _CNV_S_2_RANGE______11_CM 1 0. 0. 1. DISPLAY_IDENTIFIER LV_ACC_IS_DRIV_REQ_ENA ECU_ADDRESS 0x7fb693 /end MEASUREMENT
/begin MEASUREMENT lv_gl_var "Selection of the glowing plug generation (2 or 3)" UBYTE _CNV_S_2_RANGE______11_CM 1 0. 0. 1. DISPLAY_IDENTIFIER LV_GL_VAR ECU_ADDRESS 0x7fb694 /end MEASUREMENT
/begin CHARACTERISTIC lc_acc_is_driv_req_ena "increase of idle speed, requirement by A/C switch of manual air conditioning system allowed" VALUE 0x85c2ec _REC_VAL_20_u1 1. _CNV_A_R_LINEAR_____0_CM 0. 1. DISPLAY_IDENTIFIER LC_ACC_IS_DRIV_REQ_ENA FORMAT "%1.0" /end CHARACTERISTIC
/begin CHARACTERISTIC lc_gl_var "Selection of the glowing plug generation (2 or 3)" VALUE 0x85c327 _REC_VAL_20_u1 1. _CNV_A_R_LINEAR_____0_CM 0. 1. DISPLAY_IDENTIFIER LC_GL_VAR FORMAT "%1.0" /end CHARACTERISTIC
/begin MEASUREMENT lv_acc_is_can_state_ena "increase of idle speed, requirement because of air conditioning system compressor state allowed" UBYTE _CNV_S_2_RANGE______11_CM 1 0. 0. 1. DISPLAY_IDENTIFIER LV_ACC_IS_CAN_STATE_ENA ECU_ADDRESS 0x7fb691 /end MEASUREMENT
/begin MEASUREMENT lv_var_can_sys_info "can botschaft 'systeminfo' soll empfangen und ausgewertet werden" UBYTE _CNV_S_2_RANGE__0___88_CM 1 0. 0. 1. DISPLAY_IDENTIFIER LV_VAR_CAN_SYS_INFO ECU_ADDRESS 0x7fb696 /end MEASUREMENT
/begin MEASUREMENT lv_var_can_whl "haldex-kupplung verbaut" UBYTE _CNV_S_2_RANGE__0___88_CM 1 0. 0. 1. DISPLAY_IDENTIFIER LV_VAR_CAN_WHL ECU_ADDRESS 0x7fb695 /end MEASUREMENT
/begin MEASUREMENT lv_var_can_nom_sys "increase of idle speed, requirement because of air conditioning system compressor state allowed" UBYTE _CNV_S_2_RANGE__0___88_CM 1 0. 0. 1. DISPLAY_IDENTIFIER LV_VAR_CAN_NOM_SYS ECU_ADDRESS 0x7fb697 /end MEASUREMENT
/begin CHARACTERISTIC lc_var_can_cs "Developement  value for: Switch of clutch integrated" VALUE 0x85c386 _REC_VAL_20_u1 1. _CNV_A_R_LINEAR_____0_CM 0. 1. DISPLAY_IDENTIFIER LC_VAR_CAN_CS FORMAT "%1.0" /end CHARACTERISTIC
/begin CHARACTERISTIC lc_var_can_whl "Haldex-Kupplung verbaut" VALUE 0x8487ee _REC_VAL_20_u1 1. _CNV_A_R_LINEAR_____0_CM 0. 1. DISPLAY_IDENTIFIER LC_VAR_CAN_WHL FORMAT "%1.0" /end CHARACTERISTIC
/begin CHARACTERISTIC lc_var_can_sys_info "can botschaft 'sys_info' soll empfangen und ausgewertet werden" VALUE 0x8487ed _REC_VAL_20_u1 1. _CNV_A_R_LINEAR_____0_CM 0. 1. DISPLAY_IDENTIFIER LC_VAR_CAN_SYS_INFO FORMAT "%1.0" /end CHARACTERISTIC
/begin CHARACTERISTIC lc_var_can_nom_sys "can botschaft 'sollverbauliste_neu' soll empfangen und ausgewertet werden" VALUE 0x8487ec _REC_VAL_20_u1 1. _CNV_A_R_LINEAR_____0_CM 0. 1. DISPLAY_IDENTIFIER LC_VAR_CAN_NOM_SYS FORMAT "%1.0" /end CHARACTERISTIC
/begin MEASUREMENT vs_sum_dist "" ULONG _CNV_A_R_LINEAR_____115_CM 1 0. 0. 119304.6471 DISPLAY_IDENTIFIER VS_SUM_DIST ECU_ADDRESS 0x7fc8a8 BYTE_ORDER MSB_LAST FORMAT "%11.5" /end MEASUREMENT
/begin MEASUREMENT dist "" ULONG _CNV_A_R_LINEAR_____116_CM 1 0. 0. 429496729.5 DISPLAY_IDENTIFIER DIST ECU_ADDRESS 0x7fc8ac BYTE_ORDER MSB_LAST FORMAT "%10.1" /end MEASUREMENT
/begin MEASUREMENT ctr_vs_dist "" UWORD _CNV_A_R_LINEAR_____117_CM 1 0. 0. 6.5535 DISPLAY_IDENTIFIER CTR_VS_DIST ECU_ADDRESS 0x7fc942 BYTE_ORDER MSB_LAST FORMAT "%5.4" /end MEASUREMENT
/begin CHARACTERISTIC c_thd_ctr_vs_dist "" VALUE 0x85c194 _REC_VAL_20_u2 6.5535 _CNV_A_R_LINEAR_____117_CM 0. 6.5535 DISPLAY_IDENTIFIER C_THD_CTR_VS_DIST FORMAT "%5.4" /end CHARACTERISTIC
/begin CHARACTERISTIC c_fac_vb_fil "MF: Speed limit Filterfactor" VALUE 0x85be8e _REC_VAL_20_u1 0.99609375 _CNV_A_R_LINEAR_____34_CM 0. 0.99609375 DISPLAY_IDENTIFIER C_FAC_VB_FIL FORMAT "%5.4" /end CHARACTERISTIC
/begin MEASUREMENT lv_inh_inj_prev1 "" UBYTE _CNV_S_2_RANGE______11_CM 1 0. 0. 1. DISPLAY_IDENTIFIER LV_INH_INJ_PREV1 ECU_ADDRESS 0x7fb78c /end MEASUREMENT
/begin MEASUREMENT lv_inh_inj_prev2 "" UBYTE _CNV_S_2_RANGE______11_CM 1 0. 0. 1. DISPLAY_IDENTIFIER LV_INH_INJ_PREV2 ECU_ADDRESS 0x7fb78d /end MEASUREMENT
/begin MEASUREMENT lv_inh_inj_main1 "" UBYTE _CNV_S_2_RANGE______11_CM 1 0. 0. 1. DISPLAY_IDENTIFIER LV_INH_INJ_MAIN1 ECU_ADDRESS 0x7fb78e /end MEASUREMENT
/begin MEASUREMENT lv_inh_inj_main2 "" UBYTE _CNV_S_2_RANGE______11_CM 1 0. 0. 1. DISPLAY_IDENTIFIER LV_INH_INJ_MAIN2 ECU_ADDRESS 0x7fb78f /end MEASUREMENT
/begin MEASUREMENT lv_inh_inj_post1 "" UBYTE _CNV_S_2_RANGE______11_CM 1 0. 0. 1. DISPLAY_IDENTIFIER LV_INH_INJ_POST1 ECU_ADDRESS 0x7fb790 /end MEASUREMENT
/begin MEASUREMENT lv_inh_inj_post2 "" UBYTE _CNV_S_2_RANGE______11_CM 1 0. 0. 1. DISPLAY_IDENTIFIER LV_INH_INJ_POST2 ECU_ADDRESS 0x7fb791 /end MEASUREMENT
/begin CHARACTERISTIC ip_n_prev1_inh__vb_fil "MF: speed limit of PREV1" CURVE 0x855514 _REC_CUR_20_u2_u1 6375. _CNV_A_R_LINEAR_____5_CM 0. 6375. DISPLAY_IDENTIFIER IP_N_PREV1_INH__VB_FIL FORMAT "%4.0"
 /begin AXIS_DESCR COM_AXIS vb_fil _CNV_A_R_LINEAR_____48_CM 5 0. 28.8 FORMAT "%5.3" AXIS_PTS_REF ldpm_vb_fil_ip_n_inh /end AXIS_DESCR
/end CHARACTERISTIC
/begin AXIS_PTS ldpm_vb_fil_ip_n_inh "" 0x84448a vb_fil _REC_AXS_20_u1 28.8 _CNV_A_R_LINEAR_____48_CM 5 0. 28.8 FORMAT "%5.3" /end AXIS_PTS
/begin CHARACTERISTIC ip_n_main2_inh__vb_fil "MF: speed limit of MAIN2" CURVE 0x8554e6 _REC_CUR_20_u2_u1 6375. _CNV_A_R_LINEAR_____5_CM 0. 6375. DISPLAY_IDENTIFIER IP_N_MAIN2_INH__VB_FIL FORMAT "%4.0"
 /begin AXIS_DESCR COM_AXIS vb_fil _CNV_A_R_LINEAR_____48_CM 5 0. 28.8 FORMAT "%5.3" AXIS_PTS_REF ldpm_vb_fil_ip_n_inh /end AXIS_DESCR
/end CHARACTERISTIC
/begin CHARACTERISTIC ip_n_main1_inh__vb_fil "MF: speed limit of MAIN1" CURVE 0x8554dc _REC_CUR_20_u2_u1 6375. _CNV_A_R_LINEAR_____5_CM 0. 6375. DISPLAY_IDENTIFIER IP_N_MAIN1_INH__VB_FIL FORMAT "%4.0"
 /begin AXIS_DESCR COM_AXIS vb_fil _CNV_A_R_LINEAR_____48_CM 5 0. 28.8 FORMAT "%5.3" AXIS_PTS_REF ldpm_vb_fil_ip_n_inh /end AXIS_DESCR
/end CHARACTERISTIC
/begin CHARACTERISTIC ip_n_prev2_inh__vb_fil "MF: speed limit of PREV2" CURVE 0x85551e _REC_CUR_20_u2_u1 6375. _CNV_A_R_LINEAR_____5_CM 0. 6375. DISPLAY_IDENTIFIER IP_N_PREV2_INH__VB_FIL FORMAT "%4.0"
 /begin AXIS_DESCR COM_AXIS vb_fil _CNV_A_R_LINEAR_____48_CM 5 0. 28.8 FORMAT "%5.3" AXIS_PTS_REF ldpm_vb_fil_ip_n_inh /end AXIS_DESCR
/end CHARACTERISTIC
/begin CHARACTERISTIC ip_n_post1_inh__vb_fil "MF: speed limit of POST1" CURVE 0x855500 _REC_CUR_20_u2_u1 6375. _CNV_A_R_LINEAR_____5_CM 0. 6375. DISPLAY_IDENTIFIER IP_N_POST1_INH__VB_FIL FORMAT "%4.0"
 /begin AXIS_DESCR COM_AXIS vb_fil _CNV_A_R_LINEAR_____48_CM 5 0. 28.8 FORMAT "%5.3" AXIS_PTS_REF ldpm_vb_fil_ip_n_inh /end AXIS_DESCR
/end CHARACTERISTIC
/begin CHARACTERISTIC ip_n_post2_inh__vb_fil "MF: speed limit of POST2" CURVE 0x85550a _REC_CUR_20_u2_u1 6375. _CNV_A_R_LINEAR_____5_CM 0. 6375. DISPLAY_IDENTIFIER IP_N_POST2_INH__VB_FIL FORMAT "%4.0"
 /begin AXIS_DESCR COM_AXIS vb_fil _CNV_A_R_LINEAR_____48_CM 5 0. 28.8 FORMAT "%5.3" AXIS_PTS_REF ldpm_vb_fil_ip_n_inh /end AXIS_DESCR
/end CHARACTERISTIC
/begin MEASUREMENT v_tco "" UWORD _CNV_A_R_LINEAR_____33_CM 1 0. 0. 4.9951171875 DISPLAY_IDENTIFIER V_TCO ECU_ADDRESS 0x7fc996 BYTE_ORDER MSB_LAST FORMAT "%3.2" /end MEASUREMENT
/begin MEASUREMENT mfw_egr_kgh "" UWORD _CNV_A_R_LINEAR_____112_CM 1 0. 0. 1023.984375 DISPLAY_IDENTIFIER MFW_EGR_KGH ECU_ADDRESS 0x7fa7fe BYTE_ORDER MSB_LAST FORMAT "%6.2" /end MEASUREMENT
/begin MEASUREMENT mfw_egr_sp_kgh "" UWORD _CNV_A_R_LINEAR_____112_CM 1 0. 0. 1023.984375 DISPLAY_IDENTIFIER MFW_EGR_SP_KGH ECU_ADDRESS 0x7fa7fc BYTE_ORDER MSB_LAST FORMAT "%6.2" /end MEASUREMENT
/begin MEASUREMENT temp_egr_sp "" UWORD _CNV_A_R_LINEAR_____153_CM 1 0. 0. 1023.984375 DISPLAY_IDENTIFIER TEMP_EGR_SP ECU_ADDRESS 0x7f98a6 BYTE_ORDER MSB_LAST FORMAT "%6.2" /end MEASUREMENT
/begin MEASUREMENT temp_egr "" UWORD _CNV_A_R_LINEAR_____153_CM 1 0. 0. 1023.984375 DISPLAY_IDENTIFIER TEMP_EGR ECU_ADDRESS 0x7f98a8 BYTE_ORDER MSB_LAST FORMAT "%6.2" /end MEASUREMENT
/begin MEASUREMENT temp_up_egrv "" UWORD _CNV_A_R_LINEAR_____153_CM 1 0. 0. 1023.984375 DISPLAY_IDENTIFIER TEMP_UP_EGRV ECU_ADDRESS 0x7fa7f8 BYTE_ORDER MSB_LAST FORMAT "%6.2" /end MEASUREMENT
/begin MEASUREMENT temp_up_egrv_sp "" UWORD _CNV_A_R_LINEAR_____153_CM 1 0. 0. 1023.984375 DISPLAY_IDENTIFIER TEMP_UP_EGRV_SP ECU_ADDRESS 0x7fa7fa BYTE_ORDER MSB_LAST FORMAT "%6.2" /end MEASUREMENT
/begin CHARACTERISTIC c_fac_thermo_down_egrv "" VALUE 0x85be7e _REC_VAL_20_u2 1023.984375 _CNV_A_R_LINEAR_____112_CM 0. 1023.984375 DISPLAY_IDENTIFIER C_FAC_THERMO_DOWN_EGRV FORMAT "%6.2" /end CHARACTERISTIC
/begin CHARACTERISTIC c_fac_thermo_up_egrv "" VALUE 0x85be80 _REC_VAL_20_u2 1023.984375 _CNV_A_R_LINEAR_____112_CM 0. 1023.984375 DISPLAY_IDENTIFIER C_FAC_THERMO_UP_EGRV FORMAT "%6.2" /end CHARACTERISTIC
/begin MEASUREMENT quo_mfw_down_egrv "" UWORD _CNV_A_R_LINEAR_____159_CM 1 0. 0. 65.535 DISPLAY_IDENTIFIER QUO_MFW_DOWN_EGRV ECU_ADDRESS 0x7fa7f2 BYTE_ORDER MSB_LAST FORMAT "%5.3" /end MEASUREMENT
/begin MEASUREMENT quo_mfw_up_egrv_sp "" UWORD _CNV_A_R_LINEAR_____159_CM 1 0. 0. 65.535 DISPLAY_IDENTIFIER QUO_MFW_UP_EGRV_SP ECU_ADDRESS 0x7fa7f4 BYTE_ORDER MSB_LAST FORMAT "%5.3" /end MEASUREMENT
/begin MEASUREMENT quo_mfw_down_egrv_sp "" UWORD _CNV_A_R_LINEAR_____159_CM 1 0. 0. 65.535 DISPLAY_IDENTIFIER QUO_MFW_DOWN_EGRV_SP ECU_ADDRESS 0x7fa7f0 BYTE_ORDER MSB_LAST FORMAT "%5.3" /end MEASUREMENT
/begin MEASUREMENT quo_mfw_up_egrv "" UWORD _CNV_A_R_LINEAR_____159_CM 1 0. 0. 65.535 DISPLAY_IDENTIFIER QUO_MFW_UP_EGRV ECU_ADDRESS 0x7fa7f6 BYTE_ORDER MSB_LAST FORMAT "%5.3" /end MEASUREMENT
/begin CHARACTERISTIC ip_fac_temp_egr_cool "EGR_VAR: exp-function to calculate the temperature decrease inside the EGR-cooler" CURVE 0x84c20a _REC_CUR_20_u2_u2 0.9999847412109381 _CNV_A_R_LINEAR_____14_CM 0. 0.9999847412109381 DISPLAY_IDENTIFIER IP_FAC_TEMP_EGR_COOL FORMAT "%6.5"
 /begin AXIS_DESCR COM_AXIS quo_mfw_down_egrv_sp _CNV_A_R_LINEAR_____159_CM 12 0. 65.535 FORMAT "%6.5" AXIS_PTS_REF ldp_quo_mfw_ip_fac_temp_egr /end AXIS_DESCR
/end CHARACTERISTIC
/begin AXIS_PTS ldp_quo_mfw_ip_fac_temp_egr "" 0x842532 quo_mfw_down_egrv_sp _REC_AXS_20_u2 65.535 _CNV_A_R_LINEAR_____159_CM 12 0. 65.535 FORMAT "%6.5" /end AXIS_PTS
/begin CHARACTERISTIC c_abc_inc_v_tba_rng "" VALUE 0x84825e _REC_VAL_20_u1 255. _CNV_A_R_LINEAR_____0_CM 0. 255. DISPLAY_IDENTIFIER C_ABC_INC_V_TBA_RNG FORMAT "%3.0" /end CHARACTERISTIC
/begin CHARACTERISTIC c_abc_max_v_tba_rng "" VALUE 0x8482e0 _REC_VAL_20_u1 255. _CNV_A_R_LINEAR_____0_CM 0. 255. DISPLAY_IDENTIFIER C_ABC_MAX_V_TBA_RNG FORMAT "%3.0" /end CHARACTERISTIC
/begin CHARACTERISTIC c_abc_inc_tba_mes_grd "" VALUE 0x848245 _REC_VAL_20_u1 255. _CNV_A_R_LINEAR_____0_CM 0. 255. DISPLAY_IDENTIFIER C_ABC_INC_TBA_MES_GRD FORMAT "%3.0" /end CHARACTERISTIC
/begin CHARACTERISTIC c_abc_max_tba_mes_grd "" VALUE 0x8482c7 _REC_VAL_20_u1 255. _CNV_A_R_LINEAR_____0_CM 0. 255. DISPLAY_IDENTIFIER C_ABC_MAX_TBA_MES_GRD FORMAT "%3.0" /end CHARACTERISTIC
/begin CHARACTERISTIC c_v_tba_max_diag "" VALUE 0x85c278 _REC_VAL_20_u2 4.9951171875 _CNV_A_R_LINEAR_____33_CM 0. 4.9951171875 DISPLAY_IDENTIFIER C_V_TBA_MAX_DIAG FORMAT "%4.3" /end CHARACTERISTIC
/begin CHARACTERISTIC c_v_tba_min_diag "" VALUE 0x85c27a _REC_VAL_20_u2 4.9951171875 _CNV_A_R_LINEAR_____33_CM 0. 4.9951171875 DISPLAY_IDENTIFIER C_V_TBA_MIN_DIAG FORMAT "%3.2" /end CHARACTERISTIC
/begin CHARACTERISTIC c_tba_mes_grd_diag "" VALUE 0x85c139 _REC_VAL_20_u1 255. _CNV_A_R_LINEAR_____51_CM 0. 255. DISPLAY_IDENTIFIER C_TBA_MES_GRD_DIAG FORMAT "%3.0" /end CHARACTERISTIC
/begin MEASUREMENT lv_err_tba_mes "" UBYTE _CNV_S_2_RANGE______28_CM 1 0. 0. 1. DISPLAY_IDENTIFIER LV_ERR_TBA_MES ECU_ADDRESS 0x7fb467 /end MEASUREMENT
/begin CHARACTERISTIC c_frq_pwm_ect "Frequency electronically controlled thermostat" VALUE 0x85be9a _REC_VAL_20_u2 65535. _CNV_A_R_LINEAR_____0_CM 0. 65535. DISPLAY_IDENTIFIER C_FRQ_PWM_ECT FORMAT "%1.0" /end CHARACTERISTIC
/begin CHARACTERISTIC c_frq_pwm_ecf_1 "Frequency electronically controlled cooling fan 1" VALUE 0x85be96 _REC_VAL_20_u2 65535. _CNV_A_R_LINEAR_____0_CM 0. 65535. DISPLAY_IDENTIFIER C_FRQ_PWM_ECF_1 FORMAT "%1.0" /end CHARACTERISTIC
/begin CHARACTERISTIC c_frq_pwm_ecf_2 "Frequency electronically controlled cooling fan 1" VALUE 0x85be98 _REC_VAL_20_u2 65535. _CNV_A_R_LINEAR_____0_CM 0. 65535. DISPLAY_IDENTIFIER C_FRQ_PWM_ECF_2 FORMAT "%1.0" /end CHARACTERISTIC
/begin CHARACTERISTIC c_frq_pwm_gl "Frequency glow plug control" VALUE 0x85be9c _REC_VAL_20_u2 65535. _CNV_A_R_LINEAR_____0_CM 0. 65535. DISPLAY_IDENTIFIER C_FRQ_PWM_GL FORMAT "%1.0" /end CHARACTERISTIC
/begin CHARACTERISTIC c_frq_pwm_acc_b "Frequency air conditioning compressor bidirectional" VALUE 0x85be94 _REC_VAL_20_u2 65535. _CNV_A_R_LINEAR_____0_CM 0. 65535. DISPLAY_IDENTIFIER C_FRQ_PWM_ACC_B FORMAT "%1.0" /end CHARACTERISTIC
/begin MEASUREMENT vb_mmv "Filtered Battery Voltage" UBYTE _CNV_A_R_LINEAR_____48_CM 1 0. 0. 28.8 DISPLAY_IDENTIFIER VB_MMV ECU_ADDRESS 0x7fb81f FORMAT "%3.1" /end MEASUREMENT
/begin MEASUREMENT v_pvs_1_bas "" UWORD _CNV_A_R_LINEAR_____33_CM 1 0. 0. 4.9951171875 DISPLAY_IDENTIFIER V_PVS_1_BAS ECU_ADDRESS 0x7fc976 BYTE_ORDER MSB_LAST FORMAT "%3.2" /end MEASUREMENT
/begin MEASUREMENT v_pvs_2_bas "" UWORD _CNV_A_R_LINEAR_____33_CM 1 0. 0. 4.9951171875 DISPLAY_IDENTIFIER V_PVS_2_BAS ECU_ADDRESS 0x7fc978 BYTE_ORDER MSB_LAST FORMAT "%3.2" /end MEASUREMENT
/begin MEASUREMENT v_dcdc "" UWORD _CNV_A_R_LINEAR_____264_CM 1 0. 0. 96.32231400000001 DISPLAY_IDENTIFIER V_DCDC ECU_ADDRESS 0x7f97b0 BYTE_ORDER MSB_LAST FORMAT "%5.2" /end MEASUREMENT
/begin CHARACTERISTIC lc_ad_clr_ensd "" VALUE 0x841020 _REC_VAL_20_u1 1. _CNV_A_R_LINEAR_____0_CM 0. 1. DISPLAY_IDENTIFIER LC_AD_CLR_ENSD FORMAT "%1.0" /end CHARACTERISTIC
/begin MEASUREMENT tq_loss_dip_pf "o v" SWORD _CNV_A_R_LINEAR_____62_CM 1 0. -1024. 1023.96875 DISPLAY_IDENTIFIER TQ_LOSS_DIP_PF ECU_ADDRESS 0x7fc938 BYTE_ORDER MSB_LAST FORMAT "%6.2" /end MEASUREMENT
/begin MEASUREMENT lv_act_ico "o v" UBYTE _CNV_S_2_RANGE__0___88_CM 1 0. 0. 1. DISPLAY_IDENTIFIER LV_ACT_ICO ECU_ADDRESS 0x7fca50 /end MEASUREMENT
/begin MEASUREMENT lv_act_byp "o v" UBYTE _CNV_S_2_RANGE__0___88_CM 1 0. 0. 1. DISPLAY_IDENTIFIER LV_ACT_BYP ECU_ADDRESS 0x7fca51 /end MEASUREMENT
/begin MEASUREMENT fac_byppwm_iah_mmv "o v" UWORD _CNV_A_R_LINEAR_____284_CM 1 0. 0. 1.9999696 DISPLAY_IDENTIFIER FAC_BYPPWM_IAH_MMV ECU_ADDRESS 0x7fc92c BYTE_ORDER MSB_LAST FORMAT "%6.5" /end MEASUREMENT
/begin MEASUREMENT thrpwm_iah_clc "o v" UWORD _CNV_A_R_LINEAR_____8_CM 1 0. 0. 99.99847412109381 DISPLAY_IDENTIFIER THRPWM_IAH_CLC ECU_ADDRESS 0x7fc92e BYTE_ORDER MSB_LAST FORMAT "%5.3" /end MEASUREMENT
/begin MEASUREMENT byppwm_iah_clc "o v" UWORD _CNV_A_R_LINEAR_____8_CM 1 0. 0. 99.99847412109381 DISPLAY_IDENTIFIER BYPPWM_IAH_CLC ECU_ADDRESS 0x7fc930 BYTE_ORDER MSB_LAST FORMAT "%5.3" /end MEASUREMENT
/begin MEASUREMENT temp_cyl "o v" UWORD _CNV_A_R_LINEAR_____198_CM 1 0. -50. 973.984375 DISPLAY_IDENTIFIER TEMP_CYL ECU_ADDRESS 0x7fc932 BYTE_ORDER MSB_LAST FORMAT "%5.2" /end MEASUREMENT
/begin MEASUREMENT temp_up_ico "o v" UWORD _CNV_A_R_LINEAR_____198_CM 1 0. -50. 973.984375 DISPLAY_IDENTIFIER TEMP_UP_ICO ECU_ADDRESS 0x7fc936 BYTE_ORDER MSB_LAST FORMAT "%5.2" /end MEASUREMENT
/begin MEASUREMENT temp_up_cmp "o v" UWORD _CNV_A_R_LINEAR_____198_CM 1 0. -50. 973.984375 DISPLAY_IDENTIFIER TEMP_UP_CMP ECU_ADDRESS 0x7fc934 BYTE_ORDER MSB_LAST FORMAT "%5.2" /end MEASUREMENT
/begin MEASUREMENT lv_cdn_act_bpa_pf "o v" UBYTE _CNV_S_2_RANGE__0___88_CM 1 0. 0. 1. DISPLAY_IDENTIFIER LV_CDN_ACT_BPA_PF ECU_ADDRESS 0x7fca4d /end MEASUREMENT
/begin MEASUREMENT bpapwm_pctl_post "o v" SWORD _CNV_A_R_LINEAR_____12_CM 1 0. -100. 99.996948242 DISPLAY_IDENTIFIER BPAPWM_PCTL_POST ECU_ADDRESS 0x7fc920 BYTE_ORDER MSB_LAST FORMAT "%5.3" /end MEASUREMENT
/begin MEASUREMENT map_sp_post "o v" UWORD _CNV_A_R_LINEAR_____21_CM 1 0. 0. 5434. DISPLAY_IDENTIFIER MAP_SP_POST ECU_ADDRESS 0x7fc922 BYTE_ORDER MSB_LAST FORMAT "%6.2" /end MEASUREMENT
/begin MEASUREMENT map_sp_bas_pf "o v" UWORD _CNV_A_R_LINEAR_____21_CM 1 0. 0. 5434. DISPLAY_IDENTIFIER MAP_SP_BAS_PF ECU_ADDRESS 0x7fc926 BYTE_ORDER MSB_LAST FORMAT "%6.2" /end MEASUREMENT
/begin MEASUREMENT tba_sp_pf "o v" UWORD _CNV_A_R_LINEAR_____198_CM 1 0. -50. 973.984375 DISPLAY_IDENTIFIER TBA_SP_PF ECU_ADDRESS 0x7fc924 BYTE_ORDER MSB_LAST FORMAT "%5.2" /end MEASUREMENT
/begin MEASUREMENT thrpwm_pctl_post "o v" UWORD _CNV_A_R_LINEAR_____201_CM 1 0. 0. 99.972117 DISPLAY_IDENTIFIER THRPWM_PCTL_POST ECU_ADDRESS 0x7fc928 BYTE_ORDER MSB_LAST FORMAT "%5.3" /end MEASUREMENT
/begin MEASUREMENT thrpwm_pctl_bas_pf "o v" UWORD _CNV_A_R_LINEAR_____201_CM 1 0. 0. 99.972117 DISPLAY_IDENTIFIER THRPWM_PCTL_BAS_PF ECU_ADDRESS 0x7fc92a BYTE_ORDER MSB_LAST FORMAT "%5.3" /end MEASUREMENT
/begin MEASUREMENT fup_sp_cor_post "o v" SWORD _CNV_A_R_LINEAR_____285_CM 1 0. -100. 99.996948242 DISPLAY_IDENTIFIER FUP_SP_COR_POST ECU_ADDRESS 0x7f9ce6 BYTE_ORDER MSB_LAST FORMAT "%5.3" /end MEASUREMENT
/begin MEASUREMENT fac_mf_post2_cor_1 "o v" UWORD _CNV_A_R_LINEAR_____286_CM 1 0. 0. 1. DISPLAY_IDENTIFIER FAC_MF_POST2_COR_1 ECU_ADDRESS 0x7f9d0a BYTE_ORDER MSB_LAST FORMAT "%6.5" /end MEASUREMENT
/begin MEASUREMENT fac_mf_post2_cor_0 "o v" UWORD _CNV_A_R_LINEAR_____286_CM 1 0. 0. 1. DISPLAY_IDENTIFIER FAC_MF_POST2_COR_0 ECU_ADDRESS 0x7f9d08 BYTE_ORDER MSB_LAST FORMAT "%6.5" /end MEASUREMENT
/begin MEASUREMENT t_rgn_deact_mf_pf "o v" UWORD _CNV_A_R_LINEAR_____287_CM 1 0. 0. 15.258556 DISPLAY_IDENTIFIER T_RGN_DEACT_MF_PF ECU_ADDRESS 0x7f9ce8 BYTE_ORDER MSB_LAST FORMAT "%6.4" /end MEASUREMENT
/begin MEASUREMENT t_rgn_deact_soi_pf "o v" UWORD _CNV_A_R_LINEAR_____287_CM 1 0. 0. 15.258556 DISPLAY_IDENTIFIER T_RGN_DEACT_SOI_PF ECU_ADDRESS 0x7f9cea BYTE_ORDER MSB_LAST FORMAT "%6.4" /end MEASUREMENT
/begin MEASUREMENT t_rgn_deact_fup_pf "o v" UWORD _CNV_A_R_LINEAR_____287_CM 1 0. 0. 15.258556 DISPLAY_IDENTIFIER T_RGN_DEACT_FUP_PF ECU_ADDRESS 0x7f9cec BYTE_ORDER MSB_LAST FORMAT "%6.4" /end MEASUREMENT
/begin MEASUREMENT t_rgn_deact_map_sp_pf "o v" UWORD _CNV_A_R_LINEAR_____287_CM 1 0. 0. 15.258556 DISPLAY_IDENTIFIER T_RGN_DEACT_MAP_SP_PF ECU_ADDRESS 0x7f9cee BYTE_ORDER MSB_LAST FORMAT "%6.4" /end MEASUREMENT
/begin MEASUREMENT t_rgn_act_mf_pf "o v" UWORD _CNV_A_R_LINEAR_____287_CM 1 0. 0. 15.258556 DISPLAY_IDENTIFIER T_RGN_ACT_MF_PF ECU_ADDRESS 0x7f9cf0 BYTE_ORDER MSB_LAST FORMAT "%6.4" /end MEASUREMENT
/begin MEASUREMENT t_rgn_act_soi_pf "o v" UWORD _CNV_A_R_LINEAR_____287_CM 1 0. 0. 15.258556 DISPLAY_IDENTIFIER T_RGN_ACT_SOI_PF ECU_ADDRESS 0x7f9cf2 BYTE_ORDER MSB_LAST FORMAT "%6.4" /end MEASUREMENT
/begin MEASUREMENT t_rgn_act_fup_pf "o v" UWORD _CNV_A_R_LINEAR_____287_CM 1 0. 0. 15.258556 DISPLAY_IDENTIFIER T_RGN_ACT_FUP_PF ECU_ADDRESS 0x7f9cf4 BYTE_ORDER MSB_LAST FORMAT "%6.4" /end MEASUREMENT
/begin MEASUREMENT t_rgn_act_map_sp_pf "o v" UWORD _CNV_A_R_LINEAR_____287_CM 1 0. 0. 15.258556 DISPLAY_IDENTIFIER T_RGN_ACT_MAP_SP_PF ECU_ADDRESS 0x7f9cf6 BYTE_ORDER MSB_LAST FORMAT "%6.4" /end MEASUREMENT
/begin MEASUREMENT mf_prev1_pf "o v" UWORD _CNV_A_R_LINEAR_____55_CM 1 0. 0. 65.535 DISPLAY_IDENTIFIER MF_PREV1_PF ECU_ADDRESS 0x7f9cf8 BYTE_ORDER MSB_LAST /end MEASUREMENT
/begin MEASUREMENT mf_prev2_pf "o v" UWORD _CNV_A_R_LINEAR_____55_CM 1 0. 0. 65.535 DISPLAY_IDENTIFIER MF_PREV2_PF ECU_ADDRESS 0x7f9cfa BYTE_ORDER MSB_LAST /end MEASUREMENT
/begin MEASUREMENT mf_main1_pf "o v" UWORD _CNV_A_R_LINEAR_____55_CM 1 0. 0. 65.535 DISPLAY_IDENTIFIER MF_MAIN1_PF ECU_ADDRESS 0x7f9cfc BYTE_ORDER MSB_LAST /end MEASUREMENT
/begin MEASUREMENT mf_main2_pf "o v" UWORD _CNV_A_R_LINEAR_____55_CM 1 0. 0. 65.535 DISPLAY_IDENTIFIER MF_MAIN2_PF ECU_ADDRESS 0x7f9cfe BYTE_ORDER MSB_LAST /end MEASUREMENT
/begin MEASUREMENT mf_post1_pf "o v" UWORD _CNV_A_R_LINEAR_____55_CM 1 0. 0. 65.535 DISPLAY_IDENTIFIER MF_POST1_PF ECU_ADDRESS 0x7f9d00 BYTE_ORDER MSB_LAST /end MEASUREMENT
/begin MEASUREMENT mf_post2_pf "o v" UWORD _CNV_A_R_LINEAR_____55_CM 1 0. 0. 65.535 DISPLAY_IDENTIFIER MF_POST2_PF ECU_ADDRESS 0x7f9d02 BYTE_ORDER MSB_LAST /end MEASUREMENT
/begin MEASUREMENT soi_prev1_pf "o v" UWORD _CNV_A_R_LINEAR_____120_CM 1 0. -120. 240. DISPLAY_IDENTIFIER SOI_PREV1_PF ECU_ADDRESS 0x7f9d0e BYTE_ORDER MSB_LAST FORMAT "%5.2" /end MEASUREMENT
/begin MEASUREMENT soi_prev2_pf "o v" UWORD _CNV_A_R_LINEAR_____120_CM 1 0. -120. 240. DISPLAY_IDENTIFIER SOI_PREV2_PF ECU_ADDRESS 0x7f9d10 BYTE_ORDER MSB_LAST FORMAT "%5.2" /end MEASUREMENT
/begin MEASUREMENT soi_main1_pf "o v" UWORD _CNV_A_R_LINEAR_____120_CM 1 0. -120. 240. DISPLAY_IDENTIFIER SOI_MAIN1_PF ECU_ADDRESS 0x7f9d12 BYTE_ORDER MSB_LAST FORMAT "%5.2" /end MEASUREMENT
/begin MEASUREMENT soi_main2_pf "o v" UWORD _CNV_A_R_LINEAR_____120_CM 1 0. -120. 240. DISPLAY_IDENTIFIER SOI_MAIN2_PF ECU_ADDRESS 0x7f9d14 BYTE_ORDER MSB_LAST FORMAT "%5.2" /end MEASUREMENT
/begin MEASUREMENT soi_post1_pf "o v" UWORD _CNV_A_R_LINEAR_____120_CM 1 0. -120. 240. DISPLAY_IDENTIFIER SOI_POST1_PF ECU_ADDRESS 0x7f9d16 BYTE_ORDER MSB_LAST FORMAT "%5.2" /end MEASUREMENT
/begin MEASUREMENT soi_post2_pf "o v" UWORD _CNV_A_R_LINEAR_____120_CM 1 0. -120. 240. DISPLAY_IDENTIFIER SOI_POST2_PF ECU_ADDRESS 0x7f9d18 BYTE_ORDER MSB_LAST FORMAT "%5.2" /end MEASUREMENT
/begin MEASUREMENT lv_req_egr_pf "o v" UBYTE _CNV_S_2_RANGE__0___88_CM 1 0. 0. 1. DISPLAY_IDENTIFIER LV_REQ_EGR_PF ECU_ADDRESS 0x7fb6d1 /end MEASUREMENT
/begin MEASUREMENT lv_req_thr_pf "o v" UBYTE _CNV_S_2_RANGE__0___88_CM 1 0. 0. 1. DISPLAY_IDENTIFIER LV_REQ_THR_PF ECU_ADDRESS 0x7fb6d2 /end MEASUREMENT
/begin MEASUREMENT lv_req_bpa_pf "o v" UBYTE _CNV_S_2_RANGE__0___88_CM 1 0. 0. 1. DISPLAY_IDENTIFIER LV_REQ_BPA_PF ECU_ADDRESS 0x7fb6d3 /end MEASUREMENT
/begin MEASUREMENT lv_req_post_act "o v" UBYTE _CNV_S_2_RANGE__0___88_CM 1 0. 0. 1. DISPLAY_IDENTIFIER LV_REQ_POST_ACT ECU_ADDRESS 0x7fb6d4 /end MEASUREMENT
/begin MEASUREMENT lv_cmd_gl_ext "o v" UBYTE _CNV_S_2_RANGE__0___88_CM 1 0. 0. 1. DISPLAY_IDENTIFIER LV_CMD_GL_EXT ECU_ADDRESS 0x7fca4c /end MEASUREMENT
/begin MEASUREMENT pwm_gl_ext "o v" UBYTE _CNV_A_R_LINEAR_____44_CM 1 0. 0. 100. DISPLAY_IDENTIFIER PWM_GL_EXT ECU_ADDRESS 0x7fca4b FORMAT "%4.1" /end MEASUREMENT
/begin AXIS_PTS ldp_n_wiv_ip_toil_mdl "X Axis LDP for IP_TOIL_MDL" 0x8423de n _REC_AXS_20_u2 8160. _CNV_A_R_LINEAR_____257_CM 10 0. 8160. FORMAT "%4.0" /end AXIS_PTS
/begin MEASUREMENT tq_lim_gb_prot_raw "v" SWORD _CNV_A_R_LINEAR_____62_CM 1 0. -1024. 1023.96875 DISPLAY_IDENTIFIER TQ_LIM_GB_PROT_RAW ECU_ADDRESS 0x7fc9ec BYTE_ORDER MSB_LAST FORMAT "%6.2" /end MEASUREMENT
/begin MEASUREMENT tq_lim_gb_prot "o v" SWORD _CNV_A_R_LINEAR_____62_CM 1 0. -1024. 1023.96875 DISPLAY_IDENTIFIER TQ_LIM_GB_PROT ECU_ADDRESS 0x7fc9e8 BYTE_ORDER MSB_LAST FORMAT "%6.2" /end MEASUREMENT
/begin MEASUREMENT tqi_lim_gb_prot "o v" SWORD _CNV_A_R_LINEAR_____62_CM 1 0. -1024. 1023.96875 DISPLAY_IDENTIFIER TQI_LIM_GB_PROT ECU_ADDRESS 0x7fc9ea BYTE_ORDER MSB_LAST FORMAT "%6.2" /end MEASUREMENT
/begin CHARACTERISTIC c_dri_mid "" VALUE 0x85bdd1 _REC_VAL_20_u1 15. _CNV_A_R_LINEAR_____0_CM 0. 15. DISPLAY_IDENTIFIER C_DRI_MID FORMAT "%2.0" /end CHARACTERISTIC
/begin CHARACTERISTIC c_dri_l "" VALUE 0x85bdd0 _REC_VAL_20_u1 15. _CNV_A_R_LINEAR_____0_CM 0. 15. DISPLAY_IDENTIFIER C_DRI_L FORMAT "%2.0" /end CHARACTERISTIC
/begin CHARACTERISTIC c_crlc_tqe_dif_gb_prot "" VALUE 0x85bd56 _REC_VAL_20_u2 0.9999874 _CNV_A_R_LINEAR_____90_CM 0. 0.9999874 DISPLAY_IDENTIFIER C_CRLC_TQE_DIF_GB_PROT FORMAT "%6.5" /end CHARACTERISTIC
/begin CHARACTERISTIC lc_tqe_dif_dif_gb_prot_act "" VALUE 0x85c376 _REC_VAL_20_u1 1. _CNV_A_R_LINEAR_____0_CM 0. 1. DISPLAY_IDENTIFIER LC_TQE_DIF_DIF_GB_PROT_ACT FORMAT "%1.0" /end CHARACTERISTIC
/begin CHARACTERISTIC ip_tq_gb_prot_h__n "TQ: Maximum torque for gearbox protection in high gears" CURVE 0x85b1de _REC_CUR_20_u2_u2 2047.96875 _CNV_A_R_LINEAR_____89_CM -1024. 1023.96875 DISPLAY_IDENTIFIER IP_TQ_GB_PROT_H__N FORMAT "%6.2"
 /begin AXIS_DESCR COM_AXIS n _CNV_A_R_LINEAR_____5_CM 20 0. 6375. FORMAT "%4.0" AXIS_PTS_REF ldpm_n_ip_gb_prot /end AXIS_DESCR
/end CHARACTERISTIC
/begin AXIS_PTS ldpm_n_ip_gb_prot "" 0x843a7e n _REC_AXS_20_u2 6375. _CNV_A_R_LINEAR_____5_CM 20 0. 6375. FORMAT "%4.0" /end AXIS_PTS
/begin CHARACTERISTIC ip_tq_gb_prot_l__n "TQ: Maximum torque for gearbox protection in low gears" CURVE 0x85b206 _REC_CUR_20_u2_u2 2047.96875 _CNV_A_R_LINEAR_____89_CM -1024. 1023.96875 DISPLAY_IDENTIFIER IP_TQ_GB_PROT_L__N FORMAT "%4.0"
 /begin AXIS_DESCR COM_AXIS n _CNV_A_R_LINEAR_____5_CM 20 0. 6375. FORMAT "%4.0" AXIS_PTS_REF ldpm_n_ip_gb_prot /end AXIS_DESCR
/end CHARACTERISTIC
/begin CHARACTERISTIC ip_tq_gb_prot_mid__n "TQ: Maximum torque for gearbox protection in medium gears" CURVE 0x85b22e _REC_CUR_20_u2_u2 2047.96875 _CNV_A_R_LINEAR_____89_CM -1024. 1023.96875 DISPLAY_IDENTIFIER IP_TQ_GB_PROT_MID__N FORMAT "%6.2"
 /begin AXIS_DESCR COM_AXIS n _CNV_A_R_LINEAR_____5_CM 20 0. 6375. FORMAT "%4.0" AXIS_PTS_REF ldpm_n_ip_gb_prot /end AXIS_DESCR
/end CHARACTERISTIC
/begin CHARACTERISTIC ip_tq_gb_prot_err__n "TQ: Maximum torque at flywheel for gearbox protection when CAN error" CURVE 0x85b1b6 _REC_CUR_20_u2_u2 2047.96875 _CNV_A_R_LINEAR_____89_CM -1024. 1023.96875 DISPLAY_IDENTIFIER IP_TQ_GB_PROT_ERR__N FORMAT "%6.2"
 /begin AXIS_DESCR COM_AXIS n _CNV_A_R_LINEAR_____5_CM 20 0. 6375. FORMAT "%4.0" AXIS_PTS_REF ldpm_n_ip_gb_prot /end AXIS_DESCR
/end CHARACTERISTIC
/begin CHARACTERISTIC ip_tq_gb_prot_rvl__n "TQ: Maximum torque for gearbox protection in reverse gears" CURVE 0x85b256 _REC_CUR_20_u2_u2 2047.96875 _CNV_A_R_LINEAR_____89_CM -1024. 1023.96875 DISPLAY_IDENTIFIER IP_TQ_GB_PROT_RVL__N FORMAT "%6.2"
 /begin AXIS_DESCR COM_AXIS n _CNV_A_R_LINEAR_____5_CM 20 0. 6375. FORMAT "%4.0" AXIS_PTS_REF ldpm_n_ip_gb_prot /end AXIS_DESCR
/end CHARACTERISTIC
/begin MEASUREMENT n_max_etc "" UWORD _CNV_A_R_LINEAR_____5_CM 1 0. 0. 6375. DISPLAY_IDENTIFIER N_MAX_ETC ECU_ADDRESS 0x7fb050 BYTE_ORDER MSB_LAST FORMAT "%4.0" /end MEASUREMENT
/begin MEASUREMENT n_max_mt "" UWORD _CNV_A_R_LINEAR_____5_CM 1 0. 0. 6375. DISPLAY_IDENTIFIER N_MAX_MT ECU_ADDRESS 0x7fb04a BYTE_ORDER MSB_LAST FORMAT "%4.0" /end MEASUREMENT
/begin MEASUREMENT n_max_tqi "" UWORD _CNV_A_R_LINEAR_____5_CM 1 0. 0. 6375. DISPLAY_IDENTIFIER N_MAX_TQI ECU_ADDRESS 0x7fb04e BYTE_ORDER MSB_LAST FORMAT "%4.0" /end MEASUREMENT
/begin MEASUREMENT lv_req_ti_min_cyl_0 "" UBYTE _CNV_S_2_RANGE______11_CM 1 0. 0. 1. DISPLAY_IDENTIFIER LV_REQ_TI_MIN_CYL_0 ECU_ADDRESS 0x7fca47 /end MEASUREMENT
/begin MEASUREMENT lv_req_ti_min_cyl_1 "" UBYTE _CNV_S_2_RANGE______11_CM 1 0. 0. 1. DISPLAY_IDENTIFIER LV_REQ_TI_MIN_CYL_1 ECU_ADDRESS 0x7fca48 /end MEASUREMENT
/begin MEASUREMENT lv_req_ti_min_cyl_2 "" UBYTE _CNV_S_2_RANGE______11_CM 1 0. 0. 1. DISPLAY_IDENTIFIER LV_REQ_TI_MIN_CYL_2 ECU_ADDRESS 0x7fca49 /end MEASUREMENT
/begin MEASUREMENT lv_req_ti_min_cyl_3 "" UBYTE _CNV_S_2_RANGE______11_CM 1 0. 0. 1. DISPLAY_IDENTIFIER LV_REQ_TI_MIN_CYL_3 ECU_ADDRESS 0x7fca4a /end MEASUREMENT
/begin CHARACTERISTIC c_mf_prev1_add_tu "" VALUE 0x848824 _REC_VAL_20_s2 262.14 _CNV_A_R_LINEAR_____43_CM -131.072 131.068 DISPLAY_IDENTIFIER C_MF_PREV1_ADD_TU FORMAT "%6.2" /end CHARACTERISTIC
/begin CHARACTERISTIC c_mf_prev2_add_tu "" VALUE 0x84882e _REC_VAL_20_s2 262.14 _CNV_A_R_LINEAR_____43_CM -131.072 131.068 DISPLAY_IDENTIFIER C_MF_PREV2_ADD_TU FORMAT "%6.2" /end CHARACTERISTIC
/begin MEASUREMENT lv_ena_grd_ratio_tq_mf_clc "GRD_RATIO_TQ_MF calculation enabled" UBYTE _CNV_S_2_RANGE______11_CM 1 0. 0. 1. DISPLAY_IDENTIFIER LV_ENA_GRD_RATIO_TQ_MF_CLC ECU_ADDRESS 0x7fbbc5 /end MEASUREMENT
/begin MEASUREMENT grd_ratio_tq_mf_lim "limited gradient of RATIO_TQ_MF" SWORD _CNV_A_R___16__8000_341_CM 1 0. -16. 15.9995 DISPLAY_IDENTIFIER GRD_RATIO_TQ_MF_LIM ECU_ADDRESS 0x7fb0f2 BYTE_ORDER MSB_LAST FORMAT "%6.4" /end MEASUREMENT
/begin MEASUREMENT ratio_tq_mf_mem_new "new memorized value of RATIO_TQ_MF for gradient calculation" SWORD _CNV_A_R___16__8000_342_CM 1 0. -16. 15.9995 DISPLAY_IDENTIFIER RATIO_TQ_MF_MEM_NEW ECU_ADDRESS 0x7fb0f4 BYTE_ORDER MSB_LAST FORMAT "%6.4" /end MEASUREMENT
/begin MEASUREMENT ratio_tq_mf_mem_old "old memorized value of RATIO_TQ_MF for gradient calculation" SWORD _CNV_A_R___16__8000_342_CM 1 0. -16. 15.9995 DISPLAY_IDENTIFIER RATIO_TQ_MF_MEM_OLD ECU_ADDRESS 0x7fb0f6 BYTE_ORDER MSB_LAST FORMAT "%6.4" /end MEASUREMENT
/begin MEASUREMENT mf_tot_mem_new_grd_ratio_tq_mf "old memorized value of MF_TOT for gradient calculation" UWORD _CNV_A_R_LINEAR_____43_CM 1 0. 0. 262.14 DISPLAY_IDENTIFIER MF_TOT_MEM_NEW_GRD_RATIO_TQ_MF ECU_ADDRESS 0x7fb0f8 BYTE_ORDER MSB_LAST /end MEASUREMENT
/begin MEASUREMENT mf_tot_mem_old_grd_ratio_tq_mf "new memorized value of MF_TOT for gradient calculation" UWORD _CNV_A_R_LINEAR_____43_CM 1 0. 0. 262.14 DISPLAY_IDENTIFIER MF_TOT_MEM_OLD_GRD_RATIO_TQ_MF ECU_ADDRESS 0x7fb0fa BYTE_ORDER MSB_LAST /end MEASUREMENT
/begin MEASUREMENT grd_ratio_tq_mf "gradient of RATIO_TQ_MF" SWORD _CNV_A_R___16__8000_341_CM 1 0. -16. 15.9995 DISPLAY_IDENTIFIER GRD_RATIO_TQ_MF ECU_ADDRESS 0x7fb0fc BYTE_ORDER MSB_LAST FORMAT "%6.4" /end MEASUREMENT
/begin MEASUREMENT ratio_tq_mf_mpg_fil "filtered ratio between TQI_SP and MF_TOT corrected by ratio maps" SWORD _CNV_A_R___16__8000_342_CM 1 0. -16. 15.9995 DISPLAY_IDENTIFIER RATIO_TQ_MF_MPG_FIL ECU_ADDRESS 0x7fb0fe BYTE_ORDER MSB_LAST FORMAT "%6.4" /end MEASUREMENT
/begin MEASUREMENT ratio_tq_mf_tot "RATIO_TQ_MF out of map for MF_TOT" SWORD _CNV_A_R___16__8000_342_CM 1 0. -16. 15.9995 DISPLAY_IDENTIFIER RATIO_TQ_MF_TOT ECU_ADDRESS 0x7fb100 BYTE_ORDER MSB_LAST FORMAT "%6.4" /end MEASUREMENT
/begin MEASUREMENT ratio_tq_mf_slm "RATIO_TQ_MF out of map for MF_SLM" SWORD _CNV_A_R___16__8000_342_CM 1 0. -16. 15.9995 DISPLAY_IDENTIFIER RATIO_TQ_MF_SLM ECU_ADDRESS 0x7fb102 BYTE_ORDER MSB_LAST FORMAT "%6.4" /end MEASUREMENT
/begin MEASUREMENT ratio_tq_mf_mpg "ratio between TQI_SP and MF_TOT corrected by ratio maps" SWORD _CNV_A_R___16__8000_342_CM 1 0. -16. 15.9995 DISPLAY_IDENTIFIER RATIO_TQ_MF_MPG ECU_ADDRESS 0x7fb104 BYTE_ORDER MSB_LAST FORMAT "%6.4" /end MEASUREMENT
/begin MEASUREMENT lv_ratio_tq_mf_grd_use "gradient correction used in TQI_SLM calculation" UBYTE _CNV_S_2_RANGE______11_CM 1 0. 0. 1. DISPLAY_IDENTIFIER LV_RATIO_TQ_MF_GRD_USE ECU_ADDRESS 0x7fbbc6 /end MEASUREMENT
/begin MEASUREMENT lv_ena_ratio_tq_mf_clc "caculation of RATIO_TQ_MF_RAW enabled" UBYTE _CNV_S_2_RANGE______11_CM 1 0. 0. 1. DISPLAY_IDENTIFIER LV_ENA_RATIO_TQ_MF_CLC ECU_ADDRESS 0x7fbbc7 /end MEASUREMENT
/begin MEASUREMENT ratio_tq_mf_raw "ratio between TQI_SP and MF_TOT; raw value" SWORD _CNV_A_R___16__8000_342_CM 1 0. -16. 15.9995 DISPLAY_IDENTIFIER RATIO_TQ_MF_RAW ECU_ADDRESS 0x7fb106 BYTE_ORDER MSB_LAST FORMAT "%6.4" /end MEASUREMENT
/begin CHARACTERISTIC c_mf_delta_grd_ratio_tq_mf "delta fuel mass for gradient calculation" VALUE 0x85bf54 _REC_VAL_20_u2 262.14 _CNV_A_R_LINEAR_____43_CM 0. 262.14 DISPLAY_IDENTIFIER C_MF_DELTA_GRD_RATIO_TQ_MF /end CHARACTERISTIC
/begin CHARACTERISTIC c_mf_tot_min_grd_ratio_tq_mf "minimum MF_TOT for GRD_RATIO_TQ_MF calculation" VALUE 0x85bf6c _REC_VAL_20_u2 262.14 _CNV_A_R_LINEAR_____43_CM 0. 262.14 DISPLAY_IDENTIFIER C_MF_TOT_MIN_GRD_RATIO_TQ_MF /end CHARACTERISTIC
/begin CHARACTERISTIC c_grd_ratio_tq_mf_min "minimum limit for ratio_tq_mf gradient" VALUE 0x85bea8 _REC_VAL_20_s2 31.9995 _CNV_A_R___16__8000_341_CM -16. 15.9995 DISPLAY_IDENTIFIER C_GRD_RATIO_TQ_MF_MIN FORMAT "%6.4" /end CHARACTERISTIC
/begin CHARACTERISTIC c_grd_ratio_tq_mf_max "maximum limit for ratio_tq_mf gradient" VALUE 0x85bea6 _REC_VAL_20_s2 31.9995 _CNV_A_R___16__8000_341_CM -16. 15.9995 DISPLAY_IDENTIFIER C_GRD_RATIO_TQ_MF_MAX FORMAT "%6.4" /end CHARACTERISTIC
/begin CHARACTERISTIC c_mf_dif_max_grd_ratio_tq_mf "maximum difference between MF_TOT and MF_SLM for use of gradient calculation" VALUE 0x85bf56 _REC_VAL_20_u2 262.14 _CNV_A_R_LINEAR_____43_CM 0. 262.14 DISPLAY_IDENTIFIER C_MF_DIF_MAX_GRD_RATIO_TQ_MF /end CHARACTERISTIC
/begin CHARACTERISTIC c_mf_tot_min_ratio_tq_mf "minimum MF_TOT for RATIO_TQ_MF calculation" VALUE 0x85bf6e _REC_VAL_20_u2 262.14 _CNV_A_R_LINEAR_____43_CM 0. 262.14 DISPLAY_IDENTIFIER C_MF_TOT_MIN_RATIO_TQ_MF FORMAT "%6.4" /end CHARACTERISTIC
/begin CHARACTERISTIC ip_ratio_tq_mf_0 "TQ_MF: ratio_tq_mf for injection state 0" CURVE 0x85591a _REC_CUR_20_u2_u2 31.999512 _CNV_A_R___16__0H___343_CM -16. 15.999512 DISPLAY_IDENTIFIER IP_RATIO_TQ_MF_0 FORMAT "%6.4"
 /begin AXIS_DESCR COM_AXIS mf_slm _CNV_A_R_LINEAR_____43_CM 8 0. 262.14 AXIS_PTS_REF ldpm_mf_ip_ratio_tq_mf /end AXIS_DESCR
/end CHARACTERISTIC
/begin AXIS_PTS ldpm_mf_ip_ratio_tq_mf "" 0x843550 mf_slm _REC_AXS_20_u2 262.14 _CNV_A_R_LINEAR_____43_CM 8 0. 262.14 /end AXIS_PTS
/begin CHARACTERISTIC ip_ratio_tq_mf_2 "TQ_MF: ratio_tq_mf for injection state 2" CURVE 0x85593a _REC_CUR_20_u2_u2 31.999512 _CNV_A_R___16__0H___343_CM -16. 15.999512 DISPLAY_IDENTIFIER IP_RATIO_TQ_MF_2 FORMAT "%6.4"
 /begin AXIS_DESCR COM_AXIS mf_slm _CNV_A_R_LINEAR_____43_CM 8 0. 262.14 AXIS_PTS_REF ldpm_mf_ip_ratio_tq_mf /end AXIS_DESCR
/end CHARACTERISTIC
/begin CHARACTERISTIC ip_ratio_tq_mf_1 "TQ_MF: ratio_tq_mf for injection state 1" CURVE 0x85592a _REC_CUR_20_u2_u2 31.999512 _CNV_A_R___16__0H___343_CM -16. 15.999512 DISPLAY_IDENTIFIER IP_RATIO_TQ_MF_1 FORMAT "%6.4"
 /begin AXIS_DESCR COM_AXIS mf_slm _CNV_A_R_LINEAR_____43_CM 8 0. 262.14 AXIS_PTS_REF ldpm_mf_ip_ratio_tq_mf /end AXIS_DESCR
/end CHARACTERISTIC
/begin CHARACTERISTIC ip_ratio_tq_mf_3 "TQ_MF: ratio_tq_mf for injection state 3" CURVE 0x85594a _REC_CUR_20_u2_u2 31.999512 _CNV_A_R___16__0H___343_CM -16. 15.999512 DISPLAY_IDENTIFIER IP_RATIO_TQ_MF_3 FORMAT "%6.4"
 /begin AXIS_DESCR COM_AXIS mf_slm _CNV_A_R_LINEAR_____43_CM 8 0. 262.14 AXIS_PTS_REF ldpm_mf_ip_ratio_tq_mf /end AXIS_DESCR
/end CHARACTERISTIC
/begin CHARACTERISTIC ip_ratio_tq_mf_4 "TQ_MF: ratio_tq_mf for injection state 4" CURVE 0x85595a _REC_CUR_20_u2_u2 31.999512 _CNV_A_R___16__0H___343_CM -16. 15.999512 DISPLAY_IDENTIFIER IP_RATIO_TQ_MF_4 FORMAT "%6.4"
 /begin AXIS_DESCR COM_AXIS mf_slm _CNV_A_R_LINEAR_____43_CM 8 0. 262.14 AXIS_PTS_REF ldpm_mf_ip_ratio_tq_mf /end AXIS_DESCR
/end CHARACTERISTIC
/begin MEASUREMENT tqi_slm "" SWORD _CNV_A_R_LINEAR_____62_CM 1 0. -1024. 1023.96875 DISPLAY_IDENTIFIER TQI_SLM ECU_ADDRESS 0x7fa232 BYTE_ORDER MSB_LAST FORMAT "%7.2" /end MEASUREMENT
/begin MEASUREMENT ratio_tq_mf_grd "ratio between TQI_SP and MF_TOT corrected by gradient calculation" SWORD _CNV_A_R___16__8000_342_CM 1 0. -16. 15.9995 DISPLAY_IDENTIFIER RATIO_TQ_MF_GRD ECU_ADDRESS 0x7fb0f0 BYTE_ORDER MSB_LAST FORMAT "%6.4" /end MEASUREMENT
/begin CHARACTERISTIC c_crlc_ratio_tq_mf "correlation constant for map based ratio_tq_mf estimation" VALUE 0x85bd54 _REC_VAL_20_u2 0.9999847412109381 _CNV_A_R_LINEAR_____14_CM 0. 0.9999847412109381 DISPLAY_IDENTIFIER C_CRLC_RATIO_TQ_MF FORMAT "%6.5" /end CHARACTERISTIC
/begin CHARACTERISTIC c_ratio_tq_mf_max "correlation constant for map based ratio_tq_mf estimation" VALUE 0x85c010 _REC_VAL_20_s2 31.9995 _CNV_A_R___16__8000_342_CM -16. 15.9995 DISPLAY_IDENTIFIER C_RATIO_TQ_MF_MAX FORMAT "%6.5" /end CHARACTERISTIC
/begin CHARACTERISTIC c_ratio_tq_mf_min "correlation constant for map based ratio_tq_mf estimation" VALUE 0x85c012 _REC_VAL_20_s2 31.9995 _CNV_A_R___16__8000_342_CM -16. 15.9995 DISPLAY_IDENTIFIER C_RATIO_TQ_MF_MIN FORMAT "%6.5" /end CHARACTERISTIC
/begin MEASUREMENT tq_driv_sub "o v" SWORD _CNV_A_R_LINEAR_____62_CM 1 0. -1024. 1023.96875 DISPLAY_IDENTIFIER TQ_DRIV_SUB ECU_ADDRESS 0x7fa266 BYTE_ORDER MSB_LAST FORMAT "%6.2" /end MEASUREMENT
/begin MEASUREMENT tqi_driv_sub "o v" SWORD _CNV_A_R_LINEAR_____62_CM 1 0. -1024. 1023.96875 DISPLAY_IDENTIFIER TQI_DRIV_SUB ECU_ADDRESS 0x7fa268 BYTE_ORDER MSB_LAST FORMAT "%6.2" /end MEASUREMENT
/begin MEASUREMENT lv_tq_cru_act "o v" UBYTE _CNV_S_2_RANGE______11_CM 1 0. 0. 1. DISPLAY_IDENTIFIER LV_TQ_CRU_ACT ECU_ADDRESS 0x7fb801 /end MEASUREMENT
/begin MEASUREMENT lv_tq_vvsl_act "o v" UBYTE _CNV_S_2_RANGE______11_CM 1 0. 0. 1. DISPLAY_IDENTIFIER LV_TQ_VVSL_ACT ECU_ADDRESS 0x7fb802 /end MEASUREMENT
/begin MEASUREMENT tq_dcru_req "o v" SWORD _CNV_A_R_LINEAR_____62_CM 1 0. -1024. 1023.96875 DISPLAY_IDENTIFIER TQ_DCRU_REQ ECU_ADDRESS 0x7fa26a BYTE_ORDER MSB_LAST FORMAT "%6.2" /end MEASUREMENT
/begin MEASUREMENT tq_cru_req "o v" SWORD _CNV_A_R_LINEAR_____62_CM 1 0. -1024. 1023.96875 DISPLAY_IDENTIFIER TQ_CRU_REQ ECU_ADDRESS 0x7fa26c BYTE_ORDER MSB_LAST FORMAT "%6.2" /end MEASUREMENT
/begin MEASUREMENT tq_vs_lim_req "o v" SWORD _CNV_A_R_LINEAR_____62_CM 1 0. -1024. 1023.96875 DISPLAY_IDENTIFIER TQ_VS_LIM_REQ ECU_ADDRESS 0x7fa26e BYTE_ORDER MSB_LAST FORMAT "%6.2" /end MEASUREMENT
/begin MEASUREMENT tq_req_dcru "torque request for distance cruise control intervention" SWORD _CNV_A_R_LINEAR_____62_CM 1 0. -1024. 1023.96875 DISPLAY_IDENTIFIER TQ_REQ_DCRU ECU_ADDRESS 0x7f977a BYTE_ORDER MSB_LAST FORMAT "%6.2" /end MEASUREMENT
/begin MEASUREMENT tqi_max "" SWORD _CNV_A_R_LINEAR_____62_CM 1 0. -1024. 1023.96875 DISPLAY_IDENTIFIER TQI_MAX ECU_ADDRESS 0x7fa272 BYTE_ORDER MSB_LAST FORMAT "%7.2" /end MEASUREMENT
/begin MEASUREMENT fac_cyl_bal_ramp_tco[3] "correction factor calculated by the ramp for TCO x=0...NC_CYL_NR-1" UWORD _CNV_A_R_LINEAR_____53_CM 1 0. 0. 1.9999696 DISPLAY_IDENTIFIER FAC_CYL_BAL_RAMP_TCO_3_ ECU_ADDRESS 0x7f9792 BYTE_ORDER MSB_LAST FORMAT "%5.3" /end MEASUREMENT
/begin MEASUREMENT fac_cyl_bal[3] "cylinder balancing factor x=0...NC_CYL_NR-1" UWORD _CNV_A_R_LINEAR_____53_CM 1 0. 0. 1.9999696 DISPLAY_IDENTIFIER FAC_CYL_BAL_3_ ECU_ADDRESS 0x7f9782 BYTE_ORDER MSB_LAST FORMAT "%5.3" /end MEASUREMENT
/begin MEASUREMENT fac_cyl_bal_n_fdout[3] "" UWORD _CNV_A_R_LINEAR_____53_CM 1 0. 0. 1.9999696 DISPLAY_IDENTIFIER FAC_CYL_BAL_N_FDOUT_3_ ECU_ADDRESS 0x7fa568 BYTE_ORDER MSB_LAST FORMAT "%6.4" /end MEASUREMENT
/begin MEASUREMENT cyl_bal_pi[3] "output of the PI-controller x = 0...NC_CYL_NR-1" UWORD _CNV_A_R_LINEAR_____53_CM 1 0. 0. 1.9999696 DISPLAY_IDENTIFIER CYL_BAL_PI_3_ ECU_ADDRESS 0x7f979a BYTE_ORDER MSB_LAST FORMAT "%5.3" /end MEASUREMENT
/begin MEASUREMENT cyl_bal_dif[3] "control deviation cylinder balancing x=0...NC_CYL_NR-1" SWORD _CNV_A_R_LINEAR_____371_CM 1 0. -8. 7.999755856 DISPLAY_IDENTIFIER CYL_BAL_DIF_3_ ECU_ADDRESS 0x7f97ae BYTE_ORDER MSB_LAST FORMAT "%6.5" /end MEASUREMENT
/begin MEASUREMENT cfb_pcv_mes "" UWORD _CNV_A_R_LINEAR_____377_CM 1 0. 0. 3.25 DISPLAY_IDENTIFIER CFB_PCV_MES ECU_ADDRESS 0x7fa276 BYTE_ORDER MSB_LAST FORMAT "%3.2" /end MEASUREMENT
/begin MEASUREMENT er[3] "" SWORD _CNV_A_R_LINEAR_____359_CM 1 0. -32768. 32767. DISPLAY_IDENTIFIER ER_3_ ECU_ADDRESS 0x7f9934 BYTE_ORDER MSB_LAST FORMAT "%6.0" /end MEASUREMENT
/begin MEASUREMENT seg_ad_mmv[3] "adaptation values for each segment(x = 0...NC_CYL_NR-1)" SWORD _CNV_A_R_LINEAR_____379_CM 1 0. -7.812507 7.812269 DISPLAY_IDENTIFIER SEG_AD_MMV_3_ ECU_ADDRESS 0x7f9920 BYTE_ORDER MSB_LAST FORMAT "%7.5" /end MEASUREMENT
/begin MEASUREMENT seg_t_cor_buf[6] "" UWORD _CNV_A_R_LINEAR_____359_CM 1 0. 0. 65535. DISPLAY_IDENTIFIER SEG_T_COR_BUF_6_ ECU_ADDRESS 0x7f9942 BYTE_ORDER MSB_LAST FORMAT "%5.0" /end MEASUREMENT
/begin MEASUREMENT seg_t_cor_buf[7] "" UWORD _CNV_A_R_LINEAR_____359_CM 1 0. 0. 65535. DISPLAY_IDENTIFIER SEG_T_COR_BUF_7_ ECU_ADDRESS 0x7f9944 BYTE_ORDER MSB_LAST FORMAT "%5.0" /end MEASUREMENT
/begin MEASUREMENT lv_seg_t_ad_rst_ext_adj "" UBYTE _CNV_S_2_RANGE______11_CM 1 0. 0. 1. DISPLAY_IDENTIFIER LV_SEG_T_AD_RST_EXT_ADJ ECU_ADDRESS 0x7fb4d5 /end MEASUREMENT
/begin MEASUREMENT lv_seg_t_fast_ad_ext_adj "" UBYTE _CNV_S_2_RANGE______11_CM 1 0. 0. 1. DISPLAY_IDENTIFIER LV_SEG_T_FAST_AD_EXT_ADJ ECU_ADDRESS 0x7fb4d4 /end MEASUREMENT
/begin CHARACTERISTIC lc_seg_ad_init "" VALUE 0x85c35a _REC_VAL_20_u1 1. _CNV_A_R_LINEAR_____0_CM 0. 1. DISPLAY_IDENTIFIER LC_SEG_AD_INIT FORMAT "%1.0" /end CHARACTERISTIC
/begin MEASUREMENT ctr_t_low_maf_frq_0_av "" UWORD _CNV_A_R_LINEAR_____0_CM 1 0. 0. 65535. DISPLAY_IDENTIFIER CTR_T_LOW_MAF_FRQ_0_AV ECU_ADDRESS 0x7fc964 BYTE_ORDER MSB_LAST FORMAT "%5.0" /end MEASUREMENT
/begin MEASUREMENT vb_fil "" UBYTE _CNV_A_R_LINEAR_____48_CM 1 0. 0. 28.8 DISPLAY_IDENTIFIER VB_FIL ECU_ADDRESS 0x7fb75c FORMAT "%3.1" /end MEASUREMENT
/begin MEASUREMENT lv_key_off "" UBYTE _CNV_S_2_RANGE______28_CM 1 0. 0. 1. DISPLAY_IDENTIFIER LV_KEY_OFF ECU_ADDRESS 0x7fb882 /end MEASUREMENT
/begin AXIS_PTS ldp_v_maf_id_maf_x "" 0x8432a6 v_maf_x _REC_AXS_20_u1 15. _CNV_A_R_LINEAR_____0_CM 16 0. 15. FORMAT "%2.0" /end AXIS_PTS
/begin AXIS_PTS ldp_v_maf_id_maf_y "" 0x8432b7 v_maf_y _REC_AXS_20_u1 15. _CNV_A_R_LINEAR_____0_CM 16 0. 15. FORMAT "%2.0" /end AXIS_PTS
/begin CHARACTERISTIC id_maf_tab "mass air flow" MAP 0x848b98 _REC_MAP_20_u2_u1_u1 1023.984375 _CNV_A_R_LINEAR_____112_CM 0. 1023.984375 DISPLAY_IDENTIFIER ID_MAF_TAB FORMAT "%7.2"
 /begin AXIS_DESCR COM_AXIS v_maf_x _CNV_A_R_LINEAR_____0_CM 16 0. 15. FORMAT "%2.0" AXIS_PTS_REF ldp_v_maf_id_maf_x /end AXIS_DESCR
 /begin AXIS_DESCR COM_AXIS v_maf_y _CNV_A_R_LINEAR_____0_CM 16 0. 15. FORMAT "%2.0" AXIS_PTS_REF ldp_v_maf_id_maf_y /end AXIS_DESCR
/end CHARACTERISTIC
/begin MEASUREMENT v_map "" UWORD _CNV_A_R_LINEAR_____52_CM 1 0. 0. 4.9999237 DISPLAY_IDENTIFIER V_MAP ECU_ADDRESS 0x7fa2e8 BYTE_ORDER MSB_LAST FORMAT "%6.5" /end MEASUREMENT
/begin MEASUREMENT fup_tra_dif "" SWORD _CNV_A_R_LINEAR_____285_CM 1 0. -100. 99.996948242 DISPLAY_IDENTIFIER FUP_TRA_DIF ECU_ADDRESS 0x7fa058 BYTE_ORDER MSB_LAST FORMAT "%5.3" /end MEASUREMENT
/begin MEASUREMENT lv_inh_egr_ctl "" UBYTE _CNV_S_2_RANGE______28_CM 1 0. 0. 1. DISPLAY_IDENTIFIER LV_INH_EGR_CTL ECU_ADDRESS 0x7fb731 /end MEASUREMENT
/begin MEASUREMENT online_dummy "" UWORD _CNV_A_R_LINEAR_____1_CM 1 0. 0. 65535. DISPLAY_IDENTIFIER ONLINE_DUMMY ECU_ADDRESS 0x7fa060 BYTE_ORDER MSB_LAST FORMAT "%5.0" /end MEASUREMENT
/begin MEASUREMENT ecu_state "" UBYTE _CNV_S_6_RANGE______395_CM 1 0. 0. 5. DISPLAY_IDENTIFIER ECU_STATE ECU_ADDRESS 0x7ffd5d /end MEASUREMENT
/begin MEASUREMENT mf_bas "" UWORD _CNV_A_R_LINEAR_____43_CM 1 0. 0. 262.14 DISPLAY_IDENTIFIER MF_BAS ECU_ADDRESS 0x7fa05a BYTE_ORDER MSB_LAST FORMAT "%5.2" /end MEASUREMENT
/begin AXIS_PTS ldp_amp_2_inj_x "" 0x841082 amp _REC_AXS_20_u2 5434. _CNV_A_R_LINEAR_____21_CM 1 0. 5434. FORMAT "%7.3" /end AXIS_PTS
/begin AXIS_PTS ldp_n_3_inj_x "" 0x841910 n _REC_AXS_20_u2 6375. _CNV_A_R_LINEAR_____5_CM 1 0. 6375. FORMAT "%4.0" /end AXIS_PTS
/begin AXIS_PTS ldp_n_4_inj_x "" 0x841914 n _REC_AXS_20_u2 6375. _CNV_A_R_LINEAR_____5_CM 1 0. 6375. FORMAT "%4.0" /end AXIS_PTS
/begin MEASUREMENT lv_intv_bpa[0] "" UBYTE _CNV_A_R_LINEAR_____0_CM 1 0. 0. 1. DISPLAY_IDENTIFIER LV_INTV_BPA_0_ ECU_ADDRESS 0x7fb480 FORMAT "%1.0" /end MEASUREMENT
/begin MEASUREMENT intv_bpa[0] "" SWORD _CNV_A_R_LINEAR_____12_CM 1 0. -100. 99.996948242 DISPLAY_IDENTIFIER INTV_BPA_0_ ECU_ADDRESS 0x7f97da BYTE_ORDER MSB_LAST FORMAT "%6.2" /end MEASUREMENT
/begin MEASUREMENT lv_ad_bpa[0] "error flag for V_EGRV_j_BOL adaption out of range" UBYTE _CNV_S_2_RANGE______11_CM 1 0. 0. 1. DISPLAY_IDENTIFIER LV_AD_BPA_0_ ECU_ADDRESS 0x7fb484 /end MEASUREMENT
/begin MEASUREMENT ad_bpa_mmv[0] "" SWORD _CNV_A_R_LINEAR_____12_CM 1 0. -100. 99.996948242 DISPLAY_IDENTIFIER AD_BPA_MMV_0_ ECU_ADDRESS 0x7f9806 BYTE_ORDER MSB_LAST FORMAT "%6.2" /end MEASUREMENT
/begin MEASUREMENT lv_ad_bpa_tol[0] "" UBYTE _CNV_A_R_LINEAR_____0_CM 1 0. 0. 1. DISPLAY_IDENTIFIER LV_AD_BPA_TOL_0_ ECU_ADDRESS 0x7fb489 FORMAT "%1.0" /end MEASUREMENT
/begin MEASUREMENT lv_v_bpa_tol_ad_orng[0] "error flag for V_EGRV_j_BOL adaption out of range" UBYTE _CNV_S_2_RANGE______11_CM 1 0. 0. 1. DISPLAY_IDENTIFIER LV_V_BPA_TOL_AD_ORNG_0_ ECU_ADDRESS 0x7fb485 /end MEASUREMENT
/begin MEASUREMENT v_bpa_tol[0] "" UWORD _CNV_A_R_LINEAR_____412_CM 1 0. 0. 319.995172 DISPLAY_IDENTIFIER V_BPA_TOL_0_ ECU_ADDRESS 0x7f9802 BYTE_ORDER MSB_LAST FORMAT "%5.2" /end MEASUREMENT
/begin MEASUREMENT lv_cdn_ad_v_bpa_tol[0] "" UBYTE _CNV_A_R_LINEAR_____0_CM 1 0. 0. 1. DISPLAY_IDENTIFIER LV_CDN_AD_V_BPA_TOL_0_ ECU_ADDRESS 0x7fb487 FORMAT "%1.0" /end MEASUREMENT
/begin MEASUREMENT v_bpa_tol_det[0] "" UWORD _CNV_A_R_LINEAR_____412_CM 1 0. 0. 319.995172 DISPLAY_IDENTIFIER V_BPA_TOL_DET_0_ ECU_ADDRESS 0x7f9808 BYTE_ORDER MSB_LAST FORMAT "%5.2" /end MEASUREMENT
/begin MEASUREMENT t_ad_bpa_bol_av[0] "" UWORD _CNV_A_R_LINEAR_____76_CM 1 0. 0. 65.535 DISPLAY_IDENTIFIER T_AD_BPA_BOL_AV_0_ ECU_ADDRESS 0x7fa622 BYTE_ORDER MSB_LAST FORMAT "%5.3" /end MEASUREMENT
/begin MEASUREMENT lv_ad_bpa_bol[0] "" UBYTE _CNV_A_R_LINEAR_____0_CM 1 0. 0. 1. DISPLAY_IDENTIFIER LV_AD_BPA_BOL_0_ ECU_ADDRESS 0x7fb48a FORMAT "%1.0" /end MEASUREMENT
/begin MEASUREMENT t_ad_bpa_tol_av[0] "" UWORD _CNV_A_R_LINEAR_____76_CM 1 0. 0. 65.535 DISPLAY_IDENTIFIER T_AD_BPA_TOL_AV_0_ ECU_ADDRESS 0x7fa620 BYTE_ORDER MSB_LAST FORMAT "%5.3" /end MEASUREMENT
/begin MEASUREMENT lv_v_bpa_bol_ad_orng[0] "" UBYTE _CNV_A_R_LINEAR_____0_CM 1 0. 0. 1. DISPLAY_IDENTIFIER LV_V_BPA_BOL_AD_ORNG_0_ ECU_ADDRESS 0x7fb486 FORMAT "%1.0" /end MEASUREMENT
/begin MEASUREMENT v_bpa_bol[0] "" UWORD _CNV_A_R_LINEAR_____412_CM 1 0. 0. 319.995172 DISPLAY_IDENTIFIER V_BPA_BOL_0_ ECU_ADDRESS 0x7f9804 BYTE_ORDER MSB_LAST FORMAT "%5.2" /end MEASUREMENT
/begin MEASUREMENT lv_cdn_ad_v_bpa_bol[0] "" UBYTE _CNV_A_R_LINEAR_____0_CM 1 0. 0. 1. DISPLAY_IDENTIFIER LV_CDN_AD_V_BPA_BOL_0_ ECU_ADDRESS 0x7fb488 FORMAT "%1.0" /end MEASUREMENT
/begin MEASUREMENT v_bpa_bol_det[0] "" UWORD _CNV_A_R_LINEAR_____412_CM 1 0. 0. 319.995172 DISPLAY_IDENTIFIER V_BPA_BOL_DET_0_ ECU_ADDRESS 0x7f980a BYTE_ORDER MSB_LAST FORMAT "%5.2" /end MEASUREMENT
/begin CHARACTERISTIC c_crlc_ad_bpa[0] "" VALUE 0x85bd40 _REC_VAL_20_u2 0.9999847412109381 _CNV_A_R_LINEAR_____14_CM 0. 0.9999847412109381 DISPLAY_IDENTIFIER C_CRLC_AD_BPA_0_ FORMAT "%5.4" /end CHARACTERISTIC
/begin CHARACTERISTIC c_crlc_v_bpa_tol[0] "" VALUE 0x85bd5c _REC_VAL_20_u2 0.9999847412109381 _CNV_A_R_LINEAR_____14_CM 0. 0.9999847412109381 DISPLAY_IDENTIFIER C_CRLC_V_BPA_TOL_0_ FORMAT "%5.4" /end CHARACTERISTIC
/begin CHARACTERISTIC c_v_bpa_max_ad_tol[0] "" VALUE 0x85c1f0 _REC_VAL_20_u2 319.995172 _CNV_A_R_LINEAR_____412_CM 0. 319.995172 DISPLAY_IDENTIFIER C_V_BPA_MAX_AD_TOL_0_ FORMAT "%5.2" /end CHARACTERISTIC
/begin CHARACTERISTIC c_v_bpa_min_ad_tol[0] "" VALUE 0x85c1f6 _REC_VAL_20_u2 319.995172 _CNV_A_R_LINEAR_____412_CM 0. 319.995172 DISPLAY_IDENTIFIER C_V_BPA_MIN_AD_TOL_0_ FORMAT "%5.2" /end CHARACTERISTIC
/begin CHARACTERISTIC lc_v_bpa_tol_sub[0] "" VALUE 0x85c37d _REC_VAL_20_u1 1. _CNV_A_R_LINEAR_____0_CM 0. 1. DISPLAY_IDENTIFIER LC_V_BPA_TOL_SUB_0_ FORMAT "%1.0" /end CHARACTERISTIC
/begin CHARACTERISTIC c_v_bpa_tol_sub[0] "" VALUE 0x85c1fc _REC_VAL_20_u2 319.995172 _CNV_A_R_LINEAR_____412_CM 0. 319.995172 DISPLAY_IDENTIFIER C_V_BPA_TOL_SUB_0_ FORMAT "%5.2" /end CHARACTERISTIC
/begin CHARACTERISTIC c_ang_sp_ad_bpa_bol[0] "" VALUE 0x85bcd6 _REC_VAL_20_u2 99.99847412109381 _CNV_A_R_LINEAR_____8_CM 0. 99.99847412109381 DISPLAY_IDENTIFIER C_ANG_SP_AD_BPA_BOL_0_ FORMAT "%5.3" /end CHARACTERISTIC
/begin CHARACTERISTIC c_v_grd_bpa_st_ad_bol[0] "" VALUE 0x85c22a _REC_VAL_20_u1 124.511719 _CNV_A_R_LINEAR_____413_CM 0. 124.511719 DISPLAY_IDENTIFIER C_V_GRD_BPA_ST_AD_BOL_0_ FORMAT "%4.1" /end CHARACTERISTIC
/begin CHARACTERISTIC c_temp_st_ad_bpa_max[0] "" VALUE 0x85c177 _REC_VAL_20_u1 255. _CNV_A_R_LINEAR_____18_CM -50. 205. DISPLAY_IDENTIFIER C_TEMP_ST_AD_BPA_MAX_0_ FORMAT "%4.1" /end CHARACTERISTIC
/begin CHARACTERISTIC c_temp_st_ad_bpa_min[0] "" VALUE 0x85c178 _REC_VAL_20_u1 255. _CNV_A_R_LINEAR_____18_CM -50. 205. DISPLAY_IDENTIFIER C_TEMP_ST_AD_BPA_MIN_0_ FORMAT "%4.1" /end CHARACTERISTIC
/begin CHARACTERISTIC c_v_bpa_max_st_ad_bol[0] "" VALUE 0x85c1f2 _REC_VAL_20_u2 319.995172 _CNV_A_R_LINEAR_____412_CM 0. 319.995172 DISPLAY_IDENTIFIER C_V_BPA_MAX_ST_AD_BOL_0_ FORMAT "%5.2" /end CHARACTERISTIC
/begin CHARACTERISTIC c_vb_max_ad_bpa "" VALUE 0x85c2ae _REC_VAL_20_u1 28.8 _CNV_A_R_LINEAR_____48_CM 0. 28.8 DISPLAY_IDENTIFIER C_VB_MAX_AD_BPA FORMAT "%3.1" /end CHARACTERISTIC
/begin CHARACTERISTIC c_vb_min_ad_bpa "" VALUE 0x85c2b2 _REC_VAL_20_u1 28.8 _CNV_A_R_LINEAR_____48_CM 0. 28.8 DISPLAY_IDENTIFIER C_VB_MIN_AD_BPA FORMAT "%3.1" /end CHARACTERISTIC
/begin CHARACTERISTIC c_t_ad_bpa_bol_ini[0] "" VALUE 0x85c07e _REC_VAL_20_u2 65.535 _CNV_A_R_LINEAR_____76_CM 0. 65.535 DISPLAY_IDENTIFIER C_T_AD_BPA_BOL_INI_0_ FORMAT "%5.3" /end CHARACTERISTIC
/begin CHARACTERISTIC c_ang_sp_ad_bpa_tol[0] "" VALUE 0x85bcd8 _REC_VAL_20_u2 99.99847412109381 _CNV_A_R_LINEAR_____8_CM 0. 99.99847412109381 DISPLAY_IDENTIFIER C_ANG_SP_AD_BPA_TOL_0_ FORMAT "%5.3" /end CHARACTERISTIC
/begin CHARACTERISTIC c_v_grd_bpa_st_ad_tol[0] "" VALUE 0x85c22b _REC_VAL_20_u1 124.511719 _CNV_A_R_LINEAR_____413_CM 0. 124.511719 DISPLAY_IDENTIFIER C_V_GRD_BPA_ST_AD_TOL_0_ FORMAT "%4.1" /end CHARACTERISTIC
/begin CHARACTERISTIC c_v_bpa_min_st_ad_tol[0] "" VALUE 0x85c1f8 _REC_VAL_20_u2 319.995172 _CNV_A_R_LINEAR_____412_CM 0. 319.995172 DISPLAY_IDENTIFIER C_V_BPA_MIN_ST_AD_TOL_0_ FORMAT "%5.2" /end CHARACTERISTIC
/begin CHARACTERISTIC c_t_ad_bpa_tol_ini[0] "" VALUE 0x85c082 _REC_VAL_20_u2 65.535 _CNV_A_R_LINEAR_____76_CM 0. 65.535 DISPLAY_IDENTIFIER C_T_AD_BPA_TOL_INI_0_ FORMAT "%5.3" /end CHARACTERISTIC
/begin CHARACTERISTIC c_t_ad_bpa_tol[0] "" VALUE 0x85c080 _REC_VAL_20_u2 65.535 _CNV_A_R_LINEAR_____76_CM 0. 65.535 DISPLAY_IDENTIFIER C_T_AD_BPA_TOL_0_ FORMAT "%5.3" /end CHARACTERISTIC
/begin CHARACTERISTIC c_crlc_v_bpa_bol[0] "" VALUE 0x85bd5a _REC_VAL_20_u2 0.9999847412109381 _CNV_A_R_LINEAR_____14_CM 0. 0.9999847412109381 DISPLAY_IDENTIFIER C_CRLC_V_BPA_BOL_0_ FORMAT "%5.4" /end CHARACTERISTIC
/begin CHARACTERISTIC c_v_bpa_max_ad_bol[0] "" VALUE 0x85c1ee _REC_VAL_20_u2 319.995172 _CNV_A_R_LINEAR_____412_CM 0. 319.995172 DISPLAY_IDENTIFIER C_V_BPA_MAX_AD_BOL_0_ FORMAT "%5.2" /end CHARACTERISTIC
/begin CHARACTERISTIC c_v_bpa_min_ad_bol[0] "" VALUE 0x85c1f4 _REC_VAL_20_u2 319.995172 _CNV_A_R_LINEAR_____412_CM 0. 319.995172 DISPLAY_IDENTIFIER C_V_BPA_MIN_AD_BOL_0_ FORMAT "%5.2" /end CHARACTERISTIC
/begin CHARACTERISTIC lc_v_bpa_bol_sub[0] "" VALUE 0x85c37b _REC_VAL_20_u1 1. _CNV_A_R_LINEAR_____0_CM 0. 1. DISPLAY_IDENTIFIER LC_V_BPA_BOL_SUB_0_ FORMAT "%1.0" /end CHARACTERISTIC
/begin CHARACTERISTIC c_v_bpa_bol_sub[0] "" VALUE 0x85c1ea _REC_VAL_20_u2 319.995172 _CNV_A_R_LINEAR_____412_CM 0. 319.995172 DISPLAY_IDENTIFIER C_V_BPA_BOL_SUB_0_ FORMAT "%5.2" /end CHARACTERISTIC
/begin CHARACTERISTIC id_ad_bpa_bol__t_ad_bpa "BPA_AI: control values for adaption (BOL)" CURVE 0x8488c8 _REC_CUR_20_u2_u2 199.9969482 _CNV_A_R_LINEAR_____158_CM -100. 99.99694820000001 DISPLAY_IDENTIFIER ID_AD_BPA_BOL__T_AD_BPA FORMAT "%6.4"
 /begin AXIS_DESCR COM_AXIS t_ad_bpa_bol_av[0] _CNV_A_R_LINEAR_____76_CM 4 0. 65.535 FORMAT "%5.3" AXIS_PTS_REF ldp_t_ad_bpa_bol__ip_ad_bpa /end AXIS_DESCR
/end CHARACTERISTIC
/begin CHARACTERISTIC id_ad_bpa_tol__t_ad_bpa "BPA_AI: control values for adaption (TOL)" CURVE 0x8488d0 _REC_CUR_20_u2_u2 199.9969482 _CNV_A_R_LINEAR_____158_CM -100. 99.99694820000001 DISPLAY_IDENTIFIER ID_AD_BPA_TOL__T_AD_BPA FORMAT "%6.4"
 /begin AXIS_DESCR COM_AXIS t_ad_bpa_tol_av[0] _CNV_A_R_LINEAR_____76_CM 4 0. 65.535 FORMAT "%5.3" AXIS_PTS_REF ldp_t_ad_bpa_tol__ip_ad_bpa /end AXIS_DESCR
/end CHARACTERISTIC
/begin AXIS_PTS ldp_t_ad_bpa_tol__ip_ad_bpa "" 0x8425d6 t_ad_bpa_tol_av[0] _REC_AXS_20_u2 65.535 _CNV_A_R_LINEAR_____76_CM 4 0. 65.535 FORMAT "%5.3" /end AXIS_PTS
/begin AXIS_PTS ldp_t_ad_bpa_bol__ip_ad_bpa "" 0x8425cc t_ad_bpa_bol_av[0] _REC_AXS_20_u2 65.535 _CNV_A_R_LINEAR_____76_CM 4 0. 65.535 FORMAT "%5.3" /end AXIS_PTS
/begin CHARACTERISTIC c_t_ad_bpa_bol[0] "" VALUE 0x85c07c _REC_VAL_20_u2 65.535 _CNV_A_R_LINEAR_____76_CM 0. 65.535 DISPLAY_IDENTIFIER C_T_AD_BPA_BOL_0_ FORMAT "%5.3" /end CHARACTERISTIC
/begin CHARACTERISTIC c_v_egrv_tol_sub[0] "" VALUE 0x85c228 _REC_VAL_20_u2 319.995172 _CNV_A_R_LINEAR_____412_CM 0. 319.995172 DISPLAY_IDENTIFIER C_V_EGRV_TOL_SUB_0_ FORMAT "%5.2" /end CHARACTERISTIC
/begin CHARACTERISTIC lc_v_egrv_tol_sub[0] "" VALUE 0x85c381 _REC_VAL_20_u1 1. _CNV_A_R_LINEAR_____0_CM 0. 1. DISPLAY_IDENTIFIER LC_V_EGRV_TOL_SUB_0_ FORMAT "%1.0" /end CHARACTERISTIC
/begin MEASUREMENT ad_egrv_mmv[0] "" SWORD _CNV_A_R_LINEAR_____12_CM 1 0. -100. 99.996948242 DISPLAY_IDENTIFIER AD_EGRV_MMV_0_ ECU_ADDRESS 0x7f97d4 BYTE_ORDER MSB_LAST FORMAT "%6.2" /end MEASUREMENT
/begin CHARACTERISTIC c_crlc_v_egrv_tol[0] "" VALUE 0x85bd60 _REC_VAL_20_u2 0.9999847412109381 _CNV_A_R_LINEAR_____14_CM 0. 0.9999847412109381 DISPLAY_IDENTIFIER C_CRLC_V_EGRV_TOL_0_ FORMAT "%5.4" /end CHARACTERISTIC
/begin CHARACTERISTIC c_crlc_v_egrv_bol[0] "" VALUE 0x85bd5e _REC_VAL_20_u2 0.9999847412109381 _CNV_A_R_LINEAR_____14_CM 0. 0.9999847412109381 DISPLAY_IDENTIFIER C_CRLC_V_EGRV_BOL_0_ FORMAT "%5.4" /end CHARACTERISTIC
/begin CHARACTERISTIC c_v_egrv_max_st_ad_bol[0] "" VALUE 0x85c218 _REC_VAL_20_u2 319.995172 _CNV_A_R_LINEAR_____412_CM 0. 319.995172 DISPLAY_IDENTIFIER C_V_EGRV_MAX_ST_AD_BOL_0_ FORMAT "%5.2" /end CHARACTERISTIC
/begin CHARACTERISTIC c_v_egrv_min_st_ad_tol[0] "" VALUE 0x85c224 _REC_VAL_20_u2 319.995172 _CNV_A_R_LINEAR_____412_CM 0. 319.995172 DISPLAY_IDENTIFIER C_V_EGRV_MIN_ST_AD_TOL_0_ FORMAT "%5.2" /end CHARACTERISTIC
/begin CHARACTERISTIC c_t_ad_egrv_bol_ini[0] "" VALUE 0x85c086 _REC_VAL_20_u2 65.535 _CNV_A_R_LINEAR_____76_CM 0. 65.535 DISPLAY_IDENTIFIER C_T_AD_EGRV_BOL_INI_0_ FORMAT "%5.3" /end CHARACTERISTIC
/begin CHARACTERISTIC c_t_ad_egrv_tol_ini[0] "" VALUE 0x85c08a _REC_VAL_20_u2 65.535 _CNV_A_R_LINEAR_____76_CM 0. 65.535 DISPLAY_IDENTIFIER C_T_AD_EGRV_TOL_INI_0_ FORMAT "%5.3" /end CHARACTERISTIC
/begin MEASUREMENT lv_v_egrv_tol_ad_orng[0] "error flag for V_EGRV_j_BOL adaption out of range" UBYTE _CNV_S_2_RANGE______11_CM 1 0. 0. 1. DISPLAY_IDENTIFIER LV_V_EGRV_TOL_AD_ORNG_0_ ECU_ADDRESS 0x7fba35 /end MEASUREMENT
/begin MEASUREMENT lv_v_egrv_bol_ad_orng[0] "" UBYTE _CNV_A_R_LINEAR_____0_CM 1 0. 0. 1. DISPLAY_IDENTIFIER LV_V_EGRV_BOL_AD_ORNG_0_ ECU_ADDRESS 0x7fb47b FORMAT "%1.0" /end MEASUREMENT
/begin MEASUREMENT lv_cdn_ad_v_egrv_tol[0] "" UBYTE _CNV_A_R_LINEAR_____0_CM 1 0. 0. 1. DISPLAY_IDENTIFIER LV_CDN_AD_V_EGRV_TOL_0_ ECU_ADDRESS 0x7fba36 FORMAT "%1.0" /end MEASUREMENT
/begin MEASUREMENT lv_cdn_ad_v_egrv_bol[0] "" UBYTE _CNV_A_R_LINEAR_____0_CM 1 0. 0. 1. DISPLAY_IDENTIFIER LV_CDN_AD_V_EGRV_BOL_0_ ECU_ADDRESS 0x7fb47c FORMAT "%1.0" /end MEASUREMENT
/begin MEASUREMENT v_egrv_tol[0] "" UWORD _CNV_A_R_LINEAR_____412_CM 1 0. 0. 319.995172 DISPLAY_IDENTIFIER V_EGRV_TOL_0_ ECU_ADDRESS 0x7f97d0 BYTE_ORDER MSB_LAST FORMAT "%5.2" /end MEASUREMENT
/begin MEASUREMENT v_egrv_bol[0] "" UWORD _CNV_A_R_LINEAR_____412_CM 1 0. 0. 319.995172 DISPLAY_IDENTIFIER V_EGRV_BOL_0_ ECU_ADDRESS 0x7f97d2 BYTE_ORDER MSB_LAST FORMAT "%5.2" /end MEASUREMENT
/begin MEASUREMENT v_egrv_bol_det[0] "" UWORD _CNV_A_R_LINEAR_____412_CM 1 0. 0. 319.995172 DISPLAY_IDENTIFIER V_EGRV_BOL_DET_0_ ECU_ADDRESS 0x7f97d8 BYTE_ORDER MSB_LAST FORMAT "%5.2" /end MEASUREMENT
/begin MEASUREMENT v_egrv_tol_det[0] "" UWORD _CNV_A_R_LINEAR_____412_CM 1 0. 0. 319.995172 DISPLAY_IDENTIFIER V_EGRV_TOL_DET_0_ ECU_ADDRESS 0x7f97d6 BYTE_ORDER MSB_LAST FORMAT "%5.2" /end MEASUREMENT
/begin MEASUREMENT lv_ad_egrv_tol[0] "" UBYTE _CNV_A_R_LINEAR_____0_CM 1 0. 0. 1. DISPLAY_IDENTIFIER LV_AD_EGRV_TOL_0_ ECU_ADDRESS 0x7fb47d FORMAT "%1.0" /end MEASUREMENT
/begin MEASUREMENT lv_ad_egrv_tol_req[0] "" UBYTE _CNV_A_R_LINEAR_____0_CM 1 0. 0. 1. DISPLAY_IDENTIFIER LV_AD_EGRV_TOL_REQ_0_ ECU_ADDRESS 0x7fba33 FORMAT "%1.0" /end MEASUREMENT
/begin MEASUREMENT lv_ad_egrv_bol[0] "" UBYTE _CNV_A_R_LINEAR_____0_CM 1 0. 0. 1. DISPLAY_IDENTIFIER LV_AD_EGRV_BOL_0_ ECU_ADDRESS 0x7fb47e FORMAT "%1.0" /end MEASUREMENT
/begin MEASUREMENT lv_ad_egrv_bol_req[0] "" UBYTE _CNV_A_R_LINEAR_____0_CM 1 0. 0. 1. DISPLAY_IDENTIFIER LV_AD_EGRV_BOL_REQ_0_ ECU_ADDRESS 0x7fba34 FORMAT "%1.0" /end MEASUREMENT
/begin MEASUREMENT t_ad_egrv_tol_av[0] "" UWORD _CNV_A_R_LINEAR_____76_CM 1 0. 0. 65.535 DISPLAY_IDENTIFIER T_AD_EGRV_TOL_AV_0_ ECU_ADDRESS 0x7fa5e2 BYTE_ORDER MSB_LAST FORMAT "%5.3" /end MEASUREMENT
/begin MEASUREMENT t_ad_egrv_bol_av[0] "" UWORD _CNV_A_R_LINEAR_____76_CM 1 0. 0. 65.535 DISPLAY_IDENTIFIER T_AD_EGRV_BOL_AV_0_ ECU_ADDRESS 0x7fa5e4 BYTE_ORDER MSB_LAST FORMAT "%5.3" /end MEASUREMENT
/begin CHARACTERISTIC c_crlc_ad_egrv[0] "" VALUE 0x85bd42 _REC_VAL_20_u2 0.9999847412109381 _CNV_A_R_LINEAR_____14_CM 0. 0.9999847412109381 DISPLAY_IDENTIFIER C_CRLC_AD_EGRV_0_ FORMAT "%5.4" /end CHARACTERISTIC
/begin CHARACTERISTIC c_v_egrv_max_ad_tol[0] "" VALUE 0x85c216 _REC_VAL_20_u2 319.995172 _CNV_A_R_LINEAR_____412_CM 0. 319.995172 DISPLAY_IDENTIFIER C_V_EGRV_MAX_AD_TOL_0_ FORMAT "%5.2" /end CHARACTERISTIC
/begin CHARACTERISTIC c_v_egrv_min_ad_tol[0] "" VALUE 0x85c222 _REC_VAL_20_u2 319.995172 _CNV_A_R_LINEAR_____412_CM 0. 319.995172 DISPLAY_IDENTIFIER C_V_EGRV_MIN_AD_TOL_0_ FORMAT "%5.2" /end CHARACTERISTIC
/begin CHARACTERISTIC c_v_egrv_bol_sub[0] "" VALUE 0x85c210 _REC_VAL_20_u2 319.995172 _CNV_A_R_LINEAR_____412_CM 0. 319.995172 DISPLAY_IDENTIFIER C_V_EGRV_BOL_SUB_0_ FORMAT "%5.2" /end CHARACTERISTIC
/begin CHARACTERISTIC lc_v_egrv_bol_sub[0] "" VALUE 0x85c37f _REC_VAL_20_u1 1. _CNV_A_R_LINEAR_____0_CM 0. 1. DISPLAY_IDENTIFIER LC_V_EGRV_BOL_SUB_0_ FORMAT "%1.0" /end CHARACTERISTIC
/begin CHARACTERISTIC c_ang_sp_ad_egrv_bol[0] "" VALUE 0x85bcda _REC_VAL_20_u2 99.99847412109381 _CNV_A_R_LINEAR_____8_CM 0. 99.99847412109381 DISPLAY_IDENTIFIER C_ANG_SP_AD_EGRV_BOL_0_ FORMAT "%5.3" /end CHARACTERISTIC
/begin CHARACTERISTIC c_temp_st_ad_egrv_max[0] "" VALUE 0x85c179 _REC_VAL_20_u1 255. _CNV_A_R_LINEAR_____18_CM -50. 205. DISPLAY_IDENTIFIER C_TEMP_ST_AD_EGRV_MAX_0_ FORMAT "%4.1" /end CHARACTERISTIC
/begin CHARACTERISTIC c_v_grd_egrv_st_ad_bol[0] "" VALUE 0x85c22c _REC_VAL_20_u1 124.511719 _CNV_A_R_LINEAR_____413_CM 0. 124.511719 DISPLAY_IDENTIFIER C_V_GRD_EGRV_ST_AD_BOL_0_ FORMAT "%4.1" /end CHARACTERISTIC
/begin CHARACTERISTIC c_temp_st_ad_egrv_min[0] "" VALUE 0x85c17a _REC_VAL_20_u1 255. _CNV_A_R_LINEAR_____18_CM -50. 205. DISPLAY_IDENTIFIER C_TEMP_ST_AD_EGRV_MIN_0_ FORMAT "%4.1" /end CHARACTERISTIC
/begin CHARACTERISTIC c_t_ad_egrv_bol[0] "" VALUE 0x85c084 _REC_VAL_20_u2 65.535 _CNV_A_R_LINEAR_____76_CM 0. 65.535 DISPLAY_IDENTIFIER C_T_AD_EGRV_BOL_0_ FORMAT "%5.3" /end CHARACTERISTIC
/begin CHARACTERISTIC c_ang_sp_ad_egrv_tol[0] "" VALUE 0x85bcdc _REC_VAL_20_u2 99.99847412109381 _CNV_A_R_LINEAR_____8_CM 0. 99.99847412109381 DISPLAY_IDENTIFIER C_ANG_SP_AD_EGRV_TOL_0_ FORMAT "%5.3" /end CHARACTERISTIC
/begin CHARACTERISTIC c_v_grd_egrv_st_ad_tol[0] "" VALUE 0x85c22d _REC_VAL_20_u1 124.511719 _CNV_A_R_LINEAR_____413_CM 0. 124.511719 DISPLAY_IDENTIFIER C_V_GRD_EGRV_ST_AD_TOL_0_ FORMAT "%4.1" /end CHARACTERISTIC
/begin CHARACTERISTIC c_t_ad_egrv_tol[0] "" VALUE 0x85c088 _REC_VAL_20_u2 65.535 _CNV_A_R_LINEAR_____76_CM 0. 65.535 DISPLAY_IDENTIFIER C_T_AD_EGRV_TOL_0_ FORMAT "%5.3" /end CHARACTERISTIC
/begin CHARACTERISTIC c_v_egrv_min_ad_bol[0] "" VALUE 0x85c220 _REC_VAL_20_u2 319.995172 _CNV_A_R_LINEAR_____412_CM 0. 319.995172 DISPLAY_IDENTIFIER C_V_EGRV_MIN_AD_BOL_0_ FORMAT "%5.2" /end CHARACTERISTIC
/begin CHARACTERISTIC c_v_egrv_max_ad_bol[0] "" VALUE 0x85c214 _REC_VAL_20_u2 319.995172 _CNV_A_R_LINEAR_____412_CM 0. 319.995172 DISPLAY_IDENTIFIER C_V_EGRV_MAX_AD_BOL_0_ FORMAT "%5.2" /end CHARACTERISTIC
/begin AXIS_PTS ldp_t_ad_egrv_tol__ip_ad_egrv "" 0x8425ea t_ad_egrv_tol_av[0] _REC_AXS_20_u2 65.535 _CNV_A_R_LINEAR_____76_CM 4 0. 65.535 FORMAT "%5.3" /end AXIS_PTS
/begin AXIS_PTS ldp_t_ad_egrv_bol__ip_ad_egrv "" 0x8425e0 t_ad_egrv_bol_av[0] _REC_AXS_20_u2 65.535 _CNV_A_R_LINEAR_____76_CM 4 0. 65.535 FORMAT "%5.3" /end AXIS_PTS
/begin CHARACTERISTIC id_ad_egrv_tol__t_ad_egrv "EGRV_AD: control values for adaption (TOL)" CURVE 0x8488e0 _REC_CUR_20_u2_u2 199.9969482 _CNV_A_R_LINEAR_____158_CM -100. 99.99694820000001 DISPLAY_IDENTIFIER ID_AD_EGRV_TOL__T_AD_EGRV FORMAT "%6.4"
 /begin AXIS_DESCR COM_AXIS t_ad_egrv_tol_av[0] _CNV_A_R_LINEAR_____76_CM 4 0. 65.535 FORMAT "%5.3" AXIS_PTS_REF ldp_t_ad_egrv_tol__ip_ad_egrv /end AXIS_DESCR
/end CHARACTERISTIC
/begin CHARACTERISTIC id_ad_egrv_bol__t_ad_egrv "EGRV_AD: control values for adaption (BOL)" CURVE 0x8488d8 _REC_CUR_20_u2_u2 199.9969482 _CNV_A_R_LINEAR_____158_CM -100. 99.99694820000001 DISPLAY_IDENTIFIER ID_AD_EGRV_BOL__T_AD_EGRV FORMAT "%6.4"
 /begin AXIS_DESCR COM_AXIS t_ad_egrv_bol_av[0] _CNV_A_R_LINEAR_____76_CM 4 0. 65.535 FORMAT "%5.3" AXIS_PTS_REF ldp_t_ad_egrv_bol__ip_ad_egrv /end AXIS_DESCR
/end CHARACTERISTIC
/begin MEASUREMENT lv_ad_egrv[0] "" UBYTE _CNV_A_R_LINEAR_____0_CM 1 0. 0. 1. DISPLAY_IDENTIFIER LV_AD_EGRV_0_ ECU_ADDRESS 0x7fb47f FORMAT "%1.0" /end MEASUREMENT
/begin CHARACTERISTIC c_vb_max_ad_egrv "" VALUE 0x85c2af _REC_VAL_20_u1 28.8 _CNV_A_R_LINEAR_____48_CM 0. 28.8 DISPLAY_IDENTIFIER C_VB_MAX_AD_EGRV FORMAT "%3.1" /end CHARACTERISTIC
/begin CHARACTERISTIC c_vb_min_ad_egrv "" VALUE 0x85c2b3 _REC_VAL_20_u1 28.8 _CNV_A_R_LINEAR_____48_CM 0. 28.8 DISPLAY_IDENTIFIER C_VB_MIN_AD_EGRV FORMAT "%3.1" /end CHARACTERISTIC
/begin MEASUREMENT lv_intv_egrv[0] "" UBYTE _CNV_A_R_LINEAR_____0_CM 1 0. 0. 1. DISPLAY_IDENTIFIER LV_INTV_EGRV_0_ ECU_ADDRESS 0x7fb4a1 FORMAT "%1.0" /end MEASUREMENT
/begin MEASUREMENT lv_ang_sp_egrv_intv[0] "" UBYTE _CNV_A_R_LINEAR_____0_CM 1 0. 0. 1. DISPLAY_IDENTIFIER LV_ANG_SP_EGRV_INTV_0_ ECU_ADDRESS 0x7fb4a2 FORMAT "%1.0" /end MEASUREMENT
/begin MEASUREMENT ang_sp_egrv_intv[0] "" UWORD _CNV_A_R_LINEAR_____8_CM 1 0. 0. 99.99847412109381 DISPLAY_IDENTIFIER ANG_SP_EGRV_INTV_0_ ECU_ADDRESS 0x7f9900 BYTE_ORDER MSB_LAST FORMAT "%6.2" /end MEASUREMENT
/begin MEASUREMENT intv_egrv[0] "" SWORD _CNV_A_R_LINEAR_____12_CM 1 0. -100. 99.996948242 DISPLAY_IDENTIFIER INTV_EGRV_0_ ECU_ADDRESS 0x7f98fe BYTE_ORDER MSB_LAST FORMAT "%6.2" /end MEASUREMENT
/begin MEASUREMENT bpapwm_pctl_bas_tco_0 "uncorrected basic boost pressure adjustment precontrol (inj. state GES=0)" UWORD _CNV_A_R_LINEAR_____201_CM 1 0. 0. 99.972117 DISPLAY_IDENTIFIER BPAPWM_PCTL_BAS_TCO_0 ECU_ADDRESS 0x7fa670 BYTE_ORDER MSB_LAST FORMAT "%5.3" /end MEASUREMENT
/begin MEASUREMENT bpapwm_pctl_bas_tco_1 "uncorrected basic boost pressure adjustment precontrol (inj. state GES=1)" UWORD _CNV_A_R_LINEAR_____201_CM 1 0. 0. 99.972117 DISPLAY_IDENTIFIER BPAPWM_PCTL_BAS_TCO_1 ECU_ADDRESS 0x7fa672 BYTE_ORDER MSB_LAST FORMAT "%5.3" /end MEASUREMENT
/begin MEASUREMENT bpapwm_pctl_stat_mpg "boost pressure adjustment precontrol, steady state (map based)" UWORD _CNV_A_R_LINEAR_____201_CM 1 0. 0. 99.972117 DISPLAY_IDENTIFIER BPAPWM_PCTL_STAT_MPG ECU_ADDRESS 0x7fa65a BYTE_ORDER MSB_LAST FORMAT "%5.3" /end MEASUREMENT
/begin MEASUREMENT bpapwm_pctl_stat "boost pressure adjustment precontrol, steady state" UWORD _CNV_A_R_LINEAR_____201_CM 1 0. 0. 99.972117 DISPLAY_IDENTIFIER BPAPWM_PCTL_STAT ECU_ADDRESS 0x7fa668 BYTE_ORDER MSB_LAST FORMAT "%5.3" /end MEASUREMENT
/begin MEASUREMENT bpapwm_pctl_stat_mdl "boost pressure adjustment precontrol, steady state (map based)" UWORD _CNV_A_R_LINEAR_____201_CM 1 0. 0. 99.972117 DISPLAY_IDENTIFIER BPAPWM_PCTL_STAT_MDL ECU_ADDRESS 0x7fa66a BYTE_ORDER MSB_LAST FORMAT "%5.3" /end MEASUREMENT
/begin MEASUREMENT bpapwm_pctl_bas_0 "basic boost pressure adjustment precontrol (inj. state GES = 0)" UWORD _CNV_A_R_LINEAR_____201_CM 1 0. 0. 99.972117 DISPLAY_IDENTIFIER BPAPWM_PCTL_BAS_0 ECU_ADDRESS 0x7fa66c BYTE_ORDER MSB_LAST FORMAT "%5.3" /end MEASUREMENT
/begin MEASUREMENT bpapwm_pctl_bas_1 "basic boost pressure adjustment precontrol (inj. state GES = 1)" UWORD _CNV_A_R_LINEAR_____201_CM 1 0. 0. 99.972117 DISPLAY_IDENTIFIER BPAPWM_PCTL_BAS_1 ECU_ADDRESS 0x7fa66e BYTE_ORDER MSB_LAST FORMAT "%5.3" /end MEASUREMENT
/begin MEASUREMENT bpapwm_pctl_unlim "boost pressure adjustment precontrol" UWORD _CNV_A_R_LINEAR_____201_CM 1 0. 0. 99.972117 DISPLAY_IDENTIFIER BPAPWM_PCTL_UNLIM ECU_ADDRESS 0x7fa658 BYTE_ORDER MSB_LAST FORMAT "%5.3" /end MEASUREMENT
/begin MEASUREMENT bpapwm_pctl_tra "transient precontroller of BPAPWM" SWORD _CNV_A_R_LINEAR_____12_CM 1 0. -100. 99.996948242 DISPLAY_IDENTIFIER BPAPWM_PCTL_TRA ECU_ADDRESS 0x7fa65c BYTE_ORDER MSB_LAST FORMAT "%5.3" /end MEASUREMENT
/begin MEASUREMENT bpapwm_pctl_tqi "transient TQI correction for BPAPWM" SWORD _CNV_A_R_LINEAR_____12_CM 1 0. -100. 99.996948242 DISPLAY_IDENTIFIER BPAPWM_PCTL_TQI ECU_ADDRESS 0x7fa65e BYTE_ORDER MSB_LAST FORMAT "%5.3" /end MEASUREMENT
/begin MEASUREMENT kr_dt1_bpa_tqi "gain value for dynamic BPA on TQI" SWORD _CNV_A_R_LINEAR_____418_CM 1 0. -3.2768 3.2767 DISPLAY_IDENTIFIER KR_DT1_BPA_TQI ECU_ADDRESS 0x7fa660 BYTE_ORDER MSB_LAST FORMAT "%5.4" /end MEASUREMENT
/begin MEASUREMENT bpapwm_pctl_maf "transient MAF correction for BPAPWM" SWORD _CNV_A_R_LINEAR_____12_CM 1 0. -100. 99.996948242 DISPLAY_IDENTIFIER BPAPWM_PCTL_MAF ECU_ADDRESS 0x7fa662 BYTE_ORDER MSB_LAST FORMAT "%5.3" /end MEASUREMENT
/begin MEASUREMENT kr_dt1_bpa_maf "gain value for dynamic BPA on MAF_KGH" SWORD _CNV_A_R_LINEAR_____419_CM 1 0. -0.4096 0.409588 DISPLAY_IDENTIFIER KR_DT1_BPA_MAF ECU_ADDRESS 0x7fa664 BYTE_ORDER MSB_LAST FORMAT "%6.5" /end MEASUREMENT
/begin MEASUREMENT bpapwm_max "maximum limitation for BPAPWM" UWORD _CNV_A_R_LINEAR_____201_CM 1 0. 0. 99.972117 DISPLAY_IDENTIFIER BPAPWM_MAX ECU_ADDRESS 0x7f9824 BYTE_ORDER MSB_LAST FORMAT "%5.3" /end MEASUREMENT
/begin MEASUREMENT bpapwm_min "minimum limitation for BPAPWM" UWORD _CNV_A_R_LINEAR_____201_CM 1 0. 0. 99.972117 DISPLAY_IDENTIFIER BPAPWM_MIN ECU_ADDRESS 0x7f9826 BYTE_ORDER MSB_LAST FORMAT "%5.3" /end MEASUREMENT
/begin MEASUREMENT bpapwm_ctl_min "min. output of the BPA controller" SWORD _CNV_A_R_LINEAR_____12_CM 1 0. -100. 99.996948242 DISPLAY_IDENTIFIER BPAPWM_CTL_MIN ECU_ADDRESS 0x7f9828 BYTE_ORDER MSB_LAST FORMAT "%5.3" /end MEASUREMENT
/begin MEASUREMENT bpapwm_ctl_max "max. output of the BPA controller" SWORD _CNV_A_R_LINEAR_____12_CM 1 0. -100. 99.996948242 DISPLAY_IDENTIFIER BPAPWM_CTL_MAX ECU_ADDRESS 0x7f982a BYTE_ORDER MSB_LAST FORMAT "%5.3" /end MEASUREMENT
/begin MEASUREMENT bpapwm_pctl "precontrol value for boost pressure adjustment" UWORD _CNV_A_R_LINEAR_____201_CM 1 0. 0. 99.972117 DISPLAY_IDENTIFIER BPAPWM_PCTL ECU_ADDRESS 0x7f9822 BYTE_ORDER MSB_LAST FORMAT "%5.3" /end MEASUREMENT
/begin MEASUREMENT bpapwm_lim_dyn "dynamic correction of BPAPWM limitation" SWORD _CNV_A_R_LINEAR_____12_CM 1 0. -100. 99.996948242 DISPLAY_IDENTIFIER BPAPWM_LIM_DYN ECU_ADDRESS 0x7fa666 BYTE_ORDER MSB_LAST FORMAT "%5.3" /end MEASUREMENT
/begin CHARACTERISTIC lc_bpapwm_pctl_stat_mpg "button for boost pressure adjustment precontrol via maps" VALUE 0x85c2fd _REC_VAL_20_u1 1. _CNV_A_R_LINEAR_____0_CM 0. 1. DISPLAY_IDENTIFIER LC_BPAPWM_PCTL_STAT_MPG FORMAT "%1.0" /end CHARACTERISTIC
/begin CHARACTERISTIC lc_bpapwm_pctl_dev "activation button for BPA precontroller during development" VALUE 0x85c2fc _REC_VAL_20_u1 1. _CNV_A_R_LINEAR_____0_CM 0. 1. DISPLAY_IDENTIFIER LC_BPAPWM_PCTL_DEV FORMAT "%1.0" /end CHARACTERISTIC
/begin CHARACTERISTIC c_fac_bpapwm_pctl_dev "boost pressure precontrol: factor for development" VALUE 0x85be14 _REC_VAL_20_u2 1.9999696 _CNV_A_R_LINEAR_____53_CM 0. 1.9999696 DISPLAY_IDENTIFIER C_FAC_BPAPWM_PCTL_DEV FORMAT "%6.5" /end CHARACTERISTIC
/begin CHARACTERISTIC c_bpapwm_pctl_dev "boost pressure actuator precontrol for development" VALUE 0x85bd1a _REC_VAL_20_s2 199.996948242 _CNV_A_R_LINEAR_____12_CM -100. 99.996948242 DISPLAY_IDENTIFIER C_BPAPWM_PCTL_DEV FORMAT "%5.3" /end CHARACTERISTIC
/begin CHARACTERISTIC lc_bpa_dt1_tqi_on "activation button for interference block TQI" VALUE 0x85c2f8 _REC_VAL_20_u1 1. _CNV_A_R_LINEAR_____0_CM 0. 1. DISPLAY_IDENTIFIER LC_BPA_DT1_TQI_ON FORMAT "%1.0" /end CHARACTERISTIC
/begin CHARACTERISTIC c_t2_dt1_bpa_tqi "(T1) time value for dynamic BPA on tqi" VALUE 0x85c06e _REC_VAL_20_u2 4.19424 _CNV_A_R_LINEAR_____67_CM 0. 4.19424 DISPLAY_IDENTIFIER C_T2_DT1_BPA_TQI FORMAT "%6.5" /end CHARACTERISTIC
/begin CHARACTERISTIC c_fac_bpa_dt1_tqi_fil_0 "filter factor for transient precontrol BPA (TQI)" VALUE 0x85be04 _REC_VAL_20_u2 0.9999847412109381 _CNV_A_R_LINEAR_____14_CM 0. 0.9999847412109381 DISPLAY_IDENTIFIER C_FAC_BPA_DT1_TQI_FIL_0 FORMAT "%6.5" /end CHARACTERISTIC
/begin CHARACTERISTIC c_fac_bpa_dt1_tqi_fil_1 "filter factor for transient precontrol BPA (TQI)" VALUE 0x85be06 _REC_VAL_20_u2 0.9999847412109381 _CNV_A_R_LINEAR_____14_CM 0. 0.9999847412109381 DISPLAY_IDENTIFIER C_FAC_BPA_DT1_TQI_FIL_1 FORMAT "%6.5" /end CHARACTERISTIC
/begin CHARACTERISTIC c_bpapwm_tqi_dt1_min "min. value for transient precontrol BPA (TQI)" VALUE 0x85bd1e _REC_VAL_20_s2 199.996948242 _CNV_A_R_LINEAR_____12_CM -100. 99.996948242 DISPLAY_IDENTIFIER C_BPAPWM_TQI_DT1_MIN FORMAT "%5.3" /end CHARACTERISTIC
/begin CHARACTERISTIC c_bpapwm_tqi_dt1_max "max. value for transient precontrol BPA (TQI)" VALUE 0x85bd1c _REC_VAL_20_s2 199.996948242 _CNV_A_R_LINEAR_____12_CM -100. 99.996948242 DISPLAY_IDENTIFIER C_BPAPWM_TQI_DT1_MAX FORMAT "%5.3" /end CHARACTERISTIC
/begin CHARACTERISTIC c_t2_dt1_bpa_maf "(T1) time value for dynamic BPA on maf" VALUE 0x85c06c _REC_VAL_20_u2 16.77696 _CNV_A_R_LINEAR_____420_CM 0. 16.77696 DISPLAY_IDENTIFIER C_T2_DT1_BPA_MAF FORMAT "%6.4" /end CHARACTERISTIC
/begin CHARACTERISTIC lc_bpa_dt1_maf_on "activation button for interference block MAF" VALUE 0x85c2f6 _REC_VAL_20_u1 1. _CNV_A_R_LINEAR_____0_CM 0. 1. DISPLAY_IDENTIFIER LC_BPA_DT1_MAF_ON FORMAT "%1.0" /end CHARACTERISTIC
/begin CHARACTERISTIC c_fac_bpa_dt1maf1_fil "filter factor for MAF-DT1" VALUE 0x85be08 _REC_VAL_20_u2 0.9999847412109381 _CNV_A_R_LINEAR_____14_CM 0. 0.9999847412109381 DISPLAY_IDENTIFIER C_FAC_BPA_DT1MAF1_FIL FORMAT "%6.5" /end CHARACTERISTIC
/begin CHARACTERISTIC c_fac_bpa_dt1maf2_fil "filter factor for MAF-DT1" VALUE 0x85be0a _REC_VAL_20_u2 0.9999847412109381 _CNV_A_R_LINEAR_____14_CM 0. 0.9999847412109381 DISPLAY_IDENTIFIER C_FAC_BPA_DT1MAF2_FIL FORMAT "%6.5" /end CHARACTERISTIC
/begin CHARACTERISTIC c_bpapwm_maf_dt1_max "C_BPAPWM_MAF_DT1_MAX" VALUE 0x85bd12 _REC_VAL_20_s2 199.996948242 _CNV_A_R_LINEAR_____12_CM -100. 99.996948242 DISPLAY_IDENTIFIER C_BPAPWM_MAF_DT1_MAX FORMAT "%5.3" /end CHARACTERISTIC
/begin CHARACTERISTIC c_bpapwm_maf_dt1_min "C_BPAPWM_MAF_DT1_MIN" VALUE 0x85bd14 _REC_VAL_20_s2 199.996948242 _CNV_A_R_LINEAR_____12_CM -100. 99.996948242 DISPLAY_IDENTIFIER C_BPAPWM_MAF_DT1_MIN FORMAT "%5.3" /end CHARACTERISTIC
/begin CHARACTERISTIC c_fac_bpapwm_dyn "C_FAC_BPAPWM_DYN" VALUE 0x85be12 _REC_VAL_20_u2 0.9999847412109381 _CNV_A_R_LINEAR_____14_CM 0. 0.9999847412109381 DISPLAY_IDENTIFIER C_FAC_BPAPWM_DYN FORMAT "%6.5" /end CHARACTERISTIC
/begin CHARACTERISTIC c_t1_td1_bpapwm_dyn "C_T1_TD1_BPAPWM_DYN" VALUE 0x85c06a _REC_VAL_20_u2 4.19424 _CNV_A_R_LINEAR_____67_CM 0. 4.19424 DISPLAY_IDENTIFIER C_T1_TD1_BPAPWM_DYN FORMAT "%6.5" /end CHARACTERISTIC
/begin CHARACTERISTIC c_bpapwm_lim_dyn_max "maximum actuator limitation value" VALUE 0x85bd10 _REC_VAL_20_u2 99.972117 _CNV_A_R_LINEAR_____201_CM 0. 99.972117 DISPLAY_IDENTIFIER C_BPAPWM_LIM_DYN_MAX FORMAT "%5.3" /end CHARACTERISTIC
/begin CHARACTERISTIC c_kr_td1_bpapwm_dyn "gain for transient correction of the BPA- limits" VALUE 0x85beae _REC_VAL_20_s2 13.107 _CNV_A_R_LINEAR_____421_CM -6.5536 6.5534 DISPLAY_IDENTIFIER C_KR_TD1_BPAPWM_DYN FORMAT "%5.4" /end CHARACTERISTIC
/begin CHARACTERISTIC ip_bpapwm_pctl_stat_mdl "BPA_PRE: BPA precontrol value from model" CURVE 0x84a04a _REC_CUR_20_u2_u2 99.972117 _CNV_A_R_LINEAR_____201_CM 0. 99.972117 DISPLAY_IDENTIFIER IP_BPAPWM_PCTL_STAT_MDL FORMAT "%5.3"
 /begin AXIS_DESCR COM_AXIS bpa_psn_sp_mmv _CNV_A_R_LINEAR_____201_CM 16 0. 99.972117 FORMAT "%5.3" AXIS_PTS_REF ldp_bpa_pos_sp /end AXIS_DESCR
/end CHARACTERISTIC
/begin AXIS_PTS ldp_bpa_pos_sp "" 0x841402 bpa_psn_sp_mmv _REC_AXS_20_u2 99.972117 _CNV_A_R_LINEAR_____201_CM 16 0. 99.972117 FORMAT "%5.3" /end AXIS_PTS
/begin CHARACTERISTIC ip_fac_tran_bpapwm_pctl_0 "BPA_PRE: transition factor for the basic BPA precontrol (inj. region 0)" CURVE 0x84c88e _REC_CUR_20_u2_u1 1.9999696 _CNV_A_R_LINEAR_____53_CM 0. 1.9999696 DISPLAY_IDENTIFIER IP_FAC_TRAN_BPAPWM_PCTL_0 FORMAT "%6.5"
 /begin AXIS_DESCR COM_AXIS tco _CNV_A_R_LINEAR_____18_CM 8 -50. 205. FORMAT "%3.0" AXIS_PTS_REF ldp_tco_ip_fac_tran_bpapwm_0 /end AXIS_DESCR
/end CHARACTERISTIC
/begin AXIS_PTS ldp_tco_ip_fac_tran_bpapwm_0 "" 0x84277f tco _REC_AXS_20_u1 255. _CNV_A_R_LINEAR_____18_CM 8 -50. 205. FORMAT "%3.0" /end AXIS_PTS
/begin CHARACTERISTIC ip_fac_bpapwm_pctl_cor_amp_0 "BPA_PRE: BPA- precontrol correction factor for ambient pressure (inj. region GES = 0)" CURVE 0x84b916 _REC_CUR_20_u2_u2 0.9999847412109381 _CNV_A_R_LINEAR_____14_CM 0. 0.9999847412109381 DISPLAY_IDENTIFIER IP_FAC_BPAPWM_PCTL_COR_AMP_0 FORMAT "%6.5"
 /begin AXIS_DESCR COM_AXIS amp _CNV_A_R_LINEAR_____21_CM 8 0. 5434. FORMAT "%6.2" AXIS_PTS_REF ldp_amp_ip_fac_bpapwm_pctl_0 /end AXIS_DESCR
/end CHARACTERISTIC
/begin AXIS_PTS ldp_amp_ip_fac_bpapwm_pctl_0 "" 0x8410a4 amp _REC_AXS_20_u2 5434. _CNV_A_R_LINEAR_____21_CM 8 0. 5434. FORMAT "%6.2" /end AXIS_PTS
/begin CHARACTERISTIC ip_fac_bpapwm_pctl_cor_tgas_0 "BPA_PRE: BPA- precontrol correction factor for temperature of the intake air (inj. region GES = 0)" CURVE 0x84b936 _REC_CUR_20_u2_u1 0.9999847412109381 _CNV_A_R_LINEAR_____14_CM 0. 0.9999847412109381 DISPLAY_IDENTIFIER IP_FAC_BPAPWM_PCTL_COR_TGAS_0 FORMAT "%6.5"
 /begin AXIS_DESCR COM_AXIS tgas _CNV_A_R_LINEAR_____18_CM 8 -50. 205. FORMAT "%3.0" AXIS_PTS_REF ldp_tgas_ip_fac_bpapwm_pctl_0 /end AXIS_DESCR
/end CHARACTERISTIC
/begin AXIS_PTS ldp_tgas_ip_fac_bpapwm_pctl_0 "" 0x8428fc tgas _REC_AXS_20_u1 255. _CNV_A_R_LINEAR_____18_CM 8 -50. 205. FORMAT "%3.0" /end AXIS_PTS
/begin CHARACTERISTIC ip_fac_tran_bpapwm_pctl_1 "BPA_PRE: transition factor for the basic BPA precontrol (inj. region 1)" CURVE 0x84c89e _REC_CUR_20_u2_u1 1.9999696 _CNV_A_R_LINEAR_____53_CM 0. 1.9999696 DISPLAY_IDENTIFIER IP_FAC_TRAN_BPAPWM_PCTL_1 FORMAT "%6.5"
 /begin AXIS_DESCR COM_AXIS tco _CNV_A_R_LINEAR_____18_CM 8 -50. 205. FORMAT "%3.0" AXIS_PTS_REF ldp_tco_ip_fac_tran_bpapwm_1 /end AXIS_DESCR
/end CHARACTERISTIC
/begin AXIS_PTS ldp_tco_ip_fac_tran_bpapwm_1 "" 0x842788 tco _REC_AXS_20_u1 255. _CNV_A_R_LINEAR_____18_CM 8 -50. 205. FORMAT "%3.0" /end AXIS_PTS
/begin CHARACTERISTIC ip_fac_bpapwm_pctl_cor_amp_1 "BPA_PRE: BPA- precontrol correction factor for ambient pressure (inj. region GES = 1)" CURVE 0x84b926 _REC_CUR_20_u2_u2 0.9999847412109381 _CNV_A_R_LINEAR_____14_CM 0. 0.9999847412109381 DISPLAY_IDENTIFIER IP_FAC_BPAPWM_PCTL_COR_AMP_1 FORMAT "%6.5"
 /begin AXIS_DESCR COM_AXIS amp _CNV_A_R_LINEAR_____21_CM 8 0. 5434. FORMAT "%6.2" AXIS_PTS_REF ldp_amp_ip_fac_bpapwm_pctl_1 /end AXIS_DESCR
/end CHARACTERISTIC
/begin AXIS_PTS ldp_amp_ip_fac_bpapwm_pctl_1 "" 0x8410b6 amp _REC_AXS_20_u2 5434. _CNV_A_R_LINEAR_____21_CM 8 0. 5434. FORMAT "%6.2" /end AXIS_PTS
/begin CHARACTERISTIC ip_fac_bpapwm_pctl_cor_tgas_1 "BPA_PRE: BPA- precontrol correction factor for temperature of the intake air (inj. region GES = 1)" CURVE 0x84b946 _REC_CUR_20_u2_u1 0.9999847412109381 _CNV_A_R_LINEAR_____14_CM 0. 0.9999847412109381 DISPLAY_IDENTIFIER IP_FAC_BPAPWM_PCTL_COR_TGAS_1 FORMAT "%6.5"
 /begin AXIS_DESCR COM_AXIS tgas _CNV_A_R_LINEAR_____18_CM 8 -50. 205. FORMAT "%3.0" AXIS_PTS_REF ldp_tgas_ip_fac_bpapwm_pctl_1 /end AXIS_DESCR
/end CHARACTERISTIC
/begin AXIS_PTS ldp_tgas_ip_fac_bpapwm_pctl_1 "" 0x842905 tgas _REC_AXS_20_u1 255. _CNV_A_R_LINEAR_____18_CM 8 -50. 205. FORMAT "%3.0" /end AXIS_PTS
/begin CHARACTERISTIC ip_bpapwm_pctl_bas_0_1 "BPA_PRE: basic BPA precontrol value for warm engine (inj. region GES = 0)" MAP 0x849846 _REC_MAP_20_u2_u2_u2 100. _CNV_A_R_LINEAR_____136_CM 0. 100. DISPLAY_IDENTIFIER IP_BPAPWM_PCTL_BAS_0_1 FORMAT "%5.3"
 /begin AXIS_DESCR COM_AXIS n _CNV_A_R_LINEAR_____5_CM 16 0. 6375. FORMAT "%4.0" AXIS_PTS_REF ldpm_n_ip_bpapwm_pctl_0 /end AXIS_DESCR
 /begin AXIS_DESCR COM_AXIS tqi_bpa _CNV_A_R_LINEAR_____62_CM 16 0. 1023.96875 FORMAT "%6.2" AXIS_PTS_REF ldpm_tqi_ip_bpapwm_pctl_0 /end AXIS_DESCR
/end CHARACTERISTIC
/begin AXIS_PTS ldpm_n_ip_bpapwm_pctl_0 "" 0x843930 n _REC_AXS_20_u2 6375. _CNV_A_R_LINEAR_____5_CM 16 0. 6375. FORMAT "%4.0" /end AXIS_PTS
/begin AXIS_PTS ldpm_tqi_ip_bpapwm_pctl_0 "" 0x843f4a tqi_bpa _REC_AXS_20_u2 1023.96875 _CNV_A_R_LINEAR_____62_CM 16 0. 1023.96875 FORMAT "%6.2" /end AXIS_PTS
/begin CHARACTERISTIC ip_bpapwm_pctl_bas_0_2 "BPA_PRE: basic BPA precontrol value for cold engine (inj. region GES = 0)" MAP 0x849a46 _REC_MAP_20_u2_u2_u2 100. _CNV_A_R_LINEAR_____136_CM 0. 100. DISPLAY_IDENTIFIER IP_BPAPWM_PCTL_BAS_0_2 FORMAT "%5.3"
 /begin AXIS_DESCR COM_AXIS n _CNV_A_R_LINEAR_____5_CM 1 0. 6375. FORMAT "%4.0" AXIS_PTS_REF ldpm_n_ip_bpapwm_pctl_short /end AXIS_DESCR
 /begin AXIS_DESCR COM_AXIS tqi_bpa _CNV_A_R_LINEAR_____62_CM 1 0. 1023.96875 FORMAT "%6.2" AXIS_PTS_REF ldpm_tqi_ip_bpapwm_pctl_short /end AXIS_DESCR
/end CHARACTERISTIC
/begin CHARACTERISTIC ip_bpapwm_pctl_bas_0_0 "BPA_PRE: basic BPA precontrol value for hot engine (inj. region GES = 0)" MAP 0x849646 _REC_MAP_20_u2_u2_u2 100. _CNV_A_R_LINEAR_____136_CM 0. 100. DISPLAY_IDENTIFIER IP_BPAPWM_PCTL_BAS_0_0 FORMAT "%5.3"
 /begin AXIS_DESCR COM_AXIS n _CNV_A_R_LINEAR_____5_CM 16 0. 6375. FORMAT "%4.0" AXIS_PTS_REF ldpm_n_ip_bpapwm_pctl_0 /end AXIS_DESCR
 /begin AXIS_DESCR COM_AXIS tqi_bpa _CNV_A_R_LINEAR_____62_CM 16 0. 1023.96875 FORMAT "%6.2" AXIS_PTS_REF ldpm_tqi_ip_bpapwm_pctl_0 /end AXIS_DESCR
/end CHARACTERISTIC
/begin CHARACTERISTIC ip_bpapwm_pctl_cor_amp_0 "BPA_PRE: basic BPA precontrol correction map for ambient pressure (inj. region GES = 0)" MAP 0x849e4a _REC_MAP_20_u2_u2_u2 99.99847412 _CNV_A_R_LINEAR_____141_CM -50. 49.99847412 DISPLAY_IDENTIFIER IP_BPAPWM_PCTL_COR_AMP_0 FORMAT "%5.3"
 /begin AXIS_DESCR COM_AXIS n _CNV_A_R_LINEAR_____5_CM 8 0. 6375. FORMAT "%4.0" AXIS_PTS_REF ldp_n_ip_bpapwm_pctl_amp_0 /end AXIS_DESCR
 /begin AXIS_DESCR COM_AXIS tqi_bpa _CNV_A_R_LINEAR_____62_CM 8 0. 1023.96875 FORMAT "%6.2" AXIS_PTS_REF ldp_tqi_ip_bpapwm_pctl_amp_0 /end AXIS_DESCR
/end CHARACTERISTIC
/begin AXIS_PTS ldp_n_ip_bpapwm_pctl_amp_0 "" 0x84195a n _REC_AXS_20_u2 6375. _CNV_A_R_LINEAR_____5_CM 8 0. 6375. FORMAT "%4.0" /end AXIS_PTS
/begin AXIS_PTS ldp_tqi_ip_bpapwm_pctl_amp_0 "" 0x842a98 tqi_bpa _REC_AXS_20_u2 1023.96875 _CNV_A_R_LINEAR_____62_CM 8 0. 1023.96875 FORMAT "%6.2" /end AXIS_PTS
/begin CHARACTERISTIC ip_bpapwm_pctl_cor_tgas_0 "BPA_PRE: basic BPA precontrol correction map for temperature of the intake gas (inj. region GES = 0)" MAP 0x849f4a _REC_MAP_20_u2_u2_u2 99.99847412 _CNV_A_R_LINEAR_____141_CM -50. 49.99847412 DISPLAY_IDENTIFIER IP_BPAPWM_PCTL_COR_TGAS_0 FORMAT "%5.3"
 /begin AXIS_DESCR COM_AXIS n _CNV_A_R_LINEAR_____5_CM 8 0. 6375. FORMAT "%4.0" AXIS_PTS_REF ldp_n_ip_bpapwm_pctl_tgas_0 /end AXIS_DESCR
 /begin AXIS_DESCR COM_AXIS tqi_bpa _CNV_A_R_LINEAR_____62_CM 8 0. 1023.96875 FORMAT "%6.2" AXIS_PTS_REF ldp_tqi_ip_bpapwm_pctl_tgas_0 /end AXIS_DESCR
/end CHARACTERISTIC
/begin AXIS_PTS ldp_n_ip_bpapwm_pctl_tgas_0 "" 0x84197e n _REC_AXS_20_u2 6375. _CNV_A_R_LINEAR_____5_CM 8 0. 6375. FORMAT "%4.0" /end AXIS_PTS
/begin AXIS_PTS ldp_tqi_ip_bpapwm_pctl_tgas_0 "" 0x842abc tqi_bpa _REC_AXS_20_u2 1023.96875 _CNV_A_R_LINEAR_____62_CM 8 0. 1023.96875 FORMAT "%6.2" /end AXIS_PTS
/begin CHARACTERISTIC ip_bpapwm_pctl_bas_1_1 "BPA_PRE: basic BPA precontrol value for warm engine (inj. region GES = 1)" MAP 0x849c48 _REC_MAP_20_u2_u2_u2 100. _CNV_A_R_LINEAR_____136_CM 0. 100. DISPLAY_IDENTIFIER IP_BPAPWM_PCTL_BAS_1_1 FORMAT "%5.3"
 /begin AXIS_DESCR COM_AXIS n _CNV_A_R_LINEAR_____5_CM 16 0. 6375. FORMAT "%4.0" AXIS_PTS_REF ldpm_n_ip_bpapwm_pctl_1 /end AXIS_DESCR
 /begin AXIS_DESCR COM_AXIS tqi_bpa _CNV_A_R_LINEAR_____62_CM 16 0. 1023.96875 FORMAT "%6.2" AXIS_PTS_REF ldpm_tqi_ip_bpapwm_pctl_1 /end AXIS_DESCR
/end CHARACTERISTIC
/begin AXIS_PTS ldpm_n_ip_bpapwm_pctl_1 "" 0x843952 n _REC_AXS_20_u2 6375. _CNV_A_R_LINEAR_____5_CM 16 0. 6375. FORMAT "%4.0" /end AXIS_PTS
/begin AXIS_PTS ldpm_tqi_ip_bpapwm_pctl_1 "" 0x843f6c tqi_bpa _REC_AXS_20_u2 1023.96875 _CNV_A_R_LINEAR_____62_CM 16 0. 1023.96875 FORMAT "%6.2" /end AXIS_PTS
/begin CHARACTERISTIC ip_bpapwm_pctl_bas_1_2 "BPA_PRE: basic BPA precontrol value for cold engine (inj. region GES = 1)" MAP 0x849e48 _REC_MAP_20_u2_u2_u2 100. _CNV_A_R_LINEAR_____136_CM 0. 100. DISPLAY_IDENTIFIER IP_BPAPWM_PCTL_BAS_1_2 FORMAT "%5.3"
 /begin AXIS_DESCR COM_AXIS n _CNV_A_R_LINEAR_____5_CM 1 0. 6375. FORMAT "%4.0" AXIS_PTS_REF ldpm_n_ip_bpapwm_pctl_short /end AXIS_DESCR
 /begin AXIS_DESCR COM_AXIS tqi_bpa _CNV_A_R_LINEAR_____62_CM 1 0. 1023.96875 FORMAT "%6.2" AXIS_PTS_REF ldpm_tqi_ip_bpapwm_pctl_short /end AXIS_DESCR
/end CHARACTERISTIC
/begin CHARACTERISTIC ip_bpapwm_pctl_bas_1_0 "BPA_PRE: basic BPA precontrol value for hot engine (inj. region GES = 1)" MAP 0x849a48 _REC_MAP_20_u2_u2_u2 100. _CNV_A_R_LINEAR_____136_CM 0. 100. DISPLAY_IDENTIFIER IP_BPAPWM_PCTL_BAS_1_0 FORMAT "%5.3"
 /begin AXIS_DESCR COM_AXIS n _CNV_A_R_LINEAR_____5_CM 16 0. 6375. FORMAT "%4.0" AXIS_PTS_REF ldpm_n_ip_bpapwm_pctl_1 /end AXIS_DESCR
 /begin AXIS_DESCR COM_AXIS tqi_bpa _CNV_A_R_LINEAR_____62_CM 16 0. 1023.96875 FORMAT "%6.2" AXIS_PTS_REF ldpm_tqi_ip_bpapwm_pctl_1 /end AXIS_DESCR
/end CHARACTERISTIC
/begin CHARACTERISTIC ip_bpapwm_pctl_cor_amp_1 "BPA_PRE: basic BPA precontrol correction map for ambient pressure (inj. region GES = 1)" MAP 0x849eca _REC_MAP_20_u2_u2_u2 99.99847412 _CNV_A_R_LINEAR_____141_CM -50. 49.99847412 DISPLAY_IDENTIFIER IP_BPAPWM_PCTL_COR_AMP_1 FORMAT "%5.3"
 /begin AXIS_DESCR COM_AXIS n _CNV_A_R_LINEAR_____5_CM 8 0. 6375. FORMAT "%4.0" AXIS_PTS_REF ldp_n_ip_bpapwm_pctl_amp_1 /end AXIS_DESCR
 /begin AXIS_DESCR COM_AXIS tqi_bpa _CNV_A_R_LINEAR_____62_CM 8 0. 1023.96875 FORMAT "%6.2" AXIS_PTS_REF ldp_tqi_ip_bpapwm_pctl_amp_1 /end AXIS_DESCR
/end CHARACTERISTIC
/begin AXIS_PTS ldp_n_ip_bpapwm_pctl_amp_1 "" 0x84196c n _REC_AXS_20_u2 6375. _CNV_A_R_LINEAR_____5_CM 8 0. 6375. FORMAT "%4.0" /end AXIS_PTS
/begin AXIS_PTS ldp_tqi_ip_bpapwm_pctl_amp_1 "" 0x842aaa tqi_bpa _REC_AXS_20_u2 1023.96875 _CNV_A_R_LINEAR_____62_CM 8 0. 1023.96875 FORMAT "%6.2" /end AXIS_PTS
/begin CHARACTERISTIC ip_bpapwm_pctl_cor_tgas_1 "BPA_PRE: basic BPA precontrol correction map for temperature of the intake gas (inj. region GES = 1)" MAP 0x849fca _REC_MAP_20_u2_u2_u2 99.99847412 _CNV_A_R_LINEAR_____141_CM -50. 49.99847412 DISPLAY_IDENTIFIER IP_BPAPWM_PCTL_COR_TGAS_1 FORMAT "%5.3"
 /begin AXIS_DESCR COM_AXIS n _CNV_A_R_LINEAR_____5_CM 8 0. 6375. FORMAT "%4.0" AXIS_PTS_REF ldp_n_ip_bpapwm_pctl_tgas_1 /end AXIS_DESCR
 /begin AXIS_DESCR COM_AXIS tqi_bpa _CNV_A_R_LINEAR_____62_CM 8 0. 1023.96875 FORMAT "%6.2" AXIS_PTS_REF ldp_tqi_ip_bpapwm_pctl_tgas_1 /end AXIS_DESCR
/end CHARACTERISTIC
/begin AXIS_PTS ldp_n_ip_bpapwm_pctl_tgas_1 "" 0x841990 n _REC_AXS_20_u2 6375. _CNV_A_R_LINEAR_____5_CM 8 0. 6375. FORMAT "%4.0" /end AXIS_PTS
/begin AXIS_PTS ldp_tqi_ip_bpapwm_pctl_tgas_1 "" 0x842ace tqi_bpa _REC_AXS_20_u2 1023.96875 _CNV_A_R_LINEAR_____62_CM 8 0. 1023.96875 FORMAT "%6.2" /end AXIS_PTS
/begin CHARACTERISTIC ip_kr_dt1_bpa_tqi "BPA_PRE: gain value for dynamic bpa on tqi" MAP 0x84cc20 _REC_MAP_20_u2_u2_u2 6.5535 _CNV_A_R_LINEAR_____422_CM -3.2768 3.2767 DISPLAY_IDENTIFIER IP_KR_DT1_BPA_TQI FORMAT "%5.4"
 /begin AXIS_DESCR COM_AXIS n _CNV_A_R_LINEAR_____5_CM 8 0. 6375. FORMAT "%4.0" AXIS_PTS_REF ldp_n_ip_kr_dt1_bpa_tqi /end AXIS_DESCR
 /begin AXIS_DESCR COM_AXIS tqi_bpa _CNV_A_R_LINEAR_____62_CM 8 0. 1023.96875 FORMAT "%6.2" AXIS_PTS_REF ldp_tqi_ip_kr_dt1_bpa_tqi /end AXIS_DESCR
/end CHARACTERISTIC
/begin AXIS_PTS ldp_n_ip_kr_dt1_bpa_tqi "" 0x841a72 n _REC_AXS_20_u2 6375. _CNV_A_R_LINEAR_____5_CM 8 0. 6375. FORMAT "%4.0" /end AXIS_PTS
/begin AXIS_PTS ldp_tqi_ip_kr_dt1_bpa_tqi "" 0x842b3a tqi_bpa _REC_AXS_20_u2 1023.96875 _CNV_A_R_LINEAR_____62_CM 8 0. 1023.96875 FORMAT "%6.2" /end AXIS_PTS
/begin CHARACTERISTIC ip_kr_dt1_bpa_maf "BPA_PRE: gain value for dynamic bpa on maf" MAP 0x84cba0 _REC_MAP_20_u2_u2_u2 0.8191875 _CNV_A_R_LINEAR_____423_CM -0.4096 0.4095875 DISPLAY_IDENTIFIER IP_KR_DT1_BPA_MAF FORMAT "%6.5"
 /begin AXIS_DESCR COM_AXIS n _CNV_A_R_LINEAR_____5_CM 8 0. 6375. FORMAT "%4.0" AXIS_PTS_REF ldp_n_ip_kr_dt1_bpa_maf /end AXIS_DESCR
 /begin AXIS_DESCR COM_AXIS tqi_bpa _CNV_A_R_LINEAR_____62_CM 8 0. 1023.96875 FORMAT "%6.2" AXIS_PTS_REF ldp_tqi_ip_kr_dt1_bpa_maf /end AXIS_DESCR
/end CHARACTERISTIC
/begin AXIS_PTS ldp_n_ip_kr_dt1_bpa_maf "" 0x841a60 n _REC_AXS_20_u2 6375. _CNV_A_R_LINEAR_____5_CM 8 0. 6375. FORMAT "%4.0" /end AXIS_PTS
/begin AXIS_PTS ldp_tqi_ip_kr_dt1_bpa_maf "" 0x842b28 tqi_bpa _REC_AXS_20_u2 1023.96875 _CNV_A_R_LINEAR_____62_CM 8 0. 1023.96875 FORMAT "%6.2" /end AXIS_PTS
/begin CHARACTERISTIC ip_bpapwm_min "BPA_PRE: minimum actuator output" MAP 0x849446 _REC_MAP_20_u2_u2_u2 99.972117 _CNV_A_R_LINEAR_____201_CM 0. 99.972117 DISPLAY_IDENTIFIER IP_BPAPWM_MIN FORMAT "%5.3"
 /begin AXIS_DESCR COM_AXIS n _CNV_A_R_LINEAR_____5_CM 16 0. 6375. FORMAT "%4.0" AXIS_PTS_REF ldpm_n_ip_bpapwm_lim /end AXIS_DESCR
 /begin AXIS_DESCR COM_AXIS tqi_bpa _CNV_A_R_LINEAR_____62_CM 16 0. 1023.96875 FORMAT "%6.2" AXIS_PTS_REF ldpm_tqi_ip_bpapwm_lim /end AXIS_DESCR
/end CHARACTERISTIC
/begin AXIS_PTS ldpm_n_ip_bpapwm_lim "" 0x84390e n _REC_AXS_20_u2 6375. _CNV_A_R_LINEAR_____5_CM 16 0. 6375. FORMAT "%4.0" /end AXIS_PTS
/begin AXIS_PTS ldpm_tqi_ip_bpapwm_lim "" 0x843f28 tqi_bpa _REC_AXS_20_u2 1023.96875 _CNV_A_R_LINEAR_____62_CM 16 0. 1023.96875 FORMAT "%6.2" /end AXIS_PTS
/begin CHARACTERISTIC ip_bpapwm_max "BPA_PRE: maximum actuator output" MAP 0x849246 _REC_MAP_20_u2_u2_u2 99.972117 _CNV_A_R_LINEAR_____201_CM 0. 99.972117 DISPLAY_IDENTIFIER IP_BPAPWM_MAX FORMAT "%5.3"
 /begin AXIS_DESCR COM_AXIS n _CNV_A_R_LINEAR_____5_CM 16 0. 6375. FORMAT "%4.0" AXIS_PTS_REF ldpm_n_ip_bpapwm_lim /end AXIS_DESCR
 /begin AXIS_DESCR COM_AXIS tqi_bpa _CNV_A_R_LINEAR_____62_CM 16 0. 1023.96875 FORMAT "%6.2" AXIS_PTS_REF ldpm_tqi_ip_bpapwm_lim /end AXIS_DESCR
/end CHARACTERISTIC
/begin AXIS_PTS ldpm_n_ip_bpapwm_pctl_short "" 0x843974 n _REC_AXS_20_u2 6375. _CNV_A_R_LINEAR_____5_CM 1 0. 6375. FORMAT "%4.0" /end AXIS_PTS
/begin AXIS_PTS ldpm_tqi_ip_bpapwm_pctl_short "" 0x843f8e tqi_bpa _REC_AXS_20_u2 1023.96875 _CNV_A_R_LINEAR_____62_CM 1 0. 1023.96875 FORMAT "%6.2" /end AXIS_PTS
/begin CHARACTERISTIC c_bpa_pwm_man[0] "" VALUE 0x85bd02 _REC_VAL_20_u2 99.99847412109381 _CNV_A_R_LINEAR_____8_CM 0. 99.99847412109381 DISPLAY_IDENTIFIER C_BPA_0_PWM_MAN FORMAT "%6.4" /end CHARACTERISTIC
/begin CHARACTERISTIC c_bpa_pwm_man[1] "" VALUE 0x85bd04 _REC_VAL_20_u2 99.99847412109381 _CNV_A_R_LINEAR_____8_CM 0. 99.99847412109381 DISPLAY_IDENTIFIER C_BPA_1_PWM_MAN FORMAT "%6.4" /end CHARACTERISTIC
/begin CHARACTERISTIC lc_bpa_psn_ctl "" VALUE 0x85c2f9 _REC_VAL_20_u1 1. _CNV_A_R_LINEAR_____1_CM 0. 1. DISPLAY_IDENTIFIER LC_BPA_PSN_CTL FORMAT "%1.0" /end CHARACTERISTIC
/begin CHARACTERISTIC lc_bpapwm_ivs "" VALUE 0x85c2fa _REC_VAL_20_u1 1. _CNV_A_R_LINEAR_____0_CM 0. 1. DISPLAY_IDENTIFIER LC_BPAPWM_IVS FORMAT "%1.0" /end CHARACTERISTIC
/begin CHARACTERISTIC lc_bpapwm_man "" VALUE 0x85c2fb _REC_VAL_20_u1 1. _CNV_A_R_LINEAR_____0_CM 0. 1. DISPLAY_IDENTIFIER LC_BPAPWM_MAN FORMAT "%1.0" /end CHARACTERISTIC
/begin MEASUREMENT lv_bpapwm_lim_diag "" UBYTE _CNV_S_2_RANGE______11_CM 1 0. 0. 1. DISPLAY_IDENTIFIER LV_BPAPWM_LIM_DIAG ECU_ADDRESS 0x7fb48c /end MEASUREMENT
/begin MEASUREMENT bpa_pwm[0] "" UWORD _CNV_A_R_LINEAR_____8_CM 1 0. 0. 99.99847412109381 DISPLAY_IDENTIFIER BPA_PWM_0_ ECU_ADDRESS 0x7f9820 BYTE_ORDER MSB_LAST FORMAT "%5.2" /end MEASUREMENT
/begin MEASUREMENT bpa_pwm_bas[0] "" UWORD _CNV_A_R_LINEAR_____8_CM 1 0. 0. 99.99847412109381 DISPLAY_IDENTIFIER BPA_PWM_BAS_0_ ECU_ADDRESS 0x7f981e BYTE_ORDER MSB_LAST FORMAT "%5.2" /end MEASUREMENT
/begin MEASUREMENT fac_egrv_pwm_cor[0] "" UWORD _CNV_A_R_LINEAR_____15_CM 1 0. 0. 3.99993896484375 DISPLAY_IDENTIFIER FAC_EGRV_PWM_COR_0_ ECU_ADDRESS 0x7f9838 BYTE_ORDER MSB_LAST FORMAT "%5.4" /end MEASUREMENT
/begin CHARACTERISTIC c_fac_egrv_pwm_cor[0] "" VALUE 0x85be34 _REC_VAL_20_u2 3.99993896484375 _CNV_A_R_LINEAR_____15_CM 0. 3.99993896484375 DISPLAY_IDENTIFIER C_FAC_EGRV_0_PWM_COR FORMAT "%5.4" /end CHARACTERISTIC
/begin CHARACTERISTIC c_egrv_pwm_cor[0] "" VALUE 0x85bdee _REC_VAL_20_s2 199.99695 _CNV_A_R_LINEAR_____9_CM -100. 99.99695 DISPLAY_IDENTIFIER C_EGRV_0_PWM_COR FORMAT "%7.4" /end CHARACTERISTIC
/begin MEASUREMENT egrv_pwm_cor[0] "" SWORD _CNV_A_R_LINEAR_____9_CM 1 0. -100. 99.99695 DISPLAY_IDENTIFIER EGRV_PWM_COR_0_ ECU_ADDRESS 0x7f9834 BYTE_ORDER MSB_LAST FORMAT "%5.2" /end MEASUREMENT
/begin MEASUREMENT lv_egr_out_man "" UBYTE _CNV_S_2_RANGE______28_CM 1 0. 0. 1. DISPLAY_IDENTIFIER LV_EGR_OUT_MAN ECU_ADDRESS 0x7fb493 /end MEASUREMENT
/begin MEASUREMENT thr_pwm_cor[0] "" SWORD _CNV_A_R_LINEAR_____12_CM 1 0. -100. 99.996948242 DISPLAY_IDENTIFIER THR_PWM_COR_0_ ECU_ADDRESS 0x7f9836 BYTE_ORDER MSB_LAST FORMAT "%5.2" /end MEASUREMENT
/begin MEASUREMENT fac_thr_pwm_cor[0] "" UWORD _CNV_A_R_LINEAR_____15_CM 1 0. 0. 3.99993896484375 DISPLAY_IDENTIFIER FAC_THR_PWM_COR_0_ ECU_ADDRESS 0x7f983a BYTE_ORDER MSB_LAST FORMAT "%5.4" /end MEASUREMENT
/begin CHARACTERISTIC c_fac_thr_pwm_cor[0] "" VALUE 0x85be82 _REC_VAL_20_u2 3.99993896484375 _CNV_A_R_LINEAR_____15_CM 0. 3.99993896484375 DISPLAY_IDENTIFIER C_FAC_THR_0_PWM_COR FORMAT "%5.4" /end CHARACTERISTIC
/begin CHARACTERISTIC c_thr_pwm_cor[0] "" VALUE 0x85c19e _REC_VAL_20_s2 199.99695 _CNV_A_R_LINEAR_____9_CM -100. 99.99695 DISPLAY_IDENTIFIER C_THR_0_PWM_COR FORMAT "%7.4" /end CHARACTERISTIC
/begin CHARACTERISTIC lc_egr_out_man "" VALUE 0x85c31c _REC_VAL_20_u1 1. _CNV_A_R_LINEAR_____0_CM 0. 1. DISPLAY_IDENTIFIER LC_EGR_OUT_MAN FORMAT "%1.0" /end CHARACTERISTIC
/begin AXIS_PTS ldp_n_ip_egrvpwm "" 0x8419ea n _REC_AXS_20_u2 6375. _CNV_A_R_LINEAR_____5_CM 10 0. 6375. FORMAT "%4.0" /end AXIS_PTS
/begin AXIS_PTS ldp_mafpwm_ip_egrvpwm "" 0x8417c6 mafpwm _REC_AXS_20_u2 99.9969482421875 _CNV_A_R_LINEAR_____155_CM 16 0. 99.9969482421875 FORMAT "%4.2" /end AXIS_PTS
/begin CHARACTERISTIC ip_egrvpwm__n__mafpwm "EGRV_OUT: EGR-valve output" MAP 0x84b76a _REC_MAP_20_u2_u2_u2 99.99847412109381 _CNV_A_R_LINEAR_____8_CM 0. 99.99847412109381 DISPLAY_IDENTIFIER IP_EGRVPWM__N__MAFPWM FORMAT "%4.2"
 /begin AXIS_DESCR COM_AXIS n _CNV_A_R_LINEAR_____5_CM 10 0. 6375. FORMAT "%4.0" AXIS_PTS_REF ldp_n_ip_egrvpwm /end AXIS_DESCR
 /begin AXIS_DESCR COM_AXIS mafpwm _CNV_A_R_LINEAR_____155_CM 16 0. 99.9969482421875 FORMAT "%4.2" AXIS_PTS_REF ldp_mafpwm_ip_egrvpwm /end AXIS_DESCR
/end CHARACTERISTIC
/begin MEASUREMENT egrvpwm "" UWORD _CNV_A_R_LINEAR_____8_CM 1 0. 0. 99.99847412109381 DISPLAY_IDENTIFIER EGRVPWM ECU_ADDRESS 0x7f990a BYTE_ORDER MSB_LAST FORMAT "%4.2" /end MEASUREMENT
/begin MEASUREMENT egrv_pwm[0] "" UWORD _CNV_A_R_LINEAR_____8_CM 1 0. 0. 99.99847412109381 DISPLAY_IDENTIFIER EGRV_PWM_0_ ECU_ADDRESS 0x7f990c BYTE_ORDER MSB_LAST FORMAT "%5.2" /end MEASUREMENT
/begin AXIS_PTS ldp_ar_egrv_ip_egrvpwm "" 0x8413ce ar_egrv_ctl_the _REC_AXS_20_u2 78.08 _CNV_A_R_LINEAR_____7_CM 12 0. 78.08 FORMAT "%6.4" /end AXIS_PTS
/begin CHARACTERISTIC ip_egrvpwm__ar_egrv "EGRV_OUT: EGR-valve output as function of the cross section" CURVE 0x84b752 _REC_CUR_20_u2_u2 99.99847412109381 _CNV_A_R_LINEAR_____8_CM 0. 99.99847412109381 DISPLAY_IDENTIFIER IP_EGRVPWM__AR_EGRV FORMAT "%4.2"
 /begin AXIS_DESCR COM_AXIS ar_egrv_ctl_the _CNV_A_R_LINEAR_____7_CM 12 0. 78.08 FORMAT "%6.4" AXIS_PTS_REF ldp_ar_egrv_ip_egrvpwm /end AXIS_DESCR
/end CHARACTERISTIC
/begin MEASUREMENT lv_egrvpwm_lim_diag "" UBYTE _CNV_S_2_RANGE______11_CM 1 0. 0. 1. DISPLAY_IDENTIFIER LV_EGRVPWM_LIM_DIAG ECU_ADDRESS 0x7fba6a /end MEASUREMENT
/begin MEASUREMENT egrvpwm_egr "" UWORD _CNV_A_R_LINEAR_____8_CM 1 0. 0. 99.99847412109381 DISPLAY_IDENTIFIER EGRVPWM_EGR ECU_ADDRESS 0x7fba68 BYTE_ORDER MSB_LAST FORMAT "%4.2" /end MEASUREMENT
/begin CHARACTERISTIC c_egrv_pwm_man[0] "" VALUE 0x85bdf0 _REC_VAL_20_u2 99.99847412109381 _CNV_A_R_LINEAR_____8_CM 0. 99.99847412109381 DISPLAY_IDENTIFIER C_EGRV_0_PWM_MAN FORMAT "%5.3" /end CHARACTERISTIC
/begin CHARACTERISTIC c_egrv_pwm_man[1] "" VALUE 0x85bdf2 _REC_VAL_20_u2 99.99847412109381 _CNV_A_R_LINEAR_____8_CM 0. 99.99847412109381 DISPLAY_IDENTIFIER C_EGRV_1_PWM_MAN FORMAT "%5.3" /end CHARACTERISTIC
/begin CHARACTERISTIC c_fac_egrvpwm_es_close "" VALUE 0x85be36 _REC_VAL_20_u2 0.9999847412109381 _CNV_A_R_LINEAR_____14_CM 0. 0.9999847412109381 DISPLAY_IDENTIFIER C_FAC_EGRVPWM_ES_CLOSE FORMAT "%6.4" /end CHARACTERISTIC
/begin CHARACTERISTIC lc_egrv_psn_ctl "" VALUE 0x85c321 _REC_VAL_20_u1 1. _CNV_A_R_LINEAR_____0_CM 0. 1. DISPLAY_IDENTIFIER LC_EGRV_PSN_CTL FORMAT "%1.0" /end CHARACTERISTIC
/begin MEASUREMENT ang_sp_thr[0] "setpoint of position controller" UWORD _CNV_A_R_LINEAR_____8_CM 1 0. 0. 99.99847412109381 DISPLAY_IDENTIFIER ANG_SP_THR_0_ ECU_ADDRESS 0x7f97be BYTE_ORDER MSB_LAST FORMAT "%5.3" /end MEASUREMENT
/begin MEASUREMENT test_thr[0] "test signal for closed-loop positon control" UWORD _CNV_A_R_LINEAR_____8_CM 1 0. 0. 99.99847412109381 DISPLAY_IDENTIFIER TEST_THR_0_ ECU_ADDRESS 0x7fa5b4 BYTE_ORDER MSB_LAST FORMAT "%5.3" /end MEASUREMENT
/begin MEASUREMENT ctl_dif_thr[0] "controller deviation" SWORD _CNV_A_R_LINEAR_____12_CM 1 0. -100. 99.996948242 DISPLAY_IDENTIFIER CTL_DIF_THR_0_ ECU_ADDRESS 0x7f97c0 BYTE_ORDER MSB_LAST FORMAT "%5.3" /end MEASUREMENT
/begin MEASUREMENT ctl_thr[0] "controller output with pre-controller" SWORD _CNV_A_R_LINEAR_____399_CM 1 0. -200. 199.99389 DISPLAY_IDENTIFIER CTL_THR_0_ ECU_ADDRESS 0x7fa5b6 BYTE_ORDER MSB_LAST /end MEASUREMENT
/begin MEASUREMENT pi_dt1_thr[0] "output PI controller and DT1 function" SWORD _CNV_A_R_LINEAR_____399_CM 1 0. -200. 199.99389 DISPLAY_IDENTIFIER PI_DT1_THR_0_ ECU_ADDRESS 0x7fa5ba BYTE_ORDER MSB_LAST /end MEASUREMENT
/begin MEASUREMENT dt1_thr[0] "output DT1 function" SWORD _CNV_A_R_LINEAR_____399_CM 1 0. -200. 199.99389 DISPLAY_IDENTIFIER DT1_THR_0_ ECU_ADDRESS 0x7fa5b8 BYTE_ORDER MSB_LAST /end MEASUREMENT
/begin MEASUREMENT pi_thr[0] "output PI controller" SWORD _CNV_A_R_LINEAR_____399_CM 1 0. -200. 199.99389 DISPLAY_IDENTIFIER PI_THR_0_ ECU_ADDRESS 0x7fa5bc BYTE_ORDER MSB_LAST /end MEASUREMENT
/begin MEASUREMENT tq_mot_thr[0] "torque of DC motor" UWORD _CNV_A_R_LINEAR_____400_CM 1 0. 0. 999.98474 DISPLAY_IDENTIFIER TQ_MOT_THR_0_ ECU_ADDRESS 0x7fa5c2 BYTE_ORDER MSB_LAST FORMAT "%5.2" /end MEASUREMENT
/begin MEASUREMENT v_mot_thr[0] "voltage DC motor of THR_j" UWORD _CNV_A_R_LINEAR_____401_CM 1 0. 0. 99.99847412109381 DISPLAY_IDENTIFIER V_MOT_THR_0_ ECU_ADDRESS 0x7fa5c4 BYTE_ORDER MSB_LAST FORMAT "%5.3" /end MEASUREMENT
/begin MEASUREMENT r_mot_cor_thr[0] "corrected resistance of DC motor" UWORD _CNV_A_R_LINEAR_____402_CM 1 0. 0. 9.999874 DISPLAY_IDENTIFIER R_MOT_COR_THR_0_ ECU_ADDRESS 0x7f97c4 BYTE_ORDER MSB_LAST FORMAT "%5.4" /end MEASUREMENT
/begin MEASUREMENT pctl_thr[0] "output of the pre-controller" SWORD _CNV_A_R_LINEAR_____399_CM 1 0. -200. 199.99389 DISPLAY_IDENTIFIER PCTL_THR_0_ ECU_ADDRESS 0x7fa5be BYTE_ORDER MSB_LAST /end MEASUREMENT
/begin MEASUREMENT ctl_lim_bas_thr[0] "limited controller output" SWORD _CNV_A_R_LINEAR_____12_CM 1 0. -100. 99.996948242 DISPLAY_IDENTIFIER CTL_LIM_BAS_THR_0_ ECU_ADDRESS 0x7fa5c6 BYTE_ORDER MSB_LAST FORMAT "%5.3" /end MEASUREMENT
/begin MEASUREMENT lim_dif_thr[0] "difference between limited and unlimited controller output" SWORD _CNV_A_R_LINEAR_____12_CM 1 0. -100. 99.996948242 DISPLAY_IDENTIFIER LIM_DIF_THR_0_ ECU_ADDRESS 0x7fa5c0 BYTE_ORDER MSB_LAST FORMAT "%5.3" /end MEASUREMENT
/begin MEASUREMENT ctl_lim_thr[0] "limited controller output" SWORD _CNV_A_R_LINEAR_____12_CM 1 0. -100. 99.996948242 DISPLAY_IDENTIFIER CTL_LIM_THR_0_ ECU_ADDRESS 0x7f97c2 BYTE_ORDER MSB_LAST FORMAT "%5.3" /end MEASUREMENT
/begin MEASUREMENT ctl_thr_pre_lim[0] "THR control output before limitation" SWORD _CNV_A_R_LINEAR_____399_CM 1 0. -200. 199.99389 DISPLAY_IDENTIFIER CTL_THR_PRE_LIM_0_ ECU_ADDRESS 0x7fa5ce BYTE_ORDER MSB_LAST /end MEASUREMENT
/begin MEASUREMENT ctl_dyn_lim_thr[0] "Dynamic THR output limitation" SWORD _CNV_A_R_LINEAR_____399_CM 1 0. -200. 199.99389 DISPLAY_IDENTIFIER CTL_DYN_LIM_THR_0_ ECU_ADDRESS 0x7fa5d0 BYTE_ORDER MSB_LAST /end MEASUREMENT
/begin CHARACTERISTIC lc_test_thr[0] "" VALUE 0x85c36b _REC_VAL_20_u1 1. _CNV_A_R_LINEAR_____0_CM 0. 1. DISPLAY_IDENTIFIER LC_TEST_THR_0_ FORMAT "%1.0" /end CHARACTERISTIC
/begin CHARACTERISTIC c_test_fac_thr[0] "" VALUE 0x85c18a _REC_VAL_20_u2 99.99847412109381 _CNV_A_R_LINEAR_____8_CM 0. 99.99847412109381 DISPLAY_IDENTIFIER C_TEST_FAC_THR_0_ FORMAT "%5.3" /end CHARACTERISTIC
/begin CHARACTERISTIC c_test_add_thr[0] "" VALUE 0x85c184 _REC_VAL_20_u2 99.99847412109381 _CNV_A_R_LINEAR_____8_CM 0. 99.99847412109381 DISPLAY_IDENTIFIER C_TEST_ADD_THR_0_ FORMAT "%5.3" /end CHARACTERISTIC
/begin CHARACTERISTIC lc_dt1_thr_on[0] "" VALUE 0x85c314 _REC_VAL_20_u1 1. _CNV_A_R_LINEAR_____0_CM 0. 1. DISPLAY_IDENTIFIER LC_DT1_THR_ON_0_ FORMAT "%1.0" /end CHARACTERISTIC
/begin CHARACTERISTIC lc_pi_thr_on[0] "" VALUE 0x85c355 _REC_VAL_20_u1 1. _CNV_A_R_LINEAR_____0_CM 0. 1. DISPLAY_IDENTIFIER LC_PI_THR_ON_0_ FORMAT "%1.0" /end CHARACTERISTIC
/begin CHARACTERISTIC c_thr_ini[0] "" VALUE 0x85c19c _REC_VAL_20_s2 399.99389 _CNV_A_R_LINEAR_____399_CM -200. 199.99389 DISPLAY_IDENTIFIER C_THR_INI_0_ /end CHARACTERISTIC
/begin CHARACTERISTIC c_gear_trans_ratio_thr "gear transition ratio" VALUE 0x85bea4 _REC_VAL_20_u2 99.99847412109381 _CNV_A_R_LINEAR_____403_CM 0. 99.99847412109381 DISPLAY_IDENTIFIER C_GEAR_TRANS_RATIO_THR FORMAT "%5.3" /end CHARACTERISTIC
/begin CHARACTERISTIC c_temp_mot_thr_ref "reference temperature DC motor" VALUE 0x85c176 _REC_VAL_20_u1 255. _CNV_A_R_LINEAR_____18_CM -50. 205. DISPLAY_IDENTIFIER C_TEMP_MOT_THR_REF FORMAT "%3.0" /end CHARACTERISTIC
/begin CHARACTERISTIC c_r_mot_thr "resistance DC motor" VALUE 0x85c00c _REC_VAL_20_u2 9.999874 _CNV_A_R_LINEAR_____402_CM 0. 9.999874 DISPLAY_IDENTIFIER C_R_MOT_THR FORMAT "%5.4" /end CHARACTERISTIC
/begin CHARACTERISTIC lc_pctl_thr_lih "indicates the used precontrol value during LIH" VALUE 0x85c352 _REC_VAL_20_u1 1. _CNV_A_R_LINEAR_____0_CM 0. 1. DISPLAY_IDENTIFIER LC_PCTL_THR_LIH FORMAT "%1.0" /end CHARACTERISTIC
/begin CHARACTERISTIC c_pctl_thr_lih "precontrol value during LIH" VALUE 0x85bfea _REC_VAL_20_s2 399.99389 _CNV_A_R_LINEAR_____399_CM -200. 199.99389 DISPLAY_IDENTIFIER C_PCTL_THR_LIH /end CHARACTERISTIC
/begin CHARACTERISTIC c_temp_mot_thr[0] "" VALUE 0x85c175 _REC_VAL_20_u1 255. _CNV_A_R_LINEAR_____18_CM -50. 205. DISPLAY_IDENTIFIER C_TEMP_MOT_THR_0_ FORMAT "%3.0" /end CHARACTERISTIC
/begin CHARACTERISTIC lc_pctl_phys_thr_on[0] "" VALUE 0x85c351 _REC_VAL_20_u1 1. _CNV_A_R_LINEAR_____0_CM 0. 1. DISPLAY_IDENTIFIER LC_PCTL_PHYS_THR_ON_0_ FORMAT "%1.0" /end CHARACTERISTIC
/begin CHARACTERISTIC c_fac_ctl_lim_thr "correction factor" VALUE 0x85be20 _REC_VAL_20_s2 3.999939 _CNV_A_R_LINEAR_____405_CM -2. 1.999939 DISPLAY_IDENTIFIER C_FAC_CTL_LIM_THR FORMAT "%6.5" /end CHARACTERISTIC
/begin CHARACTERISTIC c_ctl_lim_thr_add "additive correction" VALUE 0x85bd92 _REC_VAL_20_s2 199.996948242 _CNV_A_R_LINEAR_____12_CM -100. 99.996948242 DISPLAY_IDENTIFIER C_CTL_LIM_THR_ADD FORMAT "%5.3" /end CHARACTERISTIC
/begin CHARACTERISTIC lc_ctl_lim_thr_man "activation of the manual output for the THR- position controller" VALUE 0x85c309 _REC_VAL_20_u1 1. _CNV_A_R_LINEAR_____0_CM 0. 1. DISPLAY_IDENTIFIER LC_CTL_LIM_THR_MAN FORMAT "%1.0" /end CHARACTERISTIC
/begin CHARACTERISTIC c_ctl_lim_thr_man[0] "" VALUE 0x85bd94 _REC_VAL_20_s2 199.996948242 _CNV_A_R_LINEAR_____12_CM -100. 99.996948242 DISPLAY_IDENTIFIER C_CTL_LIM_THR_MAN_0_ FORMAT "%5.3" /end CHARACTERISTIC
/begin CHARACTERISTIC c_t_lim_dyn_thr[0] "" VALUE 0x85c0e2 _REC_VAL_20_u2 65535. _CNV_A_R_LINEAR_____414_CM 0. 65535. DISPLAY_IDENTIFIER C_T_LIM_DYN_THR_0_ FORMAT "%5.0" /end CHARACTERISTIC
/begin CHARACTERISTIC c_lim_dyn_max_thr[0] "" VALUE 0x85bef4 _REC_VAL_20_u1 255. _CNV_A_R_LINEAR_____262_CM 0. 255. DISPLAY_IDENTIFIER C_LIM_DYN_MAX_THR_0_ FORMAT "%3.0" /end CHARACTERISTIC
/begin CHARACTERISTIC ip_kr_dt1_thr__ctl_dif "GE_TCLP: gain for DT1 function" CURVE 0x84cce0 _REC_CUR_20_u2_u2 4.19424 _CNV_A_R_LINEAR_____416_CM 0. 4.19424 DISPLAY_IDENTIFIER IP_KR_DT1_THR__CTL_DIF FORMAT "%6.5"
 /begin AXIS_DESCR COM_AXIS ctl_dif_thr[0] _CNV_A_R_LINEAR_____158_CM 8 -100. 99.99694820000001 FORMAT "%5.3" AXIS_PTS_REF ldp_ctl_dif__ip_kr_dt1_thr /end AXIS_DESCR
/end CHARACTERISTIC
/begin AXIS_PTS ldp_ctl_dif__ip_kr_dt1_thr "" 0x841498 ctl_dif_thr[0] _REC_AXS_20_u2 199.9969482 _CNV_A_R_LINEAR_____158_CM 8 -100. 99.99694820000001 FORMAT "%5.3" /end AXIS_PTS
/begin CHARACTERISTIC ip_t1_dt1_thr__ctl_dif "GE_TCLP: time value for DT1 function" CURVE 0x85aa54 _REC_CUR_20_u2_u2 0.125 _CNV_A_R_LINEAR_____407_CM 0. 0.125 DISPLAY_IDENTIFIER IP_T1_DT1_THR__CTL_DIF FORMAT "%7.6"
 /begin AXIS_DESCR COM_AXIS ctl_dif_thr[0] _CNV_A_R_LINEAR_____158_CM 8 -100. 99.99694820000001 FORMAT "%5.3" AXIS_PTS_REF ldp_ctl_dif__ip_t1_dt1_thr /end AXIS_DESCR
/end CHARACTERISTIC
/begin AXIS_PTS ldp_ctl_dif__ip_t1_dt1_thr "" 0x841510 ctl_dif_thr[0] _REC_AXS_20_u2 199.9969482 _CNV_A_R_LINEAR_____158_CM 8 -100. 99.99694820000001 FORMAT "%5.3" /end AXIS_PTS
/begin CHARACTERISTIC ip_kr_pi_thr__ctl_dif "GE_TCLP: proportional value for PI contoller" CURVE 0x84cf32 _REC_CUR_20_u2_u2 15.999755 _CNV_A_R_LINEAR_____13_CM 0. 15.999755 DISPLAY_IDENTIFIER IP_KR_PI_THR__CTL_DIF FORMAT "%6.4"
 /begin AXIS_DESCR COM_AXIS ctl_dif_thr[0] _CNV_A_R_LINEAR_____158_CM 9 -100. 99.99694820000001 FORMAT "%5.3" AXIS_PTS_REF ldp_ctl_dif__ip_kr_pi_thr /end AXIS_DESCR
/end CHARACTERISTIC
/begin AXIS_PTS ldp_ctl_dif__ip_kr_pi_thr "" 0x8414d8 ctl_dif_thr[0] _REC_AXS_20_u2 199.9969482 _CNV_A_R_LINEAR_____158_CM 9 -100. 99.99694820000001 FORMAT "%5.3" /end AXIS_PTS
/begin CHARACTERISTIC ip_tn_pi_thr__ctl_dif "GE_TCLP: integral value for PI contoller" CURVE 0x85b0f0 _REC_CUR_20_u2_u2 15.999755 _CNV_A_R_LINEAR_____408_CM 0. 15.999755 DISPLAY_IDENTIFIER IP_TN_PI_THR__CTL_DIF FORMAT "%6.4"
 /begin AXIS_DESCR COM_AXIS ctl_dif_thr[0] _CNV_A_R_LINEAR_____158_CM 9 -100. 99.99694820000001 FORMAT "%5.3" AXIS_PTS_REF ldp_ctl_dif__ip_tn_pi_thr /end AXIS_DESCR
/end CHARACTERISTIC
/begin AXIS_PTS ldp_ctl_dif__ip_tn_pi_thr "" 0x841550 ctl_dif_thr[0] _REC_AXS_20_u2 199.9969482 _CNV_A_R_LINEAR_____158_CM 9 -100. 99.99694820000001 FORMAT "%5.3" /end AXIS_PTS
/begin CHARACTERISTIC ip_tq_spr_thr__ang_sp_thr "GE_TCLP: characteristic of spring" CURVE 0x85b336 _REC_CUR_20_u2_u2 999.98474 _CNV_A_R_LINEAR_____400_CM 0. 999.98474 DISPLAY_IDENTIFIER IP_TQ_SPR_THR__ANG_SP_THR FORMAT "%5.2"
 /begin AXIS_DESCR COM_AXIS ang_sp_thr[0] _CNV_A_R_LINEAR_____8_CM 4 0. 99.99847412109381 FORMAT "%5.3" AXIS_PTS_REF ldp_ang_sp_thr_ip_tq_spr_thr /end AXIS_DESCR
/end CHARACTERISTIC
/begin AXIS_PTS ldp_ang_sp_thr_ip_tq_spr_thr "" 0x841394 ang_sp_thr[0] _REC_AXS_20_u2 99.99847412109381 _CNV_A_R_LINEAR_____8_CM 4 0. 99.99847412109381 FORMAT "%5.3" /end AXIS_PTS
/begin CHARACTERISTIC ip_cur_mot_thr__tq_mot "GE_TCLP: current of DC motor" CURVE 0x84a46a _REC_CUR_20_u2_u2 9.999874 _CNV_A_R_LINEAR_____409_CM 0. 9.999874 DISPLAY_IDENTIFIER IP_CUR_MOT_THR__TQ_MOT FORMAT "%5.4"
 /begin AXIS_DESCR COM_AXIS tq_mot_thr[0] _CNV_A_R_LINEAR_____400_CM 4 0. 999.98474 FORMAT "%5.2" AXIS_PTS_REF ldp_tq_mot_thr__ip_cur_mot /end AXIS_DESCR
/end CHARACTERISTIC
/begin AXIS_PTS ldp_tq_mot_thr__ip_cur_mot "" 0x842a52 tq_mot_thr[0] _REC_AXS_20_u2 999.98474 _CNV_A_R_LINEAR_____400_CM 4 0. 999.98474 FORMAT "%5.2" /end AXIS_PTS
/begin CHARACTERISTIC ip_pctl_thr__v_mot_thr "GE_TCLP: characteristic of power inverter" CURVE 0x8557c4 _REC_CUR_20_u2_u2 399.993897 _CNV_A_R_LINEAR_____410_CM -200. 199.993897 DISPLAY_IDENTIFIER IP_PCTL_THR__V_MOT_THR
 /begin AXIS_DESCR COM_AXIS v_mot_egrv[0] _CNV_A_R_LINEAR_____401_CM 4 0. 99.99847412109381 FORMAT "%5.3" AXIS_PTS_REF ldp_v_mot_thr__ip_pctl_thr /end AXIS_DESCR
/end CHARACTERISTIC
/begin AXIS_PTS ldp_v_mot_thr__ip_pctl_thr "" 0x8432e2 v_mot_egrv[0] _REC_AXS_20_u2 99.99847412109381 _CNV_A_R_LINEAR_____401_CM 4 0. 99.99847412109381 FORMAT "%5.3" /end AXIS_PTS
/begin CHARACTERISTIC ip_pctl_thr__ang_sp_thr "GE_TCLP: precontrol for pneumatic actuator" CURVE 0x8557b4 _REC_CUR_20_u2_u2 399.993897 _CNV_A_R_LINEAR_____410_CM -200. 199.993897 DISPLAY_IDENTIFIER IP_PCTL_THR__ANG_SP_THR
 /begin AXIS_DESCR COM_AXIS ang_sp_thr[0] _CNV_A_R_LINEAR_____8_CM 8 0. 99.99847412109381 FORMAT "%5.3" AXIS_PTS_REF ldp_ang_sp_thr_ip_pctl_thr /end AXIS_DESCR
/end CHARACTERISTIC
/begin AXIS_PTS ldp_ang_sp_thr_ip_pctl_thr "" 0x841382 ang_sp_thr[0] _REC_AXS_20_u2 99.99847412109381 _CNV_A_R_LINEAR_____8_CM 8 0. 99.99847412109381 FORMAT "%5.3" /end AXIS_PTS
/begin CHARACTERISTIC ip_ctl_min_thr_0__temp "GE_TCLP: minimum limit of THR_j controller output" CURVE 0x84a436 _REC_CUR_20_u1_u1 199.21875 _CNV_A_R_LINEAR_____411_CM -100. 99.21875 DISPLAY_IDENTIFIER IP_CTL_MIN_THR_0__TEMP FORMAT "%3.1"
 /begin AXIS_DESCR COM_AXIS tco _CNV_A_R_LINEAR_____18_CM 4 -50. 205. FORMAT "%3.0" AXIS_PTS_REF ldpm_temp__ip_ctl_thr /end AXIS_DESCR
/end CHARACTERISTIC
/begin AXIS_PTS ldpm_temp__ip_ctl_thr "" 0x843ebf tco _REC_AXS_20_u1 255. _CNV_A_R_LINEAR_____18_CM 4 -50. 205. FORMAT "%3.0" /end AXIS_PTS
/begin CHARACTERISTIC ip_ctl_max_thr_0__temp "GE_TCLP: maximum limit of THR_j controller output" CURVE 0x84a422 _REC_CUR_20_u1_u1 199.21875 _CNV_A_R_LINEAR_____411_CM -100. 99.21875 DISPLAY_IDENTIFIER IP_CTL_MAX_THR_0__TEMP FORMAT "%3.1"
 /begin AXIS_DESCR COM_AXIS tco _CNV_A_R_LINEAR_____18_CM 4 -50. 205. FORMAT "%3.0" AXIS_PTS_REF ldpm_temp__ip_ctl_thr /end AXIS_DESCR
/end CHARACTERISTIC
/begin CHARACTERISTIC ip_ctl_dyn_lim_thr_0__temp "GE_TCLP: maximum limit of THR_j controller output_a" CURVE 0x84a40e _REC_CUR_20_u1_u1 199.21875 _CNV_A_R_LINEAR_____411_CM -100. 99.21875 DISPLAY_IDENTIFIER IP_CTL_DYN_LIM_THR_0__TEMP FORMAT "%3.1"
 /begin AXIS_DESCR COM_AXIS tco _CNV_A_R_LINEAR_____18_CM 4 -50. 205. FORMAT "%3.0" AXIS_PTS_REF ldpm_temp__ip_ctl_thr /end AXIS_DESCR
/end CHARACTERISTIC
/begin CHARACTERISTIC lc_ctl_lim_thr_grd "enable of the gradient limitation" VALUE 0x85c308 _REC_VAL_20_u1 1. _CNV_A_R_LINEAR_____0_CM 0. 1. DISPLAY_IDENTIFIER LC_CTL_LIM_THR_GRD FORMAT "%1.0" /end CHARACTERISTIC
/begin COMPU_METHOD _CNV_A_R_LINEAR_____0_CM "" RAT_FUNC "%6.3" "[-]" COEFFS 0 1. 0. 0 0 1 /end COMPU_METHOD
/begin COMPU_METHOD _CNV_A_R_LINEAR_____1_CM "" RAT_FUNC "%6.3" "-" COEFFS 0 1. 0. 0 0 1 /end COMPU_METHOD
/begin COMPU_METHOD _CNV_A_R_LINEAR_____4_CM "" RAT_FUNC "%6.3" "[*100ms]" COEFFS 0 1. 0. 0 0 1 /end COMPU_METHOD
/begin COMPU_METHOD _CNV_A_R_LINEAR_____5_CM "" RAT_FUNC "%6.3" "[rpm]" COEFFS 0 1. 0. 0 0 1 /end COMPU_METHOD
/begin COMPU_METHOD _CNV_A_R_LINEAR_____6_CM "" RAT_FUNC "%6.3" "[ms]" COEFFS 0 2.e-003 0. 0 0 1 /end COMPU_METHOD
/begin COMPU_METHOD _CNV_A_R_LINEAR_____7_CM "" RAT_FUNC "%6.3" "[cm^2]" COEFFS 0 839.3314549180328 0. 0 0 1 /end COMPU_METHOD
/begin COMPU_METHOD _CNV_A_R_LINEAR_____8_CM "" RAT_FUNC "%6.3" "[%]" COEFFS 0 655.3599999999997 0. 0 0 1 /end COMPU_METHOD
/begin COMPU_METHOD _CNV_A_R_LINEAR_____9_CM "" RAT_FUNC "%6.3" "[%]" COEFFS 0 327.6799971199561 -2.880043939512689e-004 0 0 1 /end COMPU_METHOD
/begin COMPU_METHOD _CNV_S_2_RANGE______11_CM "" TAB_VERB "%6.3" "[-]" COMPU_TAB_REF _CNV_S_2_RANGE______11 /end COMPU_METHOD
/begin COMPU_VTAB _CNV_S_2_RANGE______11 "" TAB_VERB 2 0 "0" 1 "1" /end COMPU_VTAB
/begin COMPU_METHOD _CNV_A_R_LINEAR_____12_CM "" RAT_FUNC "%6.3" "[%]" COEFFS 0 327.6800000003072 3.071909304708242e-008 0 0 1 /end COMPU_METHOD
/begin COMPU_METHOD _CNV_A_R_LINEAR_____13_CM "" RAT_FUNC "%6.3" "[-]" COEFFS 0 4096.000220003369 0. 0 0 1 /end COMPU_METHOD
/begin COMPU_METHOD _CNV_A_R_LINEAR_____14_CM "" RAT_FUNC "%6.3" "[-]" COEFFS 0 65535.99999999996 0. 0 0 1 /end COMPU_METHOD
/begin COMPU_METHOD _CNV_A_R_LINEAR_____15_CM "" RAT_FUNC "%6.3" "[-]" COEFFS 0 16384. 0. 0 0 1 /end COMPU_METHOD
/begin COMPU_METHOD _CNV_A_R_LINEAR_____16_CM "" RAT_FUNC "%6.3" "[s]" COEFFS 0 1. 0. 0 0 1 /end COMPU_METHOD
/begin COMPU_METHOD _CNV_A_R_LINEAR_____17_CM "" RAT_FUNC "%6.3" "[°C/s]" COEFFS 0 1. 0. 0 0 1 /end COMPU_METHOD
/begin COMPU_METHOD _CNV_A_R_LINEAR_____18_CM "" RAT_FUNC "%6.3" "[°C]" COEFFS 0 1. 50. 0 0 1 /end COMPU_METHOD
/begin COMPU_METHOD _CNV_A_R_LINEAR_____19_CM "" RAT_FUNC "%6.3" "[s]" COEFFS 0 10. 0. 0 0 1 /end COMPU_METHOD
/begin COMPU_METHOD _CNV_A_R_LINEAR_____20_CM "" RAT_FUNC "%6.3" "[°C]" COEFFS 0 1. 0. 0 0 1 /end COMPU_METHOD
/begin COMPU_METHOD _CNV_A_R_LINEAR_____21_CM "" RAT_FUNC "%6.3" "[hPa]" COEFFS 0 12.06017666543982 0. 0 0 1 /end COMPU_METHOD
/begin COMPU_METHOD _CNV_A_R_LINEAR_____22_CM "" RAT_FUNC "%6.3" "[rpm]" COEFFS 0 3.137254901960784e-002 0. 0 0 1 /end COMPU_METHOD
/begin COMPU_METHOD _CNV_A_R_LINEAR_____23_CM "" RAT_FUNC "%6.3" "[mg/stk]" COEFFS 0 47.18142548596112 0. 0 0 1 /end COMPU_METHOD
/begin COMPU_METHOD _CNV_A_R_LINEAR_____24_CM "" RAT_FUNC "%6.3" "[-]" COEFFS 0 128. 0. 0 0 1 /end COMPU_METHOD
/begin COMPU_METHOD _CNV_A_R_LINEAR_____25_CM "" RAT_FUNC "%6.3" "[-]" COEFFS 0 255. 0. 0 0 1 /end COMPU_METHOD
/begin COMPU_METHOD _CNV_S_2_RANGE______28_CM "" TAB_VERB "%6.3" "[-]" COMPU_TAB_REF _CNV_S_2_RANGE______28 /end COMPU_METHOD
/begin COMPU_VTAB _CNV_S_2_RANGE______28 "" TAB_VERB 2 0 "passive" 1 "active" /end COMPU_VTAB
/begin COMPU_METHOD _CNV_A_R_LINEAR_____33_CM "" RAT_FUNC "%6.3" "[V]" COEFFS 0 204.8 0. 0 0 1 /end COMPU_METHOD
/begin COMPU_METHOD _CNV_A_R_LINEAR_____34_CM "" RAT_FUNC "%6.3" "[-]" COEFFS 0 256. 0. 0 0 1 /end COMPU_METHOD
/begin COMPU_METHOD _CNV_A_R_LINEAR_____35_CM "" RAT_FUNC "%6.3" "[1/min]" COEFFS 0 3.125e-002 0. 0 0 1 /end COMPU_METHOD
/begin COMPU_METHOD _CNV_A_R_LINEAR_____36_CM "" RAT_FUNC "%6.3" "[%]" COEFFS 0 10.24 0. 0 0 1 /end COMPU_METHOD
/begin COMPU_METHOD _CNV_A_R_LINEAR_____37_CM "" RAT_FUNC "%6.3" "[-]" COEFFS 0 8192. 0. 0 0 1 /end COMPU_METHOD
/begin COMPU_METHOD _CNV_A_R_LINEAR_____38_CM "" RAT_FUNC "%6.3" "[V]" COEFFS 0 204.8000076875076 1.921876901178621e-005 0 0 1 /end COMPU_METHOD
/begin COMPU_METHOD _CNV_A_R_LINEAR_____39_CM "" RAT_FUNC "%6.3" "[km/h]" COEFFS 0 1. 0. 0 0 1 /end COMPU_METHOD
/begin COMPU_METHOD _CNV_A_R_LINEAR_____40_CM "" RAT_FUNC "%6.3" "[V]" COEFFS 0 102.4000448438124 0. 0 0 1 /end COMPU_METHOD
/begin COMPU_METHOD _CNV_A_R_LINEAR_____43_CM "" RAT_FUNC "%6.3" "[mg/stk]" COEFFS 0 250. 0. 0 0 1 /end COMPU_METHOD
/begin COMPU_METHOD _CNV_A_R_LINEAR_____44_CM "" RAT_FUNC "%6.3" "[%]" COEFFS 0 2.55 0. 0 0 1 /end COMPU_METHOD
/begin COMPU_METHOD _CNV_A_R_LINEAR_____48_CM "" RAT_FUNC "%6.3" "[V]" COEFFS 0 8.854166666666666 0. 0 0 1 /end COMPU_METHOD
/begin COMPU_METHOD _CNV_A_R_LINEAR_____51_CM "" RAT_FUNC "%6.3" "[°C/100ms]" COEFFS 0 1. 0. 0 0 1 /end COMPU_METHOD
/begin COMPU_METHOD _CNV_A_R_LINEAR_____52_CM "" RAT_FUNC "%6.3" "[V]" COEFFS 0 13107.20001587224 0. 0 0 1 /end COMPU_METHOD
/begin COMPU_METHOD _CNV_A_R_LINEAR_____53_CM "" RAT_FUNC "%6.3" "[-]" COEFFS 0 32767.99807357072 0. 0 0 1 /end COMPU_METHOD
/begin COMPU_METHOD _CNV_A_R_LINEAR_____55_CM "" RAT_FUNC "%6.3" "[mg/stk]" COEFFS 0 1000. 0. 0 0 1 /end COMPU_METHOD
/begin COMPU_METHOD _CNV_A_R_LINEAR_____59_CM "" RAT_FUNC "%6.3" "[s]" COEFFS 0 100. 0. 0 0 1 /end COMPU_METHOD
/begin COMPU_METHOD _CNV_A_R_LINEAR_____62_CM "" RAT_FUNC "%6.3" "[Nm]" COEFFS 0 32. 0. 0 0 1 /end COMPU_METHOD
/begin COMPU_METHOD _CNV_A_R_LINEAR_____67_CM "" RAT_FUNC "%6.3" "[s]" COEFFS 0 15625. 0. 0 0 1 /end COMPU_METHOD
/begin COMPU_METHOD _CNV_P_8_TABLE_______71_CM "" TAB_NOINTP "%6.3" "[-]" COMPU_TAB_REF _CNV_P_8_TABLE_______71 /end COMPU_METHOD
/begin COMPU_TAB _CNV_P_8_TABLE_______71 "" TAB_NOINTP 8 0 0. 1 1. 2 2. 3 3. 4 4. 5 5. 6 6. 15 15. /end COMPU_TAB
/begin COMPU_METHOD _CNV_A_R_LINEAR_____72_CM "" RAT_FUNC "%6.3" "[(km/h)/rpm]" COEFFS 0 655360.0007936121 3.96806062781252e-005 0 0 1 /end COMPU_METHOD
/begin COMPU_METHOD _CNV_A_R_LINEAR_____73_CM "" RAT_FUNC "%6.3" "[(km/h)/rpm]" COEFFS 0 655350. 0. 0 0 1 /end COMPU_METHOD
/begin COMPU_METHOD _CNV_A_R_LINEAR_____74_CM "" RAT_FUNC "%6.3" "[km/h]" COEFFS 0 100. 0. 0 0 1 /end COMPU_METHOD
/begin COMPU_METHOD _CNV_A_R_LINEAR_____76_CM "" RAT_FUNC "%6.3" "[s]" COEFFS 0 1000. 0. 0 0 1 /end COMPU_METHOD
/begin COMPU_METHOD _CNV_A_R_LINEAR_____77_CM "" RAT_FUNC "%6.3" "[km/h]" COEFFS 0 10. 0. 0 0 1 /end COMPU_METHOD
/begin COMPU_METHOD _CNV_A_R_LINEAR_____78_CM "" RAT_FUNC "%6.3" "[rpm/100ms]" COEFFS 0 1. 0. 0 0 1 /end COMPU_METHOD
/begin COMPU_METHOD _CNV_A_R_LINEAR_____79_CM "" RAT_FUNC "%6.3" "[1/km]" COEFFS 0 1. 0. 0 0 1 /end COMPU_METHOD
/begin COMPU_METHOD _CNV_A_R_LINEAR_____81_CM "" RAT_FUNC "%6.3" "[%]" COEFFS 0 10.23 0. 0 0 1 /end COMPU_METHOD
/begin COMPU_METHOD _CNV_S_2_RANGE__0___88_CM "" TAB_VERB "%6.3" "-" COMPU_TAB_REF _CNV_S_2_RANGE__0___88 /end COMPU_METHOD
/begin COMPU_VTAB _CNV_S_2_RANGE__0___88 "" TAB_VERB 2 0 "0" 1 "1" /end COMPU_VTAB
/begin COMPU_METHOD _CNV_A_R_LINEAR_____89_CM "" RAT_FUNC "%6.3" "[Nm]" COEFFS 0 32. 32768. 0 0 1 /end COMPU_METHOD
/begin COMPU_METHOD _CNV_A_R_LINEAR_____90_CM "" RAT_FUNC "%6.3" "[-]" COEFFS 0 65535.82575140447 0. 0 0 1 /end COMPU_METHOD
/begin COMPU_METHOD _CNV_A_R_LINEAR_____91_CM "" RAT_FUNC "%6.3" "[-]" COEFFS 0 32767. 0. 0 0 1 /end COMPU_METHOD
/begin COMPU_METHOD _CNV_A_R_LINEAR_____93_CM "" RAT_FUNC "%6.3" "[Nm]" COEFFS 0 4. 0. 0 0 1 /end COMPU_METHOD
/begin COMPU_METHOD _CNV_A_R_LINEAR_____112_CM "" RAT_FUNC "%6.3" "[kg/h]" COEFFS 0 64. 0. 0 0 1 /end COMPU_METHOD
/begin COMPU_METHOD _CNV_S_8_gearbox_ty_114_CM "" TAB_VERB "%6.3" "[-]" COMPU_TAB_REF _CNV_S_8_gearbox_ty_114 /end COMPU_METHOD
/begin COMPU_VTAB _CNV_S_8_gearbox_ty_114 "" TAB_VERB 9 1 "Manual" 2 "Automatic" 4 "CVT" 5 "CVT" 8 "Robotized" 16 "Off Road" 32 "Reserved" 64 "Reserved" 128 "GB controled" /end COMPU_VTAB
/begin COMPU_METHOD _CNV_A_R_LINEAR_____115_CM "" RAT_FUNC "%6.3" "[m]" COEFFS 0 35999.99999497086 0. 0 0 1 /end COMPU_METHOD
/begin COMPU_METHOD _CNV_A_R_LINEAR_____116_CM "" RAT_FUNC "%6.3" "[km]" COEFFS 0 10. 0. 0 0 1 /end COMPU_METHOD
/begin COMPU_METHOD _CNV_A_R_LINEAR_____117_CM "" RAT_FUNC "%6.3" "[km]" COEFFS 0 10000. 0. 0 0 1 /end COMPU_METHOD
/begin COMPU_METHOD _CNV_A_R_LINEAR_____120_CM "" RAT_FUNC "%6.3" "[°CRK]" COEFFS 0 42.66666666666666 5120. 0 0 1 /end COMPU_METHOD
/begin COMPU_METHOD _CNV_A_R_LINEAR_____136_CM "" RAT_FUNC "%6.3" "[%]" COEFFS 0 655.35 0. 0 0 1 /end COMPU_METHOD
/begin COMPU_METHOD _CNV_A_R_LINEAR_____141_CM "" RAT_FUNC "%6.3" "[%]" COEFFS 0 655.3600000071681 32768.00000035841 0 0 1 /end COMPU_METHOD
/begin COMPU_METHOD _CNV_A_R_LINEAR_____153_CM "" RAT_FUNC "%6.3" "[°C]" COEFFS 0 64. 0. 0 0 1 /end COMPU_METHOD
/begin COMPU_METHOD _CNV_A_R_LINEAR_____155_CM "" RAT_FUNC "%6.3" "[%]" COEFFS 0 327.68 0. 0 0 1 /end COMPU_METHOD
/begin COMPU_METHOD _CNV_A_R_LINEAR_____158_CM "" RAT_FUNC "%6.3" "[%]" COEFFS 0 327.680000069121 32768.0000069121 0 0 1 /end COMPU_METHOD
/begin COMPU_METHOD _CNV_A_R_LINEAR_____159_CM "" RAT_FUNC "%6.3" "[-]" COEFFS 0 1000. 0. 0 0 1 /end COMPU_METHOD
/begin COMPU_METHOD _CNV_A_R_LINEAR_____198_CM "" RAT_FUNC "%6.3" "[°C]" COEFFS 0 64. 3200. 0 0 1 /end COMPU_METHOD
/begin COMPU_METHOD _CNV_A_R_LINEAR_____201_CM "" RAT_FUNC "%6.3" "[%]" COEFFS 0 327.7613897082924 0. 0 0 1 /end COMPU_METHOD
/begin COMPU_METHOD _CNV_A_R_LINEAR_____257_CM "" RAT_FUNC "%6.3" "rpm" COEFFS 0 1. 0. 0 0 1 /end COMPU_METHOD
/begin COMPU_METHOD _CNV_A_R_LINEAR_____262_CM "" RAT_FUNC "%6.3" "[%]" COEFFS 0 1. 0. 0 0 1 /end COMPU_METHOD
/begin COMPU_METHOD _CNV_A_R_LINEAR_____264_CM "" RAT_FUNC "%6.3" "[V]" COEFFS 0 10.62059202605951 0. 0 0 1 /end COMPU_METHOD
/begin COMPU_METHOD _CNV_A_R_LINEAR_____284_CM "" RAT_FUNC "%6.3" "-" COEFFS 0 32767.99807357072 0. 0 0 1 /end COMPU_METHOD
/begin COMPU_METHOD _CNV_A_R_LINEAR_____285_CM "" RAT_FUNC "%6.3" "[MPa]" COEFFS 0 327.6800000003072 3.071909304708242e-008 0 0 1 /end COMPU_METHOD
/begin COMPU_METHOD _CNV_A_R_LINEAR_____286_CM "" RAT_FUNC "%6.3" "-" COEFFS 0 32768. 0. 0 0 1 /end COMPU_METHOD
/begin COMPU_METHOD _CNV_A_R_LINEAR_____287_CM "" RAT_FUNC "%6.3" "[Hz]" COEFFS 0 4294.967361262757 0. 0 0 1 /end COMPU_METHOD
/begin COMPU_METHOD _CNV_A_R___16__8000_341_CM "" RAT_FUNC "%6.3" "[Nm/mg/stk/mg/stk]" COEFFS 0 2048.000750011719 1.200018750387244e-002 0 0 1 /end COMPU_METHOD
/begin COMPU_METHOD _CNV_A_R___16__8000_342_CM "" RAT_FUNC "%6.3" "[Nm/mg/stk]" COEFFS 0 2048.000750011719 1.200018750387244e-002 0 0 1 /end COMPU_METHOD
/begin COMPU_METHOD _CNV_A_R___16__0H___343_CM "" RAT_FUNC "%6.3" "[Nm/mg/stk]" COEFFS 0 2047.999981999726 32767.99971199561 0 0 1 /end COMPU_METHOD
/begin COMPU_METHOD _CNV_A_R_LINEAR_____359_CM "" RAT_FUNC "%6.3" "[us]" COEFFS 0 1. 0. 0 0 1 /end COMPU_METHOD
/begin COMPU_METHOD _CNV_A_R_LINEAR_____371_CM "" RAT_FUNC "%6.3" "[-]" COEFFS 0 4096.000000864013 6.912101525813341e-006 0 0 1 /end COMPU_METHOD
/begin COMPU_METHOD _CNV_A_R_LINEAR_____377_CM "" RAT_FUNC "%6.3" "[A]" COEFFS 0 314.7692307692308 0. 0 0 1 /end COMPU_METHOD
/begin COMPU_METHOD _CNV_A_R_LINEAR_____379_CM "" RAT_FUNC "%6.3" "[°/oo]" COEFFS 0 4194.300129486656 -8.782845907262527e-004 0 0 1 /end COMPU_METHOD
/begin COMPU_METHOD _CNV_S_6_RANGE______395_CM "" TAB_VERB "%6.3" "[-]" COMPU_TAB_REF _CNV_S_6_RANGE______395 /end COMPU_METHOD
/begin COMPU_VTAB _CNV_S_6_RANGE______395 "" TAB_VERB 6 0 "ES_ON" 1 "CRK" 2 "ERU_ON" 3 "ERU_OFF" 4 "PWL" 5 "LOCK" /end COMPU_VTAB
/begin COMPU_METHOD _CNV_A_R_LINEAR_____399_CM "" RAT_FUNC "%6.3" "[%]" COEFFS 0 163.8400026560406 5.312081193551421e-004 0 0 1 /end COMPU_METHOD
/begin COMPU_METHOD _CNV_A_R_LINEAR_____400_CM "" RAT_FUNC "%6.3" "[mNm]" COEFFS 0 65.53600007936122 0. 0 0 1 /end COMPU_METHOD
/begin COMPU_METHOD _CNV_A_R_LINEAR_____401_CM "" RAT_FUNC "%6.3" "[V]" COEFFS 0 655.3599999999997 0. 0 0 1 /end COMPU_METHOD
/begin COMPU_METHOD _CNV_A_R_LINEAR_____402_CM "" RAT_FUNC "%6.3" "[ohm]" COEFFS 0 6553.582575140446 0. 0 0 1 /end COMPU_METHOD
/begin COMPU_METHOD _CNV_A_R_LINEAR_____403_CM "" RAT_FUNC "%6.3" "[-]" COEFFS 0 655.3599999999997 0. 0 0 1 /end COMPU_METHOD
/begin COMPU_METHOD _CNV_A_R_LINEAR_____405_CM "" RAT_FUNC "%6.3" "[-]" COEFFS 0 16383.99985599781 -2.880043903132901e-004 0 0 1 /end COMPU_METHOD
/begin COMPU_METHOD _CNV_A_R_LINEAR_____407_CM "" RAT_FUNC "%6.3" "[s]" COEFFS 0 524280. 0. 0 0 1 /end COMPU_METHOD
/begin COMPU_METHOD _CNV_A_R_LINEAR_____408_CM "" RAT_FUNC "%6.3" "[s]" COEFFS 0 4096.000220003369 0. 0 0 1 /end COMPU_METHOD
/begin COMPU_METHOD _CNV_A_R_LINEAR_____409_CM "" RAT_FUNC "%6.3" "[A]" COEFFS 0 6553.582575140446 0. 0 0 1 /end COMPU_METHOD
/begin COMPU_METHOD _CNV_A_R_LINEAR_____410_CM "" RAT_FUNC "%6.3" "[%]" COEFFS 0 163.8399997887968 32767.99995775936 0 0 1 /end COMPU_METHOD
/begin COMPU_METHOD _CNV_A_R_LINEAR_____411_CM "" RAT_FUNC "%6.3" "[%]" COEFFS 0 1.28 128. 0 0 1 /end COMPU_METHOD
/begin COMPU_METHOD _CNV_A_R_LINEAR_____412_CM "" RAT_FUNC "%6.3" "[V]" COEFFS 0 204.7999649194707 0. 0 0 1 /end COMPU_METHOD
/begin COMPU_METHOD _CNV_A_R_LINEAR_____413_CM "" RAT_FUNC "%6.3" "[V/s]" COEFFS 0 2.047999995887937 0. 0 0 1 /end COMPU_METHOD
/begin COMPU_METHOD _CNV_A_R_LINEAR_____414_CM "" RAT_FUNC "%6.3" "[ms]" COEFFS 0 1. 0. 0 0 1 /end COMPU_METHOD
/begin COMPU_METHOD _CNV_A_R_LINEAR_____416_CM "" RAT_FUNC "%6.3" "[-]" COEFFS 0 15625. 0. 0 0 1 /end COMPU_METHOD
/begin COMPU_METHOD _CNV_A_R_LINEAR_____418_CM "" RAT_FUNC "%6.3" "[%*s/(N*m)]" COEFFS 0 10000. 0. 0 0 1 /end COMPU_METHOD
/begin COMPU_METHOD _CNV_A_R_LINEAR_____419_CM "" RAT_FUNC "%6.3" "[%*s/(kg/h)]" COEFFS 0 79999.95117115973 -2.000029297414585e-002 0 0 1 /end COMPU_METHOD
/begin COMPU_METHOD _CNV_A_R_LINEAR_____420_CM "" RAT_FUNC "%6.3" "[s]" COEFFS 0 3906.250000000001 0. 0 0 1 /end COMPU_METHOD
/begin COMPU_METHOD _CNV_A_R_LINEAR_____421_CM "" RAT_FUNC "%6.3" "[%*s/(N*m)]" COEFFS 0 5000. 0. 0 0 1 /end COMPU_METHOD
/begin COMPU_METHOD _CNV_A_R_LINEAR_____422_CM "" RAT_FUNC "%6.3" "[%*s/(N*m)]" COEFFS 0 10000. 32768. 0 0 1 /end COMPU_METHOD
/begin COMPU_METHOD _CNV_A_R_LINEAR_____423_CM "" RAT_FUNC "%6.3" "[%*s/(kg/h)]" COEFFS 0 80000. 32768. 0 0 1 /end COMPU_METHOD
/begin RECORD_LAYOUT _REC_VAL_20_u1 FNC_VALUES 1 UBYTE COLUMN_DIR DIRECT /end RECORD_LAYOUT
/begin RECORD_LAYOUT _REC_AXS_20_u2 NO_AXIS_PTS_X 1 UWORD AXIS_PTS_X 2 UWORD INDEX_INCR DIRECT /end RECORD_LAYOUT
/begin RECORD_LAYOUT _REC_CUR_20_u1_u2 FNC_VALUES 1 UBYTE COLUMN_DIR DIRECT /end RECORD_LAYOUT
/begin RECORD_LAYOUT _REC_MAP_20_u1_u2_u2 FNC_VALUES 1 UBYTE COLUMN_DIR DIRECT /end RECORD_LAYOUT
/begin RECORD_LAYOUT _REC_MAP_20_u2_u2_u2 FNC_VALUES 1 UWORD COLUMN_DIR DIRECT /end RECORD_LAYOUT
/begin RECORD_LAYOUT _REC_VAL_20_u2 FNC_VALUES 1 UWORD COLUMN_DIR DIRECT /end RECORD_LAYOUT
/begin RECORD_LAYOUT _REC_VAL_20_s2 FNC_VALUES 1 SWORD COLUMN_DIR DIRECT /end RECORD_LAYOUT
/begin RECORD_LAYOUT _REC_AXS_20_u1 NO_AXIS_PTS_X 1 UBYTE AXIS_PTS_X 2 UBYTE INDEX_INCR DIRECT /end RECORD_LAYOUT
/begin RECORD_LAYOUT _REC_MAP_20_u1_u1_u2 FNC_VALUES 1 UBYTE COLUMN_DIR DIRECT /end RECORD_LAYOUT
/begin RECORD_LAYOUT _REC_CUR_20_u2_u2 FNC_VALUES 1 UWORD COLUMN_DIR DIRECT /end RECORD_LAYOUT
/begin RECORD_LAYOUT _REC_CUR_20_u2_u1 FNC_VALUES 1 UWORD COLUMN_DIR DIRECT /end RECORD_LAYOUT
/begin RECORD_LAYOUT _REC_MAP_20_u2_u1_u1 FNC_VALUES 1 UWORD COLUMN_DIR DIRECT /end RECORD_LAYOUT
/begin RECORD_LAYOUT _REC_MAP_20_u2_u2_u1 FNC_VALUES 1 UWORD COLUMN_DIR DIRECT /end RECORD_LAYOUT
/begin RECORD_LAYOUT _REC_CUR_20_u1_u1 FNC_VALUES 1 UBYTE COLUMN_DIR DIRECT /end RECORD_LAYOUT
/begin FUNCTION CR_Generic ""
 /begin DEF_CHARACTERISTIC c_ctr_max_wup_cyc ldp_fmy_dtc lc_abc_bench id_clas_a_fmt id_clas_b_fmt id_err_dtc_mis c_obd_state_1 c_obd_state_2 lc_ena_scdn lc_clr_fmy lc_clr_his_fmy c_conf_mil c_conf_wal_1 c_conf_wal_2 lc_inh_wal_st c_dly_inh_iv_mis lc_ad_clr c_nvmy_inst_chk ldpm_n_ip_mf_pf c_dly_mil_ready_1 c_dly_mil_ready_2 lc_egrv_pctl_on c_bpapwm_min_diag c_bpapwm_max_diag c_fac_ar_egrv_pctl_fil c_thrpwm_min_diag c_thrpwm_max_diag c_ctr_inh_temp_diag c_tco_mes_grd_diag c_tco_mes_st_diag c_t_ast_tco_diag c_tco_plaus_inc_diag ldp_amp_ip_load_clc_amp ldp_n_32_ip_load_clc ldp_maf_ip_load_clc ldp_fmy_envd ip_load_clc_amp__amp ip_load_clc__n_32__maf c_tco_wup_thd c_tco_wup_inc c_abc_inc_pvs_l_1 c_abc_max_pvs_l_1 c_abc_inc_pvs_l_2 c_abc_max_pvs_l_2 c_abc_inc_pvs_h_1 c_abc_max_pvs_h_1 c_abc_inc_pvs_h_2 c_abc_max_pvs_h_2 c_abc_inc_pvs_ratio c_abc_max_pvs_ratio c_abc_inc_pvs_bls_bts c_abc_max_pvs_bls_bts c_abc_inc_pvs_move c_abc_max_pvs_move c_crlc_pvs_1_move c_crlc_pvs_2_move c_ctr_max_pv_av_con c_ctr_max_pvs_bls_bts_plaus c_ctr_max_pvs_h_r_1 c_ctr_max_pvs_h_r_2 c_ctr_max_pvs_is_rng c_ctr_max_pvs_move c_ctr_max_pvs_move_err c_n_pvs_bls_bts_plaus c_pv_av_hys_bls_bts_plaus c_pv_av_pvs_bls_bts_plaus c_pvs_ratio_fac c_v_pvs_max_diag_1 c_v_pvs_max_diag_2 c_v_pvs_min_diag_1 c_v_pvs_min_diag_2 c_v_pvs_min_diag_min_1 c_v_pvs_min_diag_min_2 c_v_pvs_move_hys_1 c_v_pvs_move_hys_2 c_v_pvs_ratio_ofs c_v_pvs_thd_move_1 c_vs_pvs_bls_bts_plaus lc_poti lc_pvs_bls_bts_plaus_ena ldp_v_pvs_min_ip_pvs_ratio_hys ip_pvs_ratio_hys__v_pvs_min c_abc_inc_vcc_1 c_abc_max_vcc_1 c_abc_inc_vcc_2 c_abc_max_vcc_2 c_vcc_min_diag c_vcc_max_diag c_amp_sub_diag ip_amp_mes__v_amp ldp_v_amp_ip_amp_mes c_tfu_mes_grd_diag c_abc_inc_v_tfu_rng c_abc_max_v_tfu_rng c_abc_inc_tfu_mes_grd c_abc_max_tfu_mes_grd c_v_tfu_max_diag c_v_tfu_min_diag c_tfu_sub_diag ip_tfu_mes__v_tfu c_abc_inc_cyl_bal_0 c_abc_max_cyl_bal_0 c_abc_inc_cyl_bal_1 c_abc_max_cyl_bal_1 c_abc_inc_cyl_bal_2 c_abc_max_cyl_bal_2 c_abc_inc_cyl_bal_3 c_abc_max_cyl_bal_3 c_ctr_eve_cyl_bal_max c_ctr_bas_cyl_bal_max c_fac_is_fil_neg c_fac_is_fil_pos c_t_is_fil_ais_req id_fac_pl_is__dri ip_fac_fil_pl_is__tco ip_fac_fil_st_is__tco id_dri__vs_n c_vs_n_grd_fil_thd lc_dri c_fac_fil_vs_n_grd lc_dri_sub c_dri_sub c_t_max_vs_n c_vs_n_hys c_t_max_vs_n_diag c_vs_n_hys_diag c_t_upd_vs_abs c_vs_lih_grd c_vs_lih c_fac_vs_fil lc_ac_fil c_vs_det_min c_vs_puls_div c_buf_size_vs c_abc_inc_vs c_abc_max_vs c_mf_tot_vs_cor_diag c_vs_max_diag c_vs_min_diag c_n_vs_cor_diag c_n_dif_vs_cor_diag c_tco_vs_cor_diag c_t_max_vs_cor_diag c_fac_vs lc_can_vs_abs lc_can_ac_abs lc_can_dist_abs ldpm_n_ip_tqfr lc_efp_ctl_on lc_efp_rly_man_on c_t_efp_reset_st c_t_efp_reset_es c_crlc_tqfr ip_tqfr_add__n_mmv__toil ip_tqfr_add__n_mmv__tco ip_tqfr__n ldpm_n_mmv_ip_tqfr_add ldp_toil_ip_tqfr_add ldp_tco_ip_tqfr_add c_tq_max_sca lc_tq_tra_act c_fac_pv_av_dif_tra c_pv_av_max lc_tq_tra_pv_av_lim c_n_dif_max c_fac_n_dif_tra lc_n_mmv_tra_act lc_tq_tra_n_lim c_t_dly_diag_tcs_dec c_t_max_tcs_inc c_tq_inc_sum_max_tcs c_vs_min_tcs_inc lc_tcs_dec_act lc_tcs_inc_act lc_tcs_inc_di_clu c_tqi_lih_grd_dec c_tqi_lih_grd_inc c_tqi_lih_pas lc_clr_sum_tqi_lih lc_tqi_lih_inh ip_tqi_lih__n ldp_n_ip_tqi_lih c_conf_gb c_conf_heat lc_acc_is_can_aut_ena lc_acc_is_can_state_ena lc_acc_is_can_req_ena lc_egr_conf lc_acc_is_driv_req_ena lc_gl_var lc_var_can_cs lc_var_can_whl lc_var_can_sys_info lc_var_can_nom_sys c_thd_ctr_vs_dist c_fac_vb_fil ip_n_prev1_inh__vb_fil ip_n_main2_inh__vb_fil ip_n_main1_inh__vb_fil ip_n_prev2_inh__vb_fil ip_n_post1_inh__vb_fil ip_n_post2_inh__vb_fil c_fac_thermo_down_egrv c_fac_thermo_up_egrv ip_fac_temp_egr_cool c_abc_inc_v_tba_rng c_abc_max_v_tba_rng c_abc_inc_tba_mes_grd c_abc_max_tba_mes_grd c_v_tba_max_diag c_v_tba_min_diag c_tba_mes_grd_diag c_frq_pwm_ect c_frq_pwm_ecf_1 c_frq_pwm_ecf_2 c_frq_pwm_gl c_frq_pwm_acc_b lc_ad_clr_ensd c_dri_mid c_dri_l c_crlc_tqe_dif_gb_prot lc_tqe_dif_dif_gb_prot_act ip_tq_gb_prot_h__n ldpm_n_ip_gb_prot ip_tq_gb_prot_l__n ip_tq_gb_prot_mid__n ip_tq_gb_prot_err__n ip_tq_gb_prot_rvl__n c_mf_prev1_add_tu c_mf_prev2_add_tu c_mf_delta_grd_ratio_tq_mf c_mf_tot_min_grd_ratio_tq_mf c_grd_ratio_tq_mf_min c_grd_ratio_tq_mf_max c_mf_dif_max_grd_ratio_tq_mf c_mf_tot_min_ratio_tq_mf ip_ratio_tq_mf_0 ldpm_mf_ip_ratio_tq_mf ip_ratio_tq_mf_2 ip_ratio_tq_mf_1 ip_ratio_tq_mf_3 ip_ratio_tq_mf_4 c_crlc_ratio_tq_mf c_ratio_tq_mf_max c_ratio_tq_mf_min lc_seg_ad_init id_maf_tab ldp_amp_2_inj_x ldp_n_3_inj_x ldp_n_4_inj_x c_crlc_ad_bpa[0] c_crlc_v_bpa_tol[0] c_v_bpa_max_ad_tol[0] c_v_bpa_min_ad_tol[0] lc_v_bpa_tol_sub[0] c_v_bpa_tol_sub[0] c_ang_sp_ad_bpa_bol[0] c_v_grd_bpa_st_ad_bol[0] c_temp_st_ad_bpa_max[0] c_temp_st_ad_bpa_min[0] c_v_bpa_max_st_ad_bol[0] c_vb_max_ad_bpa c_vb_min_ad_bpa c_t_ad_bpa_bol_ini[0] c_ang_sp_ad_bpa_tol[0] c_v_grd_bpa_st_ad_tol[0] c_v_bpa_min_st_ad_tol[0] c_t_ad_bpa_tol_ini[0] c_t_ad_bpa_tol[0] c_crlc_v_bpa_bol[0] c_v_bpa_max_ad_bol[0] c_v_bpa_min_ad_bol[0] lc_v_bpa_bol_sub[0] c_v_bpa_bol_sub[0] id_ad_bpa_bol__t_ad_bpa id_ad_bpa_tol__t_ad_bpa c_t_ad_bpa_bol[0] c_v_egrv_tol_sub[0] lc_v_egrv_tol_sub[0] c_crlc_v_egrv_tol[0] c_crlc_v_egrv_bol[0] c_v_egrv_max_st_ad_bol[0] c_v_egrv_min_st_ad_tol[0] c_t_ad_egrv_bol_ini[0] c_t_ad_egrv_tol_ini[0] c_crlc_ad_egrv[0] c_v_egrv_max_ad_tol[0] c_v_egrv_min_ad_tol[0] c_v_egrv_bol_sub[0] lc_v_egrv_bol_sub[0] c_ang_sp_ad_egrv_bol[0] c_temp_st_ad_egrv_max[0] c_v_grd_egrv_st_ad_bol[0] c_temp_st_ad_egrv_min[0] c_t_ad_egrv_bol[0] c_ang_sp_ad_egrv_tol[0] c_v_grd_egrv_st_ad_tol[0] c_t_ad_egrv_tol[0] c_v_egrv_min_ad_bol[0] c_v_egrv_max_ad_bol[0] id_ad_egrv_tol__t_ad_egrv id_ad_egrv_bol__t_ad_egrv c_vb_max_ad_egrv c_vb_min_ad_egrv lc_bpapwm_pctl_stat_mpg lc_bpapwm_pctl_dev c_fac_bpapwm_pctl_dev c_bpapwm_pctl_dev lc_bpa_dt1_tqi_on c_t2_dt1_bpa_tqi c_fac_bpa_dt1_tqi_fil_0 c_fac_bpa_dt1_tqi_fil_1 c_bpapwm_tqi_dt1_min c_bpapwm_tqi_dt1_max c_t2_dt1_bpa_maf lc_bpa_dt1_maf_on c_fac_bpa_dt1maf1_fil c_fac_bpa_dt1maf2_fil c_bpapwm_maf_dt1_max c_bpapwm_maf_dt1_min c_fac_bpapwm_dyn c_t1_td1_bpapwm_dyn c_bpapwm_lim_dyn_max c_kr_td1_bpapwm_dyn ip_bpapwm_pctl_stat_mdl ldp_bpa_pos_sp ip_fac_tran_bpapwm_pctl_0 ldp_tco_ip_fac_tran_bpapwm_0 ip_fac_bpapwm_pctl_cor_amp_0 ldp_amp_ip_fac_bpapwm_pctl_0 ip_fac_bpapwm_pctl_cor_tgas_0 ldp_tgas_ip_fac_bpapwm_pctl_0 ip_fac_tran_bpapwm_pctl_1 ldp_tco_ip_fac_tran_bpapwm_1 ip_fac_bpapwm_pctl_cor_amp_1 ldp_amp_ip_fac_bpapwm_pctl_1 ip_fac_bpapwm_pctl_cor_tgas_1 ldp_tgas_ip_fac_bpapwm_pctl_1 ip_bpapwm_pctl_bas_0_1 ldpm_n_ip_bpapwm_pctl_0 ldpm_tqi_ip_bpapwm_pctl_0 ip_bpapwm_pctl_bas_0_2 ip_bpapwm_pctl_bas_0_0 ip_bpapwm_pctl_cor_amp_0 ldp_n_ip_bpapwm_pctl_amp_0 ldp_tqi_ip_bpapwm_pctl_amp_0 ip_bpapwm_pctl_cor_tgas_0 ldp_n_ip_bpapwm_pctl_tgas_0 ldp_tqi_ip_bpapwm_pctl_tgas_0 ip_bpapwm_pctl_bas_1_1 ldpm_n_ip_bpapwm_pctl_1 ldpm_tqi_ip_bpapwm_pctl_1 ip_bpapwm_pctl_bas_1_2 ip_bpapwm_pctl_bas_1_0 ip_bpapwm_pctl_cor_amp_1 ldp_n_ip_bpapwm_pctl_amp_1 ldp_tqi_ip_bpapwm_pctl_amp_1 ip_bpapwm_pctl_cor_tgas_1 ldp_n_ip_bpapwm_pctl_tgas_1 ldp_tqi_ip_bpapwm_pctl_tgas_1 ip_kr_dt1_bpa_tqi ldp_n_ip_kr_dt1_bpa_tqi ldp_tqi_ip_kr_dt1_bpa_tqi ip_kr_dt1_bpa_maf ldp_n_ip_kr_dt1_bpa_maf ldp_tqi_ip_kr_dt1_bpa_maf ip_bpapwm_min ldpm_n_ip_bpapwm_lim ldpm_tqi_ip_bpapwm_lim ip_bpapwm_max ldpm_n_ip_bpapwm_pctl_short ldpm_tqi_ip_bpapwm_pctl_short c_bpa_pwm_man[0] c_bpa_pwm_man[1] lc_bpa_psn_ctl lc_bpapwm_ivs lc_bpapwm_man c_fac_egrv_pwm_cor[0] c_egrv_pwm_cor[0] c_fac_thr_pwm_cor[0] c_thr_pwm_cor[0] lc_egr_out_man ip_egrvpwm__n__mafpwm ip_egrvpwm__ar_egrv c_egrv_pwm_man[0] c_egrv_pwm_man[1] c_fac_egrvpwm_es_close lc_egrv_psn_ctl lc_test_thr[0] c_test_fac_thr[0] c_test_add_thr[0] lc_dt1_thr_on[0] lc_pi_thr_on[0] c_thr_ini[0] c_gear_trans_ratio_thr c_temp_mot_thr_ref c_r_mot_thr lc_pctl_thr_lih c_pctl_thr_lih c_temp_mot_thr[0] lc_pctl_phys_thr_on[0] c_fac_ctl_lim_thr c_ctl_lim_thr_add lc_ctl_lim_thr_man c_ctl_lim_thr_man[0] c_t_lim_dyn_thr[0] c_lim_dyn_max_thr[0] ip_kr_dt1_thr__ctl_dif ldp_ctl_dif__ip_kr_dt1_thr ip_t1_dt1_thr__ctl_dif ldp_ctl_dif__ip_t1_dt1_thr ip_kr_pi_thr__ctl_dif ldp_ctl_dif__ip_kr_pi_thr ip_tn_pi_thr__ctl_dif ldp_ctl_dif__ip_tn_pi_thr ip_tq_spr_thr__ang_sp_thr ldp_ang_sp_thr_ip_tq_spr_thr ip_cur_mot_thr__tq_mot ldp_tq_mot_thr__ip_cur_mot ip_pctl_thr__v_mot_thr ldp_v_mot_thr__ip_pctl_thr ip_pctl_thr__ang_sp_thr ldp_ang_sp_thr_ip_pctl_thr ip_ctl_min_thr_0__temp ldpm_temp__ip_ctl_thr ip_ctl_max_thr_0__temp ip_ctl_dyn_lim_thr_0__temp lc_ctl_lim_thr_grd /end DEF_CHARACTERISTIC
 /begin OUT_MEASUREMENT lv_tcs_inc tq_tcs_inter lv_tcs_ramp_end lv_tcs_ramp lv_cmd_tcs_ramp_end lv_tcs_ramp_lih lv_tcs_ramp_tq_lim lv_tcs_ramp_t_lim t_tcs_ramp t_tcs_inc lv_cmd_tcs_ramp_tq_lim lv_cmd_tcs_ramp_t_lim tq_inc_sum_tcs tq_tcs_req_inter tq_req_etcu n_sp_etcu_inter lv_req_n_ctl_etcu lv_etcu_dec_req lv_etcu_inc_req sum_tqi_lih tqi_lih_1 tqi_lih lv_tqi_lih_intv_act lv_tqi_lih_grd_lim sf_conf_gb sf_conf_acc sf_conf_heat lv_var_can_cs lv_acc_is_can_aut_ena lv_acc_is_can_req_ena lv_egr_conf lv_acc_is_driv_req_ena lv_gl_var lv_acc_is_can_state_ena lv_var_can_sys_info lv_var_can_whl lv_var_can_nom_sys vs_sum_dist dist ctr_vs_dist lv_inh_inj_prev1 lv_inh_inj_prev2 lv_inh_inj_main1 lv_inh_inj_main2 lv_inh_inj_post1 lv_inh_inj_post2 v_tco mfw_egr_kgh mfw_egr_sp_kgh temp_egr_sp temp_egr temp_up_egrv temp_up_egrv_sp quo_mfw_down_egrv quo_mfw_up_egrv_sp quo_mfw_down_egrv_sp quo_mfw_up_egrv lv_err_tba_mes vb_mmv v_pvs_1_bas v_pvs_2_bas v_dcdc tq_loss_dip_pf lv_act_ico lv_act_byp fac_byppwm_iah_mmv thrpwm_iah_clc byppwm_iah_clc temp_cyl temp_up_ico temp_up_cmp lv_cdn_act_bpa_pf bpapwm_pctl_post map_sp_post map_sp_bas_pf tba_sp_pf thrpwm_pctl_post thrpwm_pctl_bas_pf fup_sp_cor_post fac_mf_post2_cor_1 fac_mf_post2_cor_0 t_rgn_deact_mf_pf t_rgn_deact_soi_pf t_rgn_deact_fup_pf t_rgn_deact_map_sp_pf t_rgn_act_mf_pf t_rgn_act_soi_pf t_rgn_act_fup_pf t_rgn_act_map_sp_pf mf_prev1_pf mf_prev2_pf mf_main1_pf mf_main2_pf mf_post1_pf mf_post2_pf soi_prev1_pf soi_prev2_pf soi_main1_pf soi_main2_pf soi_post1_pf soi_post2_pf lv_req_egr_pf lv_req_thr_pf lv_req_bpa_pf lv_req_post_act lv_cmd_gl_ext pwm_gl_ext tq_lim_gb_prot_raw tq_lim_gb_prot tqi_lim_gb_prot n_max_etc n_max_mt n_max_tqi lv_req_ti_min_cyl_0 lv_req_ti_min_cyl_1 lv_req_ti_min_cyl_2 lv_req_ti_min_cyl_3 lv_ena_grd_ratio_tq_mf_clc grd_ratio_tq_mf_lim ratio_tq_mf_mem_new ratio_tq_mf_mem_old mf_tot_mem_new_grd_ratio_tq_mf mf_tot_mem_old_grd_ratio_tq_mf grd_ratio_tq_mf ratio_tq_mf_mpg_fil ratio_tq_mf_tot ratio_tq_mf_slm ratio_tq_mf_mpg lv_ratio_tq_mf_grd_use lv_ena_ratio_tq_mf_clc ratio_tq_mf_raw tqi_slm ratio_tq_mf_grd tq_driv_sub tqi_driv_sub lv_tq_cru_act lv_tq_vvsl_act tq_dcru_req tq_cru_req tq_vs_lim_req tq_req_dcru tqi_max cfb_pcv_mes lv_seg_t_ad_rst_ext_adj lv_seg_t_fast_ad_ext_adj ctr_t_low_maf_frq_0_av vb_fil lv_key_off v_map fup_tra_dif lv_inh_egr_ctl online_dummy ecu_state mf_bas lv_intv_bpa[0] intv_bpa[0] lv_ad_bpa[0] ad_bpa_mmv[0] lv_ad_bpa_tol[0] lv_v_bpa_tol_ad_orng[0] v_bpa_tol[0] lv_cdn_ad_v_bpa_tol[0] v_bpa_tol_det[0] t_ad_bpa_bol_av[0] lv_ad_bpa_bol[0] t_ad_bpa_tol_av[0] lv_v_bpa_bol_ad_orng[0] v_bpa_bol[0] lv_cdn_ad_v_bpa_bol[0] v_bpa_bol_det[0] ad_egrv_mmv[0] lv_v_egrv_tol_ad_orng[0] lv_v_egrv_bol_ad_orng[0] lv_cdn_ad_v_egrv_tol[0] lv_cdn_ad_v_egrv_bol[0] v_egrv_tol[0] v_egrv_bol[0] v_egrv_bol_det[0] v_egrv_tol_det[0] lv_ad_egrv_tol[0] lv_ad_egrv_tol_req[0] lv_ad_egrv_bol[0] lv_ad_egrv_bol_req[0] t_ad_egrv_tol_av[0] t_ad_egrv_bol_av[0] lv_ad_egrv[0] lv_intv_egrv[0] lv_ang_sp_egrv_intv[0] ang_sp_egrv_intv[0] intv_egrv[0] bpapwm_pctl_bas_tco_0 bpapwm_pctl_bas_tco_1 bpapwm_pctl_stat_mpg bpapwm_pctl_stat bpapwm_pctl_stat_mdl bpapwm_pctl_bas_0 bpapwm_pctl_bas_1 bpapwm_pctl_unlim bpapwm_pctl_tra bpapwm_pctl_tqi kr_dt1_bpa_tqi bpapwm_pctl_maf kr_dt1_bpa_maf bpapwm_max bpapwm_min bpapwm_ctl_min bpapwm_ctl_max bpapwm_pctl bpapwm_lim_dyn lv_bpapwm_lim_diag bpa_pwm[0] bpa_pwm_bas[0] fac_egrv_pwm_cor[0] egrv_pwm_cor[0] lv_egr_out_man thr_pwm_cor[0] fac_thr_pwm_cor[0] egrvpwm egrv_pwm[0] lv_egrvpwm_lim_diag egrvpwm_egr ang_sp_thr[0] test_thr[0] ctl_dif_thr[0] ctl_thr[0] pi_dt1_thr[0] dt1_thr[0] pi_thr[0] tq_mot_thr[0] v_mot_thr[0] r_mot_cor_thr[0] pctl_thr[0] ctl_lim_bas_thr[0] lim_dif_thr[0] ctl_lim_thr[0] ctl_thr_pre_lim[0] ctl_dyn_lim_thr[0] /end OUT_MEASUREMENT
/end FUNCTION
/begin FUNCTION PPDDOI_Generic "" /end FUNCTION
/begin FUNCTION PPDSOI_Generic "" /begin DEF_CHARACTERISTIC ldp_n_wiv_ip_toil_mdl /end DEF_CHARACTERISTIC /end FUNCTION
/begin FUNCTION CR_Generic_4_Cyl ""
 /begin OUT_MEASUREMENT ctr_bas_cyl_bal[3] ctr_eve_cyl_bal[3] fac_cyl_bal_ramp_tco[3] fac_cyl_bal[3] fac_cyl_bal_n_fdout[3] cyl_bal_pi[3] cyl_bal_dif[3] er[3] seg_ad_mmv[3] seg_t_cor_buf[6] seg_t_cor_buf[7] /end OUT_MEASUREMENT
/end FUNCTION
/end MODULE
/end PROJECT
