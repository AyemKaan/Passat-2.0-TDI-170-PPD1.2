ASAP2_VERSION 1 41
/begin PROJECT SN0 "SIMOS PPD"
/begin HEADER "_default_HeaderComment" PROJECT_NO PRJ_NUM /end HEADER
/begin MODULE _default_ModuleName "_default_ModuleLongIdentifier"
/begin MOD_COMMON "_default_ModCommonComment" DEPOSIT ABSOLUTE BYTE_ORDER MSB_FIRST ALIGNMENT_BYTE 1 ALIGNMENT_WORD 2 ALIGNMENT_LONG 4 ALIGNMENT_FLOAT32_IEEE 4 ALIGNMENT_FLOAT64_IEEE 8 /end MOD_COMMON
/begin CHARACTERISTIC ip_t_gl_puc "GLOW: Wartezeit Zwischengluehen (T_Zwischen_1)" CURVE 0x85aaca _REC_CUR_20_u2_u1 6553.5 _CNV_A_R_LINEAR_____19_CM 0. 6553.5 DISPLAY_IDENTIFIER IP_T_GL_PUC FORMAT "%5.1"
 /begin AXIS_DESCR COM_AXIS tam _CNV_A_R_LINEAR_____18_CM 3 -50. 205. FORMAT "%3.0" AXIS_PTS_REF ldp_tam_ip_t_gl_puc /end AXIS_DESCR
/end CHARACTERISTIC
/begin CHARACTERISTIC ip_pwm_gl_ast "GLOW: Tastverhaeltnis Nachgluehen" MAP 0x8558f6 _REC_MAP_20_u1_u2_u2 99.99600000000001 _CNV_A_R_LINEAR_____42_CM 0. 99.996 DISPLAY_IDENTIFIER IP_PWM_GL_AST FORMAT "%3.1"
 /begin AXIS_DESCR COM_AXIS mf_tot _CNV_A_R_LINEAR_____43_CM 6 0. 262.14 AXIS_PTS_REF ldp_mf_ip_pwm_gl_ast /end AXIS_DESCR
 /begin AXIS_DESCR COM_AXIS n _CNV_A_R_LINEAR_____5_CM 6 0. 6375. FORMAT "%4.0" AXIS_PTS_REF ldp_n_ip_pwm_gl_ast /end AXIS_DESCR
/end CHARACTERISTIC
/begin MEASUREMENT lv_gll "Gluehlampe" UBYTE _CNV_S_2_RANGE______11_CM 1 0. 0. 1. DISPLAY_IDENTIFIER LV_GLL ECU_ADDRESS 0x7fb630 /end MEASUREMENT
/begin MEASUREMENT pwm_gl "Tastverhaeltnis Gluehsteuergeraet" UBYTE _CNV_A_R_LINEAR_____44_CM 1 0. 0. 100. DISPLAY_IDENTIFIER PWM_GL ECU_ADDRESS 0x7fb631 FORMAT "%3.1" /end MEASUREMENT
/begin MEASUREMENT t_gl_es "Vorgluehzeit" UWORD _CNV_A_R_LINEAR_____19_CM 1 0. 0. 6553.5 DISPLAY_IDENTIFIER T_GL_ES ECU_ADDRESS 0x7f9bfa BYTE_ORDER MSB_LAST FORMAT "%5.1" /end MEASUREMENT
/begin MEASUREMENT t_gl_ast "Nachgluehzeit" UWORD _CNV_A_R_LINEAR_____19_CM 1 0. 0. 6553.5 DISPLAY_IDENTIFIER T_GL_AST ECU_ADDRESS 0x7fa8b4 BYTE_ORDER MSB_LAST FORMAT "%5.1" /end MEASUREMENT
/begin MEASUREMENT tco_cor_gl "Abgleichwert Kuehlmitteltemperatur" UBYTE _CNV_A_R_LINEAR_____18_CM 1 0. -50. 205. DISPLAY_IDENTIFIER TCO_COR_GL ECU_ADDRESS 0x7fba89 FORMAT "%3.0" /end MEASUREMENT
/begin MEASUREMENT lv_gl_boost "Pushen im naechsten Fahrzyklus erlaubt/verboten" UBYTE _CNV_S_2_RANGE______11_CM 1 0. 0. 1. DISPLAY_IDENTIFIER LV_GL_BOOST ECU_ADDRESS 0x7fb632 /end MEASUREMENT
/begin MEASUREMENT sf_gl_state "Status Gluehzeitsteuerung" UBYTE _CNV_S_6_Glow_State_45_CM 1 0. 0. 255. DISPLAY_IDENTIFIER SF_GL_STATE ECU_ADDRESS 0x7fba85 /end MEASUREMENT
/begin MEASUREMENT lv_gl_es "glowing active at LV_ES" UBYTE _CNV_S_2_RANGE______11_CM 1 0. 0. 1. DISPLAY_IDENTIFIER LV_GL_ES ECU_ADDRESS 0x7fb633 /end MEASUREMENT
/begin MEASUREMENT lv_gl_off "Gluehaktivierung" UBYTE _CNV_S_2_RANGE______11_CM 1 0. 0. 1. DISPLAY_IDENTIFIER LV_GL_OFF ECU_ADDRESS 0x7fba8a /end MEASUREMENT
/begin MEASUREMENT tco_cor_gl_ofs "Begrenzte Kuehlwassertemperatur" UBYTE _CNV_A_R_LINEAR_____18_CM 1 0. -50. 205. DISPLAY_IDENTIFIER TCO_COR_GL_OFS ECU_ADDRESS 0x7fb634 FORMAT "%3.0" /end MEASUREMENT
/begin MEASUREMENT lv_gl "Gluehkerzenansteuerung an/aus" UBYTE _CNV_S_2_RANGE______11_CM 1 0. 0. 1. DISPLAY_IDENTIFIER LV_GL ECU_ADDRESS 0x7fba8b /end MEASUREMENT
/begin MEASUREMENT pwm_gl_ast "Drehzahl- und Mengenabhaengiger Vorglueh-PWM-Wert" UBYTE _CNV_A_R_LINEAR_____42_CM 1 0. 0. 99.996 DISPLAY_IDENTIFIER PWM_GL_AST ECU_ADDRESS 0x7fba86 FORMAT "%3.1" /end MEASUREMENT
/begin MEASUREMENT t_gl_es_act "Zeit seit der Aktivierung der Vorgluehphase" UWORD _CNV_A_R_LINEAR_____19_CM 1 0. 0. 6553.5 DISPLAY_IDENTIFIER T_GL_ES_ACT ECU_ADDRESS 0x7fa8b8 BYTE_ORDER MSB_LAST FORMAT "%5.1" /end MEASUREMENT
/begin MEASUREMENT pwm_es "Vorglueh-PWM" UBYTE _CNV_A_R_LINEAR_____42_CM 1 0. 0. 99.996 DISPLAY_IDENTIFIER PWM_ES ECU_ADDRESS 0x7fba87 FORMAT "%3.1" /end MEASUREMENT
/begin MEASUREMENT lv_t_gl_ast_over "Nachgluehzeit abgelaufen?" UBYTE _CNV_S_2_RANGE______11_CM 1 0. 0. 1. DISPLAY_IDENTIFIER LV_T_GL_AST_OVER ECU_ADDRESS 0x7fba8c /end MEASUREMENT
/begin MEASUREMENT gl_mode "Gluehphasen-Indikator" UBYTE _CNV_S_5_Glow_Mode_46_CM 1 0. 1. 255. DISPLAY_IDENTIFIER GL_MODE ECU_ADDRESS 0x7fba88 /end MEASUREMENT
/begin MEASUREMENT t_gl_ast_frozen "Eingefrorene Nachgluehzeit" UWORD _CNV_A_R_LINEAR_____19_CM 1 0. 0. 6553.5 DISPLAY_IDENTIFIER T_GL_AST_FROZEN ECU_ADDRESS 0x7fa8ba BYTE_ORDER MSB_LAST FORMAT "%5.1" /end MEASUREMENT
/begin MEASUREMENT lv_t_gl_es_end "Vorgluehzeit abgelaufen?" UBYTE _CNV_S_2_RANGE______11_CM 1 0. 0. 1. DISPLAY_IDENTIFIER LV_T_GL_ES_END ECU_ADDRESS 0x7fba8d /end MEASUREMENT
/begin MEASUREMENT lv_t12_end "Vorglueh-Boost abgelaufen?" UBYTE _CNV_S_2_RANGE______11_CM 1 0. 0. 1. DISPLAY_IDENTIFIER LV_T12_END ECU_ADDRESS 0x7fba8e /end MEASUREMENT
/begin MEASUREMENT t12_gl_es "Vorglueh-Boost-Zeit" UWORD _CNV_A_R_LINEAR_____19_CM 1 0. 0. 6553.5 DISPLAY_IDENTIFIER T12_GL_ES ECU_ADDRESS 0x7fa8bc BYTE_ORDER MSB_LAST FORMAT "%5.1" /end MEASUREMENT
/begin MEASUREMENT lv_t_gl_st_ready_end "Bereitschaftsgluehzeit abgelaufen?" UBYTE _CNV_S_2_RANGE______11_CM 1 0. 0. 1. DISPLAY_IDENTIFIER LV_T_GL_ST_READY_END ECU_ADDRESS 0x7fba8f /end MEASUREMENT
/begin MEASUREMENT lv_gl_st_ready "Aktivierung Bereitschaftsgluehen" UBYTE _CNV_S_2_RANGE______11_CM 1 0. 0. 1. DISPLAY_IDENTIFIER LV_GL_ST_READY ECU_ADDRESS 0x7fba90 /end MEASUREMENT
/begin MEASUREMENT lv_tco_st_low "Kuehlwassertemperatur klein genug fuer Startgluehen?" UBYTE _CNV_S_2_RANGE______11_CM 1 0. 0. 1. DISPLAY_IDENTIFIER LV_TCO_ST_LOW ECU_ADDRESS 0x7fba91 /end MEASUREMENT
/begin MEASUREMENT lv_t_gl_st_end "Startgluehzeit abgelaufen?" UBYTE _CNV_S_2_RANGE______11_CM 1 0. 0. 1. DISPLAY_IDENTIFIER LV_T_GL_ST_END ECU_ADDRESS 0x7fba92 /end MEASUREMENT
/begin MEASUREMENT lv_gl_st_on "Aktivierungsbedingung Startgluehen vor Abfrage auf 'Drehzahl = 0'" UBYTE _CNV_S_2_RANGE______11_CM 1 0. 0. 1. DISPLAY_IDENTIFIER LV_GL_ST_ON ECU_ADDRESS 0x7fba93 /end MEASUREMENT
/begin MEASUREMENT lv_t_dly_gl_rly_ast_end "Relay-Schutzzeit beim Nachgluehen abgelaufen?" UBYTE _CNV_S_2_RANGE______11_CM 1 0. 0. 1. DISPLAY_IDENTIFIER LV_T_DLY_GL_RLY_AST_END ECU_ADDRESS 0x7fba94 /end MEASUREMENT
/begin MEASUREMENT lv_n_hys_gl_ast "Drehzahl-Hysterese Nachgluehen" UBYTE _CNV_S_2_RANGE______11_CM 1 0. 0. 1. DISPLAY_IDENTIFIER LV_N_HYS_GL_AST ECU_ADDRESS 0x7fba95 /end MEASUREMENT
/begin MEASUREMENT lv_mf_hys_gl_ast "Mengen-Hysterese Nachgluehen" UBYTE _CNV_S_2_RANGE______11_CM 1 0. 0. 1. DISPLAY_IDENTIFIER LV_MF_HYS_GL_AST ECU_ADDRESS 0x7fba96 /end MEASUREMENT
/begin MEASUREMENT lv_dly_gl_rly_ast_act "Beginn der Relay-Schutzzeit beim Nachgluehen" UBYTE _CNV_S_2_RANGE______11_CM 1 0. 0. 1. DISPLAY_IDENTIFIER LV_DLY_GL_RLY_AST_ACT ECU_ADDRESS 0x7fba97 /end MEASUREMENT
/begin MEASUREMENT lv_gl_ast_on "Aktivierungsbedingung Nachgluehen vor Abfrage auf 'Drehzahl = 0'" UBYTE _CNV_S_2_RANGE______11_CM 1 0. 0. 1. DISPLAY_IDENTIFIER LV_GL_AST_ON ECU_ADDRESS 0x7fba98 /end MEASUREMENT
/begin MEASUREMENT lv_t_dly_gl_rly_puc_end "Relay-Schutzzeit beim Zwischengluehen abgelaufen?" UBYTE _CNV_S_2_RANGE______11_CM 1 0. 0. 1. DISPLAY_IDENTIFIER LV_T_DLY_GL_RLY_PUC_END ECU_ADDRESS 0x7fba99 /end MEASUREMENT
/begin MEASUREMENT lv_dly_gl_rly_puc_act "Beginn der Relay-Schutzzeit beim Zwischengluehen" UBYTE _CNV_S_2_RANGE______11_CM 1 0. 0. 1. DISPLAY_IDENTIFIER LV_DLY_GL_RLY_PUC_ACT ECU_ADDRESS 0x7fba9a /end MEASUREMENT
/begin MEASUREMENT lv_pull_gl_puc "Zeitlich Entprellte Bedingung 'Menge = 0', Schub-Indikator" UBYTE _CNV_S_2_RANGE______11_CM 1 0. 0. 1. DISPLAY_IDENTIFIER LV_PULL_GL_PUC ECU_ADDRESS 0x7fba9b /end MEASUREMENT
/begin MEASUREMENT lv_pull_end_gl_puc "Zeitlich Entprellte Bedingung 'Menge > Schwelle', Indikator fuerSchub-Ende" UBYTE _CNV_S_2_RANGE______11_CM 1 0. 0. 1. DISPLAY_IDENTIFIER LV_PULL_END_GL_PUC ECU_ADDRESS 0x7fba9c /end MEASUREMENT
/begin MEASUREMENT lv_gl_puc_on "Aktivierungsbedingung Zwischengluehen vor Abfrage auf 'Drehzahl = 0'" UBYTE _CNV_S_2_RANGE______11_CM 1 0. 0. 1. DISPLAY_IDENTIFIER LV_GL_PUC_ON ECU_ADDRESS 0x7fba9d /end MEASUREMENT
/begin MEASUREMENT t_gl_puc "Wartezeit Zwischengluehen (T_Zwischen_1)" UWORD _CNV_A_R_LINEAR_____19_CM 1 0. 0. 6553.5 DISPLAY_IDENTIFIER T_GL_PUC ECU_ADDRESS 0x7fa8be BYTE_ORDER MSB_LAST FORMAT "%5.1" /end MEASUREMENT
/begin MEASUREMENT lv_gl_off_vb "Bateriespannungsabhaengige Gluehaktivierung" UBYTE _CNV_S_2_RANGE______11_CM 1 0. 0. 1. DISPLAY_IDENTIFIER LV_GL_OFF_VB ECU_ADDRESS 0x7fba9e /end MEASUREMENT
/begin CHARACTERISTIC c_tco_sp_gl "Temperatur-Vorgabewert" VALUE 0x85c154 _REC_VAL_20_u1 255. _CNV_A_R_LINEAR_____18_CM -50. 205. DISPLAY_IDENTIFIER C_TCO_SP_GL FORMAT "%3.0" /end CHARACTERISTIC
/begin CHARACTERISTIC lc_gll "Schalter Ansteuerung Gluehanzeige (Schalter 1)" VALUE 0x85c328 _REC_VAL_20_u1 1. _CNV_A_R_LINEAR_____0_CM 0. 1. DISPLAY_IDENTIFIER LC_GLL FORMAT "%1.0" /end CHARACTERISTIC
/begin CHARACTERISTIC c_tco_cor_gl_max "maximale Begrenzung Abgleichwert" VALUE 0x85c13d _REC_VAL_20_u1 255. _CNV_A_R_LINEAR_____18_CM -50. 205. DISPLAY_IDENTIFIER C_TCO_COR_GL_MAX FORMAT "%3.0" /end CHARACTERISTIC
/begin CHARACTERISTIC c_tco_cor_gl_min "minimale Begrenzung Abgleichwert" VALUE 0x85c13e _REC_VAL_20_u1 255. _CNV_A_R_LINEAR_____18_CM -50. 205. DISPLAY_IDENTIFIER C_TCO_COR_GL_MIN FORMAT "%3.0" /end CHARACTERISTIC
/begin CHARACTERISTIC c_t2_gl_es "Vorgluehen Bereich 2" VALUE 0x85c076 _REC_VAL_20_u2 6553.5 _CNV_A_R_LINEAR_____19_CM 0. 6553.5 DISPLAY_IDENTIFIER C_T2_GL_ES FORMAT "%5.1" /end CHARACTERISTIC
/begin CHARACTERISTIC lc_t_gl_es_amp_act "Auswahlschalter Vorgluehzeitberechnung aus AMP oder TCO" VALUE 0x85c363 _REC_VAL_20_u1 1. _CNV_A_R_LINEAR_____0_CM 0. 1. DISPLAY_IDENTIFIER LC_T_GL_ES_AMP_ACT FORMAT "%1.0" /end CHARACTERISTIC
/begin CHARACTERISTIC c_pwm_gl_st "Tastverhaeltnis Startgluehen (TV_Start)" VALUE 0x85c006 _REC_VAL_20_u1 99.99600000000001 _CNV_A_R_LINEAR_____42_CM 0. 99.996 DISPLAY_IDENTIFIER C_PWM_GL_ST FORMAT "%3.1" /end CHARACTERISTIC
/begin CHARACTERISTIC lc_pwm_gl_st "Schalter Auswahl Tastverhaeltnis Startgluehen" VALUE 0x85c358 _REC_VAL_20_u1 1. _CNV_A_R_LINEAR_____0_CM 0. 1. DISPLAY_IDENTIFIER LC_PWM_GL_ST FORMAT "%1.0" /end CHARACTERISTIC
/begin CHARACTERISTIC c_pwm_gl_es_1 "Tastverhaeltnis Vorgluehen Bereich 1 (TV1)" VALUE 0x85c003 _REC_VAL_20_u1 99.99600000000001 _CNV_A_R_LINEAR_____42_CM 0. 99.996 DISPLAY_IDENTIFIER C_PWM_GL_ES_1 FORMAT "%3.1" /end CHARACTERISTIC
/begin CHARACTERISTIC c_pwm_gl_es_2 "Tastverhaeltnis Vorgluehen Bereich 2 (TV2)" VALUE 0x85c004 _REC_VAL_20_u1 99.99600000000001 _CNV_A_R_LINEAR_____42_CM 0. 99.996 DISPLAY_IDENTIFIER C_PWM_GL_ES_2 FORMAT "%3.1" /end CHARACTERISTIC
/begin CHARACTERISTIC c_pwm_gl_es_3 "Tastverhaeltnis Vorgluehen Bereich 3 (TV3)" VALUE 0x85c005 _REC_VAL_20_u1 99.99600000000001 _CNV_A_R_LINEAR_____42_CM 0. 99.996 DISPLAY_IDENTIFIER C_PWM_GL_ES_3 FORMAT "%3.1" /end CHARACTERISTIC
/begin CHARACTERISTIC c_t_dly_gl_rly "Verzoegerungszeit Relaisansteuerung" VALUE 0x85c0b4 _REC_VAL_20_u2 6553.5 _CNV_A_R_LINEAR_____19_CM 0. 6553.5 DISPLAY_IDENTIFIER C_T_DLY_GL_RLY FORMAT "%5.1" /end CHARACTERISTIC
/begin CHARACTERISTIC c_n_max_gl "obere Drehzahlschwelle" VALUE 0x85bfa4 _REC_VAL_20_u2 6375. _CNV_A_R_LINEAR_____5_CM 0. 6375. DISPLAY_IDENTIFIER C_N_MAX_GL FORMAT "%4.0" /end CHARACTERISTIC
/begin CHARACTERISTIC c_t_gl_st_ready "Startbereitschaftsgluehen" VALUE 0x85c0da _REC_VAL_20_u2 6553.5 _CNV_A_R_LINEAR_____19_CM 0. 6553.5 DISPLAY_IDENTIFIER C_T_GL_ST_READY FORMAT "%5.1" /end CHARACTERISTIC
/begin CHARACTERISTIC c_tco_max_gl "Temperaturschwelle" VALUE 0x85c14e _REC_VAL_20_u1 255. _CNV_A_R_LINEAR_____18_CM -50. 205. DISPLAY_IDENTIFIER C_TCO_MAX_GL FORMAT "%3.0" /end CHARACTERISTIC
/begin CHARACTERISTIC c_t_gl_st "Startgluehzeit" VALUE 0x85c0d8 _REC_VAL_20_u2 6553.5 _CNV_A_R_LINEAR_____19_CM 0. 6553.5 DISPLAY_IDENTIFIER C_T_GL_ST FORMAT "%5.1" /end CHARACTERISTIC
/begin CHARACTERISTIC c_n_max_gl_ast "Drehzahlschwelle Nachgluehen (Drehzahl_Gluehen)" VALUE 0x85bfa6 _REC_VAL_20_u2 6375. _CNV_A_R_LINEAR_____5_CM 0. 6375. DISPLAY_IDENTIFIER C_N_MAX_GL_AST FORMAT "%4.0" /end CHARACTERISTIC
/begin CHARACTERISTIC c_mf_max_gl_ast "Mengenschwelle Nachgluehen (Menge_Gluehen)" VALUE 0x85bf60 _REC_VAL_20_u2 262.14 _CNV_A_R_LINEAR_____43_CM 0. 262.14 DISPLAY_IDENTIFIER C_MF_MAX_GL_AST FORMAT "%5.3" /end CHARACTERISTIC
/begin CHARACTERISTIC c_mf_max_gl_ast_ofs "Breite der Mengenhysterese in der Nachphase" VALUE 0x85bf62 _REC_VAL_20_s2 262.14 _CNV_A_R_LINEAR_____43_CM -131.072 131.068 DISPLAY_IDENTIFIER C_MF_MAX_GL_AST_OFS FORMAT "%5.2" /end CHARACTERISTIC
/begin CHARACTERISTIC c_n_max_gl_ast_ofs "Breite der Drehzahlhysterese in der Nachphase" VALUE 0x85bfa8 _REC_VAL_20_s2 1023.98437 _CNV_A_R_LINEAR_____47_CM -512. 511.98437 DISPLAY_IDENTIFIER C_N_MAX_GL_AST_OFS FORMAT "%3.2" /end CHARACTERISTIC
/begin CHARACTERISTIC c_t_gl_puc_3 "Wartezeit Zwischengluehen (T_Zwischen_3)" VALUE 0x85c0d6 _REC_VAL_20_u2 6553.5 _CNV_A_R_LINEAR_____19_CM 0. 6553.5 DISPLAY_IDENTIFIER C_T_GL_PUC_3 FORMAT "%5.1" /end CHARACTERISTIC
/begin CHARACTERISTIC c_mf_max_gl_puc "Mengenschwelle kein Gluehen (Menge_Glueh)" VALUE 0x85bf64 _REC_VAL_20_u2 262.14 _CNV_A_R_LINEAR_____43_CM 0. 262.14 DISPLAY_IDENTIFIER C_MF_MAX_GL_PUC FORMAT "%5.3" /end CHARACTERISTIC
/begin CHARACTERISTIC c_t_gl_puc_2 "Wartezeit Zwischengluehen (T_Zwischen_2)" VALUE 0x85c0d4 _REC_VAL_20_u2 6553.5 _CNV_A_R_LINEAR_____19_CM 0. 6553.5 DISPLAY_IDENTIFIER C_T_GL_PUC_2 FORMAT "%5.1" /end CHARACTERISTIC
/begin CHARACTERISTIC c_t_gl_boost "Zeit Pushen" VALUE 0x85c0d2 _REC_VAL_20_u2 6553.5 _CNV_A_R_LINEAR_____19_CM 0. 6553.5 DISPLAY_IDENTIFIER C_T_GL_BOOST FORMAT "%5.1" /end CHARACTERISTIC
/begin CHARACTERISTIC c_vb_gl_bol_1 "untere Grenze Hysterese Batteriespannung" VALUE 0x85c2a8 _REC_VAL_20_u1 28.8 _CNV_A_R_LINEAR_____48_CM 0. 28.8 DISPLAY_IDENTIFIER C_VB_GL_BOL_1 FORMAT "%3.1" /end CHARACTERISTIC
/begin CHARACTERISTIC c_vb_gl_tol_1 "obere Grenze Hysterese Batteriespannung" VALUE 0x85c2aa _REC_VAL_20_u1 28.8 _CNV_A_R_LINEAR_____48_CM 0. 28.8 DISPLAY_IDENTIFIER C_VB_GL_TOL_1 FORMAT "%3.1" /end CHARACTERISTIC
/begin CHARACTERISTIC c_vb_gl_bol_2 "untere Grenze Hysterese Batteriespannung" VALUE 0x85c2a9 _REC_VAL_20_u1 28.8 _CNV_A_R_LINEAR_____48_CM 0. 28.8 DISPLAY_IDENTIFIER C_VB_GL_BOL_2 FORMAT "%3.1" /end CHARACTERISTIC
/begin CHARACTERISTIC c_vb_gl_tol_2 "obere Grenze Hysterese Batteriespannung" VALUE 0x85c2ab _REC_VAL_20_u1 28.8 _CNV_A_R_LINEAR_____48_CM 0. 28.8 DISPLAY_IDENTIFIER C_VB_GL_TOL_2 FORMAT "%3.1" /end CHARACTERISTIC
/begin CHARACTERISTIC lc_gl_off "Schalter Ausschalten Gluehfunktion" VALUE 0x85c326 _REC_VAL_20_u1 1. _CNV_A_R_LINEAR_____0_CM 0. 1. DISPLAY_IDENTIFIER LC_GL_OFF FORMAT "%1.0" /end CHARACTERISTIC
/begin CHARACTERISTIC ip_t_gll "GLOW: Timer Ansteuerung Gluehlampe aus Motortemperatur" CURVE 0x85aad0 _REC_CUR_20_u2_u1 6553.5 _CNV_A_R_LINEAR_____19_CM 0. 6553.5 DISPLAY_IDENTIFIER IP_T_GLL FORMAT "%5.1"
 /begin AXIS_DESCR COM_AXIS tco _CNV_A_R_LINEAR_____18_CM 4 -50. 205. FORMAT "%3.0" AXIS_PTS_REF ldp_tco_ip_t_gll /end AXIS_DESCR
/end CHARACTERISTIC
/begin AXIS_PTS ldp_tco_ip_t_gll "" 0x84283c tco _REC_AXS_20_u1 255. _CNV_A_R_LINEAR_____18_CM 4 -50. 205. FORMAT "%3.0" /end AXIS_PTS
/begin CHARACTERISTIC ip_t_gl_ast "GLOW: Nachgluehzeit aus Motortemperatur" CURVE 0x85aa9a _REC_CUR_20_u2_u1 6553.5 _CNV_A_R_LINEAR_____19_CM 0. 6553.5 DISPLAY_IDENTIFIER IP_T_GL_AST FORMAT "%5.1"
 /begin AXIS_DESCR COM_AXIS tco _CNV_A_R_LINEAR_____18_CM 4 -50. 205. FORMAT "%3.0" AXIS_PTS_REF ldp_tco_ip_t_gl_ast /end AXIS_DESCR
/end CHARACTERISTIC
/begin AXIS_PTS ldp_tco_ip_t_gl_ast "" 0x842831 tco _REC_AXS_20_u1 255. _CNV_A_R_LINEAR_____18_CM 4 -50. 205. FORMAT "%3.0" /end AXIS_PTS
/begin CHARACTERISTIC ip_t1_gl_es "GLOW: Vorgluehen Bereich 1 (Kennlinie KL2)" CURVE 0x85aa64 _REC_CUR_20_u2_u1 6553.5 _CNV_A_R_LINEAR_____19_CM 0. 6553.5 DISPLAY_IDENTIFIER IP_T1_GL_ES FORMAT "%5.1"
 /begin AXIS_DESCR COM_AXIS tco _CNV_A_R_LINEAR_____18_CM 3 -50. 205. FORMAT "%3.0" AXIS_PTS_REF ldp_tco_ip_t1_gl_es /end AXIS_DESCR
/end CHARACTERISTIC
/begin AXIS_PTS ldp_tco_ip_t1_gl_es "" 0x842828 tco _REC_AXS_20_u1 255. _CNV_A_R_LINEAR_____18_CM 3 -50. 205. FORMAT "%3.0" /end AXIS_PTS
/begin AXIS_PTS ldp_tam_ip_t_gl_puc "" 0x842678 tam _REC_AXS_20_u1 255. _CNV_A_R_LINEAR_____18_CM 3 -50. 205. FORMAT "%3.0" /end AXIS_PTS
/begin CHARACTERISTIC ip_t_gl_es_vb "GLOW: Vorgluehen aus Batteriespannung und Wassertemperatur" MAP 0x85aab6 _REC_MAP_20_u2_u1_u1 6553.5 _CNV_A_R_LINEAR_____19_CM 0. 6553.5 DISPLAY_IDENTIFIER IP_T_GL_ES_VB FORMAT "%5.1"
 /begin AXIS_DESCR COM_AXIS vb _CNV_A_R_LINEAR_____49_CM 2 0. 28.8 FORMAT "%3.1" AXIS_PTS_REF ldp_vb_ip_t_gl_es /end AXIS_DESCR
 /begin AXIS_DESCR COM_AXIS tco _CNV_A_R_LINEAR_____18_CM 5 -50. 205. FORMAT "%3.0" AXIS_PTS_REF ldp_tco_ip_t_gl_es /end AXIS_DESCR
/end CHARACTERISTIC
/begin AXIS_PTS ldp_vb_ip_t_gl_es "" 0x84338e vb _REC_AXS_20_u1 28.8 _CNV_A_R_LINEAR_____49_CM 2 0. 28.8 FORMAT "%3.1" /end AXIS_PTS
/begin AXIS_PTS ldp_tco_ip_t_gl_es "" 0x842836 tco _REC_AXS_20_u1 255. _CNV_A_R_LINEAR_____18_CM 5 -50. 205. FORMAT "%3.0" /end AXIS_PTS
/begin CHARACTERISTIC ip_t_gl_es_amp "GLOW: Vorgluehen aus Atmosphaerendruck und Wassertemperatur" MAP 0x85aaa2 _REC_MAP_20_u2_u2_u1 6553.5 _CNV_A_R_LINEAR_____19_CM 0. 6553.5 DISPLAY_IDENTIFIER IP_T_GL_ES_AMP FORMAT "%5.1"
 /begin AXIS_DESCR COM_AXIS amp _CNV_A_R_LINEAR_____21_CM 2 0. 5434. FORMAT "%6.2" AXIS_PTS_REF ldp_amp_ip_t_gl_es /end AXIS_DESCR
 /begin AXIS_DESCR COM_AXIS tco _CNV_A_R_LINEAR_____18_CM 5 -50. 205. FORMAT "%3.0" AXIS_PTS_REF ldp_tco_ip_t_gl_es /end AXIS_DESCR
/end CHARACTERISTIC
/begin AXIS_PTS ldp_amp_ip_t_gl_es "" 0x841308 amp _REC_AXS_20_u2 5434. _CNV_A_R_LINEAR_____21_CM 2 0. 5434. FORMAT "%6.2" /end AXIS_PTS
/begin AXIS_PTS ldp_mf_ip_pwm_gl_ast "" 0x84188a mf_tot _REC_AXS_20_u2 262.14 _CNV_A_R_LINEAR_____43_CM 6 0. 262.14 /end AXIS_PTS
/begin AXIS_PTS ldp_n_ip_pwm_gl_ast "" 0x841f0a n _REC_AXS_20_u2 6375. _CNV_A_R_LINEAR_____5_CM 6 0. 6375. FORMAT "%4.0" /end AXIS_PTS
/begin MEASUREMENT t1_gl_es "Kuehlwassertemperaturabhaengige Vorglueh-Boost-Zeit (Boost-Bereich 1)" UWORD _CNV_A_R_LINEAR_____19_CM 1 0. 0. 6553.5 DISPLAY_IDENTIFIER T1_GL_ES ECU_ADDRESS 0x7fa8b6 BYTE_ORDER MSB_LAST FORMAT "%5.1" /end MEASUREMENT
/begin MEASUREMENT t3_gl_es "T3, Dauer des letzten Teils der Startgluehphase" UWORD _CNV_A_R_LINEAR_____19_CM 1 0. 0. 6553.5 DISPLAY_IDENTIFIER T3_GL_ES ECU_ADDRESS 0x7f9bfc BYTE_ORDER MSB_LAST FORMAT "%5.1" /end MEASUREMENT
/begin MEASUREMENT t2_gl_es "T2, Dauer des zweiten Teils der Startgluehphase" UWORD _CNV_A_R_LINEAR_____19_CM 1 0. 0. 6553.5 DISPLAY_IDENTIFIER T2_GL_ES ECU_ADDRESS 0x7f9bfe BYTE_ORDER MSB_LAST FORMAT "%5.1" /end MEASUREMENT
/begin MEASUREMENT n_pred "predicted engine speed" UWORD _CNV_A_R_LINEAR_____5_CM 1 0. 0. 8160. DISPLAY_IDENTIFIER N_PRED ECU_ADDRESS 0x7fa092 BYTE_ORDER MSB_LAST FORMAT "%4.0" /end MEASUREMENT
/begin MEASUREMENT t_mmv "segment time moving average over 720°CRK" UWORD _CNV_A_R_LINEAR_____64_CM 1 0. 0. 2.09712 DISPLAY_IDENTIFIER T_MMV ECU_ADDRESS 0x7fa08e BYTE_ORDER MSB_LAST FORMAT "%7.6" /end MEASUREMENT
/begin MEASUREMENT t_seg_mis "Shifted segment time for misfire detection and engine roughness calculation" UWORD _CNV_A_R_LINEAR_____65_CM 1 0. 0. 6.5536e-002 DISPLAY_IDENTIFIER T_SEG_MIS ECU_ADDRESS 0x7fa08c BYTE_ORDER MSB_LAST FORMAT "%7.6" /end MEASUREMENT
/begin MEASUREMENT tab_t_seg[0] "segment time for each cylinder" UWORD _CNV_A_R_LINEAR_____66_CM 1 0. 0. 0.26214 DISPLAY_IDENTIFIER TAB_T_SEG_0_ ECU_ADDRESS 0x7fa09c BYTE_ORDER MSB_LAST FORMAT "%7.6" /end MEASUREMENT
/begin MEASUREMENT tab_t_seg[1] "segment time for each cylinder" UWORD _CNV_A_R_LINEAR_____66_CM 1 0. 0. 0.26214 DISPLAY_IDENTIFIER TAB_T_SEG_1_ ECU_ADDRESS 0x7fa09e BYTE_ORDER MSB_LAST FORMAT "%7.6" /end MEASUREMENT
/begin MEASUREMENT tab_t_seg[2] "segment time for each cylinder" UWORD _CNV_A_R_LINEAR_____66_CM 1 0. 0. 0.26214 DISPLAY_IDENTIFIER TAB_T_SEG_2_ ECU_ADDRESS 0x7fa0a0 BYTE_ORDER MSB_LAST FORMAT "%7.6" /end MEASUREMENT
/begin MEASUREMENT tab_t_seg[3] "segment time for each cylinder" UWORD _CNV_A_R_LINEAR_____66_CM 1 0. 0. 0.26214 DISPLAY_IDENTIFIER TAB_T_SEG_3_ ECU_ADDRESS 0x7fa0a2 BYTE_ORDER MSB_LAST FORMAT "%7.6" /end MEASUREMENT
/begin MEASUREMENT t_seg_clc_red_tab[0] "array of segment times for segment tasks groups 0,1,2,3 and 4" UWORD _CNV_A_R_LINEAR_____67_CM 1 0. 0. 4.19424 DISPLAY_IDENTIFIER T_SEG_CLC_RED_TAB_0_ ECU_ADDRESS 0x7fa0a4 BYTE_ORDER MSB_LAST FORMAT "%7.6" /end MEASUREMENT
/begin MEASUREMENT t_seg_clc_red_tab[1] "array of segment times for segment tasks groups 0,1,2,3 and 4" UWORD _CNV_A_R_LINEAR_____67_CM 1 0. 0. 4.19424 DISPLAY_IDENTIFIER T_SEG_CLC_RED_TAB_1_ ECU_ADDRESS 0x7fa0a6 BYTE_ORDER MSB_LAST FORMAT "%7.6" /end MEASUREMENT
/begin MEASUREMENT t_seg_clc_red_tab[2] "array of segment times for segment tasks groups 0,1,2,3 and 4" UWORD _CNV_A_R_LINEAR_____67_CM 1 0. 0. 4.19424 DISPLAY_IDENTIFIER T_SEG_CLC_RED_TAB_2_ ECU_ADDRESS 0x7fa0a8 BYTE_ORDER MSB_LAST FORMAT "%7.6" /end MEASUREMENT
/begin MEASUREMENT t_seg_clc_red_tab[3] "array of segment times for segment tasks groups 0,1,2,3 and 4" UWORD _CNV_A_R_LINEAR_____67_CM 1 0. 0. 4.19424 DISPLAY_IDENTIFIER T_SEG_CLC_RED_TAB_3_ ECU_ADDRESS 0x7fa0aa BYTE_ORDER MSB_LAST FORMAT "%7.6" /end MEASUREMENT
/begin MEASUREMENT t_seg_clc_red_tab[4] "array of segment times for segment tasks groups 0,1,2,3 and 4" UWORD _CNV_A_R_LINEAR_____67_CM 1 0. 0. 4.19424 DISPLAY_IDENTIFIER T_SEG_CLC_RED_TAB_4_ ECU_ADDRESS 0x7fa0ac BYTE_ORDER MSB_LAST FORMAT "%7.6" /end MEASUREMENT
/begin MEASUREMENT t_seg_4 "segment time with special resolution" UWORD _CNV_A_R_LINEAR_____67_CM 1 0. 0. 4.19424 DISPLAY_IDENTIFIER T_SEG_4 ECU_ADDRESS 0x7fa090 BYTE_ORDER MSB_LAST FORMAT "%7.6" /end MEASUREMENT
/begin MEASUREMENT t_seg_clc_red "segment time for segment tasks groups 0,1,2,3 and 4" UWORD _CNV_A_R_LINEAR_____67_CM 1 0. 0. 4.19424 DISPLAY_IDENTIFIER T_SEG_CLC_RED ECU_ADDRESS 0x7fa0ae BYTE_ORDER MSB_LAST FORMAT "%7.6" /end MEASUREMENT
/begin MEASUREMENT cyl_nr "Actual segment number (from 0 to NC_CYL_NR - 1)" UBYTE _CNV_A_R_LINEAR_____0_CM 1 0. 0. 7. DISPLAY_IDENTIFIER CYL_NR ECU_ADDRESS 0x7fb767 FORMAT "%3.0" /end MEASUREMENT
/begin MEASUREMENT ptr_seg_clc "next element of segment time array to compute" UBYTE _CNV_A_R_LINEAR_____0_CM 1 0. 1. 4. DISPLAY_IDENTIFIER PTR_SEG_CLC ECU_ADDRESS 0x7fb768 FORMAT "%3.0" /end MEASUREMENT
/begin MEASUREMENT n_sp_is_cor_max "Corrected engine speed setpoint before limitation to maximum allowed engine speed" UWORD _CNV_A_R_LINEAR_____5_CM 1 0. 0. 8160. DISPLAY_IDENTIFIER N_SP_IS_COR_MAX ECU_ADDRESS 0x7f9c00 BYTE_ORDER MSB_LAST FORMAT "%4.0" /end MEASUREMENT
/begin MEASUREMENT n_sp_is "Final engine speed setpoint" UWORD _CNV_A_R_LINEAR_____5_CM 1 0. 0. 8160. DISPLAY_IDENTIFIER N_SP_IS ECU_ADDRESS 0x7f9c02 BYTE_ORDER MSB_LAST FORMAT "%4.0" /end MEASUREMENT
/begin MEASUREMENT lv_n_sp_is_max_1 "Report setpoint increase step 1 to CAN" UBYTE _CNV_S_2_RANGE______11_CM 1 0. 0. 1. DISPLAY_IDENTIFIER LV_N_SP_IS_MAX_1 ECU_ADDRESS 0x7fb636 /end MEASUREMENT
/begin MEASUREMENT lv_n_sp_is_max_2 "Report setpoint increase step 2 to CAN" UBYTE _CNV_S_2_RANGE______11_CM 1 0. 0. 1. DISPLAY_IDENTIFIER LV_N_SP_IS_MAX_2 ECU_ADDRESS 0x7fb637 /end MEASUREMENT
/begin MEASUREMENT n_sp_is_cor "Corrected engine speed setpoint" UWORD _CNV_A_R_LINEAR_____5_CM 1 0. 0. 8160. DISPLAY_IDENTIFIER N_SP_IS_COR ECU_ADDRESS 0x7f9c04 BYTE_ORDER MSB_LAST FORMAT "%4.0" /end MEASUREMENT
/begin MEASUREMENT n_sp_is_cvt "Engine speed setpoint for CVT transmission" UWORD _CNV_A_R_LINEAR_____5_CM 1 0. 0. 8160. DISPLAY_IDENTIFIER N_SP_IS_CVT ECU_ADDRESS 0x7f9c06 BYTE_ORDER MSB_LAST FORMAT "%4.0" /end MEASUREMENT
/begin MEASUREMENT n_sp_is_lim "Engine speed setpoint after limitation to maximum allowed value" UWORD _CNV_A_R_LINEAR_____5_CM 1 0. 0. 8160. DISPLAY_IDENTIFIER N_SP_IS_LIM ECU_ADDRESS 0x7f9c08 BYTE_ORDER MSB_LAST FORMAT "%4.0" /end MEASUREMENT
/begin MEASUREMENT n_sp_is_pf_rgn "Increased idle speed setpoint for pf regeneration" UWORD _CNV_A_R_LINEAR_____5_CM 1 0. 0. 8160. DISPLAY_IDENTIFIER N_SP_IS_PF_RGN ECU_ADDRESS 0x7f9c0a BYTE_ORDER MSB_LAST FORMAT "%4.0" /end MEASUREMENT
/begin MEASUREMENT lv_tpc_thd_is_sp_pf "Temperature pre catalyst is above threshold for after treatment" UBYTE _CNV_S_2_RANGE______11_CM 1 0. 0. 1. DISPLAY_IDENTIFIER LV_TPC_THD_IS_SP_PF ECU_ADDRESS 0x7fb638 /end MEASUREMENT
/begin MEASUREMENT lv_pf_rgn_is_act "PF regenration is active" UBYTE _CNV_S_2_RANGE______11_CM 1 0. 0. 1. DISPLAY_IDENTIFIER LV_PF_RGN_IS_ACT ECU_ADDRESS 0x7fb639 /end MEASUREMENT
/begin MEASUREMENT lv_n_sp_is_inc_pf_set "Increased idle speed setpoint for pf regeneration is set" UBYTE _CNV_S_2_RANGE______11_CM 1 0. 0. 1. DISPLAY_IDENTIFIER LV_N_SP_IS_INC_PF_SET ECU_ADDRESS 0x7fb63a /end MEASUREMENT
/begin MEASUREMENT lv_n_sp_is_inc_pf_rst "Increased idle speed setpoint for pf regeneration not active" UBYTE _CNV_S_2_RANGE______11_CM 1 0. 0. 1. DISPLAY_IDENTIFIER LV_N_SP_IS_INC_PF_RST ECU_ADDRESS 0x7fb63b /end MEASUREMENT
/begin MEASUREMENT lv_is_ac "Engine speed setpoint requested by air conditioning system" UBYTE _CNV_S_2_RANGE______11_CM 1 0. 0. 1. DISPLAY_IDENTIFIER LV_IS_AC ECU_ADDRESS 0x7fba9f /end MEASUREMENT
/begin MEASUREMENT lv_n_sp_is_driv "Bit indicating driver intervention" UBYTE _CNV_S_2_RANGE______11_CM 1 0. 0. 1. DISPLAY_IDENTIFIER LV_N_SP_IS_DRIV ECU_ADDRESS 0x7fbaa0 /end MEASUREMENT
/begin MEASUREMENT lv_n_sp_is_eng "indicates engine speed request by hot idle conditions" UBYTE _CNV_S_2_RANGE______11_CM 1 0. 0. 1. DISPLAY_IDENTIFIER LV_N_SP_IS_ENG ECU_ADDRESS 0x7fbaa1 /end MEASUREMENT
/begin MEASUREMENT lv_n_sp_is_ext "Engine speed setpoint request step 1" UBYTE _CNV_S_2_RANGE______11_CM 1 0. 0. 1. DISPLAY_IDENTIFIER LV_N_SP_IS_EXT ECU_ADDRESS 0x7fbaa2 /end MEASUREMENT
/begin MEASUREMENT lv_n_sp_is_ext_2 "Engine speed setpoint request step 2" UBYTE _CNV_S_2_RANGE______11_CM 1 0. 0. 1. DISPLAY_IDENTIFIER LV_N_SP_IS_EXT_2 ECU_ADDRESS 0x7fbaa3 /end MEASUREMENT
/begin MEASUREMENT n_sp_is_ac "Engine speed setpoint for air conditioning system" UWORD _CNV_A_R_LINEAR_____5_CM 1 0. 0. 8160. DISPLAY_IDENTIFIER N_SP_IS_AC ECU_ADDRESS 0x7fa8c0 BYTE_ORDER MSB_LAST FORMAT "%4.0" /end MEASUREMENT
/begin MEASUREMENT lv_is_bsg "Request by energy management control unit" UBYTE _CNV_S_2_RANGE______11_CM 1 0. 0. 1. DISPLAY_IDENTIFIER LV_IS_BSG ECU_ADDRESS 0x7fbaa4 /end MEASUREMENT
/begin MEASUREMENT n_sp_is_bsg "Engine speed setpoint step 1" UWORD _CNV_A_R_LINEAR_____5_CM 1 0. 0. 8160. DISPLAY_IDENTIFIER N_SP_IS_BSG ECU_ADDRESS 0x7fa8c2 BYTE_ORDER MSB_LAST FORMAT "%4.0" /end MEASUREMENT
/begin MEASUREMENT n_sp_is_cor_driv "Engine speed setpoint after driver intervention" UWORD _CNV_A_R_LINEAR_____5_CM 1 0. 0. 8160. DISPLAY_IDENTIFIER N_SP_IS_COR_DRIV ECU_ADDRESS 0x7fa8c4 BYTE_ORDER MSB_LAST FORMAT "%4.0" /end MEASUREMENT
/begin MEASUREMENT n_sp_is_eng "Engine speed setpoint by internal request" UWORD _CNV_A_R_LINEAR_____5_CM 1 0. 0. 8160. DISPLAY_IDENTIFIER N_SP_IS_ENG ECU_ADDRESS 0x7fa8c6 BYTE_ORDER MSB_LAST FORMAT "%4.0" /end MEASUREMENT
/begin MEASUREMENT lv_is_ramp "Engine speed setpoint ramp-up" UBYTE _CNV_S_2_RANGE______11_CM 1 0. 0. 1. DISPLAY_IDENTIFIER LV_IS_RAMP ECU_ADDRESS 0x7fbaa5 /end MEASUREMENT
/begin MEASUREMENT n_sp_is_ext "Engine speed setpoint including air conditioning, low voltage and engery management needs" UWORD _CNV_A_R_LINEAR_____5_CM 1 0. 0. 8160. DISPLAY_IDENTIFIER N_SP_IS_EXT ECU_ADDRESS 0x7fa8c8 BYTE_ORDER MSB_LAST FORMAT "%4.0" /end MEASUREMENT
/begin MEASUREMENT n_sp_is_ext_2 "Engine speed setpoint for energy management system step 2" UWORD _CNV_A_R_LINEAR_____5_CM 1 0. 0. 8160. DISPLAY_IDENTIFIER N_SP_IS_EXT_2 ECU_ADDRESS 0x7fa8ca BYTE_ORDER MSB_LAST FORMAT "%4.0" /end MEASUREMENT
/begin MEASUREMENT n_sp_is_ext_2_ramp "Engine speed setpoint step 2 for ramp-up" UWORD _CNV_A_R_LINEAR_____5_CM 1 0. 0. 8160. DISPLAY_IDENTIFIER N_SP_IS_EXT_2_RAMP ECU_ADDRESS 0x7fa8cc BYTE_ORDER MSB_LAST FORMAT "%4.0" /end MEASUREMENT
/begin MEASUREMENT n_sp_is_ext_req "Engine speed setpoint requested by air conditioning system, low voltage or energy management system" UWORD _CNV_A_R_LINEAR_____5_CM 1 0. 0. 8160. DISPLAY_IDENTIFIER N_SP_IS_EXT_REQ ECU_ADDRESS 0x7fa8ce BYTE_ORDER MSB_LAST FORMAT "%4.0" /end MEASUREMENT
/begin MEASUREMENT n_sp_is_ramp "Engine speed put out of gradient limiter" UWORD _CNV_A_R_LINEAR_____5_CM 1 0. 0. 8160. DISPLAY_IDENTIFIER N_SP_IS_RAMP ECU_ADDRESS 0x7fa8d0 BYTE_ORDER MSB_LAST FORMAT "%4.0" /end MEASUREMENT
/begin MEASUREMENT n_sp_is_ramp_tar "Engine speed setpoint target for ramp-up" UWORD _CNV_A_R_LINEAR_____5_CM 1 0. 0. 8160. DISPLAY_IDENTIFIER N_SP_IS_RAMP_TAR ECU_ADDRESS 0x7fa8d2 BYTE_ORDER MSB_LAST FORMAT "%4.0" /end MEASUREMENT
/begin MEASUREMENT n_sp_is_vb "Engine speed setpoint requested by low voltage" UWORD _CNV_A_R_LINEAR_____5_CM 1 0. 0. 8160. DISPLAY_IDENTIFIER N_SP_IS_VB ECU_ADDRESS 0x7fa8d4 BYTE_ORDER MSB_LAST FORMAT "%4.0" /end MEASUREMENT
/begin MEASUREMENT lv_is_ramp_act "Engine speed setpoint ramp-up active" UBYTE _CNV_S_2_RANGE______11_CM 1 0. 0. 1. DISPLAY_IDENTIFIER LV_IS_RAMP_ACT ECU_ADDRESS 0x7fbaa6 /end MEASUREMENT
/begin MEASUREMENT n_sp_is_vecu_2 "Internal engine speed setpoint variable" UWORD _CNV_A_R_LINEAR_____5_CM 1 0. 0. 8160. DISPLAY_IDENTIFIER N_SP_IS_VECU_2 ECU_ADDRESS 0x7fa8d6 BYTE_ORDER MSB_LAST FORMAT "%4.0" /end MEASUREMENT
/begin MEASUREMENT lv_is_ramp_ena "Engine speed setpoint ramp-up enabled" UBYTE _CNV_S_2_RANGE______11_CM 1 0. 0. 1. DISPLAY_IDENTIFIER LV_IS_RAMP_ENA ECU_ADDRESS 0x7fbaa7 /end MEASUREMENT
/begin MEASUREMENT lv_is_ramp_req "Engine speed setpoint ramp-up requested" UBYTE _CNV_S_2_RANGE______11_CM 1 0. 0. 1. DISPLAY_IDENTIFIER LV_IS_RAMP_REQ ECU_ADDRESS 0x7fbaa8 /end MEASUREMENT
/begin MEASUREMENT lv_is_ub "Engine speed setpoint request by low voltage" UBYTE _CNV_S_2_RANGE______11_CM 1 0. 0. 1. DISPLAY_IDENTIFIER LV_IS_UB ECU_ADDRESS 0x7fbaa9 /end MEASUREMENT
/begin MEASUREMENT lv_n_sp_is_ramp_max "Engine speed setpoint ramp reached maximum" UBYTE _CNV_S_2_RANGE______11_CM 1 0. 0. 1. DISPLAY_IDENTIFIER LV_N_SP_IS_RAMP_MAX ECU_ADDRESS 0x7fbaaa /end MEASUREMENT
/begin CHARACTERISTIC lc_n_sp_is_tcu_ena "Engine speed setpoint request by transmission control unit enabled" VALUE 0x8487ce _REC_VAL_20_u1 1. _CNV_A_R_LINEAR_____0_CM 0. 1. DISPLAY_IDENTIFIER LC_N_SP_IS_TCU_ENA FORMAT "%1.0" /end CHARACTERISTIC
/begin CHARACTERISTIC c_n_sp_is_dn_cvt "Engine speed setpoint change for CVT transmission" VALUE 0x848508 _REC_VAL_20_u2 8160. _CNV_A_R_LINEAR_____5_CM 0. 8160. DISPLAY_IDENTIFIER C_N_SP_IS_DN_CVT FORMAT "%4.0" /end CHARACTERISTIC
/begin CHARACTERISTIC c_lih_n_sp_is "Engine speed setpoint requested by limp-home manager" VALUE 0x8484a4 _REC_VAL_20_u2 8160. _CNV_A_R_LINEAR_____5_CM 0. 8160. DISPLAY_IDENTIFIER C_LIH_N_SP_IS FORMAT "%4.0" /end CHARACTERISTIC
/begin CHARACTERISTIC c_n_sp_is_max "Maximum allowed engine speed setpoint" VALUE 0x84850a _REC_VAL_20_u2 8160. _CNV_A_R_LINEAR_____5_CM 0. 8160. DISPLAY_IDENTIFIER C_N_SP_IS_MAX FORMAT "%4.0" /end CHARACTERISTIC
/begin CHARACTERISTIC c_n_sp_is_ofs "Hysteresis for engine speed setpoint increase" VALUE 0x84850c _REC_VAL_20_u2 8160. _CNV_A_R_LINEAR_____5_CM 0. 8160. DISPLAY_IDENTIFIER C_N_SP_IS_OFS FORMAT "%4.0" /end CHARACTERISTIC
/begin CHARACTERISTIC c_t_dly_n_sp "Delayed time for activation of some functions of engine speed setpoint calculation after engine start" VALUE 0x848630 _REC_VAL_20_u2 6553.5 _CNV_A_R_LINEAR_____19_CM 0. 6553.5 DISPLAY_IDENTIFIER C_T_DLY_N_SP FORMAT "%5.1" /end CHARACTERISTIC
/begin CHARACTERISTIC lc_is_ub_ena "Enables increase of engine speed setpoint in case of low voltage" VALUE 0x8487c4 _REC_VAL_20_u1 1. _CNV_A_R_LINEAR_____0_CM 0. 1. DISPLAY_IDENTIFIER LC_IS_UB_ENA FORMAT "%1.0" /end CHARACTERISTIC
/begin CHARACTERISTIC lc_is_ac_ena "Enables increase of engine speed setpoint for air conditioning" VALUE 0x8487b0 _REC_VAL_20_u1 1. _CNV_A_R_LINEAR_____0_CM 0. 1. DISPLAY_IDENTIFIER LC_IS_AC_ENA FORMAT "%1.0" /end CHARACTERISTIC
/begin CHARACTERISTIC lc_is_ramp_ub_req "Enables engine speed setpoint ramp-up for low voltage" VALUE 0x8487c0 _REC_VAL_20_u1 1. _CNV_A_R_LINEAR_____0_CM 0. 1. DISPLAY_IDENTIFIER LC_IS_RAMP_UB_REQ FORMAT "%1.0" /end CHARACTERISTIC
/begin CHARACTERISTIC lc_is_ramp_vecu_1_req "Enables engine speed setpoint ramp-up step 1 without driver intervention" VALUE 0x8487c1 _REC_VAL_20_u1 1. _CNV_A_R_LINEAR_____0_CM 0. 1. DISPLAY_IDENTIFIER LC_IS_RAMP_VECU_1_REQ FORMAT "%1.0" /end CHARACTERISTIC
/begin CHARACTERISTIC lc_is_bem_1_ena "Enables engine speed setpoint request step 1" VALUE 0x8487b4 _REC_VAL_20_u1 1. _CNV_A_R_LINEAR_____0_CM 0. 1. DISPLAY_IDENTIFIER LC_IS_BEM_1_ENA FORMAT "%1.0" /end CHARACTERISTIC
/begin CHARACTERISTIC lc_is_bem_2_ena "Enables engine speed setpoint request step 2" VALUE 0x8487b5 _REC_VAL_20_u1 1. _CNV_A_R_LINEAR_____0_CM 0. 1. DISPLAY_IDENTIFIER LC_IS_BEM_2_ENA FORMAT "%1.0" /end CHARACTERISTIC
/begin CHARACTERISTIC lc_is_ramp_vecu_2_req "Enables engine speed setpoint ramp-up step 2 without driver intervention" VALUE 0x8487c2 _REC_VAL_20_u1 1. _CNV_A_R_LINEAR_____0_CM 0. 1. DISPLAY_IDENTIFIER LC_IS_RAMP_VECU_2_REQ FORMAT "%1.0" /end CHARACTERISTIC
/begin CHARACTERISTIC lc_is_ramp_ac_req "Enables engine speed setpoint request by air conditioning system" VALUE 0x8487ba _REC_VAL_20_u1 1. _CNV_A_R_LINEAR_____0_CM 0. 1. DISPLAY_IDENTIFIER LC_IS_RAMP_AC_REQ FORMAT "%1.0" /end CHARACTERISTIC
/begin CHARACTERISTIC lc_is_vecu_1_ena "Enable engine speed setpoint request step 1 by energy management control unit" VALUE 0x8487c5 _REC_VAL_20_u1 1. _CNV_A_R_LINEAR_____0_CM 0. 1. DISPLAY_IDENTIFIER LC_IS_VECU_1_ENA FORMAT "%1.0" /end CHARACTERISTIC
/begin CHARACTERISTIC lc_is_vecu_2_ena "Enable engine speed setpoint request step 2 by energy management control unit" VALUE 0x8487c6 _REC_VAL_20_u1 1. _CNV_A_R_LINEAR_____0_CM 0. 1. DISPLAY_IDENTIFIER LC_IS_VECU_2_ENA FORMAT "%1.0" /end CHARACTERISTIC
/begin CHARACTERISTIC c_n_ofs_set_is_sp_pf "engine speed offset for activating idle speed setpoint increase for PF" VALUE 0x8484ec _REC_VAL_20_u2 8160. _CNV_A_R_LINEAR_____5_CM 0. 8160. DISPLAY_IDENTIFIER C_N_OFS_SET_IS_SP_PF FORMAT "%4.0" /end CHARACTERISTIC
/begin CHARACTERISTIC c_state_rgn_pf "filter mask for activation of idle speed setpoint increase for PF" VALUE 0x8485ce _REC_VAL_20_u2 65535. _CNV_A_R_LINEAR_____0_CM 0. 65535. DISPLAY_IDENTIFIER C_STATE_RGN_PF FORMAT "%5.0" /end CHARACTERISTIC
/begin CHARACTERISTIC c_temp_thd_is_sp_pf "Temperature pre catalyst threshold" VALUE 0x8486e2 _REC_VAL_20_u2 1024. _CNV_A_R_LINEAR_____56_CM 0. 1024. DISPLAY_IDENTIFIER C_TEMP_THD_IS_SP_PF FORMAT "%6.2" /end CHARACTERISTIC
/begin CHARACTERISTIC c_n_ofs_rst_is_sp_pf "engine speed offset for deactivating idle speed setpoint increase for PF" VALUE 0x8484ea _REC_VAL_20_u2 8160. _CNV_A_R_LINEAR_____5_CM 0. 8160. DISPLAY_IDENTIFIER C_N_OFS_RST_IS_SP_PF FORMAT "%4.0" /end CHARACTERISTIC
/begin CHARACTERISTIC lc_is_acin "Enables engine speed setpoint request by air conditioning system" VALUE 0x8487b3 _REC_VAL_20_u1 1. _CNV_A_R_LINEAR_____0_CM 0. 1. DISPLAY_IDENTIFIER LC_IS_ACIN FORMAT "%1.0" /end CHARACTERISTIC
/begin CHARACTERISTIC lc_is_accin_on "Enables engine speed setpoint request by air condition compressor" VALUE 0x8487b2 _REC_VAL_20_u1 1. _CNV_A_R_LINEAR_____0_CM 0. 1. DISPLAY_IDENTIFIER LC_IS_ACCIN_ON FORMAT "%1.0" /end CHARACTERISTIC
/begin CHARACTERISTIC lc_is_ac_sw "Enable engine speed setpoint request by air condition switch" VALUE 0x8487b1 _REC_VAL_20_u1 1. _CNV_A_R_LINEAR_____0_CM 0. 1. DISPLAY_IDENTIFIER LC_IS_AC_SW FORMAT "%1.0" /end CHARACTERISTIC
/begin CHARACTERISTIC c_hi_tco_thd "Threshold on temperature of cooleant for hot idle state detection" VALUE 0x84847c _REC_VAL_20_u1 255. _CNV_A_R_LINEAR_____18_CM -50. 205. DISPLAY_IDENTIFIER C_HI_TCO_THD FORMAT "%3.0" /end CHARACTERISTIC
/begin CHARACTERISTIC c_hi_tia_thd "Threshold on intake air temperature for hot idle detection" VALUE 0x84847d _REC_VAL_20_u1 255. _CNV_A_R_LINEAR_____18_CM -50. 205. DISPLAY_IDENTIFIER C_HI_TIA_THD FORMAT "%3.0" /end CHARACTERISTIC
/begin CHARACTERISTIC c_hi_toil_thd "Threshold on oil temperature for hot idle state detection" VALUE 0x84847e _REC_VAL_20_u1 200. _CNV_A_R_LINEAR_____68_CM -40. 160. DISPLAY_IDENTIFIER C_HI_TOIL_THD FORMAT "%3.0" /end CHARACTERISTIC
/begin CHARACTERISTIC lc_is_hi_ena "Enables engine speed request in hot idle state" VALUE 0x8487b6 _REC_VAL_20_u1 1. _CNV_A_R_LINEAR_____0_CM 0. 1. DISPLAY_IDENTIFIER LC_IS_HI_ENA FORMAT "%1.0" /end CHARACTERISTIC
/begin CHARACTERISTIC c_tco_max_vb_n_sp "Maximum temperature of cooleant to allow engine speed setpoint request by low voltage" VALUE 0x8486d3 _REC_VAL_20_u1 255. _CNV_A_R_LINEAR_____18_CM -50. 205. DISPLAY_IDENTIFIER C_TCO_MAX_VB_N_SP FORMAT "%3.0" /end CHARACTERISTIC
/begin CHARACTERISTIC c_n_sp_lgrd_is "Positive slope of engine speed setpoint ramp-up" VALUE 0x848512 _REC_VAL_20_u2 127.998 _CNV_A_R_LINEAR_____69_CM 2.e-003 128. DISPLAY_IDENTIFIER C_N_SP_LGRD_IS FORMAT "%5.2" /end CHARACTERISTIC
/begin CHARACTERISTIC lc_is_ramp_brake "Enable engine speed setpoint ramp if brake is actuated" VALUE 0x8487bb _REC_VAL_20_u1 1. _CNV_A_R_LINEAR_____0_CM 0. 1. DISPLAY_IDENTIFIER LC_IS_RAMP_BRAKE FORMAT "%1.0" /end CHARACTERISTIC
/begin CHARACTERISTIC lc_is_ramp_dri "Enable ramp if \"Neutral\" or \"Park\" is selected in automatic transmission vehicles" VALUE 0x8487be _REC_VAL_20_u1 1. _CNV_A_R_LINEAR_____0_CM 0. 1. DISPLAY_IDENTIFIER LC_IS_RAMP_DRI FORMAT "%1.0" /end CHARACTERISTIC
/begin CHARACTERISTIC lc_is_ramp_dct "Enable engine speed setpoint ramp if DCT-clutch is open" VALUE 0x8487bd _REC_VAL_20_u1 1. _CNV_A_R_LINEAR_____0_CM 0. 1. DISPLAY_IDENTIFIER LC_IS_RAMP_DCT FORMAT "%1.0" /end CHARACTERISTIC
/begin CHARACTERISTIC lc_is_ramp_cs_2 "Enable engine speed setpoint ramp by interlock switch" VALUE 0x8487bc _REC_VAL_20_u1 1. _CNV_A_R_LINEAR_____0_CM 0. 1. DISPLAY_IDENTIFIER LC_IS_RAMP_CS_2 FORMAT "%1.0" /end CHARACTERISTIC
/begin CHARACTERISTIC lc_is_ramp_vs_n "Enable engine speed setpoint ramp if vehicle-speed-to-engine-speed-ratio-condition is fulfilled" VALUE 0x8487c3 _REC_VAL_20_u1 1. _CNV_A_R_LINEAR_____0_CM 0. 1. DISPLAY_IDENTIFIER LC_IS_RAMP_VS_N FORMAT "%1.0" /end CHARACTERISTIC
/begin CHARACTERISTIC lc_is_ramp_man "Enable engine speed setpoint ramp manually" VALUE 0x8487bf _REC_VAL_20_u1 1. _CNV_A_R_LINEAR_____0_CM 0. 1. DISPLAY_IDENTIFIER LC_IS_RAMP_MAN FORMAT "%1.0" /end CHARACTERISTIC
/begin CHARACTERISTIC c_is_vs_n_thd "Threshold for vehicle-speed-to-engine-speed-ratio-condition" VALUE 0x848482 _REC_VAL_20_u2 0.9999874 _CNV_A_R_LINEAR_____70_CM 0. 0.9999874 DISPLAY_IDENTIFIER C_IS_VS_N_THD FORMAT "%4.3" /end CHARACTERISTIC
/begin CHARACTERISTIC lc_is_2st "Switch for single step energy management control system" VALUE 0x8487af _REC_VAL_20_u1 1. _CNV_A_R_LINEAR_____0_CM 0. 1. DISPLAY_IDENTIFIER LC_IS_2ST FORMAT "%1.0" /end CHARACTERISTIC
/begin CHARACTERISTIC id_n_sp_min_is__vb_fil "N_IS: Minimum engine speed setpoint depending on battery voltage" CURVE 0x8452ce _REC_CUR_20_u2_u1 8160. _CNV_A_R_LINEAR_____5_CM 0. 8160. DISPLAY_IDENTIFIER ID_N_SP_MIN_IS__VB_FIL FORMAT "%4.0"
 /begin AXIS_DESCR COM_AXIS vb _CNV_A_R_LINEAR_____48_CM 6 0. 28.8 FORMAT "%4.2" AXIS_PTS_REF ldp_vb_fil_n_sp_min_is /end AXIS_DESCR
/end CHARACTERISTIC
/begin AXIS_PTS ldp_vb_fil_n_sp_min_is "" 0x843382 vb _REC_AXS_20_u1 28.8 _CNV_A_R_LINEAR_____48_CM 6 0. 28.8 FORMAT "%4.2" /end AXIS_PTS
/begin CHARACTERISTIC ip_n_sp_is_cvt_vs "N_IS: Engine speed setpoint for CVT transmission depending on vehicle speed" CURVE 0x8472fc _REC_CUR_20_u2_u1 8160. _CNV_A_R_LINEAR_____5_CM 0. 8160. DISPLAY_IDENTIFIER IP_N_SP_IS_CVT_VS FORMAT "%4.0"
 /begin AXIS_DESCR COM_AXIS vs _CNV_A_R_LINEAR_____39_CM 6 0. 255. FORMAT "%3.0" AXIS_PTS_REF ldp_vs_n_sp_is_cvt_vs /end AXIS_DESCR
/end CHARACTERISTIC
/begin AXIS_PTS ldp_vs_n_sp_is_cvt_vs "" 0x8433ee vs _REC_AXS_20_u1 255. _CNV_A_R_LINEAR_____39_CM 6 0. 255. FORMAT "%3.0" /end AXIS_PTS
/begin CHARACTERISTIC ip_n_inc_is_sp_pf "N_IS: Increased idle speed setpoint for PF regeneration" CURVE 0x847204 _REC_CUR_20_u2_u1 8160. _CNV_A_R_LINEAR_____5_CM 0. 8160. DISPLAY_IDENTIFIER IP_N_INC_IS_SP_PF FORMAT "%4.0"
 /begin AXIS_DESCR COM_AXIS tco _CNV_A_R_LINEAR_____18_CM 6 -50. 205. FORMAT "%3.0" AXIS_PTS_REF ldp_tco_ip_n_inc_is_sp_pf /end AXIS_DESCR
/end CHARACTERISTIC
/begin AXIS_PTS ldp_tco_ip_n_inc_is_sp_pf "" 0x84280f tco _REC_AXS_20_u1 255. _CNV_A_R_LINEAR_____18_CM 6 -50. 205. FORMAT "%3.0" /end AXIS_PTS
/begin CHARACTERISTIC ip_n_sp_acin_dri_is__tco "N_IS: Engine speed setpoint with requested air condioning for automatic transmission vehicles in drive position" CURVE 0x847274 _REC_CUR_20_u2_u1 8160. _CNV_A_R_LINEAR_____5_CM 0. 8160. DISPLAY_IDENTIFIER IP_N_SP_ACIN_DRI_IS__TCO FORMAT "%4.0"
 /begin AXIS_DESCR COM_AXIS tco _CNV_A_R_LINEAR_____18_CM 8 -50. 205. FORMAT "%3.0" AXIS_PTS_REF ldpm_tco_ip_n_sp_is /end AXIS_DESCR
/end CHARACTERISTIC
/begin AXIS_PTS ldpm_tco_ip_n_sp_is "" 0x843eac tco _REC_AXS_20_u1 255. _CNV_A_R_LINEAR_____18_CM 8 -50. 205. FORMAT "%3.0" /end AXIS_PTS
/begin CHARACTERISTIC ip_n_sp_acin_is_at__tco "N_IS: Engine speed setpoint with requested air condioning for automatic transmission vehicles" CURVE 0x847284 _REC_CUR_20_u2_u1 8160. _CNV_A_R_LINEAR_____5_CM 0. 8160. DISPLAY_IDENTIFIER IP_N_SP_ACIN_IS_AT__TCO FORMAT "%4.0"
 /begin AXIS_DESCR COM_AXIS tco _CNV_A_R_LINEAR_____18_CM 8 -50. 205. FORMAT "%3.0" AXIS_PTS_REF ldpm_tco_ip_n_sp_is /end AXIS_DESCR
/end CHARACTERISTIC
/begin CHARACTERISTIC ip_n_sp_acin_is_mt__tco "N_IS: Engine speed setpoint with requested air condioning for manual transmission vehicles" CURVE 0x847294 _REC_CUR_20_u2_u1 8160. _CNV_A_R_LINEAR_____5_CM 0. 8160. DISPLAY_IDENTIFIER IP_N_SP_ACIN_IS_MT__TCO FORMAT "%4.0"
 /begin AXIS_DESCR COM_AXIS tco _CNV_A_R_LINEAR_____18_CM 8 -50. 205. FORMAT "%3.0" AXIS_PTS_REF ldpm_tco_ip_n_sp_is /end AXIS_DESCR
/end CHARACTERISTIC
/begin CHARACTERISTIC ip_n_sp_is_max_vecu_1_tco "N_IS: Engine speed setpoint requested by engery managment control system step 1" CURVE 0x847314 _REC_CUR_20_u2_u1 8160. _CNV_A_R_LINEAR_____5_CM 0. 8160. DISPLAY_IDENTIFIER IP_N_SP_IS_MAX_VECU_1_TCO FORMAT "%4.0"
 /begin AXIS_DESCR COM_AXIS tco _CNV_A_R_LINEAR_____18_CM 8 -50. 205. FORMAT "%3.0" AXIS_PTS_REF ldpm_tco_ip_n_sp_is /end AXIS_DESCR
/end CHARACTERISTIC
/begin CHARACTERISTIC ip_n_sp_is_max_vecu_2_tco "N_IS: Engine speed setpoint requested by engery managment control system step 2" CURVE 0x847324 _REC_CUR_20_u2_u1 8160. _CNV_A_R_LINEAR_____5_CM 0. 8160. DISPLAY_IDENTIFIER IP_N_SP_IS_MAX_VECU_2_TCO FORMAT "%4.0"
 /begin AXIS_DESCR COM_AXIS tco _CNV_A_R_LINEAR_____18_CM 8 -50. 205. FORMAT "%3.0" AXIS_PTS_REF ldpm_tco_ip_n_sp_is /end AXIS_DESCR
/end CHARACTERISTIC
/begin CHARACTERISTIC ip_n_sp_is_hi "N_IS: Engine speed setpoint for hot idle state" CURVE 0x847308 _REC_CUR_20_u2_u1 8160. _CNV_A_R_LINEAR_____5_CM 0. 8160. DISPLAY_IDENTIFIER IP_N_SP_IS_HI FORMAT "%4.0"
 /begin AXIS_DESCR COM_AXIS toil _CNV_A_R_LINEAR_____68_CM 6 -40. 160. FORMAT "%3.0" AXIS_PTS_REF ldp_toil_n_sp_is_hi /end AXIS_DESCR
/end CHARACTERISTIC
/begin AXIS_PTS ldp_toil_n_sp_is_hi "" 0x842a37 toil _REC_AXS_20_u1 200. _CNV_A_R_LINEAR_____68_CM 6 -40. 160. FORMAT "%3.0" /end AXIS_PTS
/begin MEASUREMENT n_sp_is_bas "basic idle speed setpoint" UWORD _CNV_A_R_LINEAR_____5_CM 1 0. 0. 8160. DISPLAY_IDENTIFIER N_SP_IS_BAS ECU_ADDRESS 0x7f9c0c BYTE_ORDER MSB_LAST FORMAT "%4.0" /end MEASUREMENT
/begin CHARACTERISTIC id_n_sp_is_mt_dri "N_IS_SP_I: gear dependent engine speed setpoint for manual transmission vehicles" CURVE 0x8452c0 _REC_CUR_20_u2_u1 8160. _CNV_A_R_LINEAR_____5_CM 0. 8160. DISPLAY_IDENTIFIER ID_N_SP_IS_MT_DRI FORMAT "%4.0"
 /begin AXIS_DESCR COM_AXIS dri _CNV_A_R_LINEAR_____0_CM 7 0. 6. FORMAT "%1.0" AXIS_PTS_REF ldpm_dri_n_sp_is /end AXIS_DESCR
/end CHARACTERISTIC
/begin AXIS_PTS ldpm_dri_n_sp_is "" 0x843464 dri _REC_AXS_20_u1 6. _CNV_A_R_LINEAR_____0_CM 7 0. 6. FORMAT "%1.0" /end AXIS_PTS
/begin CHARACTERISTIC id_n_sp_is_at_dri "N_IS_SP_I: gear dependent engine speed setpoint for automatic transmission vehicles" CURVE 0x8452b2 _REC_CUR_20_u2_u1 8160. _CNV_A_R_LINEAR_____5_CM 0. 8160. DISPLAY_IDENTIFIER ID_N_SP_IS_AT_DRI FORMAT "%4.0"
 /begin AXIS_DESCR COM_AXIS dri _CNV_A_R_LINEAR_____0_CM 7 0. 6. FORMAT "%1.0" AXIS_PTS_REF ldpm_dri_n_sp_is /end AXIS_DESCR
/end CHARACTERISTIC
/begin CHARACTERISTIC ip_n_sp_is_at "N_IS_SP_I: normal idle speed setpoint for automatic transmission vehicles" CURVE 0x8472ec _REC_CUR_20_u2_u1 8160. _CNV_A_R_LINEAR_____5_CM 0. 8160. DISPLAY_IDENTIFIER IP_N_SP_IS_AT FORMAT "%4.0"
 /begin AXIS_DESCR COM_AXIS tco _CNV_A_R_LINEAR_____18_CM 8 -50. 205. FORMAT "%3.0" AXIS_PTS_REF ldpm_tco_ip_n_sp_is /end AXIS_DESCR
/end CHARACTERISTIC
/begin CHARACTERISTIC ip_n_sp_is_mt "N_IS_SP_I: normal idle speed setpoint for manual transmission vehicles" CURVE 0x847334 _REC_CUR_20_u2_u1 8160. _CNV_A_R_LINEAR_____5_CM 0. 8160. DISPLAY_IDENTIFIER IP_N_SP_IS_MT FORMAT "%4.0"
 /begin AXIS_DESCR COM_AXIS tco _CNV_A_R_LINEAR_____18_CM 8 -50. 205. FORMAT "%3.0" AXIS_PTS_REF ldpm_tco_ip_n_sp_is /end AXIS_DESCR
/end CHARACTERISTIC
/begin MEASUREMENT v_dip_pf "Voltage from differential pressure sensor on particulate filter" UWORD _CNV_A_R_LINEAR_____33_CM 1 0. 0. 4.9951171875 DISPLAY_IDENTIFIER V_DIP_PF ECU_ADDRESS 0x7fa084 BYTE_ORDER MSB_LAST FORMAT "%4.3" /end MEASUREMENT
/begin MEASUREMENT dip_pf_mes "Measured differential pressure on particulate filter" UWORD _CNV_A_R_LINEAR_____21_CM 1 0. 0. 5434. DISPLAY_IDENTIFIER DIP_PF_MES ECU_ADDRESS 0x7fa086 BYTE_ORDER MSB_LAST FORMAT "%6.2" /end MEASUREMENT
/begin MEASUREMENT v_dip_pf_ad "Calibrated offset minus sensor voltage messured with zero differential pressure" SWORD _CNV_A_R_LINEAR_____109_CM 1 0. -5.00000000000182 4.99511718999747 DISPLAY_IDENTIFIER V_DIP_PF_AD ECU_ADDRESS 0x7fa082 BYTE_ORDER MSB_LAST FORMAT "%4.3" /end MEASUREMENT
/begin MEASUREMENT dip_pf "Differential Pressure on Particulate Filter" UWORD _CNV_A_R_LINEAR_____21_CM 1 0. 0. 5434. DISPLAY_IDENTIFIER DIP_PF ECU_ADDRESS 0x7fa088 BYTE_ORDER MSB_LAST FORMAT "%6.2" /end MEASUREMENT
/begin MEASUREMENT dip_pf_mmv "Filtered Differential Pressure on Particulate Filter" UWORD _CNV_A_R_LINEAR_____21_CM 1 0. 0. 5434. DISPLAY_IDENTIFIER DIP_PF_MMV ECU_ADDRESS 0x7fa08a BYTE_ORDER MSB_LAST FORMAT "%6.2" /end MEASUREMENT
/begin MEASUREMENT dip_pf_temp "Differential Pressure on Particulate Filter without filtering" UWORD _CNV_A_R_LINEAR_____21_CM 1 0. 0. 5434. DISPLAY_IDENTIFIER DIP_PF_TEMP ECU_ADDRESS 0x7fb036 BYTE_ORDER MSB_LAST FORMAT "%6.2" /end MEASUREMENT
/begin CHARACTERISTIC c_dip_pf_sub_diag "Differential Pressure on Particulate Filter substitute value" VALUE 0x848366 _REC_VAL_20_u2 5434. _CNV_A_R_LINEAR_____21_CM 0. 5434. DISPLAY_IDENTIFIER C_DIP_PF_SUB_DIAG FORMAT "%6.2" /end CHARACTERISTIC
/begin CHARACTERISTIC c_fac_dip_pf_fil "Filter factor for DIP_PV" VALUE 0x848434 _REC_VAL_20_u2 0.9999847412109381 _CNV_A_R_LINEAR_____14_CM 0. 0.9999847412109381 DISPLAY_IDENTIFIER C_FAC_DIP_PF_FIL FORMAT "%6.5" /end CHARACTERISTIC
/begin CHARACTERISTIC c_v_dip_pf_ofs "Voltage offset for DIP_PF calculation" VALUE 0x84873c _REC_VAL_20_u2 4.9951171875 _CNV_A_R_LINEAR_____33_CM 0. 4.9951171875 DISPLAY_IDENTIFIER C_V_DIP_PF_OFS FORMAT "%4.3" /end CHARACTERISTIC
/begin CHARACTERISTIC c_fac_v_dip_pf "Scaling factor for DIP_PF calculation" VALUE 0x84846c _REC_VAL_20_u2 8681.460985 _CNV_A_R_LINEAR_____118_CM 0. 8681.460985 DISPLAY_IDENTIFIER C_FAC_V_DIP_PF FORMAT "%5.1" /end CHARACTERISTIC
/begin CHARACTERISTIC c_tco_max_dip_pf_ad "Upper TCO limit for DIP_PF adaptation" VALUE 0x8486ce _REC_VAL_20_u1 255. _CNV_A_R_LINEAR_____18_CM -50. 205. DISPLAY_IDENTIFIER C_TCO_MAX_DIP_PF_AD FORMAT "%3.0" /end CHARACTERISTIC
/begin CHARACTERISTIC c_tia_min_dip_pf_ad "Lower TIA limit for DIP_PF adaptation" VALUE 0x8486f1 _REC_VAL_20_u1 255. _CNV_A_R_LINEAR_____18_CM -50. 205. DISPLAY_IDENTIFIER C_TIA_MIN_DIP_PF_AD FORMAT "%3.0" /end CHARACTERISTIC
/begin CHARACTERISTIC c_tia_max_dip_pf_ad "Upper TIA limit for DIP_PF adaptation" VALUE 0x8486f0 _REC_VAL_20_u1 255. _CNV_A_R_LINEAR_____18_CM -50. 205. DISPLAY_IDENTIFIER C_TIA_MAX_DIP_PF_AD FORMAT "%3.0" /end CHARACTERISTIC
/begin CHARACTERISTIC c_v_dip_pf_ad_max "Maximum limitation of learning offset to correct V_DIP_PF" VALUE 0x848738 _REC_VAL_20_s2 9.99511718999929 _CNV_A_R_LINEAR_____109_CM -5.00000000000182 4.99511718999747 DISPLAY_IDENTIFIER C_V_DIP_PF_AD_MAX FORMAT "%4.3" /end CHARACTERISTIC
/begin CHARACTERISTIC c_v_dip_pf_ad_min "Minimum limitation of learning offset to correct V_DIP_PF" VALUE 0x84873a _REC_VAL_20_s2 9.99511718999929 _CNV_A_R_LINEAR_____109_CM -5.00000000000182 4.99511718999747 DISPLAY_IDENTIFIER C_V_DIP_PF_AD_MIN FORMAT "%4.3" /end CHARACTERISTIC
/begin MEASUREMENT capa_inj_seq1_[0] "piezo injector capacity of injection sequence 1 (vector)" UBYTE _CNV_A_R_LINEAR_____122_CM 1 0. 0. 31.96875 DISPLAY_IDENTIFIER CAPA_INJ_SEQ1__0_ ECU_ADDRESS 0x7fb6d9 FORMAT "%4.2" /end MEASUREMENT
/begin MEASUREMENT capa_inj_seq1_[1] "piezo injector capacity of injection sequence 1 (vector)" UBYTE _CNV_A_R_LINEAR_____122_CM 1 0. 0. 31.96875 DISPLAY_IDENTIFIER CAPA_INJ_SEQ1__1_ ECU_ADDRESS 0x7fb6da FORMAT "%4.2" /end MEASUREMENT
/begin MEASUREMENT capa_inj_seq1_[2] "piezo injector capacity of injection sequence 1 (vector)" UBYTE _CNV_A_R_LINEAR_____122_CM 1 0. 0. 31.96875 DISPLAY_IDENTIFIER CAPA_INJ_SEQ1__2_ ECU_ADDRESS 0x7fb6db FORMAT "%4.2" /end MEASUREMENT
/begin MEASUREMENT capa_inj_seq1_[3] "piezo injector capacity of injection sequence 1 (vector)" UBYTE _CNV_A_R_LINEAR_____122_CM 1 0. 0. 31.96875 DISPLAY_IDENTIFIER CAPA_INJ_SEQ1__3_ ECU_ADDRESS 0x7fb6dc FORMAT "%4.2" /end MEASUREMENT
/begin MEASUREMENT capa_inj_seq1 "piezo injector capacity of injection sequence 1" UBYTE _CNV_A_R_LINEAR_____122_CM 1 0. 0. 31.96875 DISPLAY_IDENTIFIER CAPA_INJ_SEQ1 ECU_ADDRESS 0x7fb6d8 FORMAT "%4.2" /end MEASUREMENT
/begin MEASUREMENT v_inj_beg_main1_[0] "piezo injector voltage of injection MAIN1 (vector)" UWORD _CNV_A_R_LINEAR_____123_CM 1 0. 0. 255. DISPLAY_IDENTIFIER V_INJ_BEG_MAIN1__0_ ECU_ADDRESS 0x7f9d26 BYTE_ORDER MSB_LAST FORMAT "%4.1" /end MEASUREMENT
/begin MEASUREMENT v_inj_beg_main1_[1] "piezo injector voltage of injection MAIN1 (vector)" UWORD _CNV_A_R_LINEAR_____123_CM 1 0. 0. 255. DISPLAY_IDENTIFIER V_INJ_BEG_MAIN1__1_ ECU_ADDRESS 0x7f9d28 BYTE_ORDER MSB_LAST FORMAT "%4.1" /end MEASUREMENT
/begin MEASUREMENT v_inj_beg_main1_[2] "piezo injector voltage of injection MAIN1 (vector)" UWORD _CNV_A_R_LINEAR_____123_CM 1 0. 0. 255. DISPLAY_IDENTIFIER V_INJ_BEG_MAIN1__2_ ECU_ADDRESS 0x7f9d2a BYTE_ORDER MSB_LAST FORMAT "%4.1" /end MEASUREMENT
/begin MEASUREMENT v_inj_beg_main1_[3] "piezo injector voltage of injection MAIN1 (vector)" UWORD _CNV_A_R_LINEAR_____123_CM 1 0. 0. 255. DISPLAY_IDENTIFIER V_INJ_BEG_MAIN1__3_ ECU_ADDRESS 0x7f9d2c BYTE_ORDER MSB_LAST FORMAT "%4.1" /end MEASUREMENT
/begin MEASUREMENT v_inj_beg_main1 "piezo injector voltage of injection MAIN1" UWORD _CNV_A_R_LINEAR_____123_CM 1 0. 0. 255. DISPLAY_IDENTIFIER V_INJ_BEG_MAIN1 ECU_ADDRESS 0x7f9d1c BYTE_ORDER MSB_LAST FORMAT "%4.1" /end MEASUREMENT
/begin MEASUREMENT v_inj_beg_prev1 "piezo injector voltage of injection PREV1" UWORD _CNV_A_R_LINEAR_____123_CM 1 0. 0. 255. DISPLAY_IDENTIFIER V_INJ_BEG_PREV1 ECU_ADDRESS 0x7f9d1a BYTE_ORDER MSB_LAST FORMAT "%4.1" /end MEASUREMENT
/begin MEASUREMENT q_inj_seq1_[0] "piezo injector charge of sequence 1 (vector)" UWORD _CNV_A_R_LINEAR_____124_CM 1 0. 0. 4095.9375 DISPLAY_IDENTIFIER Q_INJ_SEQ1__0_ ECU_ADDRESS 0x7f9e30 BYTE_ORDER MSB_LAST FORMAT "%5.1" /end MEASUREMENT
/begin MEASUREMENT q_inj_seq1_[1] "piezo injector charge of sequence 1 (vector)" UWORD _CNV_A_R_LINEAR_____124_CM 1 0. 0. 4095.9375 DISPLAY_IDENTIFIER Q_INJ_SEQ1__1_ ECU_ADDRESS 0x7f9e32 BYTE_ORDER MSB_LAST FORMAT "%5.1" /end MEASUREMENT
/begin MEASUREMENT q_inj_seq1_[2] "piezo injector charge of sequence 1 (vector)" UWORD _CNV_A_R_LINEAR_____124_CM 1 0. 0. 4095.9375 DISPLAY_IDENTIFIER Q_INJ_SEQ1__2_ ECU_ADDRESS 0x7f9e34 BYTE_ORDER MSB_LAST FORMAT "%5.1" /end MEASUREMENT
/begin MEASUREMENT q_inj_seq1_[3] "piezo injector charge of sequence 1 (vector)" UWORD _CNV_A_R_LINEAR_____124_CM 1 0. 0. 4095.9375 DISPLAY_IDENTIFIER Q_INJ_SEQ1__3_ ECU_ADDRESS 0x7f9e36 BYTE_ORDER MSB_LAST FORMAT "%5.1" /end MEASUREMENT
/begin MEASUREMENT q_inj_seq1 "piezo injector charge of sequence 1" UWORD _CNV_A_R_LINEAR_____124_CM 1 0. 0. 4095.9375 DISPLAY_IDENTIFIER Q_INJ_SEQ1 ECU_ADDRESS 0x7f9e2e BYTE_ORDER MSB_LAST FORMAT "%5.1" /end MEASUREMENT
/begin MEASUREMENT v_ofs_cha_cal_0 "piezo injector calibration offset value bank 0" UWORD _CNV_A_R_LINEAR_____125_CM 1 0. 0. 4.995117 DISPLAY_IDENTIFIER V_OFS_CHA_CAL_0 ECU_ADDRESS 0x7f9d38 BYTE_ORDER MSB_LAST FORMAT "%4.1" /end MEASUREMENT
/begin MEASUREMENT fac_slop_cha_cal_0 "piezo injector calibration slope factor bank 0" UWORD _CNV_A_R_LINEAR_____126_CM 1 0. 0. 1023. DISPLAY_IDENTIFIER FAC_SLOP_CHA_CAL_0 ECU_ADDRESS 0x7f9d3a BYTE_ORDER MSB_LAST FORMAT "%5.2" /end MEASUREMENT
/begin CHARACTERISTIC c_fac_cha_cal_0 "factor for calculation of q_inj calibration slope bank 0" VALUE 0x85be16 _REC_VAL_20_u2 320. _CNV_A_R_LINEAR_____127_CM 0. 320. DISPLAY_IDENTIFIER C_FAC_CHA_CAL_0 FORMAT "%5.2" /end CHARACTERISTIC
/begin CHARACTERISTIC c_fac_cha_cal_1 "factor for calculation of q_inj calibration slope bank 1" VALUE 0x85be18 _REC_VAL_20_u2 320. _CNV_A_R_LINEAR_____127_CM 0. 320. DISPLAY_IDENTIFIER C_FAC_CHA_CAL_1 FORMAT "%5.2" /end CHARACTERISTIC
/begin CHARACTERISTIC c_v_cha_cal1 "replace value for v_cha_cal1" VALUE 0x85c208 _REC_VAL_20_u2 4.995117 _CNV_A_R_LINEAR_____125_CM 0. 4.995117 DISPLAY_IDENTIFIER C_V_CHA_CAL1 FORMAT "%5.3" /end CHARACTERISTIC
/begin CHARACTERISTIC c_v_cha_cal0 "replace value for v_cha_cal0" VALUE 0x85c206 _REC_VAL_20_u2 4.995117 _CNV_A_R_LINEAR_____125_CM 0. 4.995117 DISPLAY_IDENTIFIER C_V_CHA_CAL0 FORMAT "%5.3" /end CHARACTERISTIC
/begin MEASUREMENT v_inj_beg_prev1_[0] "piezo injector voltage of injection PREV1 (vector)" UWORD _CNV_A_R_LINEAR_____123_CM 1 0. 0. 255. DISPLAY_IDENTIFIER V_INJ_BEG_PREV1__0_ ECU_ADDRESS 0x7f9d1e BYTE_ORDER MSB_LAST FORMAT "%4.1" /end MEASUREMENT
/begin MEASUREMENT v_inj_beg_prev1_[1] "piezo injector voltage of injection PREV1 (vector)" UWORD _CNV_A_R_LINEAR_____123_CM 1 0. 0. 255. DISPLAY_IDENTIFIER V_INJ_BEG_PREV1__1_ ECU_ADDRESS 0x7f9d20 BYTE_ORDER MSB_LAST FORMAT "%4.1" /end MEASUREMENT
/begin MEASUREMENT v_inj_beg_prev1_[2] "piezo injector voltage of injection PREV1 (vector)" UWORD _CNV_A_R_LINEAR_____123_CM 1 0. 0. 255. DISPLAY_IDENTIFIER V_INJ_BEG_PREV1__2_ ECU_ADDRESS 0x7f9d22 BYTE_ORDER MSB_LAST FORMAT "%4.1" /end MEASUREMENT
/begin MEASUREMENT v_inj_beg_prev1_[3] "piezo injector voltage of injection PREV1 (vector)" UWORD _CNV_A_R_LINEAR_____123_CM 1 0. 0. 255. DISPLAY_IDENTIFIER V_INJ_BEG_PREV1__3_ ECU_ADDRESS 0x7f9d24 BYTE_ORDER MSB_LAST FORMAT "%4.1" /end MEASUREMENT
/begin MEASUREMENT v_inj_burst_soi_[0] "voltage values of burst measurement triggered on SOI" UWORD _CNV_A_R_LINEAR_____128_CM 1 0. 0. 255. DISPLAY_IDENTIFIER V_INJ_BURST_SOI__0_ ECU_ADDRESS 0x7f9d3e BYTE_ORDER MSB_LAST FORMAT "%4.1" /end MEASUREMENT
/begin MEASUREMENT v_inj_burst_soi_[1] "voltage values of burst measurement triggered on SOI" UWORD _CNV_A_R_LINEAR_____128_CM 1 0. 0. 255. DISPLAY_IDENTIFIER V_INJ_BURST_SOI__1_ ECU_ADDRESS 0x7f9d40 BYTE_ORDER MSB_LAST FORMAT "%4.1" /end MEASUREMENT
/begin MEASUREMENT v_inj_burst_soi_[2] "voltage values of burst measurement triggered on SOI" UWORD _CNV_A_R_LINEAR_____128_CM 1 0. 0. 255. DISPLAY_IDENTIFIER V_INJ_BURST_SOI__2_ ECU_ADDRESS 0x7f9d42 BYTE_ORDER MSB_LAST FORMAT "%4.1" /end MEASUREMENT
/begin MEASUREMENT v_inj_burst_soi_[3] "voltage values of burst measurement triggered on SOI" UWORD _CNV_A_R_LINEAR_____128_CM 1 0. 0. 255. DISPLAY_IDENTIFIER V_INJ_BURST_SOI__3_ ECU_ADDRESS 0x7f9d44 BYTE_ORDER MSB_LAST FORMAT "%4.1" /end MEASUREMENT
/begin MEASUREMENT v_inj_burst_soi_[4] "voltage values of burst measurement triggered on SOI" UWORD _CNV_A_R_LINEAR_____128_CM 1 0. 0. 255. DISPLAY_IDENTIFIER V_INJ_BURST_SOI__4_ ECU_ADDRESS 0x7f9d46 BYTE_ORDER MSB_LAST FORMAT "%4.1" /end MEASUREMENT
/begin MEASUREMENT v_inj_burst_soi_[5] "voltage values of burst measurement triggered on SOI" UWORD _CNV_A_R_LINEAR_____128_CM 1 0. 0. 255. DISPLAY_IDENTIFIER V_INJ_BURST_SOI__5_ ECU_ADDRESS 0x7f9d48 BYTE_ORDER MSB_LAST FORMAT "%4.1" /end MEASUREMENT
/begin MEASUREMENT v_inj_burst_soi_[6] "voltage values of burst measurement triggered on SOI" UWORD _CNV_A_R_LINEAR_____128_CM 1 0. 0. 255. DISPLAY_IDENTIFIER V_INJ_BURST_SOI__6_ ECU_ADDRESS 0x7f9d4a BYTE_ORDER MSB_LAST FORMAT "%4.1" /end MEASUREMENT
/begin MEASUREMENT v_inj_burst_soi_[7] "voltage values of burst measurement triggered on SOI" UWORD _CNV_A_R_LINEAR_____128_CM 1 0. 0. 255. DISPLAY_IDENTIFIER V_INJ_BURST_SOI__7_ ECU_ADDRESS 0x7f9d4c BYTE_ORDER MSB_LAST FORMAT "%4.1" /end MEASUREMENT
/begin MEASUREMENT v_inj_burst_soi_[8] "voltage values of burst measurement triggered on SOI" UWORD _CNV_A_R_LINEAR_____128_CM 1 0. 0. 255. DISPLAY_IDENTIFIER V_INJ_BURST_SOI__8_ ECU_ADDRESS 0x7f9d4e BYTE_ORDER MSB_LAST FORMAT "%4.1" /end MEASUREMENT
/begin MEASUREMENT v_inj_burst_soi_[9] "voltage values of burst measurement triggered on SOI" UWORD _CNV_A_R_LINEAR_____128_CM 1 0. 0. 255. DISPLAY_IDENTIFIER V_INJ_BURST_SOI__9_ ECU_ADDRESS 0x7f9d50 BYTE_ORDER MSB_LAST FORMAT "%4.1" /end MEASUREMENT
/begin MEASUREMENT v_inj_burst_soi_[10] "voltage values of burst measurement triggered on SOI" UWORD _CNV_A_R_LINEAR_____128_CM 1 0. 0. 255. DISPLAY_IDENTIFIER V_INJ_BURST_SOI__10_ ECU_ADDRESS 0x7f9d52 BYTE_ORDER MSB_LAST FORMAT "%4.1" /end MEASUREMENT
/begin MEASUREMENT v_inj_burst_soi_[11] "voltage values of burst measurement triggered on SOI" UWORD _CNV_A_R_LINEAR_____128_CM 1 0. 0. 255. DISPLAY_IDENTIFIER V_INJ_BURST_SOI__11_ ECU_ADDRESS 0x7f9d54 BYTE_ORDER MSB_LAST FORMAT "%4.1" /end MEASUREMENT
/begin MEASUREMENT v_inj_burst_soi_[12] "voltage values of burst measurement triggered on SOI" UWORD _CNV_A_R_LINEAR_____128_CM 1 0. 0. 255. DISPLAY_IDENTIFIER V_INJ_BURST_SOI__12_ ECU_ADDRESS 0x7f9d56 BYTE_ORDER MSB_LAST FORMAT "%4.1" /end MEASUREMENT
/begin MEASUREMENT v_inj_burst_soi_[13] "voltage values of burst measurement triggered on SOI" UWORD _CNV_A_R_LINEAR_____128_CM 1 0. 0. 255. DISPLAY_IDENTIFIER V_INJ_BURST_SOI__13_ ECU_ADDRESS 0x7f9d58 BYTE_ORDER MSB_LAST FORMAT "%4.1" /end MEASUREMENT
/begin MEASUREMENT v_inj_burst_soi_[14] "voltage values of burst measurement triggered on SOI" UWORD _CNV_A_R_LINEAR_____128_CM 1 0. 0. 255. DISPLAY_IDENTIFIER V_INJ_BURST_SOI__14_ ECU_ADDRESS 0x7f9d5a BYTE_ORDER MSB_LAST FORMAT "%4.1" /end MEASUREMENT
/begin MEASUREMENT v_inj_burst_soi_[15] "voltage values of burst measurement triggered on SOI" UWORD _CNV_A_R_LINEAR_____128_CM 1 0. 0. 255. DISPLAY_IDENTIFIER V_INJ_BURST_SOI__15_ ECU_ADDRESS 0x7f9d5c BYTE_ORDER MSB_LAST FORMAT "%4.1" /end MEASUREMENT
/begin MEASUREMENT v_inj_burst_soi_[16] "voltage values of burst measurement triggered on SOI" UWORD _CNV_A_R_LINEAR_____128_CM 1 0. 0. 255. DISPLAY_IDENTIFIER V_INJ_BURST_SOI__16_ ECU_ADDRESS 0x7f9d5e BYTE_ORDER MSB_LAST FORMAT "%4.1" /end MEASUREMENT
/begin MEASUREMENT v_inj_burst_soi_[17] "voltage values of burst measurement triggered on SOI" UWORD _CNV_A_R_LINEAR_____128_CM 1 0. 0. 255. DISPLAY_IDENTIFIER V_INJ_BURST_SOI__17_ ECU_ADDRESS 0x7f9d60 BYTE_ORDER MSB_LAST FORMAT "%4.1" /end MEASUREMENT
/begin MEASUREMENT v_inj_burst_soi_[18] "voltage values of burst measurement triggered on SOI" UWORD _CNV_A_R_LINEAR_____128_CM 1 0. 0. 255. DISPLAY_IDENTIFIER V_INJ_BURST_SOI__18_ ECU_ADDRESS 0x7f9d62 BYTE_ORDER MSB_LAST FORMAT "%4.1" /end MEASUREMENT
/begin MEASUREMENT v_inj_burst_soi_[19] "voltage values of burst measurement triggered on SOI" UWORD _CNV_A_R_LINEAR_____128_CM 1 0. 0. 255. DISPLAY_IDENTIFIER V_INJ_BURST_SOI__19_ ECU_ADDRESS 0x7f9d64 BYTE_ORDER MSB_LAST FORMAT "%4.1" /end MEASUREMENT
/begin MEASUREMENT v_inj_burst_soi_[20] "voltage values of burst measurement triggered on SOI" UWORD _CNV_A_R_LINEAR_____128_CM 1 0. 0. 255. DISPLAY_IDENTIFIER V_INJ_BURST_SOI__20_ ECU_ADDRESS 0x7f9d66 BYTE_ORDER MSB_LAST FORMAT "%4.1" /end MEASUREMENT
/begin MEASUREMENT v_inj_burst_soi_[21] "voltage values of burst measurement triggered on SOI" UWORD _CNV_A_R_LINEAR_____128_CM 1 0. 0. 255. DISPLAY_IDENTIFIER V_INJ_BURST_SOI__21_ ECU_ADDRESS 0x7f9d68 BYTE_ORDER MSB_LAST FORMAT "%4.1" /end MEASUREMENT
/begin MEASUREMENT v_inj_burst_soi_[22] "voltage values of burst measurement triggered on SOI" UWORD _CNV_A_R_LINEAR_____128_CM 1 0. 0. 255. DISPLAY_IDENTIFIER V_INJ_BURST_SOI__22_ ECU_ADDRESS 0x7f9d6a BYTE_ORDER MSB_LAST FORMAT "%4.1" /end MEASUREMENT
/begin MEASUREMENT v_inj_burst_soi_[23] "voltage values of burst measurement triggered on SOI" UWORD _CNV_A_R_LINEAR_____128_CM 1 0. 0. 255. DISPLAY_IDENTIFIER V_INJ_BURST_SOI__23_ ECU_ADDRESS 0x7f9d6c BYTE_ORDER MSB_LAST FORMAT "%4.1" /end MEASUREMENT
/begin MEASUREMENT v_inj_burst_soi_[24] "voltage values of burst measurement triggered on SOI" UWORD _CNV_A_R_LINEAR_____128_CM 1 0. 0. 255. DISPLAY_IDENTIFIER V_INJ_BURST_SOI__24_ ECU_ADDRESS 0x7f9d6e BYTE_ORDER MSB_LAST FORMAT "%4.1" /end MEASUREMENT
/begin MEASUREMENT v_inj_burst_soi_[25] "voltage values of burst measurement triggered on SOI" UWORD _CNV_A_R_LINEAR_____128_CM 1 0. 0. 255. DISPLAY_IDENTIFIER V_INJ_BURST_SOI__25_ ECU_ADDRESS 0x7f9d70 BYTE_ORDER MSB_LAST FORMAT "%4.1" /end MEASUREMENT
/begin MEASUREMENT v_inj_burst_soi_[26] "voltage values of burst measurement triggered on SOI" UWORD _CNV_A_R_LINEAR_____128_CM 1 0. 0. 255. DISPLAY_IDENTIFIER V_INJ_BURST_SOI__26_ ECU_ADDRESS 0x7f9d72 BYTE_ORDER MSB_LAST FORMAT "%4.1" /end MEASUREMENT
/begin MEASUREMENT v_inj_burst_soi_[27] "voltage values of burst measurement triggered on SOI" UWORD _CNV_A_R_LINEAR_____128_CM 1 0. 0. 255. DISPLAY_IDENTIFIER V_INJ_BURST_SOI__27_ ECU_ADDRESS 0x7f9d74 BYTE_ORDER MSB_LAST FORMAT "%4.1" /end MEASUREMENT
/begin MEASUREMENT v_inj_burst_soi_[28] "voltage values of burst measurement triggered on SOI" UWORD _CNV_A_R_LINEAR_____128_CM 1 0. 0. 255. DISPLAY_IDENTIFIER V_INJ_BURST_SOI__28_ ECU_ADDRESS 0x7f9d76 BYTE_ORDER MSB_LAST FORMAT "%4.1" /end MEASUREMENT
/begin MEASUREMENT v_inj_burst_soi_[29] "voltage values of burst measurement triggered on SOI" UWORD _CNV_A_R_LINEAR_____128_CM 1 0. 0. 255. DISPLAY_IDENTIFIER V_INJ_BURST_SOI__29_ ECU_ADDRESS 0x7f9d78 BYTE_ORDER MSB_LAST FORMAT "%4.1" /end MEASUREMENT
/begin MEASUREMENT v_inj_burst_soi_[30] "voltage values of burst measurement triggered on SOI" UWORD _CNV_A_R_LINEAR_____128_CM 1 0. 0. 255. DISPLAY_IDENTIFIER V_INJ_BURST_SOI__30_ ECU_ADDRESS 0x7f9d7a BYTE_ORDER MSB_LAST FORMAT "%4.1" /end MEASUREMENT
/begin MEASUREMENT v_inj_burst_soi_[31] "voltage values of burst measurement triggered on SOI" UWORD _CNV_A_R_LINEAR_____128_CM 1 0. 0. 255. DISPLAY_IDENTIFIER V_INJ_BURST_SOI__31_ ECU_ADDRESS 0x7f9d7c BYTE_ORDER MSB_LAST FORMAT "%4.1" /end MEASUREMENT
/begin MEASUREMENT v_inj_burst_soi_[32] "voltage values of burst measurement triggered on SOI" UWORD _CNV_A_R_LINEAR_____128_CM 1 0. 0. 255. DISPLAY_IDENTIFIER V_INJ_BURST_SOI__32_ ECU_ADDRESS 0x7f9d7e BYTE_ORDER MSB_LAST FORMAT "%4.1" /end MEASUREMENT
/begin MEASUREMENT v_inj_burst_soi_[33] "voltage values of burst measurement triggered on SOI" UWORD _CNV_A_R_LINEAR_____128_CM 1 0. 0. 255. DISPLAY_IDENTIFIER V_INJ_BURST_SOI__33_ ECU_ADDRESS 0x7f9d80 BYTE_ORDER MSB_LAST FORMAT "%4.1" /end MEASUREMENT
/begin MEASUREMENT v_inj_burst_soi_[34] "voltage values of burst measurement triggered on SOI" UWORD _CNV_A_R_LINEAR_____128_CM 1 0. 0. 255. DISPLAY_IDENTIFIER V_INJ_BURST_SOI__34_ ECU_ADDRESS 0x7f9d82 BYTE_ORDER MSB_LAST FORMAT "%4.1" /end MEASUREMENT
/begin MEASUREMENT v_inj_burst_soi_[35] "voltage values of burst measurement triggered on SOI" UWORD _CNV_A_R_LINEAR_____128_CM 1 0. 0. 255. DISPLAY_IDENTIFIER V_INJ_BURST_SOI__35_ ECU_ADDRESS 0x7f9d84 BYTE_ORDER MSB_LAST FORMAT "%4.1" /end MEASUREMENT
/begin MEASUREMENT v_inj_burst_soi_[36] "voltage values of burst measurement triggered on SOI" UWORD _CNV_A_R_LINEAR_____128_CM 1 0. 0. 255. DISPLAY_IDENTIFIER V_INJ_BURST_SOI__36_ ECU_ADDRESS 0x7f9d86 BYTE_ORDER MSB_LAST FORMAT "%4.1" /end MEASUREMENT
/begin MEASUREMENT v_inj_burst_soi_[37] "voltage values of burst measurement triggered on SOI" UWORD _CNV_A_R_LINEAR_____128_CM 1 0. 0. 255. DISPLAY_IDENTIFIER V_INJ_BURST_SOI__37_ ECU_ADDRESS 0x7f9d88 BYTE_ORDER MSB_LAST FORMAT "%4.1" /end MEASUREMENT
/begin MEASUREMENT v_inj_burst_soi_[38] "voltage values of burst measurement triggered on SOI" UWORD _CNV_A_R_LINEAR_____128_CM 1 0. 0. 255. DISPLAY_IDENTIFIER V_INJ_BURST_SOI__38_ ECU_ADDRESS 0x7f9d8a BYTE_ORDER MSB_LAST FORMAT "%4.1" /end MEASUREMENT
/begin MEASUREMENT v_inj_burst_soi_[39] "voltage values of burst measurement triggered on SOI" UWORD _CNV_A_R_LINEAR_____128_CM 1 0. 0. 255. DISPLAY_IDENTIFIER V_INJ_BURST_SOI__39_ ECU_ADDRESS 0x7f9d8c BYTE_ORDER MSB_LAST FORMAT "%4.1" /end MEASUREMENT
/begin MEASUREMENT v_inj_burst_eoi_[0] "voltage values of burst measurement triggered on EOI" UWORD _CNV_A_R_LINEAR_____128_CM 1 0. 0. 255. DISPLAY_IDENTIFIER V_INJ_BURST_EOI__0_ ECU_ADDRESS 0x7f9db6 BYTE_ORDER MSB_LAST FORMAT "%4.1" /end MEASUREMENT
/begin MEASUREMENT v_inj_burst_eoi_[1] "voltage values of burst measurement triggered on EOI" UWORD _CNV_A_R_LINEAR_____128_CM 1 0. 0. 255. DISPLAY_IDENTIFIER V_INJ_BURST_EOI__1_ ECU_ADDRESS 0x7f9db8 BYTE_ORDER MSB_LAST FORMAT "%4.1" /end MEASUREMENT
/begin MEASUREMENT v_inj_burst_eoi_[2] "voltage values of burst measurement triggered on EOI" UWORD _CNV_A_R_LINEAR_____128_CM 1 0. 0. 255. DISPLAY_IDENTIFIER V_INJ_BURST_EOI__2_ ECU_ADDRESS 0x7f9dba BYTE_ORDER MSB_LAST FORMAT "%4.1" /end MEASUREMENT
/begin MEASUREMENT v_inj_burst_eoi_[3] "voltage values of burst measurement triggered on EOI" UWORD _CNV_A_R_LINEAR_____128_CM 1 0. 0. 255. DISPLAY_IDENTIFIER V_INJ_BURST_EOI__3_ ECU_ADDRESS 0x7f9dbc BYTE_ORDER MSB_LAST FORMAT "%4.1" /end MEASUREMENT
/begin MEASUREMENT v_inj_burst_eoi_[4] "voltage values of burst measurement triggered on EOI" UWORD _CNV_A_R_LINEAR_____128_CM 1 0. 0. 255. DISPLAY_IDENTIFIER V_INJ_BURST_EOI__4_ ECU_ADDRESS 0x7f9dbe BYTE_ORDER MSB_LAST FORMAT "%4.1" /end MEASUREMENT
/begin MEASUREMENT v_inj_burst_eoi_[5] "voltage values of burst measurement triggered on EOI" UWORD _CNV_A_R_LINEAR_____128_CM 1 0. 0. 255. DISPLAY_IDENTIFIER V_INJ_BURST_EOI__5_ ECU_ADDRESS 0x7f9dc0 BYTE_ORDER MSB_LAST FORMAT "%4.1" /end MEASUREMENT
/begin MEASUREMENT v_inj_burst_eoi_[6] "voltage values of burst measurement triggered on EOI" UWORD _CNV_A_R_LINEAR_____128_CM 1 0. 0. 255. DISPLAY_IDENTIFIER V_INJ_BURST_EOI__6_ ECU_ADDRESS 0x7f9dc2 BYTE_ORDER MSB_LAST FORMAT "%4.1" /end MEASUREMENT
/begin MEASUREMENT v_inj_burst_eoi_[7] "voltage values of burst measurement triggered on EOI" UWORD _CNV_A_R_LINEAR_____128_CM 1 0. 0. 255. DISPLAY_IDENTIFIER V_INJ_BURST_EOI__7_ ECU_ADDRESS 0x7f9dc4 BYTE_ORDER MSB_LAST FORMAT "%4.1" /end MEASUREMENT
/begin MEASUREMENT v_inj_burst_eoi_[8] "voltage values of burst measurement triggered on EOI" UWORD _CNV_A_R_LINEAR_____128_CM 1 0. 0. 255. DISPLAY_IDENTIFIER V_INJ_BURST_EOI__8_ ECU_ADDRESS 0x7f9dc6 BYTE_ORDER MSB_LAST FORMAT "%4.1" /end MEASUREMENT
/begin MEASUREMENT v_inj_burst_eoi_[9] "voltage values of burst measurement triggered on EOI" UWORD _CNV_A_R_LINEAR_____128_CM 1 0. 0. 255. DISPLAY_IDENTIFIER V_INJ_BURST_EOI__9_ ECU_ADDRESS 0x7f9dc8 BYTE_ORDER MSB_LAST FORMAT "%4.1" /end MEASUREMENT
/begin MEASUREMENT v_inj_burst_eoi_[10] "voltage values of burst measurement triggered on EOI" UWORD _CNV_A_R_LINEAR_____128_CM 1 0. 0. 255. DISPLAY_IDENTIFIER V_INJ_BURST_EOI__10_ ECU_ADDRESS 0x7f9dca BYTE_ORDER MSB_LAST FORMAT "%4.1" /end MEASUREMENT
/begin MEASUREMENT v_inj_burst_eoi_[11] "voltage values of burst measurement triggered on EOI" UWORD _CNV_A_R_LINEAR_____128_CM 1 0. 0. 255. DISPLAY_IDENTIFIER V_INJ_BURST_EOI__11_ ECU_ADDRESS 0x7f9dcc BYTE_ORDER MSB_LAST FORMAT "%4.1" /end MEASUREMENT
/begin MEASUREMENT v_inj_burst_eoi_[12] "voltage values of burst measurement triggered on EOI" UWORD _CNV_A_R_LINEAR_____128_CM 1 0. 0. 255. DISPLAY_IDENTIFIER V_INJ_BURST_EOI__12_ ECU_ADDRESS 0x7f9dce BYTE_ORDER MSB_LAST FORMAT "%4.1" /end MEASUREMENT
/begin MEASUREMENT v_inj_burst_eoi_[13] "voltage values of burst measurement triggered on EOI" UWORD _CNV_A_R_LINEAR_____128_CM 1 0. 0. 255. DISPLAY_IDENTIFIER V_INJ_BURST_EOI__13_ ECU_ADDRESS 0x7f9dd0 BYTE_ORDER MSB_LAST FORMAT "%4.1" /end MEASUREMENT
/begin MEASUREMENT v_inj_burst_eoi_[14] "voltage values of burst measurement triggered on EOI" UWORD _CNV_A_R_LINEAR_____128_CM 1 0. 0. 255. DISPLAY_IDENTIFIER V_INJ_BURST_EOI__14_ ECU_ADDRESS 0x7f9dd2 BYTE_ORDER MSB_LAST FORMAT "%4.1" /end MEASUREMENT
/begin MEASUREMENT v_inj_burst_eoi_[15] "voltage values of burst measurement triggered on EOI" UWORD _CNV_A_R_LINEAR_____128_CM 1 0. 0. 255. DISPLAY_IDENTIFIER V_INJ_BURST_EOI__15_ ECU_ADDRESS 0x7f9dd4 BYTE_ORDER MSB_LAST FORMAT "%4.1" /end MEASUREMENT
/begin MEASUREMENT v_inj_burst_eoi_[16] "voltage values of burst measurement triggered on EOI" UWORD _CNV_A_R_LINEAR_____128_CM 1 0. 0. 255. DISPLAY_IDENTIFIER V_INJ_BURST_EOI__16_ ECU_ADDRESS 0x7f9dd6 BYTE_ORDER MSB_LAST FORMAT "%4.1" /end MEASUREMENT
/begin MEASUREMENT v_inj_burst_eoi_[17] "voltage values of burst measurement triggered on EOI" UWORD _CNV_A_R_LINEAR_____128_CM 1 0. 0. 255. DISPLAY_IDENTIFIER V_INJ_BURST_EOI__17_ ECU_ADDRESS 0x7f9dd8 BYTE_ORDER MSB_LAST FORMAT "%4.1" /end MEASUREMENT
/begin MEASUREMENT v_inj_burst_eoi_[18] "voltage values of burst measurement triggered on EOI" UWORD _CNV_A_R_LINEAR_____128_CM 1 0. 0. 255. DISPLAY_IDENTIFIER V_INJ_BURST_EOI__18_ ECU_ADDRESS 0x7f9dda BYTE_ORDER MSB_LAST FORMAT "%4.1" /end MEASUREMENT
/begin MEASUREMENT v_inj_burst_eoi_[19] "voltage values of burst measurement triggered on EOI" UWORD _CNV_A_R_LINEAR_____128_CM 1 0. 0. 255. DISPLAY_IDENTIFIER V_INJ_BURST_EOI__19_ ECU_ADDRESS 0x7f9ddc BYTE_ORDER MSB_LAST FORMAT "%4.1" /end MEASUREMENT
/begin MEASUREMENT v_inj_burst_eoi_[20] "voltage values of burst measurement triggered on EOI" UWORD _CNV_A_R_LINEAR_____128_CM 1 0. 0. 255. DISPLAY_IDENTIFIER V_INJ_BURST_EOI__20_ ECU_ADDRESS 0x7f9dde BYTE_ORDER MSB_LAST FORMAT "%4.1" /end MEASUREMENT
/begin MEASUREMENT v_inj_burst_eoi_[21] "voltage values of burst measurement triggered on EOI" UWORD _CNV_A_R_LINEAR_____128_CM 1 0. 0. 255. DISPLAY_IDENTIFIER V_INJ_BURST_EOI__21_ ECU_ADDRESS 0x7f9de0 BYTE_ORDER MSB_LAST FORMAT "%4.1" /end MEASUREMENT
/begin MEASUREMENT v_inj_burst_eoi_[22] "voltage values of burst measurement triggered on EOI" UWORD _CNV_A_R_LINEAR_____128_CM 1 0. 0. 255. DISPLAY_IDENTIFIER V_INJ_BURST_EOI__22_ ECU_ADDRESS 0x7f9de2 BYTE_ORDER MSB_LAST FORMAT "%4.1" /end MEASUREMENT
/begin MEASUREMENT v_inj_burst_eoi_[23] "voltage values of burst measurement triggered on EOI" UWORD _CNV_A_R_LINEAR_____128_CM 1 0. 0. 255. DISPLAY_IDENTIFIER V_INJ_BURST_EOI__23_ ECU_ADDRESS 0x7f9de4 BYTE_ORDER MSB_LAST FORMAT "%4.1" /end MEASUREMENT
/begin MEASUREMENT v_inj_burst_eoi_[24] "voltage values of burst measurement triggered on EOI" UWORD _CNV_A_R_LINEAR_____128_CM 1 0. 0. 255. DISPLAY_IDENTIFIER V_INJ_BURST_EOI__24_ ECU_ADDRESS 0x7f9de6 BYTE_ORDER MSB_LAST FORMAT "%4.1" /end MEASUREMENT
/begin MEASUREMENT v_inj_burst_eoi_[25] "voltage values of burst measurement triggered on EOI" UWORD _CNV_A_R_LINEAR_____128_CM 1 0. 0. 255. DISPLAY_IDENTIFIER V_INJ_BURST_EOI__25_ ECU_ADDRESS 0x7f9de8 BYTE_ORDER MSB_LAST FORMAT "%4.1" /end MEASUREMENT
/begin MEASUREMENT v_inj_burst_eoi_[26] "voltage values of burst measurement triggered on EOI" UWORD _CNV_A_R_LINEAR_____128_CM 1 0. 0. 255. DISPLAY_IDENTIFIER V_INJ_BURST_EOI__26_ ECU_ADDRESS 0x7f9dea BYTE_ORDER MSB_LAST FORMAT "%4.1" /end MEASUREMENT
/begin MEASUREMENT v_inj_burst_eoi_[27] "voltage values of burst measurement triggered on EOI" UWORD _CNV_A_R_LINEAR_____128_CM 1 0. 0. 255. DISPLAY_IDENTIFIER V_INJ_BURST_EOI__27_ ECU_ADDRESS 0x7f9dec BYTE_ORDER MSB_LAST FORMAT "%4.1" /end MEASUREMENT
/begin MEASUREMENT v_inj_burst_eoi_[28] "voltage values of burst measurement triggered on EOI" UWORD _CNV_A_R_LINEAR_____128_CM 1 0. 0. 255. DISPLAY_IDENTIFIER V_INJ_BURST_EOI__28_ ECU_ADDRESS 0x7f9dee BYTE_ORDER MSB_LAST FORMAT "%4.1" /end MEASUREMENT
/begin MEASUREMENT v_inj_burst_eoi_[29] "voltage values of burst measurement triggered on EOI" UWORD _CNV_A_R_LINEAR_____128_CM 1 0. 0. 255. DISPLAY_IDENTIFIER V_INJ_BURST_EOI__29_ ECU_ADDRESS 0x7f9df0 BYTE_ORDER MSB_LAST FORMAT "%4.1" /end MEASUREMENT
/begin MEASUREMENT v_inj_burst_eoi_[30] "voltage values of burst measurement triggered on EOI" UWORD _CNV_A_R_LINEAR_____128_CM 1 0. 0. 255. DISPLAY_IDENTIFIER V_INJ_BURST_EOI__30_ ECU_ADDRESS 0x7f9df2 BYTE_ORDER MSB_LAST FORMAT "%4.1" /end MEASUREMENT
/begin MEASUREMENT v_inj_burst_eoi_[31] "voltage values of burst measurement triggered on EOI" UWORD _CNV_A_R_LINEAR_____128_CM 1 0. 0. 255. DISPLAY_IDENTIFIER V_INJ_BURST_EOI__31_ ECU_ADDRESS 0x7f9df4 BYTE_ORDER MSB_LAST FORMAT "%4.1" /end MEASUREMENT
/begin MEASUREMENT v_inj_burst_eoi_[32] "voltage values of burst measurement triggered on EOI" UWORD _CNV_A_R_LINEAR_____128_CM 1 0. 0. 255. DISPLAY_IDENTIFIER V_INJ_BURST_EOI__32_ ECU_ADDRESS 0x7f9df6 BYTE_ORDER MSB_LAST FORMAT "%4.1" /end MEASUREMENT
/begin MEASUREMENT v_inj_burst_eoi_[33] "voltage values of burst measurement triggered on EOI" UWORD _CNV_A_R_LINEAR_____128_CM 1 0. 0. 255. DISPLAY_IDENTIFIER V_INJ_BURST_EOI__33_ ECU_ADDRESS 0x7f9df8 BYTE_ORDER MSB_LAST FORMAT "%4.1" /end MEASUREMENT
/begin MEASUREMENT v_inj_burst_eoi_[34] "voltage values of burst measurement triggered on EOI" UWORD _CNV_A_R_LINEAR_____128_CM 1 0. 0. 255. DISPLAY_IDENTIFIER V_INJ_BURST_EOI__34_ ECU_ADDRESS 0x7f9dfa BYTE_ORDER MSB_LAST FORMAT "%4.1" /end MEASUREMENT
/begin MEASUREMENT v_inj_burst_eoi_[35] "voltage values of burst measurement triggered on EOI" UWORD _CNV_A_R_LINEAR_____128_CM 1 0. 0. 255. DISPLAY_IDENTIFIER V_INJ_BURST_EOI__35_ ECU_ADDRESS 0x7f9dfc BYTE_ORDER MSB_LAST FORMAT "%4.1" /end MEASUREMENT
/begin MEASUREMENT v_inj_burst_eoi_[36] "voltage values of burst measurement triggered on EOI" UWORD _CNV_A_R_LINEAR_____128_CM 1 0. 0. 255. DISPLAY_IDENTIFIER V_INJ_BURST_EOI__36_ ECU_ADDRESS 0x7f9dfe BYTE_ORDER MSB_LAST FORMAT "%4.1" /end MEASUREMENT
/begin MEASUREMENT v_inj_burst_eoi_[37] "voltage values of burst measurement triggered on EOI" UWORD _CNV_A_R_LINEAR_____128_CM 1 0. 0. 255. DISPLAY_IDENTIFIER V_INJ_BURST_EOI__37_ ECU_ADDRESS 0x7f9e00 BYTE_ORDER MSB_LAST FORMAT "%4.1" /end MEASUREMENT
/begin MEASUREMENT v_inj_burst_eoi_[38] "voltage values of burst measurement triggered on EOI" UWORD _CNV_A_R_LINEAR_____128_CM 1 0. 0. 255. DISPLAY_IDENTIFIER V_INJ_BURST_EOI__38_ ECU_ADDRESS 0x7f9e02 BYTE_ORDER MSB_LAST FORMAT "%4.1" /end MEASUREMENT
/begin MEASUREMENT v_inj_burst_eoi_[39] "voltage values of burst measurement triggered on EOI" UWORD _CNV_A_R_LINEAR_____128_CM 1 0. 0. 255. DISPLAY_IDENTIFIER V_INJ_BURST_EOI__39_ ECU_ADDRESS 0x7f9e04 BYTE_ORDER MSB_LAST FORMAT "%4.1" /end MEASUREMENT
/begin MEASUREMENT q_inj_burst_soi_[0] "charge values of burst measurement mode" UWORD _CNV_A_R_LINEAR_____124_CM 1 0. 0. 4095.9375 DISPLAY_IDENTIFIER Q_INJ_BURST_SOI__0_ ECU_ADDRESS 0x7f9d8e BYTE_ORDER MSB_LAST FORMAT "%5.1" /end MEASUREMENT
/begin MEASUREMENT q_inj_burst_soi_[1] "charge values of burst measurement mode" UWORD _CNV_A_R_LINEAR_____124_CM 1 0. 0. 4095.9375 DISPLAY_IDENTIFIER Q_INJ_BURST_SOI__1_ ECU_ADDRESS 0x7f9d90 BYTE_ORDER MSB_LAST FORMAT "%5.1" /end MEASUREMENT
/begin MEASUREMENT q_inj_burst_soi_[2] "charge values of burst measurement mode" UWORD _CNV_A_R_LINEAR_____124_CM 1 0. 0. 4095.9375 DISPLAY_IDENTIFIER Q_INJ_BURST_SOI__2_ ECU_ADDRESS 0x7f9d92 BYTE_ORDER MSB_LAST FORMAT "%5.1" /end MEASUREMENT
/begin MEASUREMENT q_inj_burst_soi_[3] "charge values of burst measurement mode" UWORD _CNV_A_R_LINEAR_____124_CM 1 0. 0. 4095.9375 DISPLAY_IDENTIFIER Q_INJ_BURST_SOI__3_ ECU_ADDRESS 0x7f9d94 BYTE_ORDER MSB_LAST FORMAT "%5.1" /end MEASUREMENT
/begin MEASUREMENT q_inj_burst_soi_[4] "charge values of burst measurement mode" UWORD _CNV_A_R_LINEAR_____124_CM 1 0. 0. 4095.9375 DISPLAY_IDENTIFIER Q_INJ_BURST_SOI__4_ ECU_ADDRESS 0x7f9d96 BYTE_ORDER MSB_LAST FORMAT "%5.1" /end MEASUREMENT
/begin MEASUREMENT q_inj_burst_soi_[5] "charge values of burst measurement mode" UWORD _CNV_A_R_LINEAR_____124_CM 1 0. 0. 4095.9375 DISPLAY_IDENTIFIER Q_INJ_BURST_SOI__5_ ECU_ADDRESS 0x7f9d98 BYTE_ORDER MSB_LAST FORMAT "%5.1" /end MEASUREMENT
/begin MEASUREMENT q_inj_burst_soi_[6] "charge values of burst measurement mode" UWORD _CNV_A_R_LINEAR_____124_CM 1 0. 0. 4095.9375 DISPLAY_IDENTIFIER Q_INJ_BURST_SOI__6_ ECU_ADDRESS 0x7f9d9a BYTE_ORDER MSB_LAST FORMAT "%5.1" /end MEASUREMENT
/begin MEASUREMENT q_inj_burst_soi_[7] "charge values of burst measurement mode" UWORD _CNV_A_R_LINEAR_____124_CM 1 0. 0. 4095.9375 DISPLAY_IDENTIFIER Q_INJ_BURST_SOI__7_ ECU_ADDRESS 0x7f9d9c BYTE_ORDER MSB_LAST FORMAT "%5.1" /end MEASUREMENT
/begin MEASUREMENT q_inj_burst_soi_[8] "charge values of burst measurement mode" UWORD _CNV_A_R_LINEAR_____124_CM 1 0. 0. 4095.9375 DISPLAY_IDENTIFIER Q_INJ_BURST_SOI__8_ ECU_ADDRESS 0x7f9d9e BYTE_ORDER MSB_LAST FORMAT "%5.1" /end MEASUREMENT
/begin MEASUREMENT q_inj_burst_soi_[9] "charge values of burst measurement mode" UWORD _CNV_A_R_LINEAR_____124_CM 1 0. 0. 4095.9375 DISPLAY_IDENTIFIER Q_INJ_BURST_SOI__9_ ECU_ADDRESS 0x7f9da0 BYTE_ORDER MSB_LAST FORMAT "%5.1" /end MEASUREMENT
/begin MEASUREMENT q_inj_burst_soi_[10] "charge values of burst measurement mode" UWORD _CNV_A_R_LINEAR_____124_CM 1 0. 0. 4095.9375 DISPLAY_IDENTIFIER Q_INJ_BURST_SOI__10_ ECU_ADDRESS 0x7f9da2 BYTE_ORDER MSB_LAST FORMAT "%5.1" /end MEASUREMENT
/begin MEASUREMENT q_inj_burst_soi_[11] "charge values of burst measurement mode" UWORD _CNV_A_R_LINEAR_____124_CM 1 0. 0. 4095.9375 DISPLAY_IDENTIFIER Q_INJ_BURST_SOI__11_ ECU_ADDRESS 0x7f9da4 BYTE_ORDER MSB_LAST FORMAT "%5.1" /end MEASUREMENT
/begin MEASUREMENT q_inj_burst_soi_[12] "charge values of burst measurement mode" UWORD _CNV_A_R_LINEAR_____124_CM 1 0. 0. 4095.9375 DISPLAY_IDENTIFIER Q_INJ_BURST_SOI__12_ ECU_ADDRESS 0x7f9da6 BYTE_ORDER MSB_LAST FORMAT "%5.1" /end MEASUREMENT
/begin MEASUREMENT q_inj_burst_soi_[13] "charge values of burst measurement mode" UWORD _CNV_A_R_LINEAR_____124_CM 1 0. 0. 4095.9375 DISPLAY_IDENTIFIER Q_INJ_BURST_SOI__13_ ECU_ADDRESS 0x7f9da8 BYTE_ORDER MSB_LAST FORMAT "%5.1" /end MEASUREMENT
/begin MEASUREMENT q_inj_burst_soi_[14] "charge values of burst measurement mode" UWORD _CNV_A_R_LINEAR_____124_CM 1 0. 0. 4095.9375 DISPLAY_IDENTIFIER Q_INJ_BURST_SOI__14_ ECU_ADDRESS 0x7f9daa BYTE_ORDER MSB_LAST FORMAT "%5.1" /end MEASUREMENT
/begin MEASUREMENT q_inj_burst_soi_[15] "charge values of burst measurement mode" UWORD _CNV_A_R_LINEAR_____124_CM 1 0. 0. 4095.9375 DISPLAY_IDENTIFIER Q_INJ_BURST_SOI__15_ ECU_ADDRESS 0x7f9dac BYTE_ORDER MSB_LAST FORMAT "%5.1" /end MEASUREMENT
/begin MEASUREMENT q_inj_burst_soi_[16] "charge values of burst measurement mode" UWORD _CNV_A_R_LINEAR_____124_CM 1 0. 0. 4095.9375 DISPLAY_IDENTIFIER Q_INJ_BURST_SOI__16_ ECU_ADDRESS 0x7f9dae BYTE_ORDER MSB_LAST FORMAT "%5.1" /end MEASUREMENT
/begin MEASUREMENT q_inj_burst_soi_[17] "charge values of burst measurement mode" UWORD _CNV_A_R_LINEAR_____124_CM 1 0. 0. 4095.9375 DISPLAY_IDENTIFIER Q_INJ_BURST_SOI__17_ ECU_ADDRESS 0x7f9db0 BYTE_ORDER MSB_LAST FORMAT "%5.1" /end MEASUREMENT
/begin MEASUREMENT q_inj_burst_soi_[18] "charge values of burst measurement mode" UWORD _CNV_A_R_LINEAR_____124_CM 1 0. 0. 4095.9375 DISPLAY_IDENTIFIER Q_INJ_BURST_SOI__18_ ECU_ADDRESS 0x7f9db2 BYTE_ORDER MSB_LAST FORMAT "%5.1" /end MEASUREMENT
/begin MEASUREMENT q_inj_burst_soi_[19] "charge values of burst measurement mode" UWORD _CNV_A_R_LINEAR_____124_CM 1 0. 0. 4095.9375 DISPLAY_IDENTIFIER Q_INJ_BURST_SOI__19_ ECU_ADDRESS 0x7f9db4 BYTE_ORDER MSB_LAST FORMAT "%5.1" /end MEASUREMENT
/begin MEASUREMENT cur_inj_burst_[0] "current values of burst measurement mode" UWORD _CNV_A_R_A_129_CM 1 0. 0. 65535. DISPLAY_IDENTIFIER CUR_INJ_BURST__0_ ECU_ADDRESS 0x7f9d3c BYTE_ORDER MSB_LAST FORMAT "%5.1" /end MEASUREMENT
/begin MEASUREMENT lf_burst_prev1_act "burst measurement on PREV1 injection on/off (cylinder individual)" UWORD _CNV_A_R_LINEAR_____0_CM 1 0. 0. 65535. DISPLAY_IDENTIFIER LF_BURST_PREV1_ACT ECU_ADDRESS 0x7f9e08 BYTE_ORDER MSB_LAST FORMAT "%5.0" /end MEASUREMENT
/begin MEASUREMENT lf_burst_main1_act "burst measurement on MAIN1 injection on/off (cylinder individual)" UWORD _CNV_A_R_LINEAR_____0_CM 1 0. 0. 65535. DISPLAY_IDENTIFIER LF_BURST_MAIN1_ACT ECU_ADDRESS 0x7f9e06 BYTE_ORDER MSB_LAST FORMAT "%5.0" /end MEASUREMENT
/begin MEASUREMENT lf_burst_norm_act "burst measurement on test pulse on/off (cylinder individual)" UWORD _CNV_A_R_LINEAR_____0_CM 1 0. 0. 65535. DISPLAY_IDENTIFIER LF_BURST_NORM_ACT ECU_ADDRESS 0x7f9e0a BYTE_ORDER MSB_LAST FORMAT "%5.0" /end MEASUREMENT
/begin CHARACTERISTIC c_fac_v_inj_burst_0 "factor for calculation of injector burst voltage (bank0)" VALUE 0x85be8a _REC_VAL_20_u2 100. _CNV_A_R_LINEAR_____130_CM 0. 100. DISPLAY_IDENTIFIER C_FAC_V_INJ_BURST_0 FORMAT "%5.2" /end CHARACTERISTIC
/begin CHARACTERISTIC c_fac_cur_inj_burst_0 "factor for calculation of injector burst current (bank0)" VALUE 0x85be22 _REC_VAL_20_u2 10. _CNV_A_R_LINEAR_____131_CM 0. 10. DISPLAY_IDENTIFIER C_FAC_CUR_INJ_BURST_0 FORMAT "%5.2" /end CHARACTERISTIC
/begin CHARACTERISTIC c_ofs_v_inj_burst_0 "offset value for calculation of injector burst voltage (bank0)" VALUE 0x85bfe2 _REC_VAL_20_u2 5. _CNV_A_R_LINEAR_____132_CM 0. 5. DISPLAY_IDENTIFIER C_OFS_V_INJ_BURST_0 FORMAT "%5.2" /end CHARACTERISTIC
/begin CHARACTERISTIC c_ofs_cur_inj_burst_0 "offset value for calculation of injector burst current (bank0)" VALUE 0x85bfde _REC_VAL_20_u2 5. _CNV_A_R_LINEAR_____132_CM 0. 5. DISPLAY_IDENTIFIER C_OFS_CUR_INJ_BURST_0 FORMAT "%5.2" /end CHARACTERISTIC
/begin CHARACTERISTIC c_fac_v_inj_burst_1 "factor for calculation of injector burst voltage (bank1)" VALUE 0x85be8c _REC_VAL_20_u2 100. _CNV_A_R_LINEAR_____130_CM 0. 100. DISPLAY_IDENTIFIER C_FAC_V_INJ_BURST_1 FORMAT "%5.2" /end CHARACTERISTIC
/begin CHARACTERISTIC c_fac_cur_inj_burst_1 "factor for calculation of injector burst current (bank1)" VALUE 0x85be24 _REC_VAL_20_u2 10. _CNV_A_R_LINEAR_____131_CM 0. 10. DISPLAY_IDENTIFIER C_FAC_CUR_INJ_BURST_1 FORMAT "%5.2" /end CHARACTERISTIC
/begin CHARACTERISTIC c_ofs_v_inj_burst_1 "offset value for calculation of injector burst voltage (bank1)" VALUE 0x85bfe4 _REC_VAL_20_u2 5. _CNV_A_R_LINEAR_____132_CM 0. 5. DISPLAY_IDENTIFIER C_OFS_V_INJ_BURST_1 FORMAT "%5.2" /end CHARACTERISTIC
/begin CHARACTERISTIC c_ofs_cur_inj_burst_1 "offset value for calculation of injector burst current (bank1)" VALUE 0x85bfe0 _REC_VAL_20_u2 5. _CNV_A_R_LINEAR_____132_CM 0. 5. DISPLAY_IDENTIFIER C_OFS_CUR_INJ_BURST_1 FORMAT "%5.2" /end CHARACTERISTIC
/begin CHARACTERISTIC c_burst_inj_mode "Mode 0: measure on norm. pulse, Mode 1: measure on main pulse" VALUE 0x85bd21 _REC_VAL_20_u1 15. _CNV_A_R_LINEAR_____0_CM 0. 15. DISPLAY_IDENTIFIER C_BURST_INJ_MODE FORMAT "%1.0" /end CHARACTERISTIC
/begin CHARACTERISTIC c_burst_mes_soi_eoi "select: burst measurement on SOI or EOI" VALUE 0x85bd22 _REC_VAL_20_u1 15. _CNV_A_R_LINEAR_____0_CM 0. 15. DISPLAY_IDENTIFIER C_BURST_MES_SOI_EOI FORMAT "%1.0" /end CHARACTERISTIC
/begin MEASUREMENT lf_pps_mes_vld " PPS measurement valid flag word (cylinder individual)" UWORD _CNV_A_R_LINEAR_____0_CM 1 0. 0. 65535. DISPLAY_IDENTIFIER LF_PPS_MES_VLD ECU_ADDRESS 0x7f9e0c BYTE_ORDER MSB_LAST FORMAT "%5.0" /end MEASUREMENT
/begin MEASUREMENT v_cha_cal0 " calibration charge measurement" UWORD _CNV_A_R_LINEAR_____125_CM 1 0. 0. 4.995117 DISPLAY_IDENTIFIER V_CHA_CAL0 ECU_ADDRESS 0x7f9e42 BYTE_ORDER MSB_LAST FORMAT "%5.3" /end MEASUREMENT
/begin MEASUREMENT v_cha_cal1 " calibration charge measurement" UWORD _CNV_A_R_LINEAR_____125_CM 1 0. 0. 4.995117 DISPLAY_IDENTIFIER V_CHA_CAL1 ECU_ADDRESS 0x7f9e44 BYTE_ORDER MSB_LAST FORMAT "%5.3" /end MEASUREMENT
/begin MEASUREMENT q_inj_beg_prev1_[0] "piezo injector charge of pulse PREV1 (vector)" UWORD _CNV_A_R_LINEAR_____124_CM 1 0. 0. 4095.9375 DISPLAY_IDENTIFIER Q_INJ_BEG_PREV1__0_ ECU_ADDRESS 0x7f9d30 BYTE_ORDER MSB_LAST FORMAT "%5.1" /end MEASUREMENT
/begin MEASUREMENT q_inj_beg_prev1_[1] "piezo injector charge of pulse PREV1 (vector)" UWORD _CNV_A_R_LINEAR_____124_CM 1 0. 0. 4095.9375 DISPLAY_IDENTIFIER Q_INJ_BEG_PREV1__1_ ECU_ADDRESS 0x7f9d32 BYTE_ORDER MSB_LAST FORMAT "%5.1" /end MEASUREMENT
/begin MEASUREMENT q_inj_beg_prev1_[2] "piezo injector charge of pulse PREV1 (vector)" UWORD _CNV_A_R_LINEAR_____124_CM 1 0. 0. 4095.9375 DISPLAY_IDENTIFIER Q_INJ_BEG_PREV1__2_ ECU_ADDRESS 0x7f9d34 BYTE_ORDER MSB_LAST FORMAT "%5.1" /end MEASUREMENT
/begin MEASUREMENT q_inj_beg_prev1_[3] "piezo injector charge of pulse PREV1 (vector)" UWORD _CNV_A_R_LINEAR_____124_CM 1 0. 0. 4095.9375 DISPLAY_IDENTIFIER Q_INJ_BEG_PREV1__3_ ECU_ADDRESS 0x7f9d36 BYTE_ORDER MSB_LAST FORMAT "%5.1" /end MEASUREMENT
/begin MEASUREMENT q_inj_beg_prev1 "piezo injector charge of pulse PREV1" UWORD _CNV_A_R_LINEAR_____124_CM 1 0. 0. 4095.9375 DISPLAY_IDENTIFIER Q_INJ_BEG_PREV1 ECU_ADDRESS 0x7f9d2e BYTE_ORDER MSB_LAST FORMAT "%5.1" /end MEASUREMENT
/begin MEASUREMENT q_inj_beg_main1_[0] "piezo injector charge of pulse MAIN1 (vector)" UWORD _CNV_A_R_LINEAR_____124_CM 1 0. 0. 4095.9375 DISPLAY_IDENTIFIER Q_INJ_BEG_MAIN1__0_ ECU_ADDRESS 0x7f9e3a BYTE_ORDER MSB_LAST FORMAT "%5.1" /end MEASUREMENT
/begin MEASUREMENT q_inj_beg_main1_[1] "piezo injector charge of pulse MAIN1 (vector)" UWORD _CNV_A_R_LINEAR_____124_CM 1 0. 0. 4095.9375 DISPLAY_IDENTIFIER Q_INJ_BEG_MAIN1__1_ ECU_ADDRESS 0x7f9e3c BYTE_ORDER MSB_LAST FORMAT "%5.1" /end MEASUREMENT
/begin MEASUREMENT q_inj_beg_main1_[2] "piezo injector charge of pulse MAIN1 (vector)" UWORD _CNV_A_R_LINEAR_____124_CM 1 0. 0. 4095.9375 DISPLAY_IDENTIFIER Q_INJ_BEG_MAIN1__2_ ECU_ADDRESS 0x7f9e3e BYTE_ORDER MSB_LAST FORMAT "%5.1" /end MEASUREMENT
/begin MEASUREMENT q_inj_beg_main1_[3] "piezo injector charge of pulse MAIN1 (vector)" UWORD _CNV_A_R_LINEAR_____124_CM 1 0. 0. 4095.9375 DISPLAY_IDENTIFIER Q_INJ_BEG_MAIN1__3_ ECU_ADDRESS 0x7f9e40 BYTE_ORDER MSB_LAST FORMAT "%5.1" /end MEASUREMENT
/begin MEASUREMENT q_inj_beg_main1 "piezo injector charge of pulse MAIN1" UWORD _CNV_A_R_LINEAR_____124_CM 1 0. 0. 4095.9375 DISPLAY_IDENTIFIER Q_INJ_BEG_MAIN1 ECU_ADDRESS 0x7f9e38 BYTE_ORDER MSB_LAST FORMAT "%5.1" /end MEASUREMENT
/begin MEASUREMENT v_inj_frze_prev1_[0] "piezo injector voltage of pulse FRZE PREV1 (vector)" UWORD _CNV_A_R_LINEAR_____123_CM 1 0. 0. 255. DISPLAY_IDENTIFIER V_INJ_FRZE_PREV1__0_ ECU_ADDRESS 0x7f9e0e BYTE_ORDER MSB_LAST FORMAT "%4.1" /end MEASUREMENT
/begin MEASUREMENT v_inj_frze_prev1_[1] "piezo injector voltage of pulse FRZE PREV1 (vector)" UWORD _CNV_A_R_LINEAR_____123_CM 1 0. 0. 255. DISPLAY_IDENTIFIER V_INJ_FRZE_PREV1__1_ ECU_ADDRESS 0x7f9e10 BYTE_ORDER MSB_LAST FORMAT "%4.1" /end MEASUREMENT
/begin MEASUREMENT v_inj_frze_prev1_[2] "piezo injector voltage of pulse FRZE PREV1 (vector)" UWORD _CNV_A_R_LINEAR_____123_CM 1 0. 0. 255. DISPLAY_IDENTIFIER V_INJ_FRZE_PREV1__2_ ECU_ADDRESS 0x7f9e12 BYTE_ORDER MSB_LAST FORMAT "%4.1" /end MEASUREMENT
/begin MEASUREMENT v_inj_frze_prev1_[3] "piezo injector voltage of pulse FRZE PREV1 (vector)" UWORD _CNV_A_R_LINEAR_____123_CM 1 0. 0. 255. DISPLAY_IDENTIFIER V_INJ_FRZE_PREV1__3_ ECU_ADDRESS 0x7f9e14 BYTE_ORDER MSB_LAST FORMAT "%4.1" /end MEASUREMENT
/begin MEASUREMENT v_inj_toze_prev1_[0] "piezo injector voltage of pulse TOZE PREV1 (vector)" UWORD _CNV_A_R_LINEAR_____123_CM 1 0. 0. 255. DISPLAY_IDENTIFIER V_INJ_TOZE_PREV1__0_ ECU_ADDRESS 0x7f9e16 BYTE_ORDER MSB_LAST FORMAT "%4.1" /end MEASUREMENT
/begin MEASUREMENT v_inj_toze_prev1_[1] "piezo injector voltage of pulse TOZE PREV1 (vector)" UWORD _CNV_A_R_LINEAR_____123_CM 1 0. 0. 255. DISPLAY_IDENTIFIER V_INJ_TOZE_PREV1__1_ ECU_ADDRESS 0x7f9e18 BYTE_ORDER MSB_LAST FORMAT "%4.1" /end MEASUREMENT
/begin MEASUREMENT v_inj_toze_prev1_[2] "piezo injector voltage of pulse TOZE PREV1 (vector)" UWORD _CNV_A_R_LINEAR_____123_CM 1 0. 0. 255. DISPLAY_IDENTIFIER V_INJ_TOZE_PREV1__2_ ECU_ADDRESS 0x7f9e1a BYTE_ORDER MSB_LAST FORMAT "%4.1" /end MEASUREMENT
/begin MEASUREMENT v_inj_toze_prev1_[3] "piezo injector voltage of pulse TOZE PREV1 (vector)" UWORD _CNV_A_R_LINEAR_____123_CM 1 0. 0. 255. DISPLAY_IDENTIFIER V_INJ_TOZE_PREV1__3_ ECU_ADDRESS 0x7f9e1c BYTE_ORDER MSB_LAST FORMAT "%4.1" /end MEASUREMENT
/begin MEASUREMENT v_inj_frze_main1_[0] "piezo injector voltage of pulse FRZE MAIN1 (vector)" UWORD _CNV_A_R_LINEAR_____123_CM 1 0. 0. 255. DISPLAY_IDENTIFIER V_INJ_FRZE_MAIN1__0_ ECU_ADDRESS 0x7f9e1e BYTE_ORDER MSB_LAST FORMAT "%4.1" /end MEASUREMENT
/begin MEASUREMENT v_inj_frze_main1_[1] "piezo injector voltage of pulse FRZE MAIN1 (vector)" UWORD _CNV_A_R_LINEAR_____123_CM 1 0. 0. 255. DISPLAY_IDENTIFIER V_INJ_FRZE_MAIN1__1_ ECU_ADDRESS 0x7f9e20 BYTE_ORDER MSB_LAST FORMAT "%4.1" /end MEASUREMENT
/begin MEASUREMENT v_inj_frze_main1_[2] "piezo injector voltage of pulse FRZE MAIN1 (vector)" UWORD _CNV_A_R_LINEAR_____123_CM 1 0. 0. 255. DISPLAY_IDENTIFIER V_INJ_FRZE_MAIN1__2_ ECU_ADDRESS 0x7f9e22 BYTE_ORDER MSB_LAST FORMAT "%4.1" /end MEASUREMENT
/begin MEASUREMENT v_inj_frze_main1_[3] "piezo injector voltage of pulse FRZE MAIN1 (vector)" UWORD _CNV_A_R_LINEAR_____123_CM 1 0. 0. 255. DISPLAY_IDENTIFIER V_INJ_FRZE_MAIN1__3_ ECU_ADDRESS 0x7f9e24 BYTE_ORDER MSB_LAST FORMAT "%4.1" /end MEASUREMENT
/begin MEASUREMENT v_inj_toze_main1_[0] "piezo injector voltage of pulse TOZE MAIN1 (vector)" UWORD _CNV_A_R_LINEAR_____123_CM 1 0. 0. 255. DISPLAY_IDENTIFIER V_INJ_TOZE_MAIN1__0_ ECU_ADDRESS 0x7f9e26 BYTE_ORDER MSB_LAST FORMAT "%4.1" /end MEASUREMENT
/begin MEASUREMENT v_inj_toze_main1_[1] "piezo injector voltage of pulse TOZE MAIN1 (vector)" UWORD _CNV_A_R_LINEAR_____123_CM 1 0. 0. 255. DISPLAY_IDENTIFIER V_INJ_TOZE_MAIN1__1_ ECU_ADDRESS 0x7f9e28 BYTE_ORDER MSB_LAST FORMAT "%4.1" /end MEASUREMENT
/begin MEASUREMENT v_inj_toze_main1_[2] "piezo injector voltage of pulse TOZE MAIN1 (vector)" UWORD _CNV_A_R_LINEAR_____123_CM 1 0. 0. 255. DISPLAY_IDENTIFIER V_INJ_TOZE_MAIN1__2_ ECU_ADDRESS 0x7f9e2a BYTE_ORDER MSB_LAST FORMAT "%4.1" /end MEASUREMENT
/begin MEASUREMENT v_inj_toze_main1_[3] "piezo injector voltage of pulse TOZE MAIN1 (vector)" UWORD _CNV_A_R_LINEAR_____123_CM 1 0. 0. 255. DISPLAY_IDENTIFIER V_INJ_TOZE_MAIN1__3_ ECU_ADDRESS 0x7f9e2c BYTE_ORDER MSB_LAST FORMAT "%4.1" /end MEASUREMENT
/begin MEASUREMENT lv_heat_1 "o v" UBYTE _CNV_S_2_RANGE______11_CM 1 0. 0. 1. DISPLAY_IDENTIFIER LV_HEAT_1 ECU_ADDRESS 0x7fb729 /end MEASUREMENT
/begin MEASUREMENT lv_heat_2 "o v" UBYTE _CNV_S_2_RANGE______11_CM 1 0. 0. 1. DISPLAY_IDENTIFIER LV_HEAT_2 ECU_ADDRESS 0x7fb72a /end MEASUREMENT
/begin MEASUREMENT lv_heat_3 "o v" UBYTE _CNV_S_2_RANGE______11_CM 1 0. 0. 1. DISPLAY_IDENTIFIER LV_HEAT_3 ECU_ADDRESS 0x7fb72b /end MEASUREMENT
/begin MEASUREMENT sf_heat "o v" UWORD _CNV_A_R_LINEAR_____0_CM 1 0. 0. 32768. DISPLAY_IDENTIFIER SF_HEAT ECU_ADDRESS 0x7fa040 BYTE_ORDER MSB_LAST FORMAT "%5.0" /end MEASUREMENT
/begin MEASUREMENT lv_heat_var_temp "o v" UBYTE _CNV_S_2_RANGE______11_CM 1 0. 0. 1. DISPLAY_IDENTIFIER LV_HEAT_VAR_TEMP ECU_ADDRESS 0x7fb72c /end MEASUREMENT
/begin MEASUREMENT lv_req_n_sp_is_min_heat "o v" UBYTE _CNV_S_2_RANGE______11_CM 1 0. 0. 1. DISPLAY_IDENTIFIER LV_REQ_N_SP_IS_MIN_HEAT ECU_ADDRESS 0x7fb72d /end MEASUREMENT
/begin MEASUREMENT temp_tco_heat_tol_act "v" UBYTE _CNV_A_R_LINEAR_____18_CM 1 0. -50. 205. DISPLAY_IDENTIFIER TEMP_TCO_HEAT_TOL_ACT ECU_ADDRESS 0x7fbb4e FORMAT "%3.0" /end MEASUREMENT
/begin MEASUREMENT count_act_heat_elems "v" UBYTE _CNV_A_R_LINEAR_____0_CM 1 0. 0. 3. DISPLAY_IDENTIFIER COUNT_ACT_HEAT_ELEMS ECU_ADDRESS 0x7fbb4f FORMAT "%1.0" /end MEASUREMENT
/begin CHARACTERISTIC lc_heat_var_temp "" VALUE 0x85c32c _REC_VAL_20_u1 1. _CNV_A_R_LINEAR_____0_CM 0. 1. DISPLAY_IDENTIFIER LC_HEAT_VAR_TEMP FORMAT "%1.0" /end CHARACTERISTIC
/begin CHARACTERISTIC c_tco_heat_bol "" VALUE 0x85c147 _REC_VAL_20_u1 255. _CNV_A_R_LINEAR_____18_CM -50. 205. DISPLAY_IDENTIFIER C_TCO_HEAT_BOL FORMAT "%3.0" /end CHARACTERISTIC
/begin CHARACTERISTIC c_t_dly_heat_st "" VALUE 0x85c0b8 _REC_VAL_20_u2 6553.5 _CNV_A_R_LINEAR_____19_CM 0. 6553.5 DISPLAY_IDENTIFIER C_T_DLY_HEAT_ST FORMAT "%5.1" /end CHARACTERISTIC
/begin CHARACTERISTIC lc_heat_var_swi "" VALUE 0x85c32b _REC_VAL_20_u1 2. _CNV_A_R_LINEAR_____0_CM 0. 2. DISPLAY_IDENTIFIER LC_HEAT_VAR_SWI FORMAT "%1.0" /end CHARACTERISTIC
/begin CHARACTERISTIC lc_heat_off_ac "" VALUE 0x85c32a _REC_VAL_20_u1 1. _CNV_A_R_LINEAR_____0_CM 0. 1. DISPLAY_IDENTIFIER LC_HEAT_OFF_AC FORMAT "%1.0" /end CHARACTERISTIC
/begin CHARACTERISTIC c_vb_heat_bol "" VALUE 0x85c2ac _REC_VAL_20_u1 28.8 _CNV_A_R_LINEAR_____48_CM 0. 28.8 DISPLAY_IDENTIFIER C_VB_HEAT_BOL FORMAT "%3.1" /end CHARACTERISTIC
/begin CHARACTERISTIC c_vb_heat_tol "" VALUE 0x85c2ad _REC_VAL_20_u1 28.8 _CNV_A_R_LINEAR_____48_CM 0. 28.8 DISPLAY_IDENTIFIER C_VB_HEAT_TOL FORMAT "%3.1" /end CHARACTERISTIC
/begin CHARACTERISTIC c_n_heat_bol "" VALUE 0x85bf94 _REC_VAL_20_u2 6375. _CNV_A_R_LINEAR_____5_CM 0. 6375. DISPLAY_IDENTIFIER C_N_HEAT_BOL FORMAT "%4.0" /end CHARACTERISTIC
/begin CHARACTERISTIC c_n_heat_tol "" VALUE 0x85bf96 _REC_VAL_20_u2 6375. _CNV_A_R_LINEAR_____5_CM 0. 6375. DISPLAY_IDENTIFIER C_N_HEAT_TOL FORMAT "%4.0" /end CHARACTERISTIC
/begin CHARACTERISTIC c_tia_heat_bol "" VALUE 0x85c1b5 _REC_VAL_20_u1 255. _CNV_A_R_LINEAR_____18_CM -50. 205. DISPLAY_IDENTIFIER C_TIA_HEAT_BOL FORMAT "%3.0" /end CHARACTERISTIC
/begin CHARACTERISTIC c_tia_heat_tol "" VALUE 0x85c1b6 _REC_VAL_20_u1 255. _CNV_A_R_LINEAR_____18_CM -50. 205. DISPLAY_IDENTIFIER C_TIA_HEAT_TOL FORMAT "%3.0" /end CHARACTERISTIC
/begin CHARACTERISTIC lc_heat_3_off_ac "" VALUE 0x85c329 _REC_VAL_20_u1 1. _CNV_A_R_LINEAR_____0_CM 0. 1. DISPLAY_IDENTIFIER LC_HEAT_3_OFF_AC FORMAT "%1.0" /end CHARACTERISTIC
/begin CHARACTERISTIC c_altpwm_heat_tol_dec "" VALUE 0x85bcbe _REC_VAL_20_u2 100. _CNV_A_R_LINEAR_____136_CM 0. 100. DISPLAY_IDENTIFIER C_ALTPWM_HEAT_TOL_DEC FORMAT "%5.3" /end CHARACTERISTIC
/begin CHARACTERISTIC c_t_dly_heat "" VALUE 0x85c0b6 _REC_VAL_20_u2 6553.5 _CNV_A_R_LINEAR_____19_CM 0. 6553.5 DISPLAY_IDENTIFIER C_T_DLY_HEAT FORMAT "%5.1" /end CHARACTERISTIC
/begin CHARACTERISTIC c_fac_fil_altpwm_heat "" VALUE 0x85be3a _REC_VAL_20_u2 0.9999874 _CNV_A_R_LINEAR_____90_CM 0. 0.9999874 DISPLAY_IDENTIFIER C_FAC_FIL_ALTPWM_HEAT FORMAT "%6.5" /end CHARACTERISTIC
/begin CHARACTERISTIC c_t_dly_n_dec "" VALUE 0x85c0be _REC_VAL_20_u2 6553.5 _CNV_A_R_LINEAR_____19_CM 0. 6553.5 DISPLAY_IDENTIFIER C_T_DLY_N_DEC FORMAT "%5.1" /end CHARACTERISTIC
/begin CHARACTERISTIC ip_tco_heat_tol__temp "Higher Threshold for Water Temperature Hysteresis" CURVE 0x85ab72 _REC_CUR_20_u1_u1 255. _CNV_A_R_LINEAR_____18_CM -50. 205. DISPLAY_IDENTIFIER IP_TCO_HEAT_TOL__TEMP FORMAT "%3.0"
 /begin AXIS_DESCR COM_AXIS tco _CNV_A_R_LINEAR_____18_CM 10 -50. 205. FORMAT "%3.0" AXIS_PTS_REF ldp_tco_ip_tco_heat_tol /end AXIS_DESCR
/end CHARACTERISTIC
/begin AXIS_PTS ldp_tco_ip_tco_heat_tol "" 0x842847 tco _REC_AXS_20_u1 255. _CNV_A_R_LINEAR_____18_CM 10 -50. 205. FORMAT "%3.0" /end AXIS_PTS
/begin CHARACTERISTIC ip_altpwm_heat_bol__n "Lower Deactivation Threshold of the Generator Load Hysteresis" CURVE 0x849020 _REC_CUR_20_u2_u2 99.99847412109381 _CNV_A_R_LINEAR_____8_CM 0. 99.99847412109381 DISPLAY_IDENTIFIER IP_ALTPWM_HEAT_BOL__N FORMAT "%5.4"
 /begin AXIS_DESCR COM_AXIS n _CNV_A_R_LINEAR_____5_CM 6 0. 6375. FORMAT "%4.0" AXIS_PTS_REF ldp_n_ip_altpwm_heat_bol /end AXIS_DESCR
/end CHARACTERISTIC
/begin AXIS_PTS ldp_n_ip_altpwm_heat_bol "" 0x84193e n _REC_AXS_20_u2 6375. _CNV_A_R_LINEAR_____5_CM 6 0. 6375. FORMAT "%4.0" /end AXIS_PTS
/begin CHARACTERISTIC ip_altpwm_heat_tol__n "Higher Deactivation Threshold of Generator Load Hysteresis" CURVE 0x84902c _REC_CUR_20_u2_u2 99.99847412109381 _CNV_A_R_LINEAR_____8_CM 0. 99.99847412109381 DISPLAY_IDENTIFIER IP_ALTPWM_HEAT_TOL__N FORMAT "%5.4"
 /begin AXIS_DESCR COM_AXIS n _CNV_A_R_LINEAR_____5_CM 6 0. 6375. FORMAT "%4.0" AXIS_PTS_REF ldp_n_ip_altpwm_heat_tol /end AXIS_DESCR
/end CHARACTERISTIC
/begin AXIS_PTS ldp_n_ip_altpwm_heat_tol "" 0x84194c n _REC_AXS_20_u2 6375. _CNV_A_R_LINEAR_____5_CM 6 0. 6375. FORMAT "%4.0" /end AXIS_PTS
/begin MEASUREMENT lv_es_act "Flag indicating that the engine stop function is active" UBYTE _CNV_S_2_RANGE______11_CM 1 0. 0. 1. DISPLAY_IDENTIFIER LV_ES_ACT ECU_ADDRESS 0x7fb4b0 /end MEASUREMENT
/begin MEASUREMENT lv_es_prep "Flag indicating that the preparation phase for engine stop is active" UBYTE _CNV_S_2_RANGE______11_CM 1 0. 0. 1. DISPLAY_IDENTIFIER LV_ES_PREP ECU_ADDRESS 0x7fb4b1 /end MEASUREMENT
/begin MEASUREMENT lv_inh_es_diag "Flag to inhibit the engine stop function diagnosis" UBYTE _CNV_S_2_RANGE______11_CM 1 0. 0. 1. DISPLAY_IDENTIFIER LV_INH_ES_DIAG ECU_ADDRESS 0x7fb4b2 /end MEASUREMENT
/begin MEASUREMENT lv_pwl_lock_es "Flag indicating that the engine stop function is locking the power latch phase of the ECU" UBYTE _CNV_S_2_RANGE______11_CM 1 0. 0. 1. DISPLAY_IDENTIFIER LV_PWL_LOCK_ES ECU_ADDRESS 0x7fb4b3 /end MEASUREMENT
/begin MEASUREMENT lv_req_es_inj "request for engine stop by electrical cut-off path" UBYTE _CNV_S_2_RANGE______11_CM 1 0. 0. 1. DISPLAY_IDENTIFIER LV_REQ_ES_INJ ECU_ADDRESS 0x7fb4b4 /end MEASUREMENT
/begin MEASUREMENT lv_req_es_fup "request for engine stop by hydraulic cut-off path " UBYTE _CNV_S_2_RANGE______11_CM 1 0. 0. 1. DISPLAY_IDENTIFIER LV_REQ_ES_FUP ECU_ADDRESS 0x7fb4b5 /end MEASUREMENT
/begin MEASUREMENT lv_req_es_thr "request for engine stop for throttel control" UBYTE _CNV_S_2_RANGE______11_CM 1 0. 0. 1. DISPLAY_IDENTIFIER LV_REQ_ES_THR ECU_ADDRESS 0x7fb4b6 /end MEASUREMENT
/begin MEASUREMENT ctr_req_es_fup "counter requests engine stop by hydraulic cut-off path" UWORD _CNV_A_R_LINEAR_____0_CM 1 0. 0. 65535. DISPLAY_IDENTIFIER CTR_REQ_ES_FUP ECU_ADDRESS 0x7f9914 BYTE_ORDER MSB_LAST FORMAT "%5.0" /end MEASUREMENT
/begin MEASUREMENT lv_req_es_fup_act "request for engine stop by hydraulic cut-off path activated" UBYTE _CNV_S_2_RANGE______11_CM 1 0. 0. 1. DISPLAY_IDENTIFIER LV_REQ_ES_FUP_ACT ECU_ADDRESS 0x7fba70 /end MEASUREMENT
/begin MEASUREMENT ctr_req_es_inj "counter requests engine stop by electrical cut-off path" UWORD _CNV_A_R_LINEAR_____0_CM 1 0. 0. 65535. DISPLAY_IDENTIFIER CTR_REQ_ES_INJ ECU_ADDRESS 0x7f9916 BYTE_ORDER MSB_LAST FORMAT "%5.0" /end MEASUREMENT
/begin MEASUREMENT lv_req_es_inj_act "request for engine stop by electrical cut-off path activated" UBYTE _CNV_S_2_RANGE______11_CM 1 0. 0. 1. DISPLAY_IDENTIFIER LV_REQ_ES_INJ_ACT ECU_ADDRESS 0x7fba71 /end MEASUREMENT
/begin CHARACTERISTIC c_t_req_es_fup "time for request engine cut-off by hydraulic path" VALUE 0x85c114 _REC_VAL_20_u4 4294963695. _CNV_A_R_LINEAR_____16_CM 3600. 4294967295. DISPLAY_IDENTIFIER C_T_REQ_ES_FUP FORMAT "%10.0" /end CHARACTERISTIC
/begin CHARACTERISTIC c_t_req_es_inj "time for request engine cut-off by electrical path" VALUE 0x85c118 _REC_VAL_20_u4 4294963695. _CNV_A_R_LINEAR_____16_CM 3600. 4294967295. DISPLAY_IDENTIFIER C_T_REQ_ES_INJ FORMAT "%10.0" /end CHARACTERISTIC
/begin CHARACTERISTIC c_t_es_prep "Duration of the engine stop preparation (typical value: 50ms)" VALUE 0x85c0cd _REC_VAL_20_u1 2550. _CNV_A_R_LINEAR_____96_CM 0. 2550. DISPLAY_IDENTIFIER C_T_ES_PREP FORMAT "%4.0" /end CHARACTERISTIC
/begin MEASUREMENT lv_req_es_supp_fct "request for engine stop from supplementary functions " UBYTE _CNV_S_2_RANGE______11_CM 1 0. 0. 1. DISPLAY_IDENTIFIER LV_REQ_ES_SUPP_FCT ECU_ADDRESS 0x7fb4b7 /end MEASUREMENT
/begin MEASUREMENT altpwm "generator load value ( 0 .. 100% )" UWORD _CNV_A_R_LINEAR_____136_CM 1 0. 0. 100. DISPLAY_IDENTIFIER ALTPWM ECU_ADDRESS 0x7fa0d4 BYTE_ORDER MSB_LAST FORMAT "%4.1" /end MEASUREMENT
/begin CHARACTERISTIC c_fac_altpwm_ducy_alter_pwm "Conversion factor between DUCY_ALTER_PWM (0..100%) and ALTPWM (0 .. 100%)" VALUE 0x85bdfe _REC_VAL_20_u1 1. _CNV_A_R_LINEAR_____25_CM 0. 1. DISPLAY_IDENTIFIER C_FAC_ALTPWM_DUCY_ALTER_PWM FORMAT "%3.2" /end CHARACTERISTIC
/begin CHARACTERISTIC c_altpwm_sub "substitute value for ALTPWM" VALUE 0x85bcc0 _REC_VAL_20_u2 100. _CNV_A_R_LINEAR_____136_CM 0. 100. DISPLAY_IDENTIFIER C_ALTPWM_SUB FORMAT "%4.1" /end CHARACTERISTIC
/begin MEASUREMENT pwl_lock_cdn "power latch extension by project specific configuration:" UWORD _CNV_A_R_LINEAR_____1_CM 1 0. 0. 65535. DISPLAY_IDENTIFIER PWL_LOCK_CDN ECU_ADDRESS 0x7fa27e BYTE_ORDER MSB_LAST /end MEASUREMENT
/begin MEASUREMENT t_pwl "incrementing timer during PWL phase active" UWORD _CNV_A_R_LINEAR_____234_CM 1 0. 0. 6553.5 DISPLAY_IDENTIFIER T_PWL ECU_ADDRESS 0x7fa27c BYTE_ORDER MSB_LAST FORMAT "%6.1" /end MEASUREMENT
/begin MEASUREMENT lv_pwl_act "power latch phase active" UBYTE _CNV_S_2_RANGE__0___88_CM 1 0. 0. 1. DISPLAY_IDENTIFIER LV_PWL_ACT ECU_ADDRESS 0x7fb81c BIT_MASK 0x1 /end MEASUREMENT
/begin MEASUREMENT lv_inh_pwl_tran_es_el "flag active in shut down phase: IGK on is not accepted without reset" UBYTE _CNV_S_2_RANGE__0___88_CM 1 0. 0. 1. DISPLAY_IDENTIFIER LV_INH_PWL_TRAN_ES_EL ECU_ADDRESS 0x7fb81d BIT_MASK 0x1 /end MEASUREMENT
/begin CHARACTERISTIC c_t_min_pwl "minimum power latch time for ECU switch off" VALUE 0x84868e _REC_VAL_20_u2 6533.5 _CNV_A_R_LINEAR_____234_CM 20. 6553.5 DISPLAY_IDENTIFIER C_T_MIN_PWL FORMAT "%6.1" /end CHARACTERISTIC
/begin CHARACTERISTIC c_t_max_pwl "maximum power latch time for ECU switch off" VALUE 0x848680 _REC_VAL_20_u2 6553.5 _CNV_A_R_LINEAR_____234_CM 0. 6553.5 DISPLAY_IDENTIFIER C_T_MAX_PWL FORMAT "%6.1" /end CHARACTERISTIC
/begin MEASUREMENT lv_cwp_act "bit for active electrical coolant water pump" UBYTE _CNV_S_2_RANGE__0___88_CM 1 0. 0. 1. DISPLAY_IDENTIFIER LV_CWP_ACT ECU_ADDRESS 0x7fb810 BIT_MASK 0x1 /end MEASUREMENT
/begin MEASUREMENT lv_cwp_act_eru "bit for active electrical coolant water pump while engine running" UBYTE _CNV_S_2_RANGE__0___88_CM 1 0. 0. 1. DISPLAY_IDENTIFIER LV_CWP_ACT_ERU ECU_ADDRESS 0x7fbbe1 BIT_MASK 0x1 /end MEASUREMENT
/begin CHARACTERISTIC c_t_ast_min_cwp "minimum time after start to activate CWP while engine running" VALUE 0x8485ec _REC_VAL_20_u2 6553.5 _CNV_A_R_LINEAR_____234_CM 0. 6553.5 DISPLAY_IDENTIFIER C_T_AST_MIN_CWP FORMAT "%6.1" /end CHARACTERISTIC
/begin CHARACTERISTIC c_tam_max_cwp_act_eru "maximum TAM to activate CWP while engine running" VALUE 0x8486bd _REC_VAL_20_u1 190.5 _CNV_A_R_LINEAR_____235_CM -48. 142.5 DISPLAY_IDENTIFIER C_TAM_MAX_CWP_ACT_ERU FORMAT "%5.1" /end CHARACTERISTIC
/begin MEASUREMENT lv_equip_cwp "Vehicle has a electrical coolant water pump" UBYTE _CNV_S_2_RANGE__0___88_CM 1 0. 0. 1. DISPLAY_IDENTIFIER LV_EQUIP_CWP ECU_ADDRESS 0x7fbbe2 BIT_MASK 0x1 /end MEASUREMENT
/begin CHARACTERISTIC c_tco_max_cwp_act_eru "maximum TCO to activate CWP while engine running" VALUE 0x8486cd _REC_VAL_20_u1 190.5 _CNV_A_R_LINEAR_____235_CM -48. 142.5 DISPLAY_IDENTIFIER C_TCO_MAX_CWP_ACT_ERU FORMAT "%5.1" /end CHARACTERISTIC
/begin CHARACTERISTIC c_t_ast_max_cwp "maximum time after start to activate CWP while engine running" VALUE 0x8485ea _REC_VAL_20_u2 6553.5 _CNV_A_R_LINEAR_____234_CM 0. 6553.5 DISPLAY_IDENTIFIER C_T_AST_MAX_CWP FORMAT "%6.1" /end CHARACTERISTIC
/begin CHARACTERISTIC c_equip_cwp "0 - CWP never used" VALUE 0x84842a _REC_VAL_20_u1 255. _CNV_A_R_LINEAR_____1_CM 0. 255. DISPLAY_IDENTIFIER C_EQUIP_CWP FORMAT "%3.0" /end CHARACTERISTIC
/begin CHARACTERISTIC c_t_accin_dly_st "" VALUE 0x8485e7 _REC_VAL_20_u1 25.5 _CNV_A_R_LINEAR_____19_CM 0. 25.5 DISPLAY_IDENTIFIER C_T_ACCIN_DLY_ST FORMAT "%2.1" /end CHARACTERISTIC
/begin CHARACTERISTIC c_pv_accin_fl_thd "Volllastschwelle fuer Klimakompressorabwurf" VALUE 0x848592 _REC_VAL_20_u2 99.90000000000001 _CNV_A_R_LINEAR_____261_CM 0. 99.90000000000001 DISPLAY_IDENTIFIER C_PV_ACCIN_FL_THD FORMAT "%2.1" /end CHARACTERISTIC
/begin CHARACTERISTIC c_n_accin_fl_thd "Drehzahlschwelle fuer Klimakompressorabwurf bei Vollast" VALUE 0x8484cc _REC_VAL_20_u2 6375. _CNV_A_R_LINEAR_____262_CM 0. 6375. DISPLAY_IDENTIFIER C_N_ACCIN_FL_THD FORMAT "%4.0" /end CHARACTERISTIC
/begin CHARACTERISTIC c_t_max_accin_fl "Maximale Abschaltzeit des Kompressors bei Vollast" VALUE 0x848678 _REC_VAL_20_u1 25.5 _CNV_A_R_LINEAR_____19_CM 0. 25.5 DISPLAY_IDENTIFIER C_T_MAX_ACCIN_FL FORMAT "%3.1" /end CHARACTERISTIC
/begin CHARACTERISTIC c_t_min_accin_fl "Minimale Abschaltzeit des Kompressors bei Vollast" VALUE 0x84868a _REC_VAL_20_u1 25.5 _CNV_A_R_LINEAR_____19_CM 0. 25.5 DISPLAY_IDENTIFIER C_T_MIN_ACCIN_FL FORMAT "%3.1" /end CHARACTERISTIC
/begin CHARACTERISTIC c_tco_accin_tol "Kuehlwassertemperaturschwelle fuer Klimakompressorabwurf" VALUE 0x8486c7 _REC_VAL_20_u1 255. _CNV_A_R_LINEAR_____18_CM -50. 205. DISPLAY_IDENTIFIER C_TCO_ACCIN_TOL FORMAT "%3.0" /end CHARACTERISTIC
/begin CHARACTERISTIC c_tco_accin_bol "Kuehlwassertemperaturschwelle fuer Wiedereinschalten des Klimakompressors" VALUE 0x8486c6 _REC_VAL_20_u1 255. _CNV_A_R_LINEAR_____18_CM -50. 205. DISPLAY_IDENTIFIER C_TCO_ACCIN_BOL FORMAT "%3.0" /end CHARACTERISTIC
/begin CHARACTERISTIC c_acp_high_bol "Einschaltung Klimakompressor wegen Kaeltemitteldruck nicht mehr zu hoch" VALUE 0x8482f2 _REC_VAL_20_u1 3100. _CNV_A_R_LINEAR_____206_CM 0. 3100. DISPLAY_IDENTIFIER C_ACP_HIGH_BOL FORMAT "%4.0" /end CHARACTERISTIC
/begin CHARACTERISTIC c_acp_high_tol "Abschaltung Klimakompressor wegen Kaeltemittel zu hoch" VALUE 0x8482f3 _REC_VAL_20_u1 3100. _CNV_A_R_LINEAR_____206_CM 0. 3100. DISPLAY_IDENTIFIER C_ACP_HIGH_TOL FORMAT "%4.0" /end CHARACTERISTIC
/begin CHARACTERISTIC c_acp_low_bol "Abschaltung Klimakompressor wegen Kaeltemitteldruck zu niedrig" VALUE 0x8482f4 _REC_VAL_20_u1 3100. _CNV_A_R_LINEAR_____206_CM 0. 3100. DISPLAY_IDENTIFIER C_ACP_LOW_BOL FORMAT "%4.0" /end CHARACTERISTIC
/begin CHARACTERISTIC c_acp_low_tol "Einschaltung Klimakomporessor wegen Kaeltemitteldruck nicht mehr zu niedrig" VALUE 0x8482f5 _REC_VAL_20_u1 3100. _CNV_A_R_LINEAR_____206_CM 0. 3100. DISPLAY_IDENTIFIER C_ACP_LOW_TOL FORMAT "%4.0" /end CHARACTERISTIC
/begin CHARACTERISTIC c_t_dly_accin "Einschaltverzoegerung Klimakompressor" VALUE 0x84862a _REC_VAL_20_u1 25.5 _CNV_A_R_LINEAR_____19_CM 0. 25.5 DISPLAY_IDENTIFIER C_T_DLY_ACCIN FORMAT "%3.1" /end CHARACTERISTIC
/begin CHARACTERISTIC c_t_min_accout_rly "Minimale Abschaltzeit des Kompressors" VALUE 0x84868b _REC_VAL_20_u1 25.5 _CNV_A_R_LINEAR_____19_CM 0. 25.5 DISPLAY_IDENTIFIER C_T_MIN_ACCOUT_RLY FORMAT "%3.1" /end CHARACTERISTIC
/begin MEASUREMENT lv_acc_ena_fl "" UBYTE _CNV_S_2_RANGE__0___88_CM 1 0. 0. 1. DISPLAY_IDENTIFIER LV_ACC_ENA_FL ECU_ADDRESS 0x7fc89c /end MEASUREMENT
/begin MEASUREMENT lv_acc_ena_st "" UBYTE _CNV_S_2_RANGE__0___88_CM 1 0. 0. 1. DISPLAY_IDENTIFIER LV_ACC_ENA_ST ECU_ADDRESS 0x7fc89d /end MEASUREMENT
/begin MEASUREMENT lv_acc_ena_sys_err "" UBYTE _CNV_S_2_RANGE__0___88_CM 1 0. 0. 1. DISPLAY_IDENTIFIER LV_ACC_ENA_SYS_ERR ECU_ADDRESS 0x7fc8a1 /end MEASUREMENT
/begin MEASUREMENT lv_acc_ena_acp "" UBYTE _CNV_S_2_RANGE__0___88_CM 1 0. 0. 1. DISPLAY_IDENTIFIER LV_ACC_ENA_ACP ECU_ADDRESS 0x7fc8a2 /end MEASUREMENT
/begin MEASUREMENT lv_accin "" UBYTE _CNV_S_2_RANGE__0___88_CM 1 0. 0. 1. DISPLAY_IDENTIFIER LV_ACCIN ECU_ADDRESS 0x7fb807 /end MEASUREMENT
/begin MEASUREMENT lv_acc_ena_tco "" UBYTE _CNV_S_2_RANGE__0___88_CM 1 0. 0. 1. DISPLAY_IDENTIFIER LV_ACC_ENA_TCO ECU_ADDRESS 0x7fc89e /end MEASUREMENT
/begin MEASUREMENT lv_acc_off_cmd "" UBYTE _CNV_S_2_RANGE__0___88_CM 1 0. 0. 1. DISPLAY_IDENTIFIER LV_ACC_OFF_CMD ECU_ADDRESS 0x7fb806 /end MEASUREMENT
/begin MEASUREMENT lv_acc_driv_req "" UBYTE _CNV_S_2_RANGE__0___88_CM 1 0. 0. 1. DISPLAY_IDENTIFIER LV_ACC_DRIV_REQ ECU_ADDRESS 0x7fb808 /end MEASUREMENT
/begin MEASUREMENT lv_acin_man "" UBYTE _CNV_A_R_LINEAR_____1_CM 1 0. 0. 1. DISPLAY_IDENTIFIER LV_ACIN_MAN ECU_ADDRESS 0x7fc8a4 FORMAT "%1.0" /end MEASUREMENT
/begin MEASUREMENT lv_old_acc_di "" UBYTE _CNV_A_R_LINEAR_____1_CM 1 0. 0. 1. DISPLAY_IDENTIFIER LV_OLD_ACC_DI ECU_ADDRESS 0x7fc8a3 FORMAT "%1.0" /end MEASUREMENT
/begin MEASUREMENT lv_acin_can_ecu "" UBYTE _CNV_A_R_LINEAR_____1_CM 1 0. 0. 1. DISPLAY_IDENTIFIER LV_ACIN_CAN_ECU ECU_ADDRESS 0x7fc8a5 FORMAT "%1.0" /end MEASUREMENT
/begin MEASUREMENT accpwm_b "" UWORD _CNV_A_R_LINEAR_____8_CM 1 0. 0. 99.99847412109381 DISPLAY_IDENTIFIER ACCPWM_B ECU_ADDRESS 0x7fb80a BYTE_ORDER MSB_LAST FORMAT "%5.2" /end MEASUREMENT
/begin MEASUREMENT lv_acc_ena "" UBYTE _CNV_S_2_RANGE__0___88_CM 1 0. 0. 1. DISPLAY_IDENTIFIER LV_ACC_ENA ECU_ADDRESS 0x7fc89b /end MEASUREMENT
/begin MEASUREMENT t_accin_dly_st "" UBYTE _CNV_A_R_LINEAR_____16_CM 1 0. 0. 255. DISPLAY_IDENTIFIER T_ACCIN_DLY_ST ECU_ADDRESS 0x7fc89a FORMAT "%3.0" /end MEASUREMENT
/begin MEASUREMENT t_accin_fl "" UBYTE _CNV_A_R_LINEAR_____16_CM 1 0. 0. 255. DISPLAY_IDENTIFIER T_ACCIN_FL ECU_ADDRESS 0x7fc896 FORMAT "%3.0" /end MEASUREMENT
/begin MEASUREMENT t_dly_accin "" UBYTE _CNV_A_R_LINEAR_____16_CM 1 0. 0. 255. DISPLAY_IDENTIFIER T_DLY_ACCIN ECU_ADDRESS 0x7fc899 FORMAT "%3.0" /end MEASUREMENT
/begin MEASUREMENT t_dly_accin_st "" UBYTE _CNV_A_R_LINEAR_____16_CM 1 0. 0. 255. DISPLAY_IDENTIFIER T_DLY_ACCIN_ST ECU_ADDRESS 0x7fc897 FORMAT "%3.0" /end MEASUREMENT
/begin MEASUREMENT t_min_accout_rly "" UBYTE _CNV_A_R_LINEAR_____16_CM 1 0. 0. 255. DISPLAY_IDENTIFIER T_MIN_ACCOUT_RLY ECU_ADDRESS 0x7fc898 FORMAT "%3.0" /end MEASUREMENT
/begin MEASUREMENT lv_acc_ena_tcu1 "" UBYTE _CNV_S_2_RANGE__0___88_CM 1 0. 0. 1. DISPLAY_IDENTIFIER LV_ACC_ENA_TCU1 ECU_ADDRESS 0x7fc89f /end MEASUREMENT
/begin MEASUREMENT lv_acc_ena_vecu1 "" UBYTE _CNV_S_2_RANGE__0___88_CM 1 0. 0. 1. DISPLAY_IDENTIFIER LV_ACC_ENA_VECU1 ECU_ADDRESS 0x7fc8a0 /end MEASUREMENT
/begin MEASUREMENT lv_acin "" UBYTE _CNV_S_2_RANGE______28_CM 1 0. 0. 1. DISPLAY_IDENTIFIER LV_ACIN ECU_ADDRESS 0x7fb804 /end MEASUREMENT
/begin MEASUREMENT lv_accout_rly "" UBYTE _CNV_S_2_RANGE______28_CM 1 0. 0. 1. DISPLAY_IDENTIFIER LV_ACCOUT_RLY ECU_ADDRESS 0x7fb805 /end MEASUREMENT
/begin MEASUREMENT sf_eng_state "engine states" UBYTE _CNV_S_4_Engine_Sta_339_CM 1 0. 1. 8. DISPLAY_IDENTIFIER SF_ENG_STATE ECU_ADDRESS 0x7fb4a6 /end MEASUREMENT
/begin MEASUREMENT lv_es "engine state : engine stop" UBYTE _CNV_S_2_RANGE______11_CM 1 0. 0. 1. DISPLAY_IDENTIFIER LV_ES ECU_ADDRESS 0x7fb4a8 /end MEASUREMENT
/begin MEASUREMENT lv_st "engine state : start" UBYTE _CNV_S_2_RANGE______11_CM 1 0. 0. 1. DISPLAY_IDENTIFIER LV_ST ECU_ADDRESS 0x7fb4a9 /end MEASUREMENT
/begin MEASUREMENT lv_is "engine state : idle" UBYTE _CNV_S_2_RANGE______11_CM 1 0. 0. 1. DISPLAY_IDENTIFIER LV_IS ECU_ADDRESS 0x7fb4aa /end MEASUREMENT
/begin MEASUREMENT lv_pl "engine state : part load" UBYTE _CNV_S_2_RANGE______11_CM 1 0. 0. 1. DISPLAY_IDENTIFIER LV_PL ECU_ADDRESS 0x7fb4ab /end MEASUREMENT
/begin MEASUREMENT lv_puc "pull fuel cutoff" UBYTE _CNV_S_2_RANGE______11_CM 1 0. 0. 1. DISPLAY_IDENTIFIER LV_PUC ECU_ADDRESS 0x7fb4a7 /end MEASUREMENT
/begin MEASUREMENT lv_st_end "engine operating state start not active" UBYTE _CNV_S_2_RANGE______11_CM 1 0. 0. 1. DISPLAY_IDENTIFIER LV_ST_END ECU_ADDRESS 0x7fb4ac /end MEASUREMENT
/begin MEASUREMENT t_ast "timer after start" UWORD _CNV_A_R_LINEAR_____19_CM 1 0. 0. 6553.5 DISPLAY_IDENTIFIER T_AST ECU_ADDRESS 0x7f9910 BYTE_ORDER MSB_LAST FORMAT "%2.1" /end MEASUREMENT
/begin MEASUREMENT t_apl "timer after part load" UWORD _CNV_A_R_LINEAR_____19_CM 1 0. 0. 6553.5 DISPLAY_IDENTIFIER T_APL ECU_ADDRESS 0x7f9912 BYTE_ORDER MSB_LAST FORMAT "%2.1" /end MEASUREMENT
/begin CHARACTERISTIC ip_n_max_tol_st__tco "AENGSTAT: Threshold engine speed for ST" CURVE 0x8554f0 _REC_CUR_20_u2_u1 6375. _CNV_A_R_LINEAR_____5_CM 0. 6375. DISPLAY_IDENTIFIER IP_N_MAX_TOL_ST__TCO FORMAT "%4.0"
 /begin AXIS_DESCR COM_AXIS tco _CNV_A_R_LINEAR_____18_CM 8 -50. 205. FORMAT "%3.0" AXIS_PTS_REF ldp_tco_ip_n_max_tol_st /end AXIS_DESCR
/end CHARACTERISTIC
/begin AXIS_PTS ldp_tco_ip_n_max_tol_st "" 0x84281f tco _REC_AXS_20_u1 255. _CNV_A_R_LINEAR_____18_CM 8 -50. 205. FORMAT "%3.0" /end AXIS_PTS
/begin CHARACTERISTIC c_n_max_bol_st "Lower engine speed level" VALUE 0x85bf9e _REC_VAL_20_u2 6375. _CNV_A_R_LINEAR_____5_CM 0. 6375. DISPLAY_IDENTIFIER C_N_MAX_BOL_ST FORMAT "%4.0" /end CHARACTERISTIC
/begin CHARACTERISTIC c_n_min_bol "Upper engine speed level" VALUE 0x85bfba _REC_VAL_20_u2 6375. _CNV_A_R_LINEAR_____5_CM 0. 6375. DISPLAY_IDENTIFIER C_N_MIN_BOL FORMAT "%4.0" /end CHARACTERISTIC
/begin CHARACTERISTIC c_pv_av_min "Pedal value minimum for IS" VALUE 0x85bff2 _REC_VAL_20_u2 99.90000000000001 _CNV_A_R_LINEAR_____261_CM 0. 99.90000000000001 DISPLAY_IDENTIFIER C_PV_AV_MIN FORMAT "%4.2" /end CHARACTERISTIC
/begin CHARACTERISTIC c_ctr_max_ti_min "maximum countervalue for minimal injection-time mode" VALUE 0x85bdbd _REC_VAL_20_u1 255. _CNV_A_R_LINEAR_____0_CM 0. 255. DISPLAY_IDENTIFIER C_CTR_MAX_TI_MIN FORMAT "%3.0" /end CHARACTERISTIC
/begin MEASUREMENT lv_rest "auxiliary function re-start" UBYTE _CNV_S_2_RANGE______11_CM 1 0. 0. 1. DISPLAY_IDENTIFIER LV_REST ECU_ADDRESS 0x7fb4ae /end MEASUREMENT
/begin MEASUREMENT tco_rest "coolant temperature stored to detect  a re-start" UBYTE _CNV_A_R_LINEAR_____18_CM 1 0. -50. 205. DISPLAY_IDENTIFIER TCO_REST ECU_ADDRESS 0x7fb4ad FORMAT "%3.0" /end MEASUREMENT
/begin MEASUREMENT lv_rest_auth "authorisation for restart" UBYTE _CNV_S_2_RANGE______11_CM 1 0. 0. 1. DISPLAY_IDENTIFIER LV_REST_AUTH ECU_ADDRESS 0x7fb4af /end MEASUREMENT
/begin CHARACTERISTIC c_t_max_rest "time delay after switching on from LV_ST to detect LV_REST" VALUE 0x85c0f2 _REC_VAL_20_u2 6553.5 _CNV_A_R_LINEAR_____19_CM 0. 6553.5 DISPLAY_IDENTIFIER C_T_MAX_REST FORMAT "%5.1" /end CHARACTERISTIC
/begin CHARACTERISTIC c_tco_dif_max_rest "coolant temperature threshold to detect LV_REST" VALUE 0x85c13f _REC_VAL_20_u1 255. _CNV_A_R_LINEAR_____20_CM 0. 255. DISPLAY_IDENTIFIER C_TCO_DIF_MAX_REST FORMAT "%3.0" /end CHARACTERISTIC
/begin MEASUREMENT lv_str_1_2_on "Einschaltanforderung fuer beide Starterrelais" UBYTE _CNV_S_2_RANGE__0___88_CM 1 0. 0. 1. DISPLAY_IDENTIFIER LV_STR_1_2_ON ECU_ADDRESS 0x7fb4ba BIT_MASK 0x1 /end MEASUREMENT
/begin MEASUREMENT lv_err_str_2 "Starterrelais 2 defekt" UBYTE _CNV_S_2_RANGE__0___88_CM 1 0. 0. 1. DISPLAY_IDENTIFIER LV_ERR_STR_2 ECU_ADDRESS 0x7fb4be BIT_MASK 0x1 /end MEASUREMENT
/begin MEASUREMENT lv_str_1_2_off "Angeforderte Abschaltreihenfolge:Starterrelais 1- Starterrelais 2" UBYTE _CNV_S_2_RANGE__0___88_CM 1 0. 0. 1. DISPLAY_IDENTIFIER LV_STR_1_2_OFF ECU_ADDRESS 0x7fb4bc BIT_MASK 0x1 /end MEASUREMENT
/begin MEASUREMENT ctr_str "Zaehler Startversuche" UBYTE _CNV_A_R_LINEAR_____1_CM 1 0. 0. 255. DISPLAY_IDENTIFIER CTR_STR ECU_ADDRESS 0x7fba74 FORMAT "%3.0" /end MEASUREMENT
/begin MEASUREMENT lv_err_str_1 "Starterrelais 1 defekt" UBYTE _CNV_S_2_RANGE__0___88_CM 1 0. 0. 1. DISPLAY_IDENTIFIER LV_ERR_STR_1 ECU_ADDRESS 0x7fb4bd BIT_MASK 0x1 /end MEASUREMENT
/begin MEASUREMENT lv_err_str_1_2 "Diagnoseflag Starterrelais" UBYTE _CNV_S_2_RANGE__0___88_CM 1 0. 0. 1. DISPLAY_IDENTIFIER LV_ERR_STR_1_2 ECU_ADDRESS 0x7fb4bb BIT_MASK 0x1 /end MEASUREMENT
/begin MEASUREMENT t_str_rng "Regenerierungszeit Starter" UWORD _CNV_A_R_LINEAR_____223_CM 1 0. 0. 655.35 DISPLAY_IDENTIFIER T_STR_RNG ECU_ADDRESS 0x7fa88c BYTE_ORDER MSB_LAST FORMAT "%6.2" /end MEASUREMENT
/begin MEASUREMENT t_str_n_min "Zeit fuer N unter Einspurdrehzahl" UWORD _CNV_A_R_LINEAR_____223_CM 1 0. 0. 655.35 DISPLAY_IDENTIFIER T_STR_N_MIN ECU_ADDRESS 0x7fa890 BYTE_ORDER MSB_LAST FORMAT "%6.2" /end MEASUREMENT
/begin MEASUREMENT lv_str_1 "Starterrelais 1 (STC_HOLD)" UBYTE _CNV_S_2_RANGE__0___88_CM 1 0. 0. 1. DISPLAY_IDENTIFIER LV_STR_1 ECU_ADDRESS 0x7fb4bf BIT_MASK 0x1 /end MEASUREMENT
/begin MEASUREMENT lv_kl15_lock "Bit fuer Klemme 15 Sperre" UBYTE _CNV_S_2_RANGE__0___88_CM 1 0. 0. 1. DISPLAY_IDENTIFIER LV_KL15_LOCK ECU_ADDRESS 0x7fba75 BIT_MASK 0x1 /end MEASUREMENT
/begin MEASUREMENT t_str_sum "Zeit Anlasser aktiv bei mehreren Startversuchen" UWORD _CNV_A_R_LINEAR_____223_CM 1 0. 0. 655.35 DISPLAY_IDENTIFIER T_STR_SUM ECU_ADDRESS 0x7fa88e BYTE_ORDER MSB_LAST FORMAT "%6.2" /end MEASUREMENT
/begin MEASUREMENT t_str_act "Zeit nach Einspurdrehzahl ueberschritten" UWORD _CNV_A_R_LINEAR_____223_CM 1 0. 0. 655.35 DISPLAY_IDENTIFIER T_STR_ACT ECU_ADDRESS 0x7fa886 BYTE_ORDER MSB_LAST FORMAT "%6.2" /end MEASUREMENT
/begin MEASUREMENT t_vs_str_off "Zeit fuer die das FZ vom Anlasser bewegt wird" UWORD _CNV_A_R_LINEAR_____223_CM 1 0. 0. 655.35 DISPLAY_IDENTIFIER T_VS_STR_OFF ECU_ADDRESS 0x7fa888 BYTE_ORDER MSB_LAST FORMAT "%6.2" /end MEASUREMENT
/begin MEASUREMENT t_chk_eng_stop "Zeitzaehler fuer Pruefung \\'Motor steht\\'" UWORD _CNV_A_R_LINEAR_____223_CM 1 0. 0. 655.35 DISPLAY_IDENTIFIER T_CHK_ENG_STOP ECU_ADDRESS 0x7fa882 BYTE_ORDER MSB_LAST FORMAT "%6.2" /end MEASUREMENT
/begin MEASUREMENT lv_str_2 "Starterrelais 2 (STC_OFF)" UBYTE _CNV_S_2_RANGE__0___88_CM 1 0. 0. 1. DISPLAY_IDENTIFIER LV_STR_2 ECU_ADDRESS 0x7fb4c0 BIT_MASK 0x1 /end MEASUREMENT
/begin MEASUREMENT lv_n_sub "Flag fuer Aktivierung der Startverlaengerung bei KW-Fehler" UBYTE _CNV_S_2_RANGE__0___88_CM 1 0. 0. 1. DISPLAY_IDENTIFIER LV_N_SUB ECU_ADDRESS 0x7fba76 BIT_MASK 0x1 /end MEASUREMENT
/begin MEASUREMENT t_str_off "Abschaltzeit Starterrelais" UWORD _CNV_A_R_LINEAR_____223_CM 1 0. 0. 655.35 DISPLAY_IDENTIFIER T_STR_OFF ECU_ADDRESS 0x7fa88a BYTE_ORDER MSB_LAST FORMAT "%6.2" /end MEASUREMENT
/begin MEASUREMENT t_n_sub "Zeitzaehler fuer Pruefung KW-Fehler vorhanden" UWORD _CNV_A_R_LINEAR_____223_CM 1 0. 0. 655.35 DISPLAY_IDENTIFIER T_N_SUB ECU_ADDRESS 0x7fa884 BYTE_ORDER MSB_LAST FORMAT "%6.2" /end MEASUREMENT
/begin MEASUREMENT lv_sta_rls "Anlasserfreigabebit ueber CAN (Motor5 Byte7 Bit0)" UBYTE _CNV_S_2_RANGE__0___88_CM 1 0. 0. 1. DISPLAY_IDENTIFIER LV_STA_RLS ECU_ADDRESS 0x7fb4b8 BIT_MASK 0x1 /end MEASUREMENT
/begin MEASUREMENT lv_sta_stop "Anlasser-Stop-Bit ueber CAN (Motor5 Byte7 Bit1)" UBYTE _CNV_S_2_RANGE__0___88_CM 1 0. 0. 1. DISPLAY_IDENTIFIER LV_STA_STOP ECU_ADDRESS 0x7fb4b9 BIT_MASK 0x1 /end MEASUREMENT
/begin CHARACTERISTIC c_t_str_n_min "Max. Zeit fuer N unter Einspurdrehzahl (MSG)" VALUE 0x8486aa _REC_VAL_20_u2 655.35 _CNV_A_R_LINEAR_____223_CM 0. 655.35 DISPLAY_IDENTIFIER C_T_STR_N_MIN FORMAT "%6.2" /end CHARACTERISTIC
/begin CHARACTERISTIC c_t_max_n_sub "UEberpruefungszeit bis Startverlaengerung bei KW-Fehler aktiv (MSG)" VALUE 0x84867e _REC_VAL_20_u2 655.35 _CNV_A_R_LINEAR_____223_CM 0. 655.35 DISPLAY_IDENTIFIER C_T_MAX_N_SUB FORMAT "%6.2" /end CHARACTERISTIC
/begin CHARACTERISTIC c_cam_1_ctr_max "Max. Anzahl NW-Flanken bis Startverlaengerung bei KW-Fehler aktiv (MSG)" VALUE 0x848347 _REC_VAL_20_u1 255. _CNV_A_R_LINEAR_____1_CM 0. 255. DISPLAY_IDENTIFIER C_CAM_1_CTR_MAX FORMAT "%3.0" /end CHARACTERISTIC
/begin CHARACTERISTIC c_t_str_rng "Regenerierungszeit Starter (MSG)" VALUE 0x8486ae _REC_VAL_20_u2 655.35 _CNV_A_R_LINEAR_____223_CM 0. 655.35 DISPLAY_IDENTIFIER C_T_STR_RNG FORMAT "%6.2" /end CHARACTERISTIC
/begin CHARACTERISTIC c_n_str_min "Einspurdrehzahl (MSG + BSG)" VALUE 0x848516 _REC_VAL_20_u2 8160. _CNV_A_R_LINEAR_____257_CM 0. 8160. DISPLAY_IDENTIFIER C_N_STR_MIN FORMAT "%4.0" /end CHARACTERISTIC
/begin CHARACTERISTIC c_t_str_off_max "Max. Abschaltzeit der Starterrelais (MSG)" VALUE 0x8486ac _REC_VAL_20_u2 655.35 _CNV_A_R_LINEAR_____223_CM 0. 655.35 DISPLAY_IDENTIFIER C_T_STR_OFF_MAX FORMAT "%6.2" /end CHARACTERISTIC
/begin CHARACTERISTIC c_n_chk_eng_stop "Drehzahlschwelle fuer Erkennung \\'Motor-steht \\' (BSG)" VALUE 0x8484ce _REC_VAL_20_u2 8160. _CNV_A_R_LINEAR_____257_CM 0. 8160. DISPLAY_IDENTIFIER C_N_CHK_ENG_STOP FORMAT "%4.0" /end CHARACTERISTIC
/begin CHARACTERISTIC c_vs_str_off "Geschwindigkeitsschwelle fuer Abschalten d. Anlassers (BSG)" VALUE 0x84878a _REC_VAL_20_u1 255. _CNV_A_R_LINEAR_____239_CM 0. 255. DISPLAY_IDENTIFIER C_VS_STR_OFF FORMAT "%3.0" /end CHARACTERISTIC
/begin AXIS_PTS ldp_ctr_str_id_t_str_sum_max "" 0x844505 ctr_str _REC_AXS_20_u1 255. _CNV_A_R_LINEAR_____1_CM 6 0. 255. FORMAT "%3.0" /end AXIS_PTS
/begin CHARACTERISTIC ip_n_str_off "Drehzahlabschaltschwelle Starterrelais (MSG + BSG)" CURVE 0x847344 _REC_CUR_20_u2_u1 8160. _CNV_A_R_LINEAR_____257_CM 0. 8160. DISPLAY_IDENTIFIER IP_N_STR_OFF FORMAT "%4.0"
 /begin AXIS_DESCR COM_AXIS tco _CNV_A_R_LINEAR_____235_CM 6 -48. 142.5 FORMAT "%5.1" AXIS_PTS_REF ldp_tco_ip_n_str_off /end AXIS_DESCR
/end CHARACTERISTIC
/begin AXIS_PTS ldp_tco_ip_t_str_act_max "" 0x8447f3 tco _REC_AXS_20_u1 190.5 _CNV_A_R_LINEAR_____235_CM 6 -48. 142.5 FORMAT "%5.1" /end AXIS_PTS
/begin CHARACTERISTIC id_fac_n_str "Ausspur-Drehzahlanhebung nach Fehlstart (MSG)" CURVE 0x844a82 _REC_CUR_20_u1_u1 7.96875 _CNV_A_R_LINEAR_____299_CM 0. 7.96875 DISPLAY_IDENTIFIER ID_FAC_N_STR FORMAT "%4.2"
 /begin AXIS_DESCR COM_AXIS ctr_str _CNV_A_R_LINEAR_____1_CM 6 0. 255. FORMAT "%3.0" AXIS_PTS_REF ldp_ctr_str_id_fac_n_str /end AXIS_DESCR
/end CHARACTERISTIC
/begin CHARACTERISTIC ip_t_str_act_max "Maximale Startzeit nach UEberschreiten der Einspurdrehzahl (BSG)" CURVE 0x847942 _REC_CUR_20_u2_u1 655.35 _CNV_A_R_LINEAR_____223_CM 0. 655.35 DISPLAY_IDENTIFIER IP_T_STR_ACT_MAX FORMAT "%6.2"
 /begin AXIS_DESCR COM_AXIS tco _CNV_A_R_LINEAR_____235_CM 6 -48. 142.5 FORMAT "%5.1" AXIS_PTS_REF ldp_tco_ip_t_str_act_max /end AXIS_DESCR
/end CHARACTERISTIC
/begin CHARACTERISTIC c_t_chk_eng_stop "UEberpruefungszeit fuer Erkennung \\'Motor -steht\\' (BSG)" VALUE 0x84860c _REC_VAL_20_u2 655.35 _CNV_A_R_LINEAR_____223_CM 0. 655.35 DISPLAY_IDENTIFIER C_T_CHK_ENG_STOP FORMAT "%6.2" /end CHARACTERISTIC
/begin CHARACTERISTIC c_t_max_vs_str_off "Maximale Zeit die das FZ mit dem Anlasser bewegt werden darf" VALUE 0x848688 _REC_VAL_20_u2 655.35 _CNV_A_R_LINEAR_____223_CM 0. 655.35 DISPLAY_IDENTIFIER C_T_MAX_VS_STR_OFF FORMAT "%6.2" /end CHARACTERISTIC
/begin CHARACTERISTIC lc_kl15_lock "Schalter fuer Konfiguration Klemme 15 Sperre (BSG)" VALUE 0x8487c9 _REC_VAL_20_u1 1. _CNV_A_R_LINEAR_____0_CM 0. 1. DISPLAY_IDENTIFIER LC_KL15_LOCK FORMAT "%2.0" /end CHARACTERISTIC
/begin AXIS_PTS ldp_tco_ip_n_str_off "" 0x8447ec tco _REC_AXS_20_u1 190.5 _CNV_A_R_LINEAR_____235_CM 6 -48. 142.5 FORMAT "%5.1" /end AXIS_PTS
/begin AXIS_PTS ldp_tco_ip_dur_str_nom_str_act "" 0x8447e5 tco _REC_AXS_20_u1 190.5 _CNV_A_R_LINEAR_____235_CM 6 -48. 142.5 FORMAT "%5.1" /end AXIS_PTS
/begin AXIS_PTS ldp_ctr_str_id_fac_n_str "" 0x8444fe ctr_str _REC_AXS_20_u1 255. _CNV_A_R_LINEAR_____1_CM 6 0. 255. FORMAT "%3.0" /end AXIS_PTS
/begin AXIS_PTS ldp_t_ip_dur_str_nom_str_act "" 0x8446da t_gl_es _REC_AXS_20_u2 655.35 _CNV_A_R_LINEAR_____223_CM 6 0. 655.35 FORMAT "%6.2" /end AXIS_PTS
/begin CHARACTERISTIC id_t_str_sum_max "Max. Anlasserbetriebszeit abh.von Anzahl Startversuche (MSG)" CURVE 0x8452da _REC_CUR_20_u2_u1 655.35 _CNV_A_R_LINEAR_____223_CM 0. 655.35 DISPLAY_IDENTIFIER ID_T_STR_SUM_MAX FORMAT "%6.2"
 /begin AXIS_DESCR COM_AXIS ctr_str _CNV_A_R_LINEAR_____1_CM 6 0. 255. FORMAT "%3.0" AXIS_PTS_REF ldp_ctr_str_id_t_str_sum_max /end AXIS_DESCR
/end CHARACTERISTIC
/begin CHARACTERISTIC ip_dur_str_nom_str_act "Gluehzeit" MAP 0x846756 _REC_MAP_20_u2_u1_u2 655.35 _CNV_A_R_LINEAR_____223_CM 0. 655.35 DISPLAY_IDENTIFIER IP_DUR_STR_NOM_STR_ACT FORMAT "%6.2"
 /begin AXIS_DESCR COM_AXIS tco _CNV_A_R_LINEAR_____235_CM 6 -48. 142.5 FORMAT "%5.1" AXIS_PTS_REF ldp_tco_ip_dur_str_nom_str_act /end AXIS_DESCR
 /begin AXIS_DESCR COM_AXIS t_gl_es _CNV_A_R_LINEAR_____223_CM 6 0. 655.35 FORMAT "%6.2" AXIS_PTS_REF ldp_t_ip_dur_str_nom_str_act /end AXIS_DESCR
/end CHARACTERISTIC
/begin CHARACTERISTIC lc_n_sub "Bei LC_N_SUB = 1 wird Startverlaengerung bei defektem Drehzahlgeber ermoeglicht" VALUE 0x8487cf _REC_VAL_20_u1 1. _CNV_A_R_LINEAR_____0_CM 0. 1. DISPLAY_IDENTIFIER LC_N_SUB FORMAT "%2.0" /end CHARACTERISTIC
/begin CHARACTERISTIC lc_str_conf "Schalter fuer Konfiguration der Startersteuerung 0 = BSG / 1 = MSG" VALUE 0x8487d3 _REC_VAL_20_u1 1. _CNV_A_R_LINEAR_____0_CM 0. 1. DISPLAY_IDENTIFIER LC_STR_CONF FORMAT "%2.0" /end CHARACTERISTIC
/begin MEASUREMENT kl50r "Start Anforderungs Rueckkopplung" UBYTE _CNV_A_R_LINEAR_____0_CM 1 0. 0. 1. DISPLAY_IDENTIFIER KL50R ECU_ADDRESS 0x7fb4c1 FORMAT "%1.0" /end MEASUREMENT
/begin MEASUREMENT kl50 "Start Anforderung" UBYTE _CNV_A_R_LINEAR_____0_CM 1 0. 0. 1. DISPLAY_IDENTIFIER KL50 ECU_ADDRESS 0x7fb4c2 FORMAT "%1.0" /end MEASUREMENT
/begin MEASUREMENT cam_1_ctr "Anzahl der NW-Flanken bis Startverlaengerung bei KW_Fehler aktiv (MSG)" UBYTE _CNV_A_R_LINEAR_____0_CM 1 0. 0. 1. DISPLAY_IDENTIFIER CAM_1_CTR ECU_ADDRESS 0x7fb4c3 FORMAT "%1.0" /end MEASUREMENT
/begin MEASUREMENT lv_st_es "Start Abbruch Erkennung (MSG)" UBYTE _CNV_S_2_RANGE______11_CM 1 0. 0. 1. DISPLAY_IDENTIFIER LV_ST_ES ECU_ADDRESS 0x7fb4c4 /end MEASUREMENT
/begin MEASUREMENT lv_str_on "Starterrelais 1" UBYTE _CNV_S_2_RANGE______11_CM 1 0. 0. 1. DISPLAY_IDENTIFIER LV_STR_ON ECU_ADDRESS 0x7fb4c5 /end MEASUREMENT
/begin MEASUREMENT lv_str_off "Starterrelais 2" UBYTE _CNV_S_2_RANGE______11_CM 1 0. 0. 1. DISPLAY_IDENTIFIER LV_STR_OFF ECU_ADDRESS 0x7fb4c6 /end MEASUREMENT
/begin MEASUREMENT lv_auth_eng_rest "Authorisation f&uuml;r den Re-Start" UBYTE _CNV_S_2_RANGE______11_CM 1 0. 0. 1. DISPLAY_IDENTIFIER LV_AUTH_ENG_REST ECU_ADDRESS 0x7fb4c7 /end MEASUREMENT
/begin MEASUREMENT lv_req_es_driv "Fahrer fordert Motor Stop" UBYTE _CNV_S_2_RANGE______11_CM 1 0. 0. 1. DISPLAY_IDENTIFIER LV_REQ_ES_DRIV ECU_ADDRESS 0x7fb4c8 /end MEASUREMENT
/begin CHARACTERISTIC c_add_n_max_fcut "Additive threshold to maximum engine speed for activation fuel cut-off all cylinders" VALUE 0x85bcba _REC_VAL_20_u2 8160. _CNV_A_R_LINEAR_____383_CM 0. 8160. DISPLAY_IDENTIFIER C_ADD_N_MAX_FCUT FORMAT "%4.0" /end CHARACTERISTIC
/begin CHARACTERISTIC c_crlc_n_grd_fil_1 "N_GRD_FIL low pass filter constant if LV_N_MAX = 0" VALUE 0x85bd4e _REC_VAL_20_u2 0.9999847412109381 _CNV_A_R_LINEAR_____14_CM 0. 0.9999847412109381 DISPLAY_IDENTIFIER C_CRLC_N_GRD_FIL_1 FORMAT "%6.5" /end CHARACTERISTIC
/begin CHARACTERISTIC c_crlc_n_grd_fil_2 "N_GRD_FIL low pass filter constant if LV_N_MAX = 1" VALUE 0x85bd50 _REC_VAL_20_u2 0.9999847412109381 _CNV_A_R_LINEAR_____14_CM 0. 0.9999847412109381 DISPLAY_IDENTIFIER C_CRLC_N_GRD_FIL_2 FORMAT "%6.5" /end CHARACTERISTIC
/begin CHARACTERISTIC c_n_grd_hys "Hysteresis for N_GRD Filtering" VALUE 0x85bf92 _REC_VAL_20_s1 8160. _CNV_A_R_LINEAR_____384_CM -4096. 4064. DISPLAY_IDENTIFIER C_N_GRD_HYS FORMAT "%5.0" /end CHARACTERISTIC
/begin CHARACTERISTIC c_tqi_max_pas "Passive value for TQI_N_MAX if engine-speed limitation is passive" VALUE 0x85c1dc _REC_VAL_20_s2 1023.96875 _CNV_A_R_LINEAR_____62_CM 0. 1023.96875 DISPLAY_IDENTIFIER C_TQI_MAX_PAS FORMAT "%8.3" /end CHARACTERISTIC
/begin MEASUREMENT lv_n_max "Logical variable engine speed limitation active" UBYTE _CNV_S_2_RANGE______3_CM 1 0. 0. 1. DISPLAY_IDENTIFIER LV_N_MAX ECU_ADDRESS 0x7fb726 /end MEASUREMENT
/begin MEASUREMENT lv_n_max_req_fcut "Logical variable fuel cut-off of all cylinder requested for engine speed limitation" UBYTE _CNV_S_2_RANGE______3_CM 1 0. 0. 1. DISPLAY_IDENTIFIER LV_N_MAX_REQ_FCUT ECU_ADDRESS 0x7fb727 /end MEASUREMENT
/begin MEASUREMENT n_dif_max_lim "Engine speed difference as an input for PI-controller" SWORD _CNV_A_R_LINEAR_____383_CM 1 0. -8160. 8160. DISPLAY_IDENTIFIER N_DIF_MAX_LIM ECU_ADDRESS 0x7faffe BYTE_ORDER MSB_LAST FORMAT "%5.0" /end MEASUREMENT
/begin MEASUREMENT n_grd_fil "engine speed gradient  pre-selection for low pass filter" SBYTE _CNV_A_R_LINEAR_____384_CM 1 0. -4096. 4064. DISPLAY_IDENTIFIER N_GRD_FIL ECU_ADDRESS 0x7fbb45 FORMAT "%5.0" /end MEASUREMENT
/begin MEASUREMENT n_grd_fil_fil "Low pass filtered engine speed gradient for predicted engine speed" SBYTE _CNV_A_R_LINEAR_____384_CM 1 0. -4096. 4064. DISPLAY_IDENTIFIER N_GRD_FIL_FIL ECU_ADDRESS 0x7fbb46 FORMAT "%5.0" /end MEASUREMENT
/begin MEASUREMENT n_pred_max_lim "Predicted engine speed" UWORD _CNV_A_R_LINEAR_____383_CM 1 0. 0. 8160. DISPLAY_IDENTIFIER N_PRED_MAX_LIM ECU_ADDRESS 0x7faffc BYTE_ORDER MSB_LAST FORMAT "%4.0" /end MEASUREMENT
/begin MEASUREMENT tq_n_max_dif "Torque output of N_MAX-PI-Controller" SWORD _CNV_A_R_LINEAR_____62_CM 1 0. -1024. 1023.96875 DISPLAY_IDENTIFIER TQ_N_MAX_DIF ECU_ADDRESS 0x7fb004 BYTE_ORDER MSB_LAST FORMAT "%8.3" /end MEASUREMENT
/begin MEASUREMENT tq_n_max_dif_p "Torque output of N_MAX-P-Controller" SWORD _CNV_A_R_LINEAR_____62_CM 1 0. -1024. 1023.96875 DISPLAY_IDENTIFIER TQ_N_MAX_DIF_P ECU_ADDRESS 0x7fb006 BYTE_ORDER MSB_LAST FORMAT "%8.3" /end MEASUREMENT
/begin MEASUREMENT tq_n_max_inp_i "Torque input for N_MAX I-controller" SWORD _CNV_A_R_LINEAR_____385_CM 1 0. -4. 3.99987793 DISPLAY_IDENTIFIER TQ_N_MAX_INP_I ECU_ADDRESS 0x7fb000 BYTE_ORDER MSB_LAST FORMAT "%6.4" /end MEASUREMENT
/begin MEASUREMENT tqi_n_max_1 "Intermitted indicated engine torque after considering PI-controller output" SWORD _CNV_A_R_LINEAR_____62_CM 1 0. -1024. 1023.96875 DISPLAY_IDENTIFIER TQI_N_MAX_1 ECU_ADDRESS 0x7fb008 BYTE_ORDER MSB_LAST FORMAT "%8.3" /end MEASUREMENT
/begin MEASUREMENT tqi_n_max_ref "Reference indicated engine  torque on which controller output is applied" SWORD _CNV_A_R_LINEAR_____62_CM 1 0. 0. 1023.96875 DISPLAY_IDENTIFIER TQI_N_MAX_REF ECU_ADDRESS 0x7fb002 BYTE_ORDER MSB_LAST FORMAT "%8.3" /end MEASUREMENT
/begin AXIS_PTS ldp_n_32_n_grd_thd "Engine speed gradient threshold for filtering of basic engine speed gradient" 0x841908 n_32 _REC_AXS_20_u1 8160. _CNV_A_R_LINEAR_____35_CM 6 0. 8160. FORMAT "%4.0" /end AXIS_PTS
/begin AXIS_PTS ldpm_gear "P-control parameter for N_MAX-controller automatic transmission" 0x8434a2 dri _REC_AXS_20_u1 255. _CNV_A_R_LINEAR_____0_CM 9 0. 255. FORMAT "%3.0" /end AXIS_PTS
/begin CHARACTERISTIC id_fac_n_max_i_at__gear "ES: I-control parameter AT" CURVE 0x848946 _REC_CUR_20_u2_u1 7.9998779296875 _CNV_A_R_LINEAR_____386_CM 0. 7.9998779296875 DISPLAY_IDENTIFIER ID_FAC_N_MAX_I_AT__GEAR FORMAT "%8.7"
 /begin AXIS_DESCR COM_AXIS dri _CNV_A_R_LINEAR_____0_CM 9 0. 255. FORMAT "%3.0" AXIS_PTS_REF ldpm_gear /end AXIS_DESCR
/end CHARACTERISTIC
/begin CHARACTERISTIC id_fac_n_max_i_mt__gear "ES: I-control parameter MT" CURVE 0x848958 _REC_CUR_20_u2_u1 7.9998779296875 _CNV_A_R_LINEAR_____386_CM 0. 7.9998779296875 DISPLAY_IDENTIFIER ID_FAC_N_MAX_I_MT__GEAR FORMAT "%7.6"
 /begin AXIS_DESCR COM_AXIS dri _CNV_A_R_LINEAR_____0_CM 9 0. 255. FORMAT "%3.0" AXIS_PTS_REF ldpm_gear /end AXIS_DESCR
/end CHARACTERISTIC
/begin CHARACTERISTIC id_fac_n_max_p_at__gear "ES: P-control parameter AT" CURVE 0x84896a _REC_CUR_20_u1_u1 7.968 _CNV_A_R_LINEAR_____387_CM 0. 7.968 DISPLAY_IDENTIFIER ID_FAC_N_MAX_P_AT__GEAR FORMAT "%4.3"
 /begin AXIS_DESCR COM_AXIS dri _CNV_A_R_LINEAR_____0_CM 9 0. 255. FORMAT "%3.0" AXIS_PTS_REF ldpm_gear /end AXIS_DESCR
/end CHARACTERISTIC
/begin CHARACTERISTIC id_fac_n_max_p_mt__gear "ES: P-control parameter MT" CURVE 0x848973 _REC_CUR_20_u1_u1 7.968 _CNV_A_R_LINEAR_____387_CM 0. 7.968 DISPLAY_IDENTIFIER ID_FAC_N_MAX_P_MT__GEAR FORMAT "%4.3"
 /begin AXIS_DESCR COM_AXIS dri _CNV_A_R_LINEAR_____0_CM 9 0. 255. FORMAT "%3.0" AXIS_PTS_REF ldpm_gear /end AXIS_DESCR
/end CHARACTERISTIC
/begin CHARACTERISTIC id_t_n_max_pred_at__gear "ES: prediction time for AT" CURVE 0x848f0c _REC_CUR_20_u1_u1 7.968 _CNV_A_R_LINEAR_____388_CM 0. 7.968 DISPLAY_IDENTIFIER ID_T_N_MAX_PRED_AT__GEAR FORMAT "%6.5"
 /begin AXIS_DESCR COM_AXIS dri _CNV_A_R_LINEAR_____0_CM 9 0. 255. FORMAT "%3.0" AXIS_PTS_REF ldpm_gear /end AXIS_DESCR
/end CHARACTERISTIC
/begin CHARACTERISTIC id_t_n_max_pred_mt__gear "ES: prediction time for MT" CURVE 0x848f15 _REC_CUR_20_u1_u1 7.968 _CNV_A_R_LINEAR_____389_CM 0. 7.968 DISPLAY_IDENTIFIER ID_T_N_MAX_PRED_MT__GEAR FORMAT "%6.5"
 /begin AXIS_DESCR COM_AXIS dri _CNV_A_R_LINEAR_____0_CM 9 0. 255. FORMAT "%3.0" AXIS_PTS_REF ldpm_gear /end AXIS_DESCR
/end CHARACTERISTIC
/begin CHARACTERISTIC ip_n_grd_thd__n_32 "ES: gradient threshold for filter" CURVE 0x8554c6 _REC_CUR_20_u1_u1 8160. _CNV_A_R_LINEAR_____390_CM -4096. 4064. DISPLAY_IDENTIFIER IP_N_GRD_THD__N_32 FORMAT "%5.0"
 /begin AXIS_DESCR COM_AXIS n_32 _CNV_A_R_LINEAR_____35_CM 6 0. 8160. FORMAT "%4.0" AXIS_PTS_REF ldp_n_32_n_grd_thd /end AXIS_DESCR
/end CHARACTERISTIC
/begin MEASUREMENT tq_n_max_dif_i.sbyte[0] "" SBYTE _CNV_A_R_LINEAR_____0_CM 1 0. -128. 127. DISPLAY_IDENTIFIER TQ_N_MAX_DIF_I_SBYTE_0_ ECU_ADDRESS 0x7fb00c /end MEASUREMENT
/begin MEASUREMENT tq_n_max_dif_i.sbyte[1] "" SBYTE _CNV_A_R_LINEAR_____0_CM 1 0. -128. 127. DISPLAY_IDENTIFIER TQ_N_MAX_DIF_I_SBYTE_1_ ECU_ADDRESS 0x7fb00d /end MEASUREMENT
/begin MEASUREMENT tq_n_max_dif_i.sbyte[2] "" SBYTE _CNV_A_R_LINEAR_____0_CM 1 0. -128. 127. DISPLAY_IDENTIFIER TQ_N_MAX_DIF_I_SBYTE_2_ ECU_ADDRESS 0x7fb00e /end MEASUREMENT
/begin MEASUREMENT tq_n_max_dif_i.sbyte[3] "" SBYTE _CNV_A_R_LINEAR_____0_CM 1 0. -128. 127. DISPLAY_IDENTIFIER TQ_N_MAX_DIF_I_SBYTE_3_ ECU_ADDRESS 0x7fb00f /end MEASUREMENT
/begin MEASUREMENT tq_n_max_dif_i.sword[0] "" SWORD _CNV_A_R_LINEAR_____0_CM 1 0. -32768. 32767. DISPLAY_IDENTIFIER TQ_N_MAX_DIF_I_SWORD_0_ ECU_ADDRESS 0x7fb00c BYTE_ORDER MSB_LAST /end MEASUREMENT
/begin MEASUREMENT tq_n_max_dif_i.sword[1] "" SWORD _CNV_A_R_LINEAR_____0_CM 1 0. -32768. 32767. DISPLAY_IDENTIFIER TQ_N_MAX_DIF_I_SWORD_1_ ECU_ADDRESS 0x7fb00e BYTE_ORDER MSB_LAST /end MEASUREMENT
/begin MEASUREMENT tq_n_max_dif_i.slongword "" SLONG _CNV_A_R_LINEAR_____391_CM 1 0. -1024. 1023.96875 DISPLAY_IDENTIFIER TQ_N_MAX_DIF_I_SLONGWORD ECU_ADDRESS 0x7fb00c BYTE_ORDER MSB_LAST FORMAT "%12.7" /end MEASUREMENT
/begin MEASUREMENT teg_tur_up "Exhaust gas temperature before turbine regulation" UWORD _CNV_A_R_LINEAR_____153_CM 1 0. 0. 1023.984375 DISPLAY_IDENTIFIER TEG_TUR_UP ECU_ADDRESS 0x7fa0cc BYTE_ORDER MSB_LAST FORMAT "%6.2" /end MEASUREMENT
/begin CHARACTERISTIC c_teg_tur_up_sub_diag "Exhaust gas temperature before turbine substitute value" VALUE 0x85c15e _REC_VAL_20_u2 1024. _CNV_A_R_LINEAR_____56_CM 0. 1024. DISPLAY_IDENTIFIER C_TEG_TUR_UP_SUB_DIAG FORMAT "%6.2" /end CHARACTERISTIC
/begin MEASUREMENT teg_tur_up_mes "measured exhaust gas temperature before turbine" UWORD _CNV_A_R_LINEAR_____56_CM 1 0. 0. 1024. DISPLAY_IDENTIFIER TEG_TUR_UP_MES ECU_ADDRESS 0x7fa0ce BYTE_ORDER MSB_LAST FORMAT "%6.2" /end MEASUREMENT
/begin MEASUREMENT v_teg_tur_up "v_teg_tur_up" UWORD _CNV_A_R_LINEAR_____358_CM 1 0. 0. 5. DISPLAY_IDENTIFIER V_TEG_TUR_UP ECU_ADDRESS 0x7fa0d0 BYTE_ORDER MSB_LAST FORMAT "%4.3" /end MEASUREMENT
/begin CHARACTERISTIC ip_teg_tur_up_mes "TEGPC: TEG_TUR_UP sensor map" CURVE 0x85ab7c _REC_CUR_20_u2_u2 1024. _CNV_A_R_LINEAR_____56_CM 0. 1024. DISPLAY_IDENTIFIER IP_TEG_TUR_UP_MES FORMAT "%6.2"
 /begin AXIS_DESCR COM_AXIS v_teg_tur_up _CNV_A_R_LINEAR_____358_CM 16 0. 5. FORMAT "%4.3" AXIS_PTS_REF ldp_v_teg_tur_up_ip_teg_tur_up /end AXIS_DESCR
/end CHARACTERISTIC
/begin AXIS_PTS ldp_v_teg_tur_up_ip_teg_tur_up "" 0x84333e v_teg_tur_up _REC_AXS_20_u2 5. _CNV_A_R_LINEAR_____358_CM 16 0. 5. FORMAT "%4.3" /end AXIS_PTS
/begin MEASUREMENT sf_conf_inj "Injection configuration region" UBYTE _CNV_A_R_LINEAR_____0_CM 1 0. 0. 4. DISPLAY_IDENTIFIER SF_CONF_INJ ECU_ADDRESS 0x7fb4c9 FORMAT "%1.0" /end MEASUREMENT
/begin MEASUREMENT sf_conf_inj_rgn_1 "Injection configuration region during regeneration 1" UBYTE _CNV_A_R_LINEAR_____0_CM 1 0. 0. 4. DISPLAY_IDENTIFIER SF_CONF_INJ_RGN_1 ECU_ADDRESS 0x7fb4ca FORMAT "%1.0" /end MEASUREMENT
/begin MEASUREMENT sf_conf_inj_rgn_2 "Injection configuration region during regeneration 2" UBYTE _CNV_A_R_LINEAR_____0_CM 1 0. 0. 4. DISPLAY_IDENTIFIER SF_CONF_INJ_RGN_2 ECU_ADDRESS 0x7fb4cb FORMAT "%1.0" /end MEASUREMENT
/begin CHARACTERISTIC id_conf_inj "ACMB_MNG: Injection Region" CURVE 0x8488f8 _REC_CUR_20_u1_u1 4. _CNV_A_R_LINEAR_____0_CM 0. 4. DISPLAY_IDENTIFIER ID_CONF_INJ FORMAT "%1.0"
 /begin AXIS_DESCR COM_AXIS act_inj_coded _CNV_A_R_LINEAR_____0_CM 16 0. 15. FORMAT "%2.0" AXIS_PTS_REF ldpm_sf_conf_inj /end AXIS_DESCR
/end CHARACTERISTIC
/begin CHARACTERISTIC id_conf_inj_rgn_1 "ACMB_MNG: Injection Region for Regeneration 1" CURVE 0x848918 _REC_CUR_20_u1_u1 4. _CNV_A_R_LINEAR_____0_CM 0. 4. DISPLAY_IDENTIFIER ID_CONF_INJ_RGN_1 FORMAT "%1.0"
 /begin AXIS_DESCR COM_AXIS act_inj_coded _CNV_A_R_LINEAR_____0_CM 16 0. 15. FORMAT "%2.0" AXIS_PTS_REF ldpm_sf_conf_inj /end AXIS_DESCR
/end CHARACTERISTIC
/begin CHARACTERISTIC id_conf_inj_rgn_2 "ACMB_MNG: Injection Region for Regeneration 2" CURVE 0x848928 _REC_CUR_20_u1_u1 4. _CNV_A_R_LINEAR_____0_CM 0. 4. DISPLAY_IDENTIFIER ID_CONF_INJ_RGN_2 FORMAT "%1.0"
 /begin AXIS_DESCR COM_AXIS act_inj_coded _CNV_A_R_LINEAR_____0_CM 16 0. 15. FORMAT "%2.0" AXIS_PTS_REF ldpm_sf_conf_inj /end AXIS_DESCR
/end CHARACTERISTIC
/begin AXIS_PTS ldpm_sf_conf_inj "Injection Region" 0x843e5a act_inj_coded _REC_AXS_20_u1 15. _CNV_A_R_LINEAR_____0_CM 16 0. 15. FORMAT "%2.0" /end AXIS_PTS
/begin MEASUREMENT act_inj_coded "Injection Region" UBYTE _CNV_A_R_LINEAR_____0_CM 1 0. 0. 15. DISPLAY_IDENTIFIER ACT_INJ_CODED ECU_ADDRESS 0x7fba79 FORMAT "%3.0" /end MEASUREMENT
/begin MEASUREMENT tgas "Air Temperature (ambiant or intake manifold)" UBYTE _CNV_A_R_LINEAR_____18_CM 1 0. -50. 205. DISPLAY_IDENTIFIER TGAS ECU_ADDRESS 0x7fb4cc FORMAT "%3.0" /end MEASUREMENT
/begin CHARACTERISTIC lc_ena_tia "LC_ENA_TIA : switch between TIA and TBA enable flag" VALUE 0x85c323 _REC_VAL_20_u1 1. _CNV_A_R_LINEAR_____0_CM 0. 1. DISPLAY_IDENTIFIER LC_ENA_TIA FORMAT "%1.0" /end CHARACTERISTIC
/begin MEASUREMENT lv_ena_clc_mf_main1 "Flag to enable the calculation of MF_MAIN1" UBYTE _CNV_S_2_RANGE______11_CM 1 0. 0. 1. DISPLAY_IDENTIFIER LV_ENA_CLC_MF_MAIN1 ECU_ADDRESS 0x7fb4cd /end MEASUREMENT
/begin CHARACTERISTIC lc_ena_clc_mf_main1 "Enable flag to calculate MF_MAIN1" VALUE 0x85c322 _REC_VAL_20_u1 1. _CNV_A_R_LINEAR_____0_CM 0. 1. DISPLAY_IDENTIFIER LC_ENA_CLC_MF_MAIN1 FORMAT "%1.0" /end CHARACTERISTIC
/begin MEASUREMENT ang_bpa[0] "valve opening" SWORD _CNV_A_R_LINEAR_____12_CM 1 0. -100. 99.996948242 DISPLAY_IDENTIFIER ANG_BPA_0_ ECU_ADDRESS 0x7fa0b8 BYTE_ORDER MSB_LAST FORMAT "%5.3" /end MEASUREMENT
/begin MEASUREMENT v_bpa[0] "boost pressure actuator position ( j=0..NC_BPA_NR-1 )" UWORD _CNV_A_R_LINEAR_____33_CM 1 0. 0. 4.9951171875 DISPLAY_IDENTIFIER V_BPA_0_ ECU_ADDRESS 0x7fa0ba BYTE_ORDER MSB_LAST FORMAT "%4.3" /end MEASUREMENT
/begin MEASUREMENT v_bpa_mes[0] "measured boost pressure actuator position ( j=0..NC_BPA_NR-1 )" UWORD _CNV_A_R_LINEAR_____33_CM 1 0. 0. 4.9951171875 DISPLAY_IDENTIFIER V_BPA_MES_0_ ECU_ADDRESS 0x7fa0bc BYTE_ORDER MSB_LAST FORMAT "%4.3" /end MEASUREMENT
/begin CHARACTERISTIC lc_v_bpa_bol_man[0] "" VALUE 0x85c37a _REC_VAL_20_u1 1. _CNV_A_R_LINEAR_____0_CM 0. 1. DISPLAY_IDENTIFIER LC_V_BPA_BOL_MAN_0_ FORMAT "%1.0" /end CHARACTERISTIC
/begin CHARACTERISTIC c_v_bpa_bol_man[0] "" VALUE 0x85c1e8 _REC_VAL_20_u2 319.995172 _CNV_A_R_LINEAR_____412_CM 0. 319.995172 DISPLAY_IDENTIFIER C_V_BPA_BOL_MAN_0_ /end CHARACTERISTIC
/begin CHARACTERISTIC c_ang_bpa_tol[0] "" VALUE 0x85bcd0 _REC_VAL_20_s2 399.99389 _CNV_A_R_LINEAR_____399_CM -200. 199.99389 DISPLAY_IDENTIFIER C_ANG_BPA_TOL_0_ /end CHARACTERISTIC
/begin CHARACTERISTIC c_ang_bpa_bol[0] "" VALUE 0x85bcce _REC_VAL_20_s2 399.99389 _CNV_A_R_LINEAR_____399_CM -200. 199.99389 DISPLAY_IDENTIFIER C_ANG_BPA_BOL_0_ /end CHARACTERISTIC
/begin CHARACTERISTIC lc_v_bpa_dif_bol_tol_man[0] "" VALUE 0x85c37c _REC_VAL_20_u1 1. _CNV_A_R_LINEAR_____0_CM 0. 1. DISPLAY_IDENTIFIER LC_V_BPA_DIF_BOL_TOL_MAN_0_ FORMAT "%1.0" /end CHARACTERISTIC
/begin CHARACTERISTIC c_v_bpa_dif_bol_tol_man[0] "" VALUE 0x85c1ec _REC_VAL_20_u2 319.995172 _CNV_A_R_LINEAR_____412_CM 0. 319.995172 DISPLAY_IDENTIFIER C_V_BPA_DIF_BOL_TOL_MAN_0_ /end CHARACTERISTIC
/begin CHARACTERISTIC c_v_bpa_sub_diag "BPA position substitute value" VALUE 0x85c1fa _REC_VAL_20_u2 4.9951171875 _CNV_A_R_LINEAR_____33_CM 0. 4.9951171875 DISPLAY_IDENTIFIER C_V_BPA_SUB_DIAG FORMAT "%4.3" /end CHARACTERISTIC
/begin MEASUREMENT ang_egrv[0] "valve opening" SWORD _CNV_A_R_LINEAR_____12_CM 1 0. -100. 99.996948242 DISPLAY_IDENTIFIER ANG_EGRV_0_ ECU_ADDRESS 0x7fa0b2 BYTE_ORDER MSB_LAST FORMAT "%5.3" /end MEASUREMENT
/begin MEASUREMENT v_egrv[0] "EGR valve position for valve j ( j=0..NC_EGRV_NR-1 )" UWORD _CNV_A_R_LINEAR_____33_CM 1 0. 0. 4.9951171875 DISPLAY_IDENTIFIER V_EGRV_0_ ECU_ADDRESS 0x7fa0b4 BYTE_ORDER MSB_LAST FORMAT "%4.3" /end MEASUREMENT
/begin MEASUREMENT v_egrv_mes[0] "measured EGR valve position for valve j ( j=0..NC_EGRV_NR-1 )" UWORD _CNV_A_R_LINEAR_____33_CM 1 0. 0. 4.9951171875 DISPLAY_IDENTIFIER V_EGRV_MES_0_ ECU_ADDRESS 0x7fa0b6 BYTE_ORDER MSB_LAST FORMAT "%4.3" /end MEASUREMENT
/begin CHARACTERISTIC lc_v_egrv_bol_man[0] "" VALUE 0x85c37e _REC_VAL_20_u1 1. _CNV_A_R_LINEAR_____0_CM 0. 1. DISPLAY_IDENTIFIER LC_V_EGRV_BOL_MAN_0_ FORMAT "%1.0" /end CHARACTERISTIC
/begin CHARACTERISTIC c_v_egrv_bol_man[0] "" VALUE 0x85c20e _REC_VAL_20_u2 319.995172 _CNV_A_R_LINEAR_____412_CM 0. 319.995172 DISPLAY_IDENTIFIER C_V_EGRV_BOL_MAN_0_ /end CHARACTERISTIC
/begin CHARACTERISTIC c_v_egrv_dif_bol_tol_man[0] "" VALUE 0x85c212 _REC_VAL_20_u2 319.995172 _CNV_A_R_LINEAR_____412_CM 0. 319.995172 DISPLAY_IDENTIFIER C_V_EGRV_DIF_BOL_TOL_MAN_0_ /end CHARACTERISTIC
/begin CHARACTERISTIC lc_v_egrv_dif_bol_tol_man[0] "" VALUE 0x85c380 _REC_VAL_20_u1 1. _CNV_A_R_LINEAR_____0_CM 0. 1. DISPLAY_IDENTIFIER LC_V_EGRV_DIF_BOL_TOL_MAN_0_ FORMAT "%1.0" /end CHARACTERISTIC
/begin CHARACTERISTIC c_ang_egrv_tol[0] "" VALUE 0x85bcd4 _REC_VAL_20_s2 399.99389 _CNV_A_R_LINEAR_____399_CM -200. 199.99389 DISPLAY_IDENTIFIER C_ANG_EGRV_TOL_0_ /end CHARACTERISTIC
/begin CHARACTERISTIC c_ang_egrv_bol[0] "" VALUE 0x85bcd2 _REC_VAL_20_s2 399.99389 _CNV_A_R_LINEAR_____399_CM -200. 199.99389 DISPLAY_IDENTIFIER C_ANG_EGRV_BOL_0_ /end CHARACTERISTIC
/begin CHARACTERISTIC c_v_egrv_sub_diag "EGRV position substitute value" VALUE 0x85c226 _REC_VAL_20_u2 4.9951171875 _CNV_A_R_LINEAR_____33_CM 0. 4.9951171875 DISPLAY_IDENTIFIER C_V_EGRV_SUB_DIAG FORMAT "%4.3" /end CHARACTERISTIC
/begin MEASUREMENT ang_thr[0] "actual position of the throttle (j = 0..NC_EGRV_NR-1)" SWORD _CNV_A_R_LINEAR_____155_CM 1 0. -100. 99.9969482421875 DISPLAY_IDENTIFIER ANG_THR_0_ ECU_ADDRESS 0x7fa0be BYTE_ORDER MSB_LAST FORMAT "%5.3" /end MEASUREMENT
/begin MEASUREMENT v_thr[0] "throttle position j ( j=0..NC_THR_NR-1 )" UWORD _CNV_A_R_LINEAR_____33_CM 1 0. 0. 4.9951171875 DISPLAY_IDENTIFIER V_THR_0_ ECU_ADDRESS 0x7fa0c0 BYTE_ORDER MSB_LAST FORMAT "%4.3" /end MEASUREMENT
/begin MEASUREMENT v_thr_mes[0] "measured throttle position j ( j=0..NC_THR_NR-1 )" UWORD _CNV_A_R_LINEAR_____33_CM 1 0. 0. 4.9951171875 DISPLAY_IDENTIFIER V_THR_MES_0_ ECU_ADDRESS 0x7fa0c2 BYTE_ORDER MSB_LAST FORMAT "%4.3" /end MEASUREMENT
/begin MEASUREMENT ang_grd_thr_fil[0] "gradient of the actual position of the throttle (j = 0..NC_EGRV_NR-1)" SWORD _CNV_A_R_LINEAR_____425_CM 1 0. -32768. 32767. DISPLAY_IDENTIFIER ANG_GRD_THR_FIL_0_ ECU_ADDRESS 0x7fa0c4 BYTE_ORDER MSB_LAST FORMAT "%5.0" /end MEASUREMENT
/begin MEASUREMENT ang_thr_fil[0] "actual position of the throttle, PT1 filtered (j = 0..NC_THR_NR-1)" SWORD _CNV_A_R_LINEAR_____155_CM 1 0. -100. 99.9969482421875 DISPLAY_IDENTIFIER ANG_THR_FIL_0_ ECU_ADDRESS 0x7fa0c6 BYTE_ORDER MSB_LAST FORMAT "%5.3" /end MEASUREMENT
/begin MEASUREMENT ang_thr_fil_dif[0] "difference between the unfiltered and filtered actual position" SWORD _CNV_A_R_LINEAR_____155_CM 1 0. -100. 99.9969482421875 DISPLAY_IDENTIFIER ANG_THR_FIL_DIF_0_ ECU_ADDRESS 0x7fa0c8 BYTE_ORDER MSB_LAST FORMAT "%5.3" /end MEASUREMENT
/begin CHARACTERISTIC c_v_thr_bol_man[0] "" VALUE 0x84874a _REC_VAL_20_u2 319.995172 _CNV_A_R_LINEAR_____412_CM 0. 319.995172 DISPLAY_IDENTIFIER C_V_THR_BOL_MAN_0_ /end CHARACTERISTIC
/begin CHARACTERISTIC lc_v_thr_dif_bol_tol_man[0] "" VALUE 0x8487eb _REC_VAL_20_u1 1. _CNV_A_R_LINEAR_____0_CM 0. 1. DISPLAY_IDENTIFIER LC_V_THR_DIF_BOL_TOL_MAN_0_ FORMAT "%1.0" /end CHARACTERISTIC
/begin CHARACTERISTIC lc_v_thr_bol_man[0] "" VALUE 0x8487ea _REC_VAL_20_u1 1. _CNV_A_R_LINEAR_____0_CM 0. 1. DISPLAY_IDENTIFIER LC_V_THR_BOL_MAN_0_ FORMAT "%1.0" /end CHARACTERISTIC
/begin CHARACTERISTIC c_ang_thr_bol[0] "" VALUE 0x848300 _REC_VAL_20_s2 399.99389 _CNV_A_R_LINEAR_____399_CM -200. 199.99389 DISPLAY_IDENTIFIER C_ANG_THR_BOL_0_ /end CHARACTERISTIC
/begin CHARACTERISTIC c_ang_thr_tol[0] "" VALUE 0x848302 _REC_VAL_20_s2 399.99389 _CNV_A_R_LINEAR_____399_CM -200. 199.99389 DISPLAY_IDENTIFIER C_ANG_THR_TOL_0_ /end CHARACTERISTIC
/begin CHARACTERISTIC c_v_thr_dif_bol_tol_man[0] "" VALUE 0x84874c _REC_VAL_20_u2 319.995172 _CNV_A_R_LINEAR_____412_CM 0. 319.995172 DISPLAY_IDENTIFIER C_V_THR_DIF_BOL_TOL_MAN_0_ /end CHARACTERISTIC
/begin CHARACTERISTIC c_v_thr_sub_diag "THR position substitute value" VALUE 0x84874e _REC_VAL_20_u2 4.9951171875 _CNV_A_R_LINEAR_____33_CM 0. 4.9951171875 DISPLAY_IDENTIFIER C_V_THR_SUB_DIAG FORMAT "%4.3" /end CHARACTERISTIC
/begin CHARACTERISTIC ip_t_lpf_ang_thr_fil "THRAQ: Time constant of the low-pass filter for ANG_THR_FIL_j" CURVE 0x847840 _REC_CUR_20_u2_u2 65.535 _CNV_A_R_LINEAR_____76_CM 0. 65.535 DISPLAY_IDENTIFIER IP_T_LPF_ANG_THR_FIL FORMAT "%5.3"
 /begin AXIS_DESCR COM_AXIS ang_thr_fil_dif[0] _CNV_A_R_LINEAR_____158_CM 9 -100. 99.99694820000001 FORMAT "%5.3" AXIS_PTS_REF ldp_ang_thr_fil_dif_ip_t_lpf /end AXIS_DESCR
/end CHARACTERISTIC
/begin AXIS_PTS ldp_ang_thr_fil_dif_ip_t_lpf "" 0x84139e ang_thr_fil_dif[0] _REC_AXS_20_u2 199.9969482 _CNV_A_R_LINEAR_____158_CM 9 -100. 99.99694820000001 FORMAT "%5.3" /end AXIS_PTS
/begin MEASUREMENT tqi_lim_dmf "Torque limitation for DMF protection" SWORD _CNV_A_R_LINEAR_____62_CM 1 0. -1024. 1023.96875 DISPLAY_IDENTIFIER TQI_LIM_DMF ECU_ADDRESS 0x7fa042 BYTE_ORDER MSB_LAST FORMAT "%6.2" /end MEASUREMENT
/begin MEASUREMENT lv_dly_ctr_ena_dmf "Delay counter enabled" UBYTE _CNV_S_2_RANGE______11_CM 1 0. 0. 1. DISPLAY_IDENTIFIER LV_DLY_CTR_ENA_DMF ECU_ADDRESS 0x7fbb58 /end MEASUREMENT
/begin MEASUREMENT lv_dly_n_thd_dmf_act "2nd engine speed theshold for DMF protection during start active" UBYTE _CNV_S_2_RANGE______11_CM 1 0. 0. 1. DISPLAY_IDENTIFIER LV_DLY_N_THD_DMF_ACT ECU_ADDRESS 0x7fbb59 /end MEASUREMENT
/begin MEASUREMENT lv_trig_chk_n_thd_dmf "1st engine speed theshold for DMF protection during start active" UBYTE _CNV_S_2_RANGE______11_CM 1 0. 0. 1. DISPLAY_IDENTIFIER LV_TRIG_CHK_N_THD_DMF ECU_ADDRESS 0x7fbb5a /end MEASUREMENT
/begin MEASUREMENT lv_dmf_fcut "Fuel cut off in progress" UBYTE _CNV_S_2_RANGE______11_CM 1 0. 0. 1. DISPLAY_IDENTIFIER LV_DMF_FCUT ECU_ADDRESS 0x7fbb5b /end MEASUREMENT
/begin MEASUREMENT lv_dmf_fcut_byp "Fuel cut off conditions present" UBYTE _CNV_S_2_RANGE______11_CM 1 0. 0. 1. DISPLAY_IDENTIFIER LV_DMF_FCUT_BYP ECU_ADDRESS 0x7fbb5c /end MEASUREMENT
/begin MEASUREMENT t_fcut_dmf_prot "Fuel cut-off time for DMF protection" UWORD _CNV_A_R_LINEAR_____59_CM 1 0. 0. 10.23 DISPLAY_IDENTIFIER T_FCUT_DMF_PROT ECU_ADDRESS 0x7fb020 BYTE_ORDER MSB_LAST FORMAT "%4.2" /end MEASUREMENT
/begin CHARACTERISTIC c_t_off_dmf "Time for fuel cut off during normal engine state" VALUE 0x848690 _REC_VAL_20_u2 10.23 _CNV_A_R_LINEAR_____59_CM 0. 10.23 DISPLAY_IDENTIFIER C_T_OFF_DMF FORMAT "%4.2" /end CHARACTERISTIC
/begin CHARACTERISTIC c_t_off_dmf_st "Time for fuel cut off during start" VALUE 0x848692 _REC_VAL_20_u2 10.23 _CNV_A_R_LINEAR_____59_CM 0. 10.23 DISPLAY_IDENTIFIER C_T_OFF_DMF_ST FORMAT "%4.2" /end CHARACTERISTIC
/begin CHARACTERISTIC c_n_thd_dmf_syn "Engine speed theshold for DMF protection with synchronised engine" VALUE 0x84851e _REC_VAL_20_u2 8160. _CNV_A_R_LINEAR_____5_CM 0. 8160. DISPLAY_IDENTIFIER C_N_THD_DMF_SYN FORMAT "%4.0" /end CHARACTERISTIC
/begin CHARACTERISTIC c_n_thd_dmf_not_syn "Engine speed threshold for DMF protection with not synchonised engine" VALUE 0x84851a _REC_VAL_20_u2 8160. _CNV_A_R_LINEAR_____5_CM 0. 8160. DISPLAY_IDENTIFIER C_N_THD_DMF_NOT_SYN FORMAT "%4.0" /end CHARACTERISTIC
/begin CHARACTERISTIC c_vb_fil_min_gra_dmf "Minimum positive gradient of battery voltage for detection of disconnected starter" VALUE 0x848774 _REC_VAL_20_u2 28.8 _CNV_A_R_LINEAR_____48_CM 0. 28.8 DISPLAY_IDENTIFIER C_VB_FIL_MIN_GRA_DMF FORMAT "%4.2" /end CHARACTERISTIC
/begin CHARACTERISTIC c_vb_fil_min_dmf "Minimum battery voltage for detection of disconnected starter" VALUE 0x848772 _REC_VAL_20_u2 28.8 _CNV_A_R_LINEAR_____48_CM 0. 28.8 DISPLAY_IDENTIFIER C_VB_FIL_MIN_DMF FORMAT "%4.2" /end CHARACTERISTIC
/begin CHARACTERISTIC c_n_thd_dmf_prot_act "Engine speed threshold for activation of DMF protection" VALUE 0x84851c _REC_VAL_20_u2 8160. _CNV_A_R_LINEAR_____5_CM 0. 8160. DISPLAY_IDENTIFIER C_N_THD_DMF_PROT_ACT FORMAT "%4.0" /end CHARACTERISTIC
/begin CHARACTERISTIC c_t_dly_st_dmf "Delay-time for activation of 2nd engine speed threshold for DMF-protection during start" VALUE 0x848632 _REC_VAL_20_u2 10.23 _CNV_A_R_LINEAR_____59_CM 0. 10.23 DISPLAY_IDENTIFIER C_T_DLY_ST_DMF FORMAT "%4.2" /end CHARACTERISTIC
/begin CHARACTERISTIC ip_n_thd_st_dmf "DMFPROT: Engine speed threshold for DMF protection during start" CURVE 0x847350 _REC_CUR_20_u2_u1 8160. _CNV_A_R_LINEAR_____5_CM 0. 8160. DISPLAY_IDENTIFIER IP_N_THD_ST_DMF FORMAT "%4.0"
 /begin AXIS_DESCR COM_AXIS tco _CNV_A_R_LINEAR_____18_CM 6 -50. 205. FORMAT "%3.0" AXIS_PTS_REF ldpm_tco_1_dmf_prot /end AXIS_DESCR
/end CHARACTERISTIC
/begin AXIS_PTS ldpm_tco_1_dmf_prot "" 0x843e7e tco _REC_AXS_20_u1 255. _CNV_A_R_LINEAR_____18_CM 6 -50. 205. FORMAT "%3.0" /end AXIS_PTS
/begin CHARACTERISTIC ip_n_thd_st_post_dly_dmf "DMFPROT: Engine speed theshold for DMF protection during start (after delay)" CURVE 0x84735c _REC_CUR_20_u2_u1 8160. _CNV_A_R_LINEAR_____5_CM 0. 8160. DISPLAY_IDENTIFIER IP_N_THD_ST_POST_DLY_DMF FORMAT "%4.0"
 /begin AXIS_DESCR COM_AXIS tco _CNV_A_R_LINEAR_____18_CM 6 -50. 205. FORMAT "%3.0" AXIS_PTS_REF ldpm_tco_1_dmf_prot /end AXIS_DESCR
/end CHARACTERISTIC
/begin MEASUREMENT lv_aeb "active engine bracket hard/soft" UBYTE _CNV_S_2_RANGE______11_CM 1 0. 0. 1. DISPLAY_IDENTIFIER LV_AEB ECU_ADDRESS 0x7fb72e /end MEASUREMENT
/begin MEASUREMENT aeb_act "Control of Active Engine Brackets" UBYTE _CNV_A_R_LINEAR_____34_CM 1 0. 0. 0.99609375 DISPLAY_IDENTIFIER AEB_ACT ECU_ADDRESS 0x7fbb60 FORMAT "%4.3" /end MEASUREMENT
/begin CHARACTERISTIC c_aeb_hys_up "upper value for hysteresis" VALUE 0x8482fb _REC_VAL_20_u1 0.99609375 _CNV_A_R_LINEAR_____34_CM 0. 0.99609375 DISPLAY_IDENTIFIER C_AEB_HYS_UP FORMAT "%4.3" /end CHARACTERISTIC
/begin CHARACTERISTIC c_aeb_hys_down "under value for hysteresis" VALUE 0x8482fa _REC_VAL_20_u1 0.99609375 _CNV_A_R_LINEAR_____34_CM 0. 0.99609375 DISPLAY_IDENTIFIER C_AEB_HYS_DOWN FORMAT "%4.3" /end CHARACTERISTIC
/begin CHARACTERISTIC ip_aeb_act__n__tqi_sp "SUPP_AEB: map for control of Active Engine Brackets" MAP 0x845474 _REC_MAP_20_u1_u2_u2 0.99609375 _CNV_A_R_LINEAR_____34_CM 0. 0.99609375 DISPLAY_IDENTIFIER IP_AEB_ACT__N__TQI_SP FORMAT "%4.3"
 /begin AXIS_DESCR COM_AXIS n _CNV_A_R_LINEAR_____5_CM 5 0. 8160. FORMAT "%4.0" AXIS_PTS_REF ldpm_n_ip_aeb_act /end AXIS_DESCR
 /begin AXIS_DESCR COM_AXIS tqi_sp _CNV_A_R_LINEAR_____340_CM 5 -1024. 1023.97 FORMAT "%6.2" AXIS_PTS_REF ldpm_tqi_sp_ip_aeb_act /end AXIS_DESCR
/end CHARACTERISTIC
/begin AXIS_PTS ldpm_n_ip_aeb_act "" 0x8438f4 n _REC_AXS_20_u2 8160. _CNV_A_R_LINEAR_____5_CM 5 0. 8160. FORMAT "%4.0" /end AXIS_PTS
/begin AXIS_PTS ldpm_tqi_sp_ip_aeb_act "" 0x844410 tqi_sp _REC_AXS_20_u2 2047.97 _CNV_A_R_LINEAR_____340_CM 5 -1024. 1023.97 FORMAT "%6.2" /end AXIS_PTS
/begin COMPU_METHOD _CNV_A_R_LINEAR_____0_CM "" RAT_FUNC "%6.3" "[-]" COEFFS 0 1. 0. 0 0 1 /end COMPU_METHOD
/begin COMPU_METHOD _CNV_A_R_LINEAR_____1_CM "" RAT_FUNC "%6.3" "-" COEFFS 0 1. 0. 0 0 1 /end COMPU_METHOD
/begin COMPU_METHOD _CNV_S_2_RANGE______3_CM "" TAB_VERB "%6.3" "[-]" COMPU_TAB_REF _CNV_S_2_RANGE______3 /end COMPU_METHOD
/begin COMPU_VTAB _CNV_S_2_RANGE______3 "" TAB_VERB 2 0 "" 1 "1" /end COMPU_VTAB
/begin COMPU_METHOD _CNV_A_R_LINEAR_____5_CM "" RAT_FUNC "%6.3" "[rpm]" COEFFS 0 1. 0. 0 0 1 /end COMPU_METHOD
/begin COMPU_METHOD _CNV_A_R_LINEAR_____8_CM "" RAT_FUNC "%6.3" "[%]" COEFFS 0 655.3599999999997 0. 0 0 1 /end COMPU_METHOD
/begin COMPU_METHOD _CNV_S_2_RANGE______11_CM "" TAB_VERB "%6.3" "[-]" COMPU_TAB_REF _CNV_S_2_RANGE______11 /end COMPU_METHOD
/begin COMPU_VTAB _CNV_S_2_RANGE______11 "" TAB_VERB 2 0 "0" 1 "1" /end COMPU_VTAB
/begin COMPU_METHOD _CNV_A_R_LINEAR_____12_CM "" RAT_FUNC "%6.3" "[%]" COEFFS 0 327.6800000003072 3.071909304708242e-008 0 0 1 /end COMPU_METHOD
/begin COMPU_METHOD _CNV_A_R_LINEAR_____14_CM "" RAT_FUNC "%6.3" "[-]" COEFFS 0 65535.99999999996 0. 0 0 1 /end COMPU_METHOD
/begin COMPU_METHOD _CNV_A_R_LINEAR_____16_CM "" RAT_FUNC "%6.3" "[s]" COEFFS 0 1. 0. 0 0 1 /end COMPU_METHOD
/begin COMPU_METHOD _CNV_A_R_LINEAR_____18_CM "" RAT_FUNC "%6.3" "[°C]" COEFFS 0 1. 50. 0 0 1 /end COMPU_METHOD
/begin COMPU_METHOD _CNV_A_R_LINEAR_____19_CM "" RAT_FUNC "%6.3" "[s]" COEFFS 0 10. 0. 0 0 1 /end COMPU_METHOD
/begin COMPU_METHOD _CNV_A_R_LINEAR_____20_CM "" RAT_FUNC "%6.3" "[°C]" COEFFS 0 1. 0. 0 0 1 /end COMPU_METHOD
/begin COMPU_METHOD _CNV_A_R_LINEAR_____21_CM "" RAT_FUNC "%6.3" "[hPa]" COEFFS 0 12.06017666543982 0. 0 0 1 /end COMPU_METHOD
/begin COMPU_METHOD _CNV_A_R_LINEAR_____25_CM "" RAT_FUNC "%6.3" "[-]" COEFFS 0 255. 0. 0 0 1 /end COMPU_METHOD
/begin COMPU_METHOD _CNV_S_2_RANGE______28_CM "" TAB_VERB "%6.3" "[-]" COMPU_TAB_REF _CNV_S_2_RANGE______28 /end COMPU_METHOD
/begin COMPU_VTAB _CNV_S_2_RANGE______28 "" TAB_VERB 2 0 "passive" 1 "active" /end COMPU_VTAB
/begin COMPU_METHOD _CNV_A_R_LINEAR_____33_CM "" RAT_FUNC "%6.3" "[V]" COEFFS 0 204.8 0. 0 0 1 /end COMPU_METHOD
/begin COMPU_METHOD _CNV_A_R_LINEAR_____34_CM "" RAT_FUNC "%6.3" "[-]" COEFFS 0 256. 0. 0 0 1 /end COMPU_METHOD
/begin COMPU_METHOD _CNV_A_R_LINEAR_____35_CM "" RAT_FUNC "%6.3" "[1/min]" COEFFS 0 3.125e-002 0. 0 0 1 /end COMPU_METHOD
/begin COMPU_METHOD _CNV_A_R_LINEAR_____39_CM "" RAT_FUNC "%6.3" "[km/h]" COEFFS 0 1. 0. 0 0 1 /end COMPU_METHOD
/begin COMPU_METHOD _CNV_A_R_LINEAR_____42_CM "" RAT_FUNC "%6.3" "[%]" COEFFS 0 2.550102004080163 0. 0 0 1 /end COMPU_METHOD
/begin COMPU_METHOD _CNV_A_R_LINEAR_____43_CM "" RAT_FUNC "%6.3" "[mg/stk]" COEFFS 0 250. 0. 0 0 1 /end COMPU_METHOD
/begin COMPU_METHOD _CNV_A_R_LINEAR_____44_CM "" RAT_FUNC "%6.3" "[%]" COEFFS 0 2.55 0. 0 0 1 /end COMPU_METHOD
/begin COMPU_METHOD _CNV_S_6_Glow_State_45_CM "" TAB_VERB "%6.3" "[-]" COMPU_TAB_REF _CNV_S_6_Glow_State_45 /end COMPU_METHOD
/begin COMPU_VTAB _CNV_S_6_Glow_State_45 "" TAB_VERB 6 0 "SF_GL_ES" 1 "SF_GL_ST_REDY" 2 "SF_GL_ST" 3 "SF_GL_AST" 4 "SF_GL_PUC" 255 "DONT GLOW" /end COMPU_VTAB
/begin COMPU_METHOD _CNV_S_5_Glow_Mode_46_CM "" TAB_VERB "%6.3" "[-]" COMPU_TAB_REF _CNV_S_5_Glow_Mode_46 /end COMPU_METHOD
/begin COMPU_VTAB _CNV_S_5_Glow_Mode_46 "" TAB_VERB 5 1 "PRE START MODE ON" 2 "START MODE ON" 3 "POST START MODE ON" 4 "INTERMEDIATE MODE ON" 255 "DONT GLOW" /end COMPU_VTAB
/begin COMPU_METHOD _CNV_A_R_LINEAR_____47_CM "" RAT_FUNC "%6.3" "[rpm]" COEFFS 0 0.9990386864987011 -0.4921925126650422 0 0 1 /end COMPU_METHOD
/begin COMPU_METHOD _CNV_A_R_LINEAR_____48_CM "" RAT_FUNC "%6.3" "[V]" COEFFS 0 8.854166666666666 0. 0 0 1 /end COMPU_METHOD
/begin COMPU_METHOD _CNV_A_R_LINEAR_____49_CM "" RAT_FUNC "%6.3" "[s]" COEFFS 0 8.854166666666666 0. 0 0 1 /end COMPU_METHOD
/begin COMPU_METHOD _CNV_A_R_LINEAR_____56_CM "" RAT_FUNC "%6.3" "[°C]" COEFFS 0 63.9990234375 0. 0 0 1 /end COMPU_METHOD
/begin COMPU_METHOD _CNV_A_R_LINEAR_____59_CM "" RAT_FUNC "%6.3" "[s]" COEFFS 0 100. 0. 0 0 1 /end COMPU_METHOD
/begin COMPU_METHOD _CNV_A_R_LINEAR_____62_CM "" RAT_FUNC "%6.3" "[Nm]" COEFFS 0 32. 0. 0 0 1 /end COMPU_METHOD
/begin COMPU_METHOD _CNV_A_R_LINEAR_____64_CM "" RAT_FUNC "%6.3" "[s]" COEFFS 0 31250. 0. 0 0 1 /end COMPU_METHOD
/begin COMPU_METHOD _CNV_A_R_LINEAR_____65_CM "" RAT_FUNC "%6.3" "[s]" COEFFS 0 999984.7412109375 0. 0 0 1 /end COMPU_METHOD
/begin COMPU_METHOD _CNV_A_R_LINEAR_____66_CM "" RAT_FUNC "%6.3" "[s]" COEFFS 0 250000. 0. 0 0 1 /end COMPU_METHOD
/begin COMPU_METHOD _CNV_A_R_LINEAR_____67_CM "" RAT_FUNC "%6.3" "[s]" COEFFS 0 15625. 0. 0 0 1 /end COMPU_METHOD
/begin COMPU_METHOD _CNV_A_R_LINEAR_____68_CM "" RAT_FUNC "%6.3" "°C" COEFFS 0 1. 40. 0 0 1 /end COMPU_METHOD
/begin COMPU_METHOD _CNV_A_R_LINEAR_____69_CM "" RAT_FUNC "%6.3" "[rpm/10ms]" COEFFS 0 511.9921875 0. 0 0 1 /end COMPU_METHOD
/begin COMPU_METHOD _CNV_A_R_LINEAR_____70_CM "" RAT_FUNC "%6.3" "[km/h/rpm]" COEFFS 0 65535.82575140447 0. 0 0 1 /end COMPU_METHOD
/begin COMPU_METHOD _CNV_A_R_LINEAR_____76_CM "" RAT_FUNC "%6.3" "[s]" COEFFS 0 1000. 0. 0 0 1 /end COMPU_METHOD
/begin COMPU_METHOD _CNV_S_2_RANGE__0___88_CM "" TAB_VERB "%6.3" "-" COMPU_TAB_REF _CNV_S_2_RANGE__0___88 /end COMPU_METHOD
/begin COMPU_VTAB _CNV_S_2_RANGE__0___88 "" TAB_VERB 2 0 "0" 1 "1" /end COMPU_VTAB
/begin COMPU_METHOD _CNV_A_R_LINEAR_____90_CM "" RAT_FUNC "%6.3" "[-]" COEFFS 0 65535.82575140447 0. 0 0 1 /end COMPU_METHOD
/begin COMPU_METHOD _CNV_A_R_LINEAR_____96_CM "" RAT_FUNC "%6.3" "[ms]" COEFFS 0 0.1 0. 0 0 1 /end COMPU_METHOD
/begin COMPU_METHOD _CNV_A_R_LINEAR_____109_CM "" RAT_FUNC "%6.3" "[V]" COEFFS 0 204.7999999487896 -2.556795379859977e-007 0 0 1 /end COMPU_METHOD
/begin COMPU_METHOD _CNV_A_R_LINEAR_____118_CM "" RAT_FUNC "%6.3" "[hPa/V]" COEFFS 0 7.548844614199462 0. 0 0 1 /end COMPU_METHOD
/begin COMPU_METHOD _CNV_A_R_LINEAR_____122_CM "" RAT_FUNC "%6.3" "[uF]" COEFFS 0 7.976539589442815 0. 0 0 1 /end COMPU_METHOD
/begin COMPU_METHOD _CNV_A_R_LINEAR_____123_CM "" RAT_FUNC "%6.3" "[V]" COEFFS 0 4.011764705882353 0. 0 0 1 /end COMPU_METHOD
/begin COMPU_METHOD _CNV_A_R_LINEAR_____124_CM "" RAT_FUNC "%6.3" "[uAs]" COEFFS 0 16. 0. 0 0 1 /end COMPU_METHOD
/begin COMPU_METHOD _CNV_A_R_LINEAR_____125_CM "" RAT_FUNC "%6.3" "[V]" COEFFS 0 6553.600246000245 0. 0 0 1 /end COMPU_METHOD
/begin COMPU_METHOD _CNV_A_R_LINEAR_____126_CM "" RAT_FUNC "%6.3" "[uAs/V]" COEFFS 0 64.06158357771261 0. 0 0 1 /end COMPU_METHOD
/begin COMPU_METHOD _CNV_A_R_LINEAR_____127_CM "" RAT_FUNC "%6.3" "[uAs/VV]" COEFFS 0 204.796875 0. 0 0 1 /end COMPU_METHOD
/begin COMPU_METHOD _CNV_A_R_LINEAR_____128_CM "" RAT_FUNC "%6.3" "V" COEFFS 0 4.011764705882353 0. 0 0 1 /end COMPU_METHOD
/begin COMPU_METHOD _CNV_A_R_A_129_CM "" RAT_FUNC "%6.3" "[A]" COEFFS 0 1. 0. 0 0 1 /end COMPU_METHOD
/begin COMPU_METHOD _CNV_A_R_LINEAR_____130_CM "" RAT_FUNC "%6.3" "[-]" COEFFS 0 655.35 0. 0 0 1 /end COMPU_METHOD
/begin COMPU_METHOD _CNV_A_R_LINEAR_____131_CM "" RAT_FUNC "%6.3" "[A/V]" COEFFS 0 6553.5 0. 0 0 1 /end COMPU_METHOD
/begin COMPU_METHOD _CNV_A_R_LINEAR_____132_CM "" RAT_FUNC "%6.3" "[-]" COEFFS 0 204.6 0. 0 0 1 /end COMPU_METHOD
/begin COMPU_METHOD _CNV_A_R_LINEAR_____136_CM "" RAT_FUNC "%6.3" "[%]" COEFFS 0 655.35 0. 0 0 1 /end COMPU_METHOD
/begin COMPU_METHOD _CNV_A_R_LINEAR_____153_CM "" RAT_FUNC "%6.3" "[°C]" COEFFS 0 64. 0. 0 0 1 /end COMPU_METHOD
/begin COMPU_METHOD _CNV_A_R_LINEAR_____155_CM "" RAT_FUNC "%6.3" "[%]" COEFFS 0 327.68 0. 0 0 1 /end COMPU_METHOD
/begin COMPU_METHOD _CNV_A_R_LINEAR_____158_CM "" RAT_FUNC "%6.3" "[%]" COEFFS 0 327.680000069121 32768.0000069121 0 0 1 /end COMPU_METHOD
/begin COMPU_METHOD _CNV_A_R_LINEAR_____206_CM "" RAT_FUNC "%6.3" "[kPa]" COEFFS 0 8.225806451612903e-002 0. 0 0 1 /end COMPU_METHOD
/begin COMPU_METHOD _CNV_A_R_LINEAR_____223_CM "" RAT_FUNC "%6.3" "s" COEFFS 0 100. 0. 0 0 1 /end COMPU_METHOD
/begin COMPU_METHOD _CNV_A_R_LINEAR_____234_CM "" RAT_FUNC "%6.3" "s" COEFFS 0 10. 0. 0 0 1 /end COMPU_METHOD
/begin COMPU_METHOD _CNV_A_R_LINEAR_____235_CM "" RAT_FUNC "%6.3" "[\260C]" COEFFS 0 1.333333333333333 64. 0 0 1 /end COMPU_METHOD
/begin COMPU_METHOD _CNV_A_R_LINEAR_____239_CM "" RAT_FUNC "%6.3" "km/h" COEFFS 0 1. 0. 0 0 1 /end COMPU_METHOD
/begin COMPU_METHOD _CNV_A_R_LINEAR_____257_CM "" RAT_FUNC "%6.3" "rpm" COEFFS 0 1. 0. 0 0 1 /end COMPU_METHOD
/begin COMPU_METHOD _CNV_A_R_LINEAR_____261_CM "" RAT_FUNC "%6.3" "[%]" COEFFS 0 10.24024024024024 0. 0 0 1 /end COMPU_METHOD
/begin COMPU_METHOD _CNV_A_R_LINEAR_____262_CM "" RAT_FUNC "%6.3" "[%]" COEFFS 0 1. 0. 0 0 1 /end COMPU_METHOD
/begin COMPU_METHOD _CNV_A_R_LINEAR_____299_CM "" RAT_FUNC "%6.3" "-" COEFFS 0 32. 0. 0 0 1 /end COMPU_METHOD
/begin COMPU_METHOD _CNV_S_4_Engine_Sta_339_CM "" TAB_VERB "%6.3" "[-]" COMPU_TAB_REF _CNV_S_4_Engine_Sta_339 /end COMPU_METHOD
/begin COMPU_VTAB _CNV_S_4_Engine_Sta_339 "" TAB_VERB 4 1 "ES" 2 "ST" 4 "IS" 8 "PL" /end COMPU_VTAB
/begin COMPU_METHOD _CNV_A_R_LINEAR_____340_CM "" RAT_FUNC "%6.3" "[Nm]" COEFFS 0 31.99998046846389 32767.97999970703 0 0 1 /end COMPU_METHOD
/begin COMPU_METHOD _CNV_A_R_LINEAR_____358_CM "" RAT_FUNC "%6.3" "[V]" COEFFS 0 204.6 0. 0 0 1 /end COMPU_METHOD
/begin COMPU_METHOD _CNV_A_R_LINEAR_____383_CM "" RAT_FUNC "%6.3" "[1/min]" COEFFS 0 1. 0. 0 0 1 /end COMPU_METHOD
/begin COMPU_METHOD _CNV_A_R_LINEAR_____384_CM "" RAT_FUNC "%6.3" "[(1/min)/s]" COEFFS 0 3.125e-002 0. 0 0 1 /end COMPU_METHOD
/begin COMPU_METHOD _CNV_A_R_LINEAR_____385_CM "" RAT_FUNC "%6.3" "[Nm]" COEFFS 0 8191.999999679995 -1.280019205296412e-006 0 0 1 /end COMPU_METHOD
/begin COMPU_METHOD _CNV_A_R_LINEAR_____386_CM "" RAT_FUNC "%6.3" "[Nm(1/min)]" COEFFS 0 8192. 0. 0 0 1 /end COMPU_METHOD
/begin COMPU_METHOD _CNV_A_R_LINEAR_____387_CM "" RAT_FUNC "%6.3" "[Nm(1/min)]" COEFFS 0 32.00301204819277 0. 0 0 1 /end COMPU_METHOD
/begin COMPU_METHOD _CNV_A_R_LINEAR_____388_CM "" RAT_FUNC "%6.3" "[rpm]" COEFFS 0 32.00301204819277 0. 0 0 1 /end COMPU_METHOD
/begin COMPU_METHOD _CNV_A_R_LINEAR_____389_CM "" RAT_FUNC "%6.3" "[s]" COEFFS 0 32.00301204819277 0. 0 0 1 /end COMPU_METHOD
/begin COMPU_METHOD _CNV_A_R_LINEAR_____390_CM "" RAT_FUNC "%6.3" "[(1/min)/s]" COEFFS 0 3.125e-002 128. 0 0 1 /end COMPU_METHOD
/begin COMPU_METHOD _CNV_A_R_LINEAR_____391_CM "" RAT_FUNC "%6.3" "[Nm]" COEFFS 0 2097184. 32768. 0 0 1 /end COMPU_METHOD
/begin COMPU_METHOD _CNV_A_R_LINEAR_____399_CM "" RAT_FUNC "%6.3" "[%]" COEFFS 0 163.8400026560406 5.312081193551421e-004 0 0 1 /end COMPU_METHOD
/begin COMPU_METHOD _CNV_A_R_LINEAR_____412_CM "" RAT_FUNC "%6.3" "[V]" COEFFS 0 204.7999649194707 0. 0 0 1 /end COMPU_METHOD
/begin COMPU_METHOD _CNV_A_R_LINEAR_____425_CM "" RAT_FUNC "%6.3" "[%/s]" COEFFS 0 1. 0. 0 0 1 /end COMPU_METHOD
/begin RECORD_LAYOUT _REC_VAL_20_u1 FNC_VALUES 1 UBYTE COLUMN_DIR DIRECT /end RECORD_LAYOUT
/begin RECORD_LAYOUT _REC_AXS_20_u2 NO_AXIS_PTS_X 1 UWORD AXIS_PTS_X 2 UWORD INDEX_INCR DIRECT /end RECORD_LAYOUT
/begin RECORD_LAYOUT _REC_MAP_20_u1_u2_u2 FNC_VALUES 1 UBYTE COLUMN_DIR DIRECT /end RECORD_LAYOUT
/begin RECORD_LAYOUT _REC_VAL_20_u2 FNC_VALUES 1 UWORD COLUMN_DIR DIRECT /end RECORD_LAYOUT
/begin RECORD_LAYOUT _REC_VAL_20_s2 FNC_VALUES 1 SWORD COLUMN_DIR DIRECT /end RECORD_LAYOUT
/begin RECORD_LAYOUT _REC_AXS_20_u1 NO_AXIS_PTS_X 1 UBYTE AXIS_PTS_X 2 UBYTE INDEX_INCR DIRECT /end RECORD_LAYOUT
/begin RECORD_LAYOUT _REC_CUR_20_u2_u2 FNC_VALUES 1 UWORD COLUMN_DIR DIRECT /end RECORD_LAYOUT
/begin RECORD_LAYOUT _REC_CUR_20_u2_u1 FNC_VALUES 1 UWORD COLUMN_DIR DIRECT /end RECORD_LAYOUT
/begin RECORD_LAYOUT _REC_MAP_20_u2_u1_u1 FNC_VALUES 1 UWORD COLUMN_DIR DIRECT /end RECORD_LAYOUT
/begin RECORD_LAYOUT _REC_MAP_20_u2_u2_u1 FNC_VALUES 1 UWORD COLUMN_DIR DIRECT /end RECORD_LAYOUT
/begin RECORD_LAYOUT _REC_CUR_20_u1_u1 FNC_VALUES 1 UBYTE COLUMN_DIR DIRECT /end RECORD_LAYOUT
/begin RECORD_LAYOUT _REC_MAP_20_u2_u1_u2 FNC_VALUES 1 UWORD COLUMN_DIR DIRECT /end RECORD_LAYOUT
/begin RECORD_LAYOUT _REC_VAL_20_u4 FNC_VALUES 1 ULONG COLUMN_DIR DIRECT /end RECORD_LAYOUT
/begin RECORD_LAYOUT _REC_VAL_20_s1 FNC_VALUES 1 SBYTE COLUMN_DIR DIRECT /end RECORD_LAYOUT
/begin FUNCTION VAR_APPSCLC ""
 /begin DEF_CHARACTERISTIC c_fac_cha_cal_0 c_fac_cha_cal_1 c_v_cha_cal1 c_v_cha_cal0 c_fac_v_inj_burst_0 c_fac_cur_inj_burst_0 c_ofs_v_inj_burst_0 c_ofs_cur_inj_burst_0 c_fac_v_inj_burst_1 c_fac_cur_inj_burst_1 c_ofs_v_inj_burst_1 c_ofs_cur_inj_burst_1 c_burst_inj_mode c_burst_mes_soi_eoi /end DEF_CHARACTERISTIC
 /begin OUT_MEASUREMENT capa_inj_seq1_[0] capa_inj_seq1_[1] capa_inj_seq1_[2] capa_inj_seq1_[3] capa_inj_seq1 v_inj_beg_main1_[0] v_inj_beg_main1_[1] v_inj_beg_main1_[2] v_inj_beg_main1_[3] v_inj_beg_main1 v_inj_beg_prev1 q_inj_seq1_[0] q_inj_seq1_[1] q_inj_seq1_[2] q_inj_seq1_[3] q_inj_seq1 v_ofs_cha_cal_0 fac_slop_cha_cal_0 v_inj_beg_prev1_[0] v_inj_beg_prev1_[1] v_inj_beg_prev1_[2] v_inj_beg_prev1_[3] v_inj_burst_soi_[0] v_inj_burst_soi_[1] v_inj_burst_soi_[2] v_inj_burst_soi_[3] v_inj_burst_soi_[4] v_inj_burst_soi_[5] v_inj_burst_soi_[6] v_inj_burst_soi_[7] v_inj_burst_soi_[8] v_inj_burst_soi_[9] v_inj_burst_soi_[10] v_inj_burst_soi_[11] v_inj_burst_soi_[12] v_inj_burst_soi_[13] v_inj_burst_soi_[14] v_inj_burst_soi_[15] v_inj_burst_soi_[16] v_inj_burst_soi_[17] v_inj_burst_soi_[18] v_inj_burst_soi_[19] v_inj_burst_soi_[20] v_inj_burst_soi_[21] v_inj_burst_soi_[22] v_inj_burst_soi_[23] v_inj_burst_soi_[24] v_inj_burst_soi_[25] v_inj_burst_soi_[26] v_inj_burst_soi_[27] v_inj_burst_soi_[28] v_inj_burst_soi_[29] v_inj_burst_soi_[30] v_inj_burst_soi_[31] v_inj_burst_soi_[32] v_inj_burst_soi_[33] v_inj_burst_soi_[34] v_inj_burst_soi_[35] v_inj_burst_soi_[36] v_inj_burst_soi_[37] v_inj_burst_soi_[38] v_inj_burst_soi_[39] v_inj_burst_eoi_[0] v_inj_burst_eoi_[1] v_inj_burst_eoi_[2] v_inj_burst_eoi_[3] v_inj_burst_eoi_[4] v_inj_burst_eoi_[5] v_inj_burst_eoi_[6] v_inj_burst_eoi_[7] v_inj_burst_eoi_[8] v_inj_burst_eoi_[9] v_inj_burst_eoi_[10] v_inj_burst_eoi_[11] v_inj_burst_eoi_[12] v_inj_burst_eoi_[13] v_inj_burst_eoi_[14] v_inj_burst_eoi_[15] v_inj_burst_eoi_[16] v_inj_burst_eoi_[17] v_inj_burst_eoi_[18] v_inj_burst_eoi_[19] v_inj_burst_eoi_[20] v_inj_burst_eoi_[21] v_inj_burst_eoi_[22] v_inj_burst_eoi_[23] v_inj_burst_eoi_[24] v_inj_burst_eoi_[25] v_inj_burst_eoi_[26] v_inj_burst_eoi_[27] v_inj_burst_eoi_[28] v_inj_burst_eoi_[29] v_inj_burst_eoi_[30] v_inj_burst_eoi_[31] v_inj_burst_eoi_[32] v_inj_burst_eoi_[33] v_inj_burst_eoi_[34] v_inj_burst_eoi_[35] v_inj_burst_eoi_[36] v_inj_burst_eoi_[37] v_inj_burst_eoi_[38] v_inj_burst_eoi_[39] q_inj_burst_soi_[0] q_inj_burst_soi_[1] q_inj_burst_soi_[2] q_inj_burst_soi_[3] q_inj_burst_soi_[4] q_inj_burst_soi_[5] q_inj_burst_soi_[6] q_inj_burst_soi_[7] q_inj_burst_soi_[8] q_inj_burst_soi_[9] q_inj_burst_soi_[10] q_inj_burst_soi_[11] q_inj_burst_soi_[12] q_inj_burst_soi_[13] q_inj_burst_soi_[14] q_inj_burst_soi_[15] q_inj_burst_soi_[16] q_inj_burst_soi_[17] q_inj_burst_soi_[18] q_inj_burst_soi_[19] cur_inj_burst_[0] lf_burst_prev1_act lf_burst_main1_act lf_burst_norm_act lf_pps_mes_vld v_cha_cal0 v_cha_cal1 q_inj_beg_prev1_[0] q_inj_beg_prev1_[1] q_inj_beg_prev1_[2] q_inj_beg_prev1_[3] q_inj_beg_prev1 q_inj_beg_main1_[0] q_inj_beg_main1_[1] q_inj_beg_main1_[2] q_inj_beg_main1_[3] q_inj_beg_main1 v_inj_frze_prev1_[0] v_inj_frze_prev1_[1] v_inj_frze_prev1_[2] v_inj_frze_prev1_[3] v_inj_toze_prev1_[0] v_inj_toze_prev1_[1] v_inj_toze_prev1_[2] v_inj_toze_prev1_[3] v_inj_frze_main1_[0] v_inj_frze_main1_[1] v_inj_frze_main1_[2] v_inj_frze_main1_[3] v_inj_toze_main1_[0] v_inj_toze_main1_[1] v_inj_toze_main1_[2] v_inj_toze_main1_[3] /end OUT_MEASUREMENT
/end FUNCTION
/begin FUNCTION SYS_VAR_AALT "Generator load signal acquisition" /begin DEF_CHARACTERISTIC c_fac_altpwm_ducy_alter_pwm c_altpwm_sub /end DEF_CHARACTERISTIC /begin OUT_MEASUREMENT altpwm /end OUT_MEASUREMENT /end FUNCTION
/begin FUNCTION SYS_VAR_BPAAQ "Acquisition of the BPA- position"
 /begin DEF_CHARACTERISTIC lc_v_bpa_bol_man[0] c_v_bpa_bol_man[0] c_ang_bpa_tol[0] c_ang_bpa_bol[0] lc_v_bpa_dif_bol_tol_man[0] c_v_bpa_dif_bol_tol_man[0] c_v_bpa_sub_diag /end DEF_CHARACTERISTIC
 /begin OUT_MEASUREMENT ang_bpa[0] v_bpa[0] v_bpa_mes[0] /end OUT_MEASUREMENT
/end FUNCTION
/begin FUNCTION SYS_VAR_EGRVAQ "Acquisition of the EGR- valve position"
 /begin DEF_CHARACTERISTIC lc_v_egrv_bol_man[0] c_v_egrv_bol_man[0] c_v_egrv_dif_bol_tol_man[0] lc_v_egrv_dif_bol_tol_man[0] c_ang_egrv_tol[0] c_ang_egrv_bol[0] c_v_egrv_sub_diag /end DEF_CHARACTERISTIC
 /begin OUT_MEASUREMENT ang_egrv[0] v_egrv[0] v_egrv_mes[0] /end OUT_MEASUREMENT
/end FUNCTION
/begin FUNCTION SYS_VAR_THRAQ "Acquisition of the THR- position"
 /begin DEF_CHARACTERISTIC c_v_thr_bol_man[0] lc_v_thr_dif_bol_tol_man[0] lc_v_thr_bol_man[0] c_ang_thr_bol[0] c_ang_thr_tol[0] c_v_thr_dif_bol_tol_man[0] c_v_thr_sub_diag ip_t_lpf_ang_thr_fil ldp_ang_thr_fil_dif_ip_t_lpf /end DEF_CHARACTERISTIC
 /begin OUT_MEASUREMENT ang_thr[0] v_thr[0] v_thr_mes[0] ang_grd_thr_fil[0] ang_thr_fil[0] ang_thr_fil_dif[0] /end OUT_MEASUREMENT
/end FUNCTION
/begin FUNCTION SYS_VAR_AN ""
 /begin OUT_MEASUREMENT n_pred t_mmv t_seg_mis tab_t_seg[0] tab_t_seg[1] tab_t_seg[2] tab_t_seg[3] t_seg_clc_red_tab[0] t_seg_clc_red_tab[1] t_seg_clc_red_tab[2] t_seg_clc_red_tab[3] t_seg_clc_red_tab[4] t_seg_4 t_seg_clc_red cyl_nr ptr_seg_clc /end OUT_MEASUREMENT
/end FUNCTION
/begin FUNCTION SYS_VAR_AN_IS_SP "IS SP Calculation"
 /begin DEF_CHARACTERISTIC lc_n_sp_is_tcu_ena c_n_sp_is_dn_cvt c_lih_n_sp_is c_n_sp_is_max c_n_sp_is_ofs c_t_dly_n_sp lc_is_ub_ena lc_is_ac_ena lc_is_ramp_ub_req lc_is_ramp_vecu_1_req lc_is_bem_1_ena lc_is_bem_2_ena lc_is_ramp_vecu_2_req lc_is_ramp_ac_req lc_is_vecu_1_ena lc_is_vecu_2_ena c_n_ofs_set_is_sp_pf c_state_rgn_pf c_temp_thd_is_sp_pf c_n_ofs_rst_is_sp_pf lc_is_acin lc_is_accin_on lc_is_ac_sw c_hi_tco_thd c_hi_tia_thd c_hi_toil_thd lc_is_hi_ena c_tco_max_vb_n_sp c_n_sp_lgrd_is lc_is_ramp_brake lc_is_ramp_dri lc_is_ramp_dct lc_is_ramp_cs_2 lc_is_ramp_vs_n lc_is_ramp_man c_is_vs_n_thd lc_is_2st id_n_sp_min_is__vb_fil ldp_vb_fil_n_sp_min_is ip_n_sp_is_cvt_vs ldp_vs_n_sp_is_cvt_vs ip_n_inc_is_sp_pf ldp_tco_ip_n_inc_is_sp_pf ip_n_sp_acin_dri_is__tco ldpm_tco_ip_n_sp_is ip_n_sp_acin_is_at__tco ip_n_sp_acin_is_mt__tco ip_n_sp_is_max_vecu_1_tco ip_n_sp_is_max_vecu_2_tco ip_n_sp_is_hi ldp_toil_n_sp_is_hi /end DEF_CHARACTERISTIC
 /begin OUT_MEASUREMENT n_sp_is_cor_max n_sp_is lv_n_sp_is_max_1 lv_n_sp_is_max_2 n_sp_is_cor n_sp_is_cvt n_sp_is_lim n_sp_is_pf_rgn lv_tpc_thd_is_sp_pf lv_pf_rgn_is_act lv_n_sp_is_inc_pf_set lv_n_sp_is_inc_pf_rst lv_is_ac lv_n_sp_is_driv lv_n_sp_is_eng lv_n_sp_is_ext lv_n_sp_is_ext_2 n_sp_is_ac lv_is_bsg n_sp_is_bsg n_sp_is_cor_driv n_sp_is_eng lv_is_ramp n_sp_is_ext n_sp_is_ext_2 n_sp_is_ext_2_ramp n_sp_is_ext_req n_sp_is_ramp n_sp_is_ramp_tar n_sp_is_vb lv_is_ramp_act n_sp_is_vecu_2 lv_is_ramp_ena lv_is_ramp_req lv_is_ub lv_n_sp_is_ramp_max /end OUT_MEASUREMENT
/end FUNCTION
/begin FUNCTION SYS_VAR_AN_IS_SP_I "IS SP Calculation (Appl.Inc.)"
 /begin DEF_CHARACTERISTIC id_n_sp_is_mt_dri ldpm_dri_n_sp_is id_n_sp_is_at_dri ip_n_sp_is_at ip_n_sp_is_mt /end DEF_CHARACTERISTIC
 /begin OUT_MEASUREMENT n_sp_is_bas /end OUT_MEASUREMENT
/end FUNCTION
/begin FUNCTION SYS_VAR_ATEGPC ""
 /begin DEF_CHARACTERISTIC c_teg_tur_up_sub_diag ip_teg_tur_up_mes ldp_v_teg_tur_up_ip_teg_tur_up /end DEF_CHARACTERISTIC
 /begin OUT_MEASUREMENT teg_tur_up teg_tur_up_mes v_teg_tur_up /end OUT_MEASUREMENT
/end FUNCTION
/begin FUNCTION VAR_ADIP_PF ""
 /begin DEF_CHARACTERISTIC c_dip_pf_sub_diag c_fac_dip_pf_fil c_v_dip_pf_ofs c_fac_v_dip_pf c_tco_max_dip_pf_ad c_tia_min_dip_pf_ad c_tia_max_dip_pf_ad c_v_dip_pf_ad_max c_v_dip_pf_ad_min /end DEF_CHARACTERISTIC
 /begin OUT_MEASUREMENT v_dip_pf dip_pf_mes v_dip_pf_ad dip_pf dip_pf_mmv dip_pf_temp /end OUT_MEASUREMENT
/end FUNCTION
/begin FUNCTION C_5_EOS "" /begin SUB_FUNCTION EOS_AENGSTAT EOS_ASPL_MOD EOS_AREST /end SUB_FUNCTION /end FUNCTION
/begin FUNCTION EOS_AENGSTAT "Engine States"
 /begin DEF_CHARACTERISTIC ip_n_max_tol_st__tco ldp_tco_ip_n_max_tol_st c_n_max_bol_st c_n_min_bol c_pv_av_min /end DEF_CHARACTERISTIC
 /begin OUT_MEASUREMENT sf_eng_state lv_es lv_st lv_is lv_pl lv_puc lv_st_end t_ast t_apl /end OUT_MEASUREMENT
/end FUNCTION
/begin FUNCTION EOS_ASPL_MOD "Special engine states" /begin DEF_CHARACTERISTIC c_ctr_max_ti_min /end DEF_CHARACTERISTIC /end FUNCTION
/begin FUNCTION EOS_AREST "Auxiliary Start Functions" /begin DEF_CHARACTERISTIC c_t_max_rest c_tco_dif_max_rest /end DEF_CHARACTERISTIC /begin OUT_MEASUREMENT lv_rest tco_rest lv_rest_auth /end OUT_MEASUREMENT /end FUNCTION
/begin FUNCTION C_5_STAT "" /begin SUB_FUNCTION STAT_STST STAT_STSTAI STAT_AENGSSFI STAT_ACMB_MNG /end SUB_FUNCTION /end FUNCTION
/begin FUNCTION STAT_STST ""
 /begin DEF_CHARACTERISTIC c_t_str_n_min c_t_max_n_sub c_cam_1_ctr_max c_t_str_rng c_n_str_min c_t_str_off_max c_n_chk_eng_stop c_vs_str_off ldp_ctr_str_id_t_str_sum_max ip_n_str_off ldp_tco_ip_t_str_act_max id_fac_n_str ip_t_str_act_max c_t_chk_eng_stop c_t_max_vs_str_off lc_kl15_lock ldp_tco_ip_n_str_off ldp_tco_ip_dur_str_nom_str_act ldp_ctr_str_id_fac_n_str ldp_t_ip_dur_str_nom_str_act id_t_str_sum_max ip_dur_str_nom_str_act lc_n_sub lc_str_conf /end DEF_CHARACTERISTIC
 /begin OUT_MEASUREMENT lv_str_1_2_on lv_err_str_2 lv_str_1_2_off ctr_str lv_err_str_1 lv_err_str_1_2 t_str_rng t_str_n_min lv_str_1 lv_kl15_lock t_str_sum t_str_act t_vs_str_off t_chk_eng_stop lv_str_2 lv_n_sub t_str_off t_n_sub lv_sta_rls lv_sta_stop /end OUT_MEASUREMENT
/end FUNCTION
/begin FUNCTION STAT_STSTAI ""
 /begin OUT_MEASUREMENT kl50r kl50 cam_1_ctr lv_st_es lv_str_on lv_str_off lv_auth_eng_rest lv_req_es_driv /end OUT_MEASUREMENT
/end FUNCTION
/begin FUNCTION STAT_AENGSSFI "" /end FUNCTION
/begin FUNCTION STAT_ACMB_MNG ""
 /begin DEF_CHARACTERISTIC id_conf_inj id_conf_inj_rgn_1 id_conf_inj_rgn_2 ldpm_sf_conf_inj lc_ena_tia lc_ena_clc_mf_main1 /end DEF_CHARACTERISTIC
 /begin OUT_MEASUREMENT sf_conf_inj sf_conf_inj_rgn_1 sf_conf_inj_rgn_2 act_inj_coded tgas lv_ena_clc_mf_main1 /end OUT_MEASUREMENT
/end FUNCTION
/begin FUNCTION C_9_SUPP ""
 /begin DEF_CHARACTERISTIC c_t_accin_dly_st c_pv_accin_fl_thd c_n_accin_fl_thd c_t_max_accin_fl c_t_min_accin_fl c_tco_accin_tol c_tco_accin_bol c_acp_high_bol c_acp_high_tol c_acp_low_bol c_acp_low_tol c_t_dly_accin c_t_min_accout_rly /end DEF_CHARACTERISTIC
 /begin OUT_MEASUREMENT lv_acc_ena_fl lv_acc_ena_st lv_acc_ena_sys_err lv_acc_ena_acp lv_accin lv_acc_ena_tco lv_acc_off_cmd lv_acc_driv_req lv_acin_man lv_old_acc_di lv_acin_can_ecu accpwm_b lv_acc_ena t_accin_dly_st t_accin_fl t_dly_accin t_dly_accin_st t_min_accout_rly lv_acc_ena_tcu1 lv_acc_ena_vecu1 lv_acin lv_accout_rly /end OUT_MEASUREMENT
 /begin SUB_FUNCTION AHEAT SUPP_STOP SUPP_AGLOW SUPP_ASTOP SUPP_AN_LIM SUPP_ADMFPROT SUPP_AEB /end SUB_FUNCTION
/end FUNCTION
/begin FUNCTION AHEAT ""
 /begin DEF_CHARACTERISTIC lc_heat_var_temp c_tco_heat_bol c_t_dly_heat_st lc_heat_var_swi lc_heat_off_ac c_vb_heat_bol c_vb_heat_tol c_n_heat_bol c_n_heat_tol c_tia_heat_bol c_tia_heat_tol lc_heat_3_off_ac c_altpwm_heat_tol_dec c_t_dly_heat c_fac_fil_altpwm_heat c_t_dly_n_dec ip_tco_heat_tol__temp ldp_tco_ip_tco_heat_tol ip_altpwm_heat_bol__n ldp_n_ip_altpwm_heat_bol ip_altpwm_heat_tol__n ldp_n_ip_altpwm_heat_tol /end DEF_CHARACTERISTIC
 /begin OUT_MEASUREMENT lv_heat_1 lv_heat_2 lv_heat_3 sf_heat lv_heat_var_temp lv_req_n_sp_is_min_heat temp_tco_heat_tol_act count_act_heat_elems /end OUT_MEASUREMENT
/end FUNCTION
/begin FUNCTION SUPP_STOP "" /end FUNCTION
/begin FUNCTION SUPP_AGLOW ""
 /begin DEF_CHARACTERISTIC ip_t_gl_puc ip_pwm_gl_ast c_tco_sp_gl lc_gll c_tco_cor_gl_max c_tco_cor_gl_min c_t2_gl_es lc_t_gl_es_amp_act c_pwm_gl_st lc_pwm_gl_st c_pwm_gl_es_1 c_pwm_gl_es_2 c_pwm_gl_es_3 c_t_dly_gl_rly c_n_max_gl c_t_gl_st_ready c_tco_max_gl c_t_gl_st c_n_max_gl_ast c_mf_max_gl_ast c_mf_max_gl_ast_ofs c_n_max_gl_ast_ofs c_t_gl_puc_3 c_mf_max_gl_puc c_t_gl_puc_2 c_t_gl_boost c_vb_gl_bol_1 c_vb_gl_tol_1 c_vb_gl_bol_2 c_vb_gl_tol_2 lc_gl_off ip_t_gll ldp_tco_ip_t_gll ip_t_gl_ast ldp_tco_ip_t_gl_ast ip_t1_gl_es ldp_tco_ip_t1_gl_es ldp_tam_ip_t_gl_puc ip_t_gl_es_vb ldp_vb_ip_t_gl_es ldp_tco_ip_t_gl_es ip_t_gl_es_amp ldp_amp_ip_t_gl_es ldp_mf_ip_pwm_gl_ast ldp_n_ip_pwm_gl_ast /end DEF_CHARACTERISTIC
 /begin OUT_MEASUREMENT lv_gll pwm_gl t_gl_es t_gl_ast tco_cor_gl lv_gl_boost sf_gl_state lv_gl_es lv_gl_off tco_cor_gl_ofs lv_gl pwm_gl_ast t_gl_es_act pwm_es lv_t_gl_ast_over gl_mode t_gl_ast_frozen lv_t_gl_es_end lv_t12_end t12_gl_es lv_t_gl_st_ready_end lv_gl_st_ready lv_tco_st_low lv_t_gl_st_end lv_gl_st_on lv_t_dly_gl_rly_ast_end lv_n_hys_gl_ast lv_mf_hys_gl_ast lv_dly_gl_rly_ast_act lv_gl_ast_on lv_t_dly_gl_rly_puc_end lv_dly_gl_rly_puc_act lv_pull_gl_puc lv_pull_end_gl_puc lv_gl_puc_on t_gl_puc lv_gl_off_vb t1_gl_es t3_gl_es t2_gl_es /end OUT_MEASUREMENT
/end FUNCTION
/begin FUNCTION SUPP_ASTOP "Engine Stop Function" /begin DEF_CHARACTERISTIC c_t_req_es_fup c_t_req_es_inj c_t_es_prep /end DEF_CHARACTERISTIC
 /begin OUT_MEASUREMENT lv_es_act lv_es_prep lv_inh_es_diag lv_pwl_lock_es lv_req_es_inj lv_req_es_fup lv_req_es_thr ctr_req_es_fup lv_req_es_fup_act ctr_req_es_inj lv_req_es_inj_act lv_req_es_supp_fct /end OUT_MEASUREMENT
/end FUNCTION
/begin FUNCTION SUPP_AN_LIM "Engine speed limitation"
 /begin DEF_CHARACTERISTIC c_add_n_max_fcut c_crlc_n_grd_fil_1 c_crlc_n_grd_fil_2 c_n_grd_hys c_tqi_max_pas id_fac_n_max_i_at__gear id_fac_n_max_i_mt__gear id_fac_n_max_p_at__gear id_fac_n_max_p_mt__gear id_t_n_max_pred_at__gear id_t_n_max_pred_mt__gear ip_n_grd_thd__n_32 /end DEF_CHARACTERISTIC
 /begin OUT_MEASUREMENT lv_n_max lv_n_max_req_fcut n_dif_max_lim n_grd_fil n_grd_fil_fil n_pred_max_lim tq_n_max_dif tq_n_max_dif_p tq_n_max_inp_i tqi_n_max_1 tqi_n_max_ref tq_n_max_dif_i.sbyte[0] tq_n_max_dif_i.sbyte[1] tq_n_max_dif_i.sbyte[2] tq_n_max_dif_i.sbyte[3] tq_n_max_dif_i.sword[0] tq_n_max_dif_i.sword[1] tq_n_max_dif_i.slongword /end OUT_MEASUREMENT
/end FUNCTION
/begin FUNCTION SUPP_ADMFPROT "Protection of Dual Mass Flywheel"
 /begin DEF_CHARACTERISTIC c_t_off_dmf c_t_off_dmf_st c_n_thd_dmf_syn c_n_thd_dmf_not_syn c_vb_fil_min_gra_dmf c_vb_fil_min_dmf c_n_thd_dmf_prot_act c_t_dly_st_dmf ip_n_thd_st_dmf ldpm_tco_1_dmf_prot ip_n_thd_st_post_dly_dmf /end DEF_CHARACTERISTIC
 /begin OUT_MEASUREMENT tqi_lim_dmf lv_dly_ctr_ena_dmf lv_dly_n_thd_dmf_act lv_trig_chk_n_thd_dmf lv_dmf_fcut lv_dmf_fcut_byp t_fcut_dmf_prot /end OUT_MEASUREMENT
/end FUNCTION
/begin FUNCTION SUPP_AEB "Active Engine Brackets"
 /begin DEF_CHARACTERISTIC c_aeb_hys_up c_aeb_hys_down ip_aeb_act__n__tqi_sp ldpm_n_ip_aeb_act ldpm_tqi_sp_ip_aeb_act /end DEF_CHARACTERISTIC
 /begin OUT_MEASUREMENT lv_aeb aeb_act /end OUT_MEASUREMENT
/end FUNCTION
/begin FUNCTION C_9_AUX ""
 /begin SUB_FUNCTION AUX_ECU_Power_Latch_Manag AUX_Electr_Contr_Water_Pump AUX_Electr_Contr_Thermostat AUX_Electr_Cool_Fans AUX_Eng_Cool_Control AUX_Calc_Lubric_Maint_Interv AUX_Calc_Lubric_Maint_Interv__AI AUX_ECU_Power_Latch_Manag__AI AUX_Fuel_Consumption_Calc /end SUB_FUNCTION
/end FUNCTION
/begin FUNCTION AUX_ECU_Power_Latch_Manag "" /begin DEF_CHARACTERISTIC c_t_min_pwl c_t_max_pwl /end DEF_CHARACTERISTIC /begin OUT_MEASUREMENT pwl_lock_cdn t_pwl lv_pwl_act lv_inh_pwl_tran_es_el /end OUT_MEASUREMENT /end FUNCTION
/begin FUNCTION AUX_Electr_Contr_Water_Pump ""
 /begin DEF_CHARACTERISTIC c_t_ast_min_cwp c_tam_max_cwp_act_eru c_tco_max_cwp_act_eru c_t_ast_max_cwp c_equip_cwp /end DEF_CHARACTERISTIC
 /begin OUT_MEASUREMENT lv_cwp_act lv_cwp_act_eru lv_equip_cwp /end OUT_MEASUREMENT
/end FUNCTION
/end MODULE
/end PROJECT
