ASAP2_VERSION 1 41
/begin PROJECT SN0 "SIMOS PPD"
/begin HEADER "_default_HeaderComment" PROJECT_NO PRJ_NUM /end HEADER
/begin MODULE _default_ModuleName "_default_ModuleLongIdentifier"
/begin MOD_COMMON "_default_ModCommonComment" DEPOSIT ABSOLUTE BYTE_ORDER MSB_FIRST ALIGNMENT_BYTE 1 ALIGNMENT_WORD 2 ALIGNMENT_LONG 4 ALIGNMENT_FLOAT32_IEEE 4 ALIGNMENT_FLOAT64_IEEE 8 /end MOD_COMMON
/begin MEASUREMENT fmy_stat_can_tcs.ctr_abc "anti bounce counter for diagnosis instance CAN_TCS" UBYTE _CNV_A_R_LINEAR_____1_CM 1 0. 0. 255. DISPLAY_IDENTIFIER CTR_ABC_CAN_TCS ECU_ADDRESS 0x7f9a41 FORMAT "%3.0" /end MEASUREMENT
/begin MEASUREMENT fmy_stat_can_tcs.ctr_end_diag "counter for end of diagnosis for diagnosis instance CAN_TCS" UBYTE _CNV_A_R_LINEAR_____1_CM 1 0. 0. 255. DISPLAY_IDENTIFIER CTR_ABC_END_DIAG_CAN_TCS ECU_ADDRESS 0x7f9a40 FORMAT "%3.0" /end MEASUREMENT
/begin MEASUREMENT fmy_stat_can_tcs.err_info_stat.reserved "" UWORD _CNV_A_R_LINEAR_____0_CM 1 0. 0. 65535. DISPLAY_IDENTIFIER FMY_STAT_CAN_TCS_ERR_INFO_STAT_R ECU_ADDRESS 0x7f9a3e BYTE_ORDER MSB_LAST BIT_MASK 0xF800 /end MEASUREMENT
/begin MEASUREMENT fmy_stat_can_tcs.err_info_stat.lv_cdn_diag_stc "Statistical flag for condition of diagnosis of the diagnosis instance CAN_TCS" UWORD _CNV_S_2_RANGE______380_CM 1 0. 0. 1. DISPLAY_IDENTIFIER LV_CDN_DIAG_STC_CAN_TCS ECU_ADDRESS 0x7f9a3e BYTE_ORDER MSB_LAST BIT_MASK 0x400 /end MEASUREMENT
/begin MEASUREMENT fmy_stat_can_tcs.err_info_stat.lv_lock_diag "lock flag (CPU load optimisation) of the diagnosis instance CAN_TCS" UWORD _CNV_S_2_RANGE______380_CM 1 0. 0. 1. DISPLAY_IDENTIFIER LV_LOCK_DIAG_CAN_TCS ECU_ADDRESS 0x7f9a3e BYTE_ORDER MSB_LAST BIT_MASK 0x200 /end MEASUREMENT
/begin MEASUREMENT fmy_stat_can_tcs.err_info_stat.lv_err_mem "storage in dynamic failure memory of the diagnosis instance CAN_TCS" UWORD _CNV_S_2_RANGE______380_CM 1 0. 0. 1. DISPLAY_IDENTIFIER LV_ERR_MEM_CAN_TCS ECU_ADDRESS 0x7f9a3e BYTE_ORDER MSB_LAST BIT_MASK 0x80 /end MEASUREMENT
/begin MEASUREMENT fmy_stat_can_tcs.err_info_stat.lv_ready "readiness status of the diagnosis instance CAN_TCS" UWORD _CNV_S_2_RANGE______380_CM 1 0. 0. 1. DISPLAY_IDENTIFIER LV_READY_CAN_TCS ECU_ADDRESS 0x7f9a3e BYTE_ORDER MSB_LAST BIT_MASK 0x40 /end MEASUREMENT
/begin MEASUREMENT fmy_stat_can_tcs.err_info_stat.lv_end_diag "end of diagnosis of the diagnosis instance CAN_TCS" UWORD _CNV_S_2_RANGE______380_CM 1 0. 0. 1. DISPLAY_IDENTIFIER LV_END_DIAG_CAN_TCS ECU_ADDRESS 0x7f9a3e BYTE_ORDER MSB_LAST BIT_MASK 0x20 /end MEASUREMENT
/begin MEASUREMENT fmy_stat_can_tcs.err_info_stat.lv_cdn_diag "diagnosis condition of the diagnosis instance CAN_TCS" UWORD _CNV_S_2_RANGE______380_CM 1 0. 0. 1. DISPLAY_IDENTIFIER LV_CDN_DIAG_CAN_TCS ECU_ADDRESS 0x7f9a3e BYTE_ORDER MSB_LAST BIT_MASK 0x10 /end MEASUREMENT
/begin MEASUREMENT fmy_stat_can_tcs.err_info_stat.err_sym "symptoms of the diagnosis instance CAN_TCS" UWORD _CNV_S_6_CONV_ERRM__27_CM 1 0. 0. 15. DISPLAY_IDENTIFIER ERR_SYM_CAN_TCS ECU_ADDRESS 0x7f9a3e BYTE_ORDER MSB_LAST BIT_MASK 0xF /end MEASUREMENT
/begin MEASUREMENT fmy_stat_can_tcu.ctr_abc "anti bounce counter for diagnosis instance CAN_TCU" UBYTE _CNV_A_R_LINEAR_____1_CM 1 0. 0. 255. DISPLAY_IDENTIFIER CTR_ABC_CAN_TCU ECU_ADDRESS 0x7f9a45 FORMAT "%3.0" /end MEASUREMENT
/begin MEASUREMENT fmy_stat_can_tcu.ctr_end_diag "counter for end of diagnosis for diagnosis instance CAN_TCU" UBYTE _CNV_A_R_LINEAR_____1_CM 1 0. 0. 255. DISPLAY_IDENTIFIER CTR_ABC_END_DIAG_CAN_TCU ECU_ADDRESS 0x7f9a44 FORMAT "%3.0" /end MEASUREMENT
/begin MEASUREMENT fmy_stat_can_tcu.err_info_stat.reserved "" UWORD _CNV_A_R_LINEAR_____0_CM 1 0. 0. 65535. DISPLAY_IDENTIFIER FMY_STAT_CAN_TCU_ERR_INFO_STAT_R ECU_ADDRESS 0x7f9a42 BYTE_ORDER MSB_LAST BIT_MASK 0xF800 /end MEASUREMENT
/begin MEASUREMENT fmy_stat_can_tcu.err_info_stat.lv_cdn_diag_stc "Statistical flag for condition of diagnosis of the diagnosis instance CAN_TCU" UWORD _CNV_S_2_RANGE______380_CM 1 0. 0. 1. DISPLAY_IDENTIFIER LV_CDN_DIAG_STC_CAN_TCU ECU_ADDRESS 0x7f9a42 BYTE_ORDER MSB_LAST BIT_MASK 0x400 /end MEASUREMENT
/begin MEASUREMENT fmy_stat_can_tcu.err_info_stat.lv_lock_diag "lock flag (CPU load optimisation) of the diagnosis instance CAN_TCU" UWORD _CNV_S_2_RANGE______380_CM 1 0. 0. 1. DISPLAY_IDENTIFIER LV_LOCK_DIAG_CAN_TCU ECU_ADDRESS 0x7f9a42 BYTE_ORDER MSB_LAST BIT_MASK 0x200 /end MEASUREMENT
/begin MEASUREMENT fmy_stat_can_tcu.err_info_stat.lv_err_mem "storage in dynamic failure memory of the diagnosis instance CAN_TCU" UWORD _CNV_S_2_RANGE______380_CM 1 0. 0. 1. DISPLAY_IDENTIFIER LV_ERR_MEM_CAN_TCU ECU_ADDRESS 0x7f9a42 BYTE_ORDER MSB_LAST BIT_MASK 0x80 /end MEASUREMENT
/begin MEASUREMENT fmy_stat_can_tcu.err_info_stat.lv_ready "readiness status of the diagnosis instance CAN_TCU" UWORD _CNV_S_2_RANGE______380_CM 1 0. 0. 1. DISPLAY_IDENTIFIER LV_READY_CAN_TCU ECU_ADDRESS 0x7f9a42 BYTE_ORDER MSB_LAST BIT_MASK 0x40 /end MEASUREMENT
/begin MEASUREMENT fmy_stat_can_tcu.err_info_stat.lv_end_diag "end of diagnosis of the diagnosis instance CAN_TCU" UWORD _CNV_S_2_RANGE______380_CM 1 0. 0. 1. DISPLAY_IDENTIFIER LV_END_DIAG_CAN_TCU ECU_ADDRESS 0x7f9a42 BYTE_ORDER MSB_LAST BIT_MASK 0x20 /end MEASUREMENT
/begin MEASUREMENT fmy_stat_can_tcu.err_info_stat.lv_cdn_diag "diagnosis condition of the diagnosis instance CAN_TCU" UWORD _CNV_S_2_RANGE______380_CM 1 0. 0. 1. DISPLAY_IDENTIFIER LV_CDN_DIAG_CAN_TCU ECU_ADDRESS 0x7f9a42 BYTE_ORDER MSB_LAST BIT_MASK 0x10 /end MEASUREMENT
/begin MEASUREMENT fmy_stat_can_tcu.err_info_stat.err_sym "symptoms of the diagnosis instance CAN_TCU" UWORD _CNV_S_6_CONV_ERRM__27_CM 1 0. 0. 15. DISPLAY_IDENTIFIER ERR_SYM_CAN_TCU ECU_ADDRESS 0x7f9a42 BYTE_ORDER MSB_LAST BIT_MASK 0xF /end MEASUREMENT
/begin MEASUREMENT fmy_stat_can_acu.ctr_abc "anti bounce counter for diagnosis instance CAN_ACU" UBYTE _CNV_A_R_LINEAR_____1_CM 1 0. 0. 255. DISPLAY_IDENTIFIER CTR_ABC_CAN_ACU ECU_ADDRESS 0x7f9a49 FORMAT "%3.0" /end MEASUREMENT
/begin MEASUREMENT fmy_stat_can_acu.ctr_end_diag "counter for end of diagnosis for diagnosis instance CAN_ACU" UBYTE _CNV_A_R_LINEAR_____1_CM 1 0. 0. 255. DISPLAY_IDENTIFIER CTR_ABC_END_DIAG_CAN_ACU ECU_ADDRESS 0x7f9a48 FORMAT "%3.0" /end MEASUREMENT
/begin MEASUREMENT fmy_stat_can_acu.err_info_stat.reserved "" UWORD _CNV_A_R_LINEAR_____0_CM 1 0. 0. 65535. DISPLAY_IDENTIFIER FMY_STAT_CAN_ACU_ERR_INFO_STAT_R ECU_ADDRESS 0x7f9a46 BYTE_ORDER MSB_LAST BIT_MASK 0xF800 /end MEASUREMENT
/begin MEASUREMENT fmy_stat_can_acu.err_info_stat.lv_cdn_diag_stc "Statistical flag for condition of diagnosis of the diagnosis instance CAN_ACU" UWORD _CNV_S_2_RANGE______380_CM 1 0. 0. 1. DISPLAY_IDENTIFIER LV_CDN_DIAG_STC_CAN_ACU ECU_ADDRESS 0x7f9a46 BYTE_ORDER MSB_LAST BIT_MASK 0x400 /end MEASUREMENT
/begin MEASUREMENT fmy_stat_can_acu.err_info_stat.lv_lock_diag "lock flag (CPU load optimisation) of the diagnosis instance CAN_ACU" UWORD _CNV_S_2_RANGE______380_CM 1 0. 0. 1. DISPLAY_IDENTIFIER LV_LOCK_DIAG_CAN_ACU ECU_ADDRESS 0x7f9a46 BYTE_ORDER MSB_LAST BIT_MASK 0x200 /end MEASUREMENT
/begin MEASUREMENT fmy_stat_can_acu.err_info_stat.lv_err_mem "storage in dynamic failure memory of the diagnosis instance CAN_ACU" UWORD _CNV_S_2_RANGE______380_CM 1 0. 0. 1. DISPLAY_IDENTIFIER LV_ERR_MEM_CAN_ACU ECU_ADDRESS 0x7f9a46 BYTE_ORDER MSB_LAST BIT_MASK 0x80 /end MEASUREMENT
/begin MEASUREMENT fmy_stat_can_acu.err_info_stat.lv_ready "readiness status of the diagnosis instance CAN_ACU" UWORD _CNV_S_2_RANGE______380_CM 1 0. 0. 1. DISPLAY_IDENTIFIER LV_READY_CAN_ACU ECU_ADDRESS 0x7f9a46 BYTE_ORDER MSB_LAST BIT_MASK 0x40 /end MEASUREMENT
/begin MEASUREMENT fmy_stat_can_acu.err_info_stat.lv_end_diag "end of diagnosis of the diagnosis instance CAN_ACU" UWORD _CNV_S_2_RANGE______380_CM 1 0. 0. 1. DISPLAY_IDENTIFIER LV_END_DIAG_CAN_ACU ECU_ADDRESS 0x7f9a46 BYTE_ORDER MSB_LAST BIT_MASK 0x20 /end MEASUREMENT
/begin MEASUREMENT fmy_stat_can_acu.err_info_stat.lv_cdn_diag "diagnosis condition of the diagnosis instance CAN_ACU" UWORD _CNV_S_2_RANGE______380_CM 1 0. 0. 1. DISPLAY_IDENTIFIER LV_CDN_DIAG_CAN_ACU ECU_ADDRESS 0x7f9a46 BYTE_ORDER MSB_LAST BIT_MASK 0x10 /end MEASUREMENT
/begin MEASUREMENT fmy_stat_can_acu.err_info_stat.err_sym "symptoms of the diagnosis instance CAN_ACU" UWORD _CNV_S_6_CONV_ERRM__27_CM 1 0. 0. 15. DISPLAY_IDENTIFIER ERR_SYM_CAN_ACU ECU_ADDRESS 0x7f9a46 BYTE_ORDER MSB_LAST BIT_MASK 0xF /end MEASUREMENT
/begin MEASUREMENT fmy_stat_can_ccu.ctr_abc "anti bounce counter for diagnosis instance CAN_CCU" UBYTE _CNV_A_R_LINEAR_____1_CM 1 0. 0. 255. DISPLAY_IDENTIFIER CTR_ABC_CAN_CCU ECU_ADDRESS 0x7f9a4d FORMAT "%3.0" /end MEASUREMENT
/begin MEASUREMENT fmy_stat_can_ccu.ctr_end_diag "counter for end of diagnosis for diagnosis instance CAN_CCU" UBYTE _CNV_A_R_LINEAR_____1_CM 1 0. 0. 255. DISPLAY_IDENTIFIER CTR_ABC_END_DIAG_CAN_CCU ECU_ADDRESS 0x7f9a4c FORMAT "%3.0" /end MEASUREMENT
/begin MEASUREMENT fmy_stat_can_ccu.err_info_stat.reserved "" UWORD _CNV_A_R_LINEAR_____0_CM 1 0. 0. 65535. DISPLAY_IDENTIFIER FMY_STAT_CAN_CCU_ERR_INFO_STAT_R ECU_ADDRESS 0x7f9a4a BYTE_ORDER MSB_LAST BIT_MASK 0xF800 /end MEASUREMENT
/begin MEASUREMENT fmy_stat_can_ccu.err_info_stat.lv_cdn_diag_stc "Statistical flag for condition of diagnosis of the diagnosis instance CAN_CCU" UWORD _CNV_S_2_RANGE______380_CM 1 0. 0. 1. DISPLAY_IDENTIFIER LV_CDN_DIAG_STC_CAN_CCU ECU_ADDRESS 0x7f9a4a BYTE_ORDER MSB_LAST BIT_MASK 0x400 /end MEASUREMENT
/begin MEASUREMENT fmy_stat_can_ccu.err_info_stat.lv_lock_diag "lock flag (CPU load optimisation) of the diagnosis instance CAN_CCU" UWORD _CNV_S_2_RANGE______380_CM 1 0. 0. 1. DISPLAY_IDENTIFIER LV_LOCK_DIAG_CAN_CCU ECU_ADDRESS 0x7f9a4a BYTE_ORDER MSB_LAST BIT_MASK 0x200 /end MEASUREMENT
/begin MEASUREMENT fmy_stat_can_ccu.err_info_stat.lv_err_mem "storage in dynamic failure memory of the diagnosis instance CAN_CCU" UWORD _CNV_S_2_RANGE______380_CM 1 0. 0. 1. DISPLAY_IDENTIFIER LV_ERR_MEM_CAN_CCU ECU_ADDRESS 0x7f9a4a BYTE_ORDER MSB_LAST BIT_MASK 0x80 /end MEASUREMENT
/begin MEASUREMENT fmy_stat_can_ccu.err_info_stat.lv_ready "readiness status of the diagnosis instance CAN_CCU" UWORD _CNV_S_2_RANGE______380_CM 1 0. 0. 1. DISPLAY_IDENTIFIER LV_READY_CAN_CCU ECU_ADDRESS 0x7f9a4a BYTE_ORDER MSB_LAST BIT_MASK 0x40 /end MEASUREMENT
/begin MEASUREMENT fmy_stat_can_ccu.err_info_stat.lv_end_diag "end of diagnosis of the diagnosis instance CAN_CCU" UWORD _CNV_S_2_RANGE______380_CM 1 0. 0. 1. DISPLAY_IDENTIFIER LV_END_DIAG_CAN_CCU ECU_ADDRESS 0x7f9a4a BYTE_ORDER MSB_LAST BIT_MASK 0x20 /end MEASUREMENT
/begin MEASUREMENT fmy_stat_can_ccu.err_info_stat.lv_cdn_diag "diagnosis condition of the diagnosis instance CAN_CCU" UWORD _CNV_S_2_RANGE______380_CM 1 0. 0. 1. DISPLAY_IDENTIFIER LV_CDN_DIAG_CAN_CCU ECU_ADDRESS 0x7f9a4a BYTE_ORDER MSB_LAST BIT_MASK 0x10 /end MEASUREMENT
/begin MEASUREMENT fmy_stat_can_ccu.err_info_stat.err_sym "symptoms of the diagnosis instance CAN_CCU" UWORD _CNV_S_6_CONV_ERRM__27_CM 1 0. 0. 15. DISPLAY_IDENTIFIER ERR_SYM_CAN_CCU ECU_ADDRESS 0x7f9a4a BYTE_ORDER MSB_LAST BIT_MASK 0xF /end MEASUREMENT
/begin MEASUREMENT fmy_stat_can_icl.ctr_abc "anti bounce counter for diagnosis instance CAN_ICL" UBYTE _CNV_A_R_LINEAR_____1_CM 1 0. 0. 255. DISPLAY_IDENTIFIER CTR_ABC_CAN_ICL ECU_ADDRESS 0x7f9a51 FORMAT "%3.0" /end MEASUREMENT
/begin MEASUREMENT fmy_stat_can_icl.ctr_end_diag "counter for end of diagnosis for diagnosis instance CAN_ICL" UBYTE _CNV_A_R_LINEAR_____1_CM 1 0. 0. 255. DISPLAY_IDENTIFIER CTR_ABC_END_DIAG_CAN_ICL ECU_ADDRESS 0x7f9a50 FORMAT "%3.0" /end MEASUREMENT
/begin MEASUREMENT fmy_stat_can_icl.err_info_stat.reserved "" UWORD _CNV_A_R_LINEAR_____0_CM 1 0. 0. 65535. DISPLAY_IDENTIFIER FMY_STAT_CAN_ICL_ERR_INFO_STAT_R ECU_ADDRESS 0x7f9a4e BYTE_ORDER MSB_LAST BIT_MASK 0xF800 /end MEASUREMENT
/begin MEASUREMENT fmy_stat_can_icl.err_info_stat.lv_cdn_diag_stc "Statistical flag for condition of diagnosis of the diagnosis instance CAN_ICL" UWORD _CNV_S_2_RANGE______380_CM 1 0. 0. 1. DISPLAY_IDENTIFIER LV_CDN_DIAG_STC_CAN_ICL ECU_ADDRESS 0x7f9a4e BYTE_ORDER MSB_LAST BIT_MASK 0x400 /end MEASUREMENT
/begin MEASUREMENT fmy_stat_can_icl.err_info_stat.lv_lock_diag "lock flag (CPU load optimisation) of the diagnosis instance CAN_ICL" UWORD _CNV_S_2_RANGE______380_CM 1 0. 0. 1. DISPLAY_IDENTIFIER LV_LOCK_DIAG_CAN_ICL ECU_ADDRESS 0x7f9a4e BYTE_ORDER MSB_LAST BIT_MASK 0x200 /end MEASUREMENT
/begin MEASUREMENT fmy_stat_can_icl.err_info_stat.lv_err_mem "storage in dynamic failure memory of the diagnosis instance CAN_ICL" UWORD _CNV_S_2_RANGE______380_CM 1 0. 0. 1. DISPLAY_IDENTIFIER LV_ERR_MEM_CAN_ICL ECU_ADDRESS 0x7f9a4e BYTE_ORDER MSB_LAST BIT_MASK 0x80 /end MEASUREMENT
/begin MEASUREMENT fmy_stat_can_icl.err_info_stat.lv_ready "readiness status of the diagnosis instance CAN_ICL" UWORD _CNV_S_2_RANGE______380_CM 1 0. 0. 1. DISPLAY_IDENTIFIER LV_READY_CAN_ICL ECU_ADDRESS 0x7f9a4e BYTE_ORDER MSB_LAST BIT_MASK 0x40 /end MEASUREMENT
/begin MEASUREMENT fmy_stat_can_icl.err_info_stat.lv_end_diag "end of diagnosis of the diagnosis instance CAN_ICL" UWORD _CNV_S_2_RANGE______380_CM 1 0. 0. 1. DISPLAY_IDENTIFIER LV_END_DIAG_CAN_ICL ECU_ADDRESS 0x7f9a4e BYTE_ORDER MSB_LAST BIT_MASK 0x20 /end MEASUREMENT
/begin MEASUREMENT fmy_stat_can_icl.err_info_stat.lv_cdn_diag "diagnosis condition of the diagnosis instance CAN_ICL" UWORD _CNV_S_2_RANGE______380_CM 1 0. 0. 1. DISPLAY_IDENTIFIER LV_CDN_DIAG_CAN_ICL ECU_ADDRESS 0x7f9a4e BYTE_ORDER MSB_LAST BIT_MASK 0x10 /end MEASUREMENT
/begin MEASUREMENT fmy_stat_can_icl.err_info_stat.err_sym "symptoms of the diagnosis instance CAN_ICL" UWORD _CNV_S_6_CONV_ERRM__27_CM 1 0. 0. 15. DISPLAY_IDENTIFIER ERR_SYM_CAN_ICL ECU_ADDRESS 0x7f9a4e BYTE_ORDER MSB_LAST BIT_MASK 0xF /end MEASUREMENT
/begin MEASUREMENT fmy_stat_can_vecu.ctr_abc "anti bounce counter for diagnosis instance CAN_VECU" UBYTE _CNV_A_R_LINEAR_____1_CM 1 0. 0. 255. DISPLAY_IDENTIFIER CTR_ABC_CAN_VECU ECU_ADDRESS 0x7f9a55 FORMAT "%3.0" /end MEASUREMENT
/begin MEASUREMENT fmy_stat_can_vecu.ctr_end_diag "counter for end of diagnosis for diagnosis instance CAN_VECU" UBYTE _CNV_A_R_LINEAR_____1_CM 1 0. 0. 255. DISPLAY_IDENTIFIER CTR_ABC_END_DIAG_CAN_VECU ECU_ADDRESS 0x7f9a54 FORMAT "%3.0" /end MEASUREMENT
/begin MEASUREMENT fmy_stat_can_vecu.err_info_stat.reserved "" UWORD _CNV_A_R_LINEAR_____0_CM 1 0. 0. 65535. DISPLAY_IDENTIFIER FMY_STAT_CAN_VECU_ERR_INFO_STAT_ ECU_ADDRESS 0x7f9a52 BYTE_ORDER MSB_LAST BIT_MASK 0xF800 /end MEASUREMENT
/begin MEASUREMENT fmy_stat_can_vecu.err_info_stat.lv_cdn_diag_stc "Statistical flag for condition of diagnosis of the diagnosis instance CAN_VECU" UWORD _CNV_S_2_RANGE______380_CM 1 0. 0. 1. DISPLAY_IDENTIFIER LV_CDN_DIAG_STC_CAN_VECU ECU_ADDRESS 0x7f9a52 BYTE_ORDER MSB_LAST BIT_MASK 0x400 /end MEASUREMENT
/begin MEASUREMENT fmy_stat_can_vecu.err_info_stat.lv_lock_diag "lock flag (CPU load optimisation) of the diagnosis instance CAN_VECU" UWORD _CNV_S_2_RANGE______380_CM 1 0. 0. 1. DISPLAY_IDENTIFIER LV_LOCK_DIAG_CAN_VECU ECU_ADDRESS 0x7f9a52 BYTE_ORDER MSB_LAST BIT_MASK 0x200 /end MEASUREMENT
/begin MEASUREMENT fmy_stat_can_vecu.err_info_stat.lv_err_mem "storage in dynamic failure memory of the diagnosis instance CAN_VECU" UWORD _CNV_S_2_RANGE______380_CM 1 0. 0. 1. DISPLAY_IDENTIFIER LV_ERR_MEM_CAN_VECU ECU_ADDRESS 0x7f9a52 BYTE_ORDER MSB_LAST BIT_MASK 0x80 /end MEASUREMENT
/begin MEASUREMENT fmy_stat_can_vecu.err_info_stat.lv_ready "readiness status of the diagnosis instance CAN_VECU" UWORD _CNV_S_2_RANGE______380_CM 1 0. 0. 1. DISPLAY_IDENTIFIER LV_READY_CAN_VECU ECU_ADDRESS 0x7f9a52 BYTE_ORDER MSB_LAST BIT_MASK 0x40 /end MEASUREMENT
/begin MEASUREMENT fmy_stat_can_vecu.err_info_stat.lv_end_diag "end of diagnosis of the diagnosis instance CAN_VECU" UWORD _CNV_S_2_RANGE______380_CM 1 0. 0. 1. DISPLAY_IDENTIFIER LV_END_DIAG_CAN_VECU ECU_ADDRESS 0x7f9a52 BYTE_ORDER MSB_LAST BIT_MASK 0x20 /end MEASUREMENT
/begin MEASUREMENT fmy_stat_can_vecu.err_info_stat.lv_cdn_diag "diagnosis condition of the diagnosis instance CAN_VECU" UWORD _CNV_S_2_RANGE______380_CM 1 0. 0. 1. DISPLAY_IDENTIFIER LV_CDN_DIAG_CAN_VECU ECU_ADDRESS 0x7f9a52 BYTE_ORDER MSB_LAST BIT_MASK 0x10 /end MEASUREMENT
/begin MEASUREMENT fmy_stat_can_vecu.err_info_stat.err_sym "symptoms of the diagnosis instance CAN_VECU" UWORD _CNV_S_6_CONV_ERRM__27_CM 1 0. 0. 15. DISPLAY_IDENTIFIER ERR_SYM_CAN_VECU ECU_ADDRESS 0x7f9a52 BYTE_ORDER MSB_LAST BIT_MASK 0xF /end MEASUREMENT
/begin MEASUREMENT fmy_stat_can_smls.ctr_abc "anti bounce counter for diagnosis instance CAN_SMLS" UBYTE _CNV_A_R_LINEAR_____1_CM 1 0. 0. 255. DISPLAY_IDENTIFIER CTR_ABC_CAN_SMLS ECU_ADDRESS 0x7f9a59 FORMAT "%3.0" /end MEASUREMENT
/begin MEASUREMENT fmy_stat_can_smls.ctr_end_diag "counter for end of diagnosis for diagnosis instance CAN_SMLS" UBYTE _CNV_A_R_LINEAR_____1_CM 1 0. 0. 255. DISPLAY_IDENTIFIER CTR_ABC_END_DIAG_CAN_SMLS ECU_ADDRESS 0x7f9a58 FORMAT "%3.0" /end MEASUREMENT
/begin MEASUREMENT fmy_stat_can_smls.err_info_stat.reserved "" UWORD _CNV_A_R_LINEAR_____0_CM 1 0. 0. 65535. DISPLAY_IDENTIFIER FMY_STAT_CAN_SMLS_ERR_INFO_STAT_ ECU_ADDRESS 0x7f9a56 BYTE_ORDER MSB_LAST BIT_MASK 0xF800 /end MEASUREMENT
/begin MEASUREMENT fmy_stat_can_smls.err_info_stat.lv_cdn_diag_stc "Statistical flag for condition of diagnosis of the diagnosis instance CAN_SMLS" UWORD _CNV_S_2_RANGE______380_CM 1 0. 0. 1. DISPLAY_IDENTIFIER LV_CDN_DIAG_STC_CAN_SMLS ECU_ADDRESS 0x7f9a56 BYTE_ORDER MSB_LAST BIT_MASK 0x400 /end MEASUREMENT
/begin MEASUREMENT fmy_stat_can_smls.err_info_stat.lv_lock_diag "lock flag (CPU load optimisation) of the diagnosis instance CAN_SMLS" UWORD _CNV_S_2_RANGE______380_CM 1 0. 0. 1. DISPLAY_IDENTIFIER LV_LOCK_DIAG_CAN_SMLS ECU_ADDRESS 0x7f9a56 BYTE_ORDER MSB_LAST BIT_MASK 0x200 /end MEASUREMENT
/begin MEASUREMENT fmy_stat_can_smls.err_info_stat.lv_err_mem "storage in dynamic failure memory of the diagnosis instance CAN_SMLS" UWORD _CNV_S_2_RANGE______380_CM 1 0. 0. 1. DISPLAY_IDENTIFIER LV_ERR_MEM_CAN_SMLS ECU_ADDRESS 0x7f9a56 BYTE_ORDER MSB_LAST BIT_MASK 0x80 /end MEASUREMENT
/begin MEASUREMENT fmy_stat_can_smls.err_info_stat.lv_ready "readiness status of the diagnosis instance CAN_SMLS" UWORD _CNV_S_2_RANGE______380_CM 1 0. 0. 1. DISPLAY_IDENTIFIER LV_READY_CAN_SMLS ECU_ADDRESS 0x7f9a56 BYTE_ORDER MSB_LAST BIT_MASK 0x40 /end MEASUREMENT
/begin MEASUREMENT fmy_stat_can_smls.err_info_stat.lv_end_diag "end of diagnosis of the diagnosis instance CAN_SMLS" UWORD _CNV_S_2_RANGE______380_CM 1 0. 0. 1. DISPLAY_IDENTIFIER LV_END_DIAG_CAN_SMLS ECU_ADDRESS 0x7f9a56 BYTE_ORDER MSB_LAST BIT_MASK 0x20 /end MEASUREMENT
/begin MEASUREMENT fmy_stat_can_smls.err_info_stat.lv_cdn_diag "diagnosis condition of the diagnosis instance CAN_SMLS" UWORD _CNV_S_2_RANGE______380_CM 1 0. 0. 1. DISPLAY_IDENTIFIER LV_CDN_DIAG_CAN_SMLS ECU_ADDRESS 0x7f9a56 BYTE_ORDER MSB_LAST BIT_MASK 0x10 /end MEASUREMENT
/begin MEASUREMENT fmy_stat_can_smls.err_info_stat.err_sym "symptoms of the diagnosis instance CAN_SMLS" UWORD _CNV_S_6_CONV_ERRM__27_CM 1 0. 0. 15. DISPLAY_IDENTIFIER ERR_SYM_CAN_SMLS ECU_ADDRESS 0x7f9a56 BYTE_ORDER MSB_LAST BIT_MASK 0xF /end MEASUREMENT
/begin MEASUREMENT fmy_stat_can_boff.ctr_abc "anti bounce counter for diagnosis instance CAN_BOFF" UBYTE _CNV_A_R_LINEAR_____1_CM 1 0. 0. 255. DISPLAY_IDENTIFIER CTR_ABC_CAN_BOFF ECU_ADDRESS 0x7f9a5d FORMAT "%3.0" /end MEASUREMENT
/begin MEASUREMENT fmy_stat_can_boff.ctr_end_diag "counter for end of diagnosis for diagnosis instance CAN_BOFF" UBYTE _CNV_A_R_LINEAR_____1_CM 1 0. 0. 255. DISPLAY_IDENTIFIER CTR_ABC_END_DIAG_CAN_BOFF ECU_ADDRESS 0x7f9a5c FORMAT "%3.0" /end MEASUREMENT
/begin MEASUREMENT fmy_stat_can_boff.err_info_stat.reserved "" UWORD _CNV_A_R_LINEAR_____0_CM 1 0. 0. 65535. DISPLAY_IDENTIFIER FMY_STAT_CAN_BOFF_ERR_INFO_STAT_ ECU_ADDRESS 0x7f9a5a BYTE_ORDER MSB_LAST BIT_MASK 0xF800 /end MEASUREMENT
/begin MEASUREMENT fmy_stat_can_boff.err_info_stat.lv_cdn_diag_stc "Statistical flag for condition of diagnosis of the diagnosis instance CAN_BOFF" UWORD _CNV_S_2_RANGE______380_CM 1 0. 0. 1. DISPLAY_IDENTIFIER LV_CDN_DIAG_STC_CAN_BOFF ECU_ADDRESS 0x7f9a5a BYTE_ORDER MSB_LAST BIT_MASK 0x400 /end MEASUREMENT
/begin MEASUREMENT fmy_stat_can_boff.err_info_stat.lv_lock_diag "lock flag (CPU load optimisation) of the diagnosis instance CAN_BOFF" UWORD _CNV_S_2_RANGE______380_CM 1 0. 0. 1. DISPLAY_IDENTIFIER LV_LOCK_DIAG_CAN_BOFF ECU_ADDRESS 0x7f9a5a BYTE_ORDER MSB_LAST BIT_MASK 0x200 /end MEASUREMENT
/begin MEASUREMENT fmy_stat_can_boff.err_info_stat.lv_err_mem "storage in dynamic failure memory of the diagnosis instance CAN_BOFF" UWORD _CNV_S_2_RANGE______380_CM 1 0. 0. 1. DISPLAY_IDENTIFIER LV_ERR_MEM_CAN_BOFF ECU_ADDRESS 0x7f9a5a BYTE_ORDER MSB_LAST BIT_MASK 0x80 /end MEASUREMENT
/begin MEASUREMENT fmy_stat_can_boff.err_info_stat.lv_ready "readiness status of the diagnosis instance CAN_BOFF" UWORD _CNV_S_2_RANGE______380_CM 1 0. 0. 1. DISPLAY_IDENTIFIER LV_READY_CAN_BOFF ECU_ADDRESS 0x7f9a5a BYTE_ORDER MSB_LAST BIT_MASK 0x40 /end MEASUREMENT
/begin MEASUREMENT fmy_stat_can_boff.err_info_stat.lv_end_diag "end of diagnosis of the diagnosis instance CAN_BOFF" UWORD _CNV_S_2_RANGE______380_CM 1 0. 0. 1. DISPLAY_IDENTIFIER LV_END_DIAG_CAN_BOFF ECU_ADDRESS 0x7f9a5a BYTE_ORDER MSB_LAST BIT_MASK 0x20 /end MEASUREMENT
/begin MEASUREMENT fmy_stat_can_boff.err_info_stat.lv_cdn_diag "diagnosis condition of the diagnosis instance CAN_BOFF" UWORD _CNV_S_2_RANGE______380_CM 1 0. 0. 1. DISPLAY_IDENTIFIER LV_CDN_DIAG_CAN_BOFF ECU_ADDRESS 0x7f9a5a BYTE_ORDER MSB_LAST BIT_MASK 0x10 /end MEASUREMENT
/begin MEASUREMENT fmy_stat_can_boff.err_info_stat.err_sym "symptoms of the diagnosis instance CAN_BOFF" UWORD _CNV_S_6_CONV_ERRM__27_CM 1 0. 0. 15. DISPLAY_IDENTIFIER ERR_SYM_CAN_BOFF ECU_ADDRESS 0x7f9a5a BYTE_ORDER MSB_LAST BIT_MASK 0xF /end MEASUREMENT
/begin MEASUREMENT fmy_stat_can_bem.ctr_abc "anti bounce counter for diagnosis instance CAN_BEM" UBYTE _CNV_A_R_LINEAR_____1_CM 1 0. 0. 255. DISPLAY_IDENTIFIER CTR_ABC_CAN_BEM ECU_ADDRESS 0x7f9a61 FORMAT "%3.0" /end MEASUREMENT
/begin MEASUREMENT fmy_stat_can_bem.ctr_end_diag "counter for end of diagnosis for diagnosis instance CAN_BEM" UBYTE _CNV_A_R_LINEAR_____1_CM 1 0. 0. 255. DISPLAY_IDENTIFIER CTR_ABC_END_DIAG_CAN_BEM ECU_ADDRESS 0x7f9a60 FORMAT "%3.0" /end MEASUREMENT
/begin MEASUREMENT fmy_stat_can_bem.err_info_stat.reserved "" UWORD _CNV_A_R_LINEAR_____0_CM 1 0. 0. 65535. DISPLAY_IDENTIFIER FMY_STAT_CAN_BEM_ERR_INFO_STAT_R ECU_ADDRESS 0x7f9a5e BYTE_ORDER MSB_LAST BIT_MASK 0xF800 /end MEASUREMENT
/begin MEASUREMENT fmy_stat_can_bem.err_info_stat.lv_cdn_diag_stc "Statistical flag for condition of diagnosis of the diagnosis instance CAN_BEM" UWORD _CNV_S_2_RANGE______380_CM 1 0. 0. 1. DISPLAY_IDENTIFIER LV_CDN_DIAG_STC_CAN_BEM ECU_ADDRESS 0x7f9a5e BYTE_ORDER MSB_LAST BIT_MASK 0x400 /end MEASUREMENT
/begin MEASUREMENT fmy_stat_can_bem.err_info_stat.lv_lock_diag "lock flag (CPU load optimisation) of the diagnosis instance CAN_BEM" UWORD _CNV_S_2_RANGE______380_CM 1 0. 0. 1. DISPLAY_IDENTIFIER LV_LOCK_DIAG_CAN_BEM ECU_ADDRESS 0x7f9a5e BYTE_ORDER MSB_LAST BIT_MASK 0x200 /end MEASUREMENT
/begin MEASUREMENT fmy_stat_can_bem.err_info_stat.lv_err_mem "storage in dynamic failure memory of the diagnosis instance CAN_BEM" UWORD _CNV_S_2_RANGE______380_CM 1 0. 0. 1. DISPLAY_IDENTIFIER LV_ERR_MEM_CAN_BEM ECU_ADDRESS 0x7f9a5e BYTE_ORDER MSB_LAST BIT_MASK 0x80 /end MEASUREMENT
/begin MEASUREMENT fmy_stat_can_bem.err_info_stat.lv_ready "readiness status of the diagnosis instance CAN_BEM" UWORD _CNV_S_2_RANGE______380_CM 1 0. 0. 1. DISPLAY_IDENTIFIER LV_READY_CAN_BEM ECU_ADDRESS 0x7f9a5e BYTE_ORDER MSB_LAST BIT_MASK 0x40 /end MEASUREMENT
/begin MEASUREMENT fmy_stat_can_bem.err_info_stat.lv_end_diag "end of diagnosis of the diagnosis instance CAN_BEM" UWORD _CNV_S_2_RANGE______380_CM 1 0. 0. 1. DISPLAY_IDENTIFIER LV_END_DIAG_CAN_BEM ECU_ADDRESS 0x7f9a5e BYTE_ORDER MSB_LAST BIT_MASK 0x20 /end MEASUREMENT
/begin MEASUREMENT fmy_stat_can_bem.err_info_stat.lv_cdn_diag "diagnosis condition of the diagnosis instance CAN_BEM" UWORD _CNV_S_2_RANGE______380_CM 1 0. 0. 1. DISPLAY_IDENTIFIER LV_CDN_DIAG_CAN_BEM ECU_ADDRESS 0x7f9a5e BYTE_ORDER MSB_LAST BIT_MASK 0x10 /end MEASUREMENT
/begin MEASUREMENT fmy_stat_can_bem.err_info_stat.err_sym "symptoms of the diagnosis instance CAN_BEM" UWORD _CNV_S_6_CONV_ERRM__27_CM 1 0. 0. 15. DISPLAY_IDENTIFIER ERR_SYM_CAN_BEM ECU_ADDRESS 0x7f9a5e BYTE_ORDER MSB_LAST BIT_MASK 0xF /end MEASUREMENT
/begin MEASUREMENT fmy_stat_can_if_cft.ctr_abc "anti bounce counter for diagnosis instance CAN_IF_CFT" UBYTE _CNV_A_R_LINEAR_____1_CM 1 0. 0. 255. DISPLAY_IDENTIFIER CTR_ABC_CAN_IF_CFT ECU_ADDRESS 0x7f9a65 FORMAT "%3.0" /end MEASUREMENT
/begin MEASUREMENT fmy_stat_can_if_cft.ctr_end_diag "counter for end of diagnosis for diagnosis instance CAN_IF_CFT" UBYTE _CNV_A_R_LINEAR_____1_CM 1 0. 0. 255. DISPLAY_IDENTIFIER CTR_ABC_END_DIAG_CAN_IF_CFT ECU_ADDRESS 0x7f9a64 FORMAT "%3.0" /end MEASUREMENT
/begin MEASUREMENT fmy_stat_can_if_cft.err_info_stat.reserved "" UWORD _CNV_A_R_LINEAR_____0_CM 1 0. 0. 65535. DISPLAY_IDENTIFIER FMY_STAT_CAN_IF_CFT_ERR_INFO_STA ECU_ADDRESS 0x7f9a62 BYTE_ORDER MSB_LAST BIT_MASK 0xF800 /end MEASUREMENT
/begin MEASUREMENT fmy_stat_can_if_cft.err_info_stat.lv_cdn_diag_stc "Statistical flag for condition of diagnosis of the diagnosis instance CAN_IF_CFT" UWORD _CNV_S_2_RANGE______380_CM 1 0. 0. 1. DISPLAY_IDENTIFIER LV_CDN_DIAG_STC_CAN_IF_CFT ECU_ADDRESS 0x7f9a62 BYTE_ORDER MSB_LAST BIT_MASK 0x400 /end MEASUREMENT
/begin MEASUREMENT fmy_stat_can_if_cft.err_info_stat.lv_lock_diag "lock flag (CPU load optimisation) of the diagnosis instance CAN_IF_CFT" UWORD _CNV_S_2_RANGE______380_CM 1 0. 0. 1. DISPLAY_IDENTIFIER LV_LOCK_DIAG_CAN_IF_CFT ECU_ADDRESS 0x7f9a62 BYTE_ORDER MSB_LAST BIT_MASK 0x200 /end MEASUREMENT
/begin MEASUREMENT fmy_stat_can_if_cft.err_info_stat.lv_err_mem "storage in dynamic failure memory of the diagnosis instance CAN_IF_CFT" UWORD _CNV_S_2_RANGE______380_CM 1 0. 0. 1. DISPLAY_IDENTIFIER LV_ERR_MEM_CAN_IF_CFT ECU_ADDRESS 0x7f9a62 BYTE_ORDER MSB_LAST BIT_MASK 0x80 /end MEASUREMENT
/begin MEASUREMENT fmy_stat_can_if_cft.err_info_stat.lv_ready "readiness status of the diagnosis instance CAN_IF_CFT" UWORD _CNV_S_2_RANGE______380_CM 1 0. 0. 1. DISPLAY_IDENTIFIER LV_READY_CAN_IF_CFT ECU_ADDRESS 0x7f9a62 BYTE_ORDER MSB_LAST BIT_MASK 0x40 /end MEASUREMENT
/begin MEASUREMENT fmy_stat_can_if_cft.err_info_stat.lv_end_diag "end of diagnosis of the diagnosis instance CAN_IF_CFT" UWORD _CNV_S_2_RANGE______380_CM 1 0. 0. 1. DISPLAY_IDENTIFIER LV_END_DIAG_CAN_IF_CFT ECU_ADDRESS 0x7f9a62 BYTE_ORDER MSB_LAST BIT_MASK 0x20 /end MEASUREMENT
/begin MEASUREMENT fmy_stat_can_if_cft.err_info_stat.lv_cdn_diag "diagnosis condition of the diagnosis instance CAN_IF_CFT" UWORD _CNV_S_2_RANGE______380_CM 1 0. 0. 1. DISPLAY_IDENTIFIER LV_CDN_DIAG_CAN_IF_CFT ECU_ADDRESS 0x7f9a62 BYTE_ORDER MSB_LAST BIT_MASK 0x10 /end MEASUREMENT
/begin MEASUREMENT fmy_stat_can_if_cft.err_info_stat.err_sym "symptoms of the diagnosis instance CAN_IF_CFT" UWORD _CNV_S_6_CONV_ERRM__27_CM 1 0. 0. 15. DISPLAY_IDENTIFIER ERR_SYM_CAN_IF_CFT ECU_ADDRESS 0x7f9a62 BYTE_ORDER MSB_LAST BIT_MASK 0xF /end MEASUREMENT
/begin MEASUREMENT fmy_stat_can_tot.ctr_abc "anti bounce counter for diagnosis instance CAN_TOT" UBYTE _CNV_A_R_LINEAR_____1_CM 1 0. 0. 255. DISPLAY_IDENTIFIER CTR_ABC_CAN_TOT ECU_ADDRESS 0x7f9a69 FORMAT "%3.0" /end MEASUREMENT
/begin MEASUREMENT fmy_stat_can_tot.ctr_end_diag "counter for end of diagnosis for diagnosis instance CAN_TOT" UBYTE _CNV_A_R_LINEAR_____1_CM 1 0. 0. 255. DISPLAY_IDENTIFIER CTR_ABC_END_DIAG_CAN_TOT ECU_ADDRESS 0x7f9a68 FORMAT "%3.0" /end MEASUREMENT
/begin MEASUREMENT fmy_stat_can_tot.err_info_stat.reserved "" UWORD _CNV_A_R_LINEAR_____0_CM 1 0. 0. 65535. DISPLAY_IDENTIFIER FMY_STAT_CAN_TOT_ERR_INFO_STAT_R ECU_ADDRESS 0x7f9a66 BYTE_ORDER MSB_LAST BIT_MASK 0xF800 /end MEASUREMENT
/begin MEASUREMENT fmy_stat_can_tot.err_info_stat.lv_cdn_diag_stc "Statistical flag for condition of diagnosis of the diagnosis instance CAN_TOT" UWORD _CNV_S_2_RANGE______380_CM 1 0. 0. 1. DISPLAY_IDENTIFIER LV_CDN_DIAG_STC_CAN_TOT ECU_ADDRESS 0x7f9a66 BYTE_ORDER MSB_LAST BIT_MASK 0x400 /end MEASUREMENT
/begin MEASUREMENT fmy_stat_can_tot.err_info_stat.lv_lock_diag "lock flag (CPU load optimisation) of the diagnosis instance CAN_TOT" UWORD _CNV_S_2_RANGE______380_CM 1 0. 0. 1. DISPLAY_IDENTIFIER LV_LOCK_DIAG_CAN_TOT ECU_ADDRESS 0x7f9a66 BYTE_ORDER MSB_LAST BIT_MASK 0x200 /end MEASUREMENT
/begin MEASUREMENT fmy_stat_can_tot.err_info_stat.lv_err_mem "storage in dynamic failure memory of the diagnosis instance CAN_TOT" UWORD _CNV_S_2_RANGE______380_CM 1 0. 0. 1. DISPLAY_IDENTIFIER LV_ERR_MEM_CAN_TOT ECU_ADDRESS 0x7f9a66 BYTE_ORDER MSB_LAST BIT_MASK 0x80 /end MEASUREMENT
/begin MEASUREMENT fmy_stat_can_tot.err_info_stat.lv_ready "readiness status of the diagnosis instance CAN_TOT" UWORD _CNV_S_2_RANGE______380_CM 1 0. 0. 1. DISPLAY_IDENTIFIER LV_READY_CAN_TOT ECU_ADDRESS 0x7f9a66 BYTE_ORDER MSB_LAST BIT_MASK 0x40 /end MEASUREMENT
/begin MEASUREMENT fmy_stat_can_tot.err_info_stat.lv_end_diag "end of diagnosis of the diagnosis instance CAN_TOT" UWORD _CNV_S_2_RANGE______380_CM 1 0. 0. 1. DISPLAY_IDENTIFIER LV_END_DIAG_CAN_TOT ECU_ADDRESS 0x7f9a66 BYTE_ORDER MSB_LAST BIT_MASK 0x20 /end MEASUREMENT
/begin MEASUREMENT fmy_stat_can_tot.err_info_stat.lv_cdn_diag "diagnosis condition of the diagnosis instance CAN_TOT" UWORD _CNV_S_2_RANGE______380_CM 1 0. 0. 1. DISPLAY_IDENTIFIER LV_CDN_DIAG_CAN_TOT ECU_ADDRESS 0x7f9a66 BYTE_ORDER MSB_LAST BIT_MASK 0x10 /end MEASUREMENT
/begin MEASUREMENT fmy_stat_can_tot.err_info_stat.err_sym "symptoms of the diagnosis instance CAN_TOT" UWORD _CNV_S_6_CONV_ERRM__27_CM 1 0. 0. 15. DISPLAY_IDENTIFIER ERR_SYM_CAN_TOT ECU_ADDRESS 0x7f9a66 BYTE_ORDER MSB_LAST BIT_MASK 0xF /end MEASUREMENT
/begin MEASUREMENT fmy_stat_varcod.ctr_abc "anti bounce counter for diagnosis instance VARCOD" UBYTE _CNV_A_R_LINEAR_____1_CM 1 0. 0. 255. DISPLAY_IDENTIFIER CTR_ABC_VARCOD ECU_ADDRESS 0x7f9a6d FORMAT "%3.0" /end MEASUREMENT
/begin MEASUREMENT fmy_stat_varcod.ctr_end_diag "counter for end of diagnosis for diagnosis instance VARCOD" UBYTE _CNV_A_R_LINEAR_____1_CM 1 0. 0. 255. DISPLAY_IDENTIFIER CTR_ABC_END_DIAG_VARCOD ECU_ADDRESS 0x7f9a6c FORMAT "%3.0" /end MEASUREMENT
/begin MEASUREMENT fmy_stat_varcod.err_info_stat.reserved "" UWORD _CNV_A_R_LINEAR_____0_CM 1 0. 0. 65535. DISPLAY_IDENTIFIER FMY_STAT_VARCOD_ERR_INFO_STAT_RE ECU_ADDRESS 0x7f9a6a BYTE_ORDER MSB_LAST BIT_MASK 0xF800 /end MEASUREMENT
/begin MEASUREMENT fmy_stat_varcod.err_info_stat.lv_cdn_diag_stc "Statistical flag for condition of diagnosis of the diagnosis instance VARCOD" UWORD _CNV_S_2_RANGE______380_CM 1 0. 0. 1. DISPLAY_IDENTIFIER LV_CDN_DIAG_STC_VARCOD ECU_ADDRESS 0x7f9a6a BYTE_ORDER MSB_LAST BIT_MASK 0x400 /end MEASUREMENT
/begin MEASUREMENT fmy_stat_varcod.err_info_stat.lv_lock_diag "lock flag (CPU load optimisation) of the diagnosis instance VARCOD" UWORD _CNV_S_2_RANGE______380_CM 1 0. 0. 1. DISPLAY_IDENTIFIER LV_LOCK_DIAG_VARCOD ECU_ADDRESS 0x7f9a6a BYTE_ORDER MSB_LAST BIT_MASK 0x200 /end MEASUREMENT
/begin MEASUREMENT fmy_stat_varcod.err_info_stat.lv_err_mem "storage in dynamic failure memory of the diagnosis instance VARCOD" UWORD _CNV_S_2_RANGE______380_CM 1 0. 0. 1. DISPLAY_IDENTIFIER LV_ERR_MEM_VARCOD ECU_ADDRESS 0x7f9a6a BYTE_ORDER MSB_LAST BIT_MASK 0x80 /end MEASUREMENT
/begin MEASUREMENT fmy_stat_varcod.err_info_stat.lv_ready "readiness status of the diagnosis instance VARCOD" UWORD _CNV_S_2_RANGE______380_CM 1 0. 0. 1. DISPLAY_IDENTIFIER LV_READY_VARCOD ECU_ADDRESS 0x7f9a6a BYTE_ORDER MSB_LAST BIT_MASK 0x40 /end MEASUREMENT
/begin MEASUREMENT fmy_stat_varcod.err_info_stat.lv_end_diag "end of diagnosis of the diagnosis instance VARCOD" UWORD _CNV_S_2_RANGE______380_CM 1 0. 0. 1. DISPLAY_IDENTIFIER LV_END_DIAG_VARCOD ECU_ADDRESS 0x7f9a6a BYTE_ORDER MSB_LAST BIT_MASK 0x20 /end MEASUREMENT
/begin MEASUREMENT fmy_stat_varcod.err_info_stat.lv_cdn_diag "diagnosis condition of the diagnosis instance VARCOD" UWORD _CNV_S_2_RANGE______380_CM 1 0. 0. 1. DISPLAY_IDENTIFIER LV_CDN_DIAG_VARCOD ECU_ADDRESS 0x7f9a6a BYTE_ORDER MSB_LAST BIT_MASK 0x10 /end MEASUREMENT
/begin MEASUREMENT fmy_stat_varcod.err_info_stat.err_sym "symptoms of the diagnosis instance VARCOD" UWORD _CNV_S_6_CONV_ERRM__27_CM 1 0. 0. 15. DISPLAY_IDENTIFIER ERR_SYM_VARCOD ECU_ADDRESS 0x7f9a6a BYTE_ORDER MSB_LAST BIT_MASK 0xF /end MEASUREMENT
/begin MEASUREMENT lv_err_acp_mes_rng "Error flag of diagnosis instance ACP_MES_RNG" UBYTE _CNV_S_2_RANGE______28_CM 1 0. 0. 1. DISPLAY_IDENTIFIER LV_ERR_ACP_MES_RNG ECU_ADDRESS 0x7fb520 /end MEASUREMENT
/begin MEASUREMENT fmy_stat_acp_mes_rng.ctr_abc "anti bounce counter for diagnosis instance ACP_MES_RNG" UBYTE _CNV_A_R_LINEAR_____1_CM 1 0. 0. 255. DISPLAY_IDENTIFIER CTR_ABC_ACP_MES_RNG ECU_ADDRESS 0x7f9a71 FORMAT "%3.0" /end MEASUREMENT
/begin MEASUREMENT fmy_stat_acp_mes_rng.ctr_end_diag "counter for end of diagnosis for diagnosis instance ACP_MES_RNG" UBYTE _CNV_A_R_LINEAR_____1_CM 1 0. 0. 255. DISPLAY_IDENTIFIER CTR_ABC_END_DIAG_ACP_MES_RNG ECU_ADDRESS 0x7f9a70 FORMAT "%3.0" /end MEASUREMENT
/begin MEASUREMENT fmy_stat_acp_mes_rng.err_info_stat.reserved "" UWORD _CNV_A_R_LINEAR_____0_CM 1 0. 0. 65535. DISPLAY_IDENTIFIER FMY_STAT_ACP_MES_RNG_ERR_INFO_ST ECU_ADDRESS 0x7f9a6e BYTE_ORDER MSB_LAST BIT_MASK 0xF800 /end MEASUREMENT
/begin MEASUREMENT fmy_stat_acp_mes_rng.err_info_stat.lv_cdn_diag_stc "Statistical flag for condition of diagnosis of the diagnosis instance ACP_MES_RNG" UWORD _CNV_S_2_RANGE______380_CM 1 0. 0. 1. DISPLAY_IDENTIFIER LV_CDN_DIAG_STC_ACP_MES_RNG ECU_ADDRESS 0x7f9a6e BYTE_ORDER MSB_LAST BIT_MASK 0x400 /end MEASUREMENT
/begin MEASUREMENT fmy_stat_acp_mes_rng.err_info_stat.lv_lock_diag "lock flag (CPU load optimisation) of the diagnosis instance ACP_MES_RNG" UWORD _CNV_S_2_RANGE______380_CM 1 0. 0. 1. DISPLAY_IDENTIFIER LV_LOCK_DIAG_ACP_MES_RNG ECU_ADDRESS 0x7f9a6e BYTE_ORDER MSB_LAST BIT_MASK 0x200 /end MEASUREMENT
/begin MEASUREMENT fmy_stat_acp_mes_rng.err_info_stat.lv_err_mem "storage in dynamic failure memory of the diagnosis instance ACP_MES_RNG" UWORD _CNV_S_2_RANGE______380_CM 1 0. 0. 1. DISPLAY_IDENTIFIER LV_ERR_MEM_ACP_MES_RNG ECU_ADDRESS 0x7f9a6e BYTE_ORDER MSB_LAST BIT_MASK 0x80 /end MEASUREMENT
/begin MEASUREMENT fmy_stat_acp_mes_rng.err_info_stat.lv_ready "readiness status of the diagnosis instance ACP_MES_RNG" UWORD _CNV_S_2_RANGE______380_CM 1 0. 0. 1. DISPLAY_IDENTIFIER LV_READY_ACP_MES_RNG ECU_ADDRESS 0x7f9a6e BYTE_ORDER MSB_LAST BIT_MASK 0x40 /end MEASUREMENT
/begin MEASUREMENT fmy_stat_acp_mes_rng.err_info_stat.lv_end_diag "end of diagnosis of the diagnosis instance ACP_MES_RNG" UWORD _CNV_S_2_RANGE______380_CM 1 0. 0. 1. DISPLAY_IDENTIFIER LV_END_DIAG_ACP_MES_RNG ECU_ADDRESS 0x7f9a6e BYTE_ORDER MSB_LAST BIT_MASK 0x20 /end MEASUREMENT
/begin MEASUREMENT fmy_stat_acp_mes_rng.err_info_stat.lv_cdn_diag "diagnosis condition of the diagnosis instance ACP_MES_RNG" UWORD _CNV_S_2_RANGE______380_CM 1 0. 0. 1. DISPLAY_IDENTIFIER LV_CDN_DIAG_ACP_MES_RNG ECU_ADDRESS 0x7f9a6e BYTE_ORDER MSB_LAST BIT_MASK 0x10 /end MEASUREMENT
/begin MEASUREMENT fmy_stat_acp_mes_rng.err_info_stat.err_sym "symptoms of the diagnosis instance ACP_MES_RNG" UWORD _CNV_S_6_CONV_ERRM__27_CM 1 0. 0. 15. DISPLAY_IDENTIFIER ERR_SYM_ACP_MES_RNG ECU_ADDRESS 0x7f9a6e BYTE_ORDER MSB_LAST BIT_MASK 0xF /end MEASUREMENT
/begin MEASUREMENT lv_err_acp_mes_grd "Error flag of diagnosis instance ACP_MES_GRD" UBYTE _CNV_S_2_RANGE______28_CM 1 0. 0. 1. DISPLAY_IDENTIFIER LV_ERR_ACP_MES_GRD ECU_ADDRESS 0x7fb521 /end MEASUREMENT
/begin MEASUREMENT fmy_stat_acp_mes_grd.ctr_abc "anti bounce counter for diagnosis instance ACP_MES_GRD" UBYTE _CNV_A_R_LINEAR_____1_CM 1 0. 0. 255. DISPLAY_IDENTIFIER CTR_ABC_ACP_MES_GRD ECU_ADDRESS 0x7f9a75 FORMAT "%3.0" /end MEASUREMENT
/begin MEASUREMENT fmy_stat_acp_mes_grd.ctr_end_diag "counter for end of diagnosis for diagnosis instance ACP_MES_GRD" UBYTE _CNV_A_R_LINEAR_____1_CM 1 0. 0. 255. DISPLAY_IDENTIFIER CTR_ABC_END_DIAG_ACP_MES_GRD ECU_ADDRESS 0x7f9a74 FORMAT "%3.0" /end MEASUREMENT
/begin MEASUREMENT fmy_stat_acp_mes_grd.err_info_stat.reserved "" UWORD _CNV_A_R_LINEAR_____0_CM 1 0. 0. 65535. DISPLAY_IDENTIFIER FMY_STAT_ACP_MES_GRD_ERR_INFO_ST ECU_ADDRESS 0x7f9a72 BYTE_ORDER MSB_LAST BIT_MASK 0xF800 /end MEASUREMENT
/begin MEASUREMENT fmy_stat_acp_mes_grd.err_info_stat.lv_cdn_diag_stc "Statistical flag for condition of diagnosis of the diagnosis instance ACP_MES_GRD" UWORD _CNV_S_2_RANGE______380_CM 1 0. 0. 1. DISPLAY_IDENTIFIER LV_CDN_DIAG_STC_ACP_MES_GRD ECU_ADDRESS 0x7f9a72 BYTE_ORDER MSB_LAST BIT_MASK 0x400 /end MEASUREMENT
/begin MEASUREMENT fmy_stat_acp_mes_grd.err_info_stat.lv_lock_diag "lock flag (CPU load optimisation) of the diagnosis instance ACP_MES_GRD" UWORD _CNV_S_2_RANGE______380_CM 1 0. 0. 1. DISPLAY_IDENTIFIER LV_LOCK_DIAG_ACP_MES_GRD ECU_ADDRESS 0x7f9a72 BYTE_ORDER MSB_LAST BIT_MASK 0x200 /end MEASUREMENT
/begin MEASUREMENT fmy_stat_acp_mes_grd.err_info_stat.lv_err_mem "storage in dynamic failure memory of the diagnosis instance ACP_MES_GRD" UWORD _CNV_S_2_RANGE______380_CM 1 0. 0. 1. DISPLAY_IDENTIFIER LV_ERR_MEM_ACP_MES_GRD ECU_ADDRESS 0x7f9a72 BYTE_ORDER MSB_LAST BIT_MASK 0x80 /end MEASUREMENT
/begin MEASUREMENT fmy_stat_acp_mes_grd.err_info_stat.lv_ready "readiness status of the diagnosis instance ACP_MES_GRD" UWORD _CNV_S_2_RANGE______380_CM 1 0. 0. 1. DISPLAY_IDENTIFIER LV_READY_ACP_MES_GRD ECU_ADDRESS 0x7f9a72 BYTE_ORDER MSB_LAST BIT_MASK 0x40 /end MEASUREMENT
/begin MEASUREMENT fmy_stat_acp_mes_grd.err_info_stat.lv_end_diag "end of diagnosis of the diagnosis instance ACP_MES_GRD" UWORD _CNV_S_2_RANGE______380_CM 1 0. 0. 1. DISPLAY_IDENTIFIER LV_END_DIAG_ACP_MES_GRD ECU_ADDRESS 0x7f9a72 BYTE_ORDER MSB_LAST BIT_MASK 0x20 /end MEASUREMENT
/begin MEASUREMENT fmy_stat_acp_mes_grd.err_info_stat.lv_cdn_diag "diagnosis condition of the diagnosis instance ACP_MES_GRD" UWORD _CNV_S_2_RANGE______380_CM 1 0. 0. 1. DISPLAY_IDENTIFIER LV_CDN_DIAG_ACP_MES_GRD ECU_ADDRESS 0x7f9a72 BYTE_ORDER MSB_LAST BIT_MASK 0x10 /end MEASUREMENT
/begin MEASUREMENT fmy_stat_acp_mes_grd.err_info_stat.err_sym "symptoms of the diagnosis instance ACP_MES_GRD" UWORD _CNV_S_6_CONV_ERRM__27_CM 1 0. 0. 15. DISPLAY_IDENTIFIER ERR_SYM_ACP_MES_GRD ECU_ADDRESS 0x7f9a72 BYTE_ORDER MSB_LAST BIT_MASK 0xF /end MEASUREMENT
/begin MEASUREMENT lv_err_v_tba_rng "Error flag of diagnosis instance V_TBA_RNG" UBYTE _CNV_S_2_RANGE______28_CM 1 0. 0. 1. DISPLAY_IDENTIFIER LV_ERR_V_TBA_RNG ECU_ADDRESS 0x7fb522 /end MEASUREMENT
/begin MEASUREMENT fmy_stat_v_tba_rng.ctr_abc "anti bounce counter for diagnosis instance V_TBA_RNG" UBYTE _CNV_A_R_LINEAR_____1_CM 1 0. 0. 255. DISPLAY_IDENTIFIER CTR_ABC_V_TBA_RNG ECU_ADDRESS 0x7f9a79 FORMAT "%3.0" /end MEASUREMENT
/begin MEASUREMENT fmy_stat_v_tba_rng.ctr_end_diag "counter for end of diagnosis for diagnosis instance V_TBA_RNG" UBYTE _CNV_A_R_LINEAR_____1_CM 1 0. 0. 255. DISPLAY_IDENTIFIER CTR_ABC_END_DIAG_V_TBA_RNG ECU_ADDRESS 0x7f9a78 FORMAT "%3.0" /end MEASUREMENT
/begin MEASUREMENT fmy_stat_v_tba_rng.err_info_stat.reserved "" UWORD _CNV_A_R_LINEAR_____0_CM 1 0. 0. 65535. DISPLAY_IDENTIFIER FMY_STAT_V_TBA_RNG_ERR_INFO_STAT ECU_ADDRESS 0x7f9a76 BYTE_ORDER MSB_LAST BIT_MASK 0xF800 /end MEASUREMENT
/begin MEASUREMENT fmy_stat_v_tba_rng.err_info_stat.lv_cdn_diag_stc "Statistical flag for condition of diagnosis of the diagnosis instance V_TBA_RNG" UWORD _CNV_S_2_RANGE______380_CM 1 0. 0. 1. DISPLAY_IDENTIFIER LV_CDN_DIAG_STC_V_TBA_RNG ECU_ADDRESS 0x7f9a76 BYTE_ORDER MSB_LAST BIT_MASK 0x400 /end MEASUREMENT
/begin MEASUREMENT fmy_stat_v_tba_rng.err_info_stat.lv_lock_diag "lock flag (CPU load optimisation) of the diagnosis instance V_TBA_RNG" UWORD _CNV_S_2_RANGE______380_CM 1 0. 0. 1. DISPLAY_IDENTIFIER LV_LOCK_DIAG_V_TBA_RNG ECU_ADDRESS 0x7f9a76 BYTE_ORDER MSB_LAST BIT_MASK 0x200 /end MEASUREMENT
/begin MEASUREMENT fmy_stat_v_tba_rng.err_info_stat.lv_err_mem "storage in dynamic failure memory of the diagnosis instance V_TBA_RNG" UWORD _CNV_S_2_RANGE______380_CM 1 0. 0. 1. DISPLAY_IDENTIFIER LV_ERR_MEM_V_TBA_RNG ECU_ADDRESS 0x7f9a76 BYTE_ORDER MSB_LAST BIT_MASK 0x80 /end MEASUREMENT
/begin MEASUREMENT fmy_stat_v_tba_rng.err_info_stat.lv_ready "readiness status of the diagnosis instance V_TBA_RNG" UWORD _CNV_S_2_RANGE______380_CM 1 0. 0. 1. DISPLAY_IDENTIFIER LV_READY_V_TBA_RNG ECU_ADDRESS 0x7f9a76 BYTE_ORDER MSB_LAST BIT_MASK 0x40 /end MEASUREMENT
/begin MEASUREMENT fmy_stat_v_tba_rng.err_info_stat.lv_end_diag "end of diagnosis of the diagnosis instance V_TBA_RNG" UWORD _CNV_S_2_RANGE______380_CM 1 0. 0. 1. DISPLAY_IDENTIFIER LV_END_DIAG_V_TBA_RNG ECU_ADDRESS 0x7f9a76 BYTE_ORDER MSB_LAST BIT_MASK 0x20 /end MEASUREMENT
/begin MEASUREMENT fmy_stat_v_tba_rng.err_info_stat.lv_cdn_diag "diagnosis condition of the diagnosis instance V_TBA_RNG" UWORD _CNV_S_2_RANGE______380_CM 1 0. 0. 1. DISPLAY_IDENTIFIER LV_CDN_DIAG_V_TBA_RNG ECU_ADDRESS 0x7f9a76 BYTE_ORDER MSB_LAST BIT_MASK 0x10 /end MEASUREMENT
/begin MEASUREMENT fmy_stat_v_tba_rng.err_info_stat.err_sym "symptoms of the diagnosis instance V_TBA_RNG" UWORD _CNV_S_6_CONV_ERRM__27_CM 1 0. 0. 15. DISPLAY_IDENTIFIER ERR_SYM_V_TBA_RNG ECU_ADDRESS 0x7f9a76 BYTE_ORDER MSB_LAST BIT_MASK 0xF /end MEASUREMENT
/begin MEASUREMENT lv_err_tba_mes_grd "Error flag of diagnosis instance TBA_MES_GRD" UBYTE _CNV_S_2_RANGE______28_CM 1 0. 0. 1. DISPLAY_IDENTIFIER LV_ERR_TBA_MES_GRD ECU_ADDRESS 0x7fb523 /end MEASUREMENT
/begin MEASUREMENT fmy_stat_tba_mes_grd.ctr_abc "anti bounce counter for diagnosis instance TBA_MES_GRD" UBYTE _CNV_A_R_LINEAR_____1_CM 1 0. 0. 255. DISPLAY_IDENTIFIER CTR_ABC_TBA_MES_GRD ECU_ADDRESS 0x7f9a7d FORMAT "%3.0" /end MEASUREMENT
/begin MEASUREMENT fmy_stat_tba_mes_grd.ctr_end_diag "counter for end of diagnosis for diagnosis instance TBA_MES_GRD" UBYTE _CNV_A_R_LINEAR_____1_CM 1 0. 0. 255. DISPLAY_IDENTIFIER CTR_ABC_END_DIAG_TBA_MES_GRD ECU_ADDRESS 0x7f9a7c FORMAT "%3.0" /end MEASUREMENT
/begin MEASUREMENT fmy_stat_tba_mes_grd.err_info_stat.reserved "" UWORD _CNV_A_R_LINEAR_____0_CM 1 0. 0. 65535. DISPLAY_IDENTIFIER FMY_STAT_TBA_MES_GRD_ERR_INFO_ST ECU_ADDRESS 0x7f9a7a BYTE_ORDER MSB_LAST BIT_MASK 0xF800 /end MEASUREMENT
/begin MEASUREMENT fmy_stat_tba_mes_grd.err_info_stat.lv_cdn_diag_stc "Statistical flag for condition of diagnosis of the diagnosis instance TBA_MES_GRD" UWORD _CNV_S_2_RANGE______380_CM 1 0. 0. 1. DISPLAY_IDENTIFIER LV_CDN_DIAG_STC_TBA_MES_GRD ECU_ADDRESS 0x7f9a7a BYTE_ORDER MSB_LAST BIT_MASK 0x400 /end MEASUREMENT
/begin MEASUREMENT fmy_stat_tba_mes_grd.err_info_stat.lv_lock_diag "lock flag (CPU load optimisation) of the diagnosis instance TBA_MES_GRD" UWORD _CNV_S_2_RANGE______380_CM 1 0. 0. 1. DISPLAY_IDENTIFIER LV_LOCK_DIAG_TBA_MES_GRD ECU_ADDRESS 0x7f9a7a BYTE_ORDER MSB_LAST BIT_MASK 0x200 /end MEASUREMENT
/begin MEASUREMENT fmy_stat_tba_mes_grd.err_info_stat.lv_err_mem "storage in dynamic failure memory of the diagnosis instance TBA_MES_GRD" UWORD _CNV_S_2_RANGE______380_CM 1 0. 0. 1. DISPLAY_IDENTIFIER LV_ERR_MEM_TBA_MES_GRD ECU_ADDRESS 0x7f9a7a BYTE_ORDER MSB_LAST BIT_MASK 0x80 /end MEASUREMENT
/begin MEASUREMENT fmy_stat_tba_mes_grd.err_info_stat.lv_ready "readiness status of the diagnosis instance TBA_MES_GRD" UWORD _CNV_S_2_RANGE______380_CM 1 0. 0. 1. DISPLAY_IDENTIFIER LV_READY_TBA_MES_GRD ECU_ADDRESS 0x7f9a7a BYTE_ORDER MSB_LAST BIT_MASK 0x40 /end MEASUREMENT
/begin MEASUREMENT fmy_stat_tba_mes_grd.err_info_stat.lv_end_diag "end of diagnosis of the diagnosis instance TBA_MES_GRD" UWORD _CNV_S_2_RANGE______380_CM 1 0. 0. 1. DISPLAY_IDENTIFIER LV_END_DIAG_TBA_MES_GRD ECU_ADDRESS 0x7f9a7a BYTE_ORDER MSB_LAST BIT_MASK 0x20 /end MEASUREMENT
/begin MEASUREMENT fmy_stat_tba_mes_grd.err_info_stat.lv_cdn_diag "diagnosis condition of the diagnosis instance TBA_MES_GRD" UWORD _CNV_S_2_RANGE______380_CM 1 0. 0. 1. DISPLAY_IDENTIFIER LV_CDN_DIAG_TBA_MES_GRD ECU_ADDRESS 0x7f9a7a BYTE_ORDER MSB_LAST BIT_MASK 0x10 /end MEASUREMENT
/begin MEASUREMENT fmy_stat_tba_mes_grd.err_info_stat.err_sym "symptoms of the diagnosis instance TBA_MES_GRD" UWORD _CNV_S_6_CONV_ERRM__27_CM 1 0. 0. 15. DISPLAY_IDENTIFIER ERR_SYM_TBA_MES_GRD ECU_ADDRESS 0x7f9a7a BYTE_ORDER MSB_LAST BIT_MASK 0xF /end MEASUREMENT
/begin MEASUREMENT lv_err_ducy_alter_pwm_rng "Error flag of diagnosis instance DUCY_ALTER_PWM_RNG" UBYTE _CNV_S_2_RANGE______28_CM 1 0. 0. 1. DISPLAY_IDENTIFIER LV_ERR_DUCY_ALTER_PWM_RNG ECU_ADDRESS 0x7fb524 /end MEASUREMENT
/begin MEASUREMENT fmy_stat_ducy_alter_pwm_rng.ctr_abc "anti bounce counter for diagnosis instance DUCY_ALTER_PWM_RNG" UBYTE _CNV_A_R_LINEAR_____1_CM 1 0. 0. 255. DISPLAY_IDENTIFIER CTR_ABC_DUCY_ALTER_PWM_RNG ECU_ADDRESS 0x7f9a81 FORMAT "%3.0" /end MEASUREMENT
/begin MEASUREMENT fmy_stat_ducy_alter_pwm_rng.ctr_end_diag "counter for end of diagnosis for diagnosis instance DUCY_ALTER_PWM_RNG" UBYTE _CNV_A_R_LINEAR_____1_CM 1 0. 0. 255. DISPLAY_IDENTIFIER CTR_ABC_END_DIAG_DUCY_ALTER_PWM_ ECU_ADDRESS 0x7f9a80 FORMAT "%3.0" /end MEASUREMENT
/begin MEASUREMENT fmy_stat_ducy_alter_pwm_rng.err_info_stat.reserved "" UWORD _CNV_A_R_LINEAR_____0_CM 1 0. 0. 65535. DISPLAY_IDENTIFIER FMY_STAT_DUCY_ALTER_PWM_RNG_ERR_ ECU_ADDRESS 0x7f9a7e BYTE_ORDER MSB_LAST BIT_MASK 0xF800 /end MEASUREMENT
/begin MEASUREMENT fmy_stat_ducy_alter_pwm_rng.err_info_stat.lv_cdn_diag_stc "Statistical flag for condition of diagnosis of the diagnosis instance DUCY_ALTER_PWM_RNG" UWORD _CNV_S_2_RANGE______380_CM 1 0. 0. 1. DISPLAY_IDENTIFIER LV_CDN_DIAG_STC_DUCY_ALTER_PWM_R ECU_ADDRESS 0x7f9a7e BYTE_ORDER MSB_LAST BIT_MASK 0x400 /end MEASUREMENT
/begin MEASUREMENT fmy_stat_ducy_alter_pwm_rng.err_info_stat.lv_lock_diag "lock flag (CPU load optimisation) of the diagnosis instance DUCY_ALTER_PWM_RNG" UWORD _CNV_S_2_RANGE______380_CM 1 0. 0. 1. DISPLAY_IDENTIFIER LV_LOCK_DIAG_DUCY_ALTER_PWM_RNG ECU_ADDRESS 0x7f9a7e BYTE_ORDER MSB_LAST BIT_MASK 0x200 /end MEASUREMENT
/begin MEASUREMENT fmy_stat_ducy_alter_pwm_rng.err_info_stat.lv_err_mem "storage in dynamic failure memory of the diagnosis instance DUCY_ALTER_PWM_RNG" UWORD _CNV_S_2_RANGE______380_CM 1 0. 0. 1. DISPLAY_IDENTIFIER LV_ERR_MEM_DUCY_ALTER_PWM_RNG ECU_ADDRESS 0x7f9a7e BYTE_ORDER MSB_LAST BIT_MASK 0x80 /end MEASUREMENT
/begin MEASUREMENT fmy_stat_ducy_alter_pwm_rng.err_info_stat.lv_ready "readiness status of the diagnosis instance DUCY_ALTER_PWM_RNG" UWORD _CNV_S_2_RANGE______380_CM 1 0. 0. 1. DISPLAY_IDENTIFIER LV_READY_DUCY_ALTER_PWM_RNG ECU_ADDRESS 0x7f9a7e BYTE_ORDER MSB_LAST BIT_MASK 0x40 /end MEASUREMENT
/begin MEASUREMENT fmy_stat_ducy_alter_pwm_rng.err_info_stat.lv_end_diag "end of diagnosis of the diagnosis instance DUCY_ALTER_PWM_RNG" UWORD _CNV_S_2_RANGE______380_CM 1 0. 0. 1. DISPLAY_IDENTIFIER LV_END_DIAG_DUCY_ALTER_PWM_RNG ECU_ADDRESS 0x7f9a7e BYTE_ORDER MSB_LAST BIT_MASK 0x20 /end MEASUREMENT
/begin MEASUREMENT fmy_stat_ducy_alter_pwm_rng.err_info_stat.lv_cdn_diag "diagnosis condition of the diagnosis instance DUCY_ALTER_PWM_RNG" UWORD _CNV_S_2_RANGE______380_CM 1 0. 0. 1. DISPLAY_IDENTIFIER LV_CDN_DIAG_DUCY_ALTER_PWM_RNG ECU_ADDRESS 0x7f9a7e BYTE_ORDER MSB_LAST BIT_MASK 0x10 /end MEASUREMENT
/begin MEASUREMENT fmy_stat_ducy_alter_pwm_rng.err_info_stat.err_sym "symptoms of the diagnosis instance DUCY_ALTER_PWM_RNG" UWORD _CNV_S_6_CONV_ERRM__27_CM 1 0. 0. 15. DISPLAY_IDENTIFIER ERR_SYM_DUCY_ALTER_PWM_RNG ECU_ADDRESS 0x7f9a7e BYTE_ORDER MSB_LAST BIT_MASK 0xF /end MEASUREMENT
/begin MEASUREMENT lv_err_ducy_alter_pwm_grd "Error flag of diagnosis instance DUCY_ALTER_PWM_GRD" UBYTE _CNV_S_2_RANGE______28_CM 1 0. 0. 1. DISPLAY_IDENTIFIER LV_ERR_DUCY_ALTER_PWM_GRD ECU_ADDRESS 0x7fb525 /end MEASUREMENT
/begin MEASUREMENT fmy_stat_ducy_alter_pwm_grd.ctr_abc "anti bounce counter for diagnosis instance DUCY_ALTER_PWM_GRD" UBYTE _CNV_A_R_LINEAR_____1_CM 1 0. 0. 255. DISPLAY_IDENTIFIER CTR_ABC_DUCY_ALTER_PWM_GRD ECU_ADDRESS 0x7f9a85 FORMAT "%3.0" /end MEASUREMENT
/begin MEASUREMENT fmy_stat_ducy_alter_pwm_grd.ctr_end_diag "counter for end of diagnosis for diagnosis instance DUCY_ALTER_PWM_GRD" UBYTE _CNV_A_R_LINEAR_____1_CM 1 0. 0. 255. DISPLAY_IDENTIFIER CTR_ABC_END_DIAG_DUCY_ALTER_PWM_ ECU_ADDRESS 0x7f9a84 FORMAT "%3.0" /end MEASUREMENT
/begin MEASUREMENT fmy_stat_ducy_alter_pwm_grd.err_info_stat.reserved "" UWORD _CNV_A_R_LINEAR_____0_CM 1 0. 0. 65535. DISPLAY_IDENTIFIER FMY_STAT_DUCY_ALTER_PWM_GRD_ERR_ ECU_ADDRESS 0x7f9a82 BYTE_ORDER MSB_LAST BIT_MASK 0xF800 /end MEASUREMENT
/begin MEASUREMENT fmy_stat_ducy_alter_pwm_grd.err_info_stat.lv_cdn_diag_stc "Statistical flag for condition of diagnosis of the diagnosis instance DUCY_ALTER_PWM_GRD" UWORD _CNV_S_2_RANGE______380_CM 1 0. 0. 1. DISPLAY_IDENTIFIER LV_CDN_DIAG_STC_DUCY_ALTER_PWM_G ECU_ADDRESS 0x7f9a82 BYTE_ORDER MSB_LAST BIT_MASK 0x400 /end MEASUREMENT
/begin MEASUREMENT fmy_stat_ducy_alter_pwm_grd.err_info_stat.lv_lock_diag "lock flag (CPU load optimisation) of the diagnosis instance DUCY_ALTER_PWM_GRD" UWORD _CNV_S_2_RANGE______380_CM 1 0. 0. 1. DISPLAY_IDENTIFIER LV_LOCK_DIAG_DUCY_ALTER_PWM_GRD ECU_ADDRESS 0x7f9a82 BYTE_ORDER MSB_LAST BIT_MASK 0x200 /end MEASUREMENT
/begin MEASUREMENT fmy_stat_ducy_alter_pwm_grd.err_info_stat.lv_err_mem "storage in dynamic failure memory of the diagnosis instance DUCY_ALTER_PWM_GRD" UWORD _CNV_S_2_RANGE______380_CM 1 0. 0. 1. DISPLAY_IDENTIFIER LV_ERR_MEM_DUCY_ALTER_PWM_GRD ECU_ADDRESS 0x7f9a82 BYTE_ORDER MSB_LAST BIT_MASK 0x80 /end MEASUREMENT
/begin MEASUREMENT fmy_stat_ducy_alter_pwm_grd.err_info_stat.lv_ready "readiness status of the diagnosis instance DUCY_ALTER_PWM_GRD" UWORD _CNV_S_2_RANGE______380_CM 1 0. 0. 1. DISPLAY_IDENTIFIER LV_READY_DUCY_ALTER_PWM_GRD ECU_ADDRESS 0x7f9a82 BYTE_ORDER MSB_LAST BIT_MASK 0x40 /end MEASUREMENT
/begin MEASUREMENT fmy_stat_ducy_alter_pwm_grd.err_info_stat.lv_end_diag "end of diagnosis of the diagnosis instance DUCY_ALTER_PWM_GRD" UWORD _CNV_S_2_RANGE______380_CM 1 0. 0. 1. DISPLAY_IDENTIFIER LV_END_DIAG_DUCY_ALTER_PWM_GRD ECU_ADDRESS 0x7f9a82 BYTE_ORDER MSB_LAST BIT_MASK 0x20 /end MEASUREMENT
/begin MEASUREMENT fmy_stat_ducy_alter_pwm_grd.err_info_stat.lv_cdn_diag "diagnosis condition of the diagnosis instance DUCY_ALTER_PWM_GRD" UWORD _CNV_S_2_RANGE______380_CM 1 0. 0. 1. DISPLAY_IDENTIFIER LV_CDN_DIAG_DUCY_ALTER_PWM_GRD ECU_ADDRESS 0x7f9a82 BYTE_ORDER MSB_LAST BIT_MASK 0x10 /end MEASUREMENT
/begin MEASUREMENT fmy_stat_ducy_alter_pwm_grd.err_info_stat.err_sym "symptoms of the diagnosis instance DUCY_ALTER_PWM_GRD" UWORD _CNV_S_6_CONV_ERRM__27_CM 1 0. 0. 15. DISPLAY_IDENTIFIER ERR_SYM_DUCY_ALTER_PWM_GRD ECU_ADDRESS 0x7f9a82 BYTE_ORDER MSB_LAST BIT_MASK 0xF /end MEASUREMENT
/begin MEASUREMENT lv_err_v_egrv_0_rng "Error flag of diagnosis instance V_EGRV_0_RNG" UBYTE _CNV_S_2_RANGE______28_CM 1 0. 0. 1. DISPLAY_IDENTIFIER LV_ERR_V_EGRV_0_RNG ECU_ADDRESS 0x7fb526 /end MEASUREMENT
/begin MEASUREMENT fmy_stat_v_egrv_0_rng.ctr_abc "anti bounce counter for diagnosis instance V_EGRV_0_RNG" UBYTE _CNV_A_R_LINEAR_____1_CM 1 0. 0. 255. DISPLAY_IDENTIFIER CTR_ABC_V_EGRV_0_RNG ECU_ADDRESS 0x7f9a89 FORMAT "%3.0" /end MEASUREMENT
/begin MEASUREMENT fmy_stat_v_egrv_0_rng.ctr_end_diag "counter for end of diagnosis for diagnosis instance V_EGRV_0_RNG" UBYTE _CNV_A_R_LINEAR_____1_CM 1 0. 0. 255. DISPLAY_IDENTIFIER CTR_ABC_END_DIAG_V_EGRV_0_RNG ECU_ADDRESS 0x7f9a88 FORMAT "%3.0" /end MEASUREMENT
/begin MEASUREMENT fmy_stat_v_egrv_0_rng.err_info_stat.reserved "" UWORD _CNV_A_R_LINEAR_____0_CM 1 0. 0. 65535. DISPLAY_IDENTIFIER FMY_STAT_V_EGRV_0_RNG_ERR_INFO_S ECU_ADDRESS 0x7f9a86 BYTE_ORDER MSB_LAST BIT_MASK 0xF800 /end MEASUREMENT
/begin MEASUREMENT fmy_stat_v_egrv_0_rng.err_info_stat.lv_cdn_diag_stc "Statistical flag for condition of diagnosis of the diagnosis instance V_EGRV_0_RNG" UWORD _CNV_S_2_RANGE______380_CM 1 0. 0. 1. DISPLAY_IDENTIFIER LV_CDN_DIAG_STC_V_EGRV_0_RNG ECU_ADDRESS 0x7f9a86 BYTE_ORDER MSB_LAST BIT_MASK 0x400 /end MEASUREMENT
/begin MEASUREMENT fmy_stat_v_egrv_0_rng.err_info_stat.lv_lock_diag "lock flag (CPU load optimisation) of the diagnosis instance V_EGRV_0_RNG" UWORD _CNV_S_2_RANGE______380_CM 1 0. 0. 1. DISPLAY_IDENTIFIER LV_LOCK_DIAG_V_EGRV_0_RNG ECU_ADDRESS 0x7f9a86 BYTE_ORDER MSB_LAST BIT_MASK 0x200 /end MEASUREMENT
/begin MEASUREMENT fmy_stat_v_egrv_0_rng.err_info_stat.lv_err_mem "storage in dynamic failure memory of the diagnosis instance V_EGRV_0_RNG" UWORD _CNV_S_2_RANGE______380_CM 1 0. 0. 1. DISPLAY_IDENTIFIER LV_ERR_MEM_V_EGRV_0_RNG ECU_ADDRESS 0x7f9a86 BYTE_ORDER MSB_LAST BIT_MASK 0x80 /end MEASUREMENT
/begin MEASUREMENT fmy_stat_v_egrv_0_rng.err_info_stat.lv_ready "readiness status of the diagnosis instance V_EGRV_0_RNG" UWORD _CNV_S_2_RANGE______380_CM 1 0. 0. 1. DISPLAY_IDENTIFIER LV_READY_V_EGRV_0_RNG ECU_ADDRESS 0x7f9a86 BYTE_ORDER MSB_LAST BIT_MASK 0x40 /end MEASUREMENT
/begin MEASUREMENT fmy_stat_v_egrv_0_rng.err_info_stat.lv_end_diag "end of diagnosis of the diagnosis instance V_EGRV_0_RNG" UWORD _CNV_S_2_RANGE______380_CM 1 0. 0. 1. DISPLAY_IDENTIFIER LV_END_DIAG_V_EGRV_0_RNG ECU_ADDRESS 0x7f9a86 BYTE_ORDER MSB_LAST BIT_MASK 0x20 /end MEASUREMENT
/begin MEASUREMENT fmy_stat_v_egrv_0_rng.err_info_stat.lv_cdn_diag "diagnosis condition of the diagnosis instance V_EGRV_0_RNG" UWORD _CNV_S_2_RANGE______380_CM 1 0. 0. 1. DISPLAY_IDENTIFIER LV_CDN_DIAG_V_EGRV_0_RNG ECU_ADDRESS 0x7f9a86 BYTE_ORDER MSB_LAST BIT_MASK 0x10 /end MEASUREMENT
/begin MEASUREMENT fmy_stat_v_egrv_0_rng.err_info_stat.err_sym "symptoms of the diagnosis instance V_EGRV_0_RNG" UWORD _CNV_S_6_CONV_ERRM__27_CM 1 0. 0. 15. DISPLAY_IDENTIFIER ERR_SYM_V_EGRV_0_RNG ECU_ADDRESS 0x7f9a86 BYTE_ORDER MSB_LAST BIT_MASK 0xF /end MEASUREMENT
/begin MEASUREMENT lv_err_v_egrv_1_rng "Error flag of diagnosis instance V_EGRV_1_RNG" UBYTE _CNV_S_2_RANGE______28_CM 1 0. 0. 1. DISPLAY_IDENTIFIER LV_ERR_V_EGRV_1_RNG ECU_ADDRESS 0x7fb527 /end MEASUREMENT
/begin MEASUREMENT fmy_stat_v_egrv_1_rng.ctr_abc "anti bounce counter for diagnosis instance V_EGRV_1_RNG" UBYTE _CNV_A_R_LINEAR_____1_CM 1 0. 0. 255. DISPLAY_IDENTIFIER CTR_ABC_V_EGRV_1_RNG ECU_ADDRESS 0x7f9a8d FORMAT "%3.0" /end MEASUREMENT
/begin MEASUREMENT fmy_stat_v_egrv_1_rng.ctr_end_diag "counter for end of diagnosis for diagnosis instance V_EGRV_1_RNG" UBYTE _CNV_A_R_LINEAR_____1_CM 1 0. 0. 255. DISPLAY_IDENTIFIER CTR_ABC_END_DIAG_V_EGRV_1_RNG ECU_ADDRESS 0x7f9a8c FORMAT "%3.0" /end MEASUREMENT
/begin MEASUREMENT fmy_stat_v_egrv_1_rng.err_info_stat.reserved "" UWORD _CNV_A_R_LINEAR_____0_CM 1 0. 0. 65535. DISPLAY_IDENTIFIER FMY_STAT_V_EGRV_1_RNG_ERR_INFO_S ECU_ADDRESS 0x7f9a8a BYTE_ORDER MSB_LAST BIT_MASK 0xF800 /end MEASUREMENT
/begin MEASUREMENT fmy_stat_v_egrv_1_rng.err_info_stat.lv_cdn_diag_stc "Statistical flag for condition of diagnosis of the diagnosis instance V_EGRV_1_RNG" UWORD _CNV_S_2_RANGE______380_CM 1 0. 0. 1. DISPLAY_IDENTIFIER LV_CDN_DIAG_STC_V_EGRV_1_RNG ECU_ADDRESS 0x7f9a8a BYTE_ORDER MSB_LAST BIT_MASK 0x400 /end MEASUREMENT
/begin MEASUREMENT fmy_stat_v_egrv_1_rng.err_info_stat.lv_lock_diag "lock flag (CPU load optimisation) of the diagnosis instance V_EGRV_1_RNG" UWORD _CNV_S_2_RANGE______380_CM 1 0. 0. 1. DISPLAY_IDENTIFIER LV_LOCK_DIAG_V_EGRV_1_RNG ECU_ADDRESS 0x7f9a8a BYTE_ORDER MSB_LAST BIT_MASK 0x200 /end MEASUREMENT
/begin MEASUREMENT fmy_stat_v_egrv_1_rng.err_info_stat.lv_err_mem "storage in dynamic failure memory of the diagnosis instance V_EGRV_1_RNG" UWORD _CNV_S_2_RANGE______380_CM 1 0. 0. 1. DISPLAY_IDENTIFIER LV_ERR_MEM_V_EGRV_1_RNG ECU_ADDRESS 0x7f9a8a BYTE_ORDER MSB_LAST BIT_MASK 0x80 /end MEASUREMENT
/begin MEASUREMENT fmy_stat_v_egrv_1_rng.err_info_stat.lv_ready "readiness status of the diagnosis instance V_EGRV_1_RNG" UWORD _CNV_S_2_RANGE______380_CM 1 0. 0. 1. DISPLAY_IDENTIFIER LV_READY_V_EGRV_1_RNG ECU_ADDRESS 0x7f9a8a BYTE_ORDER MSB_LAST BIT_MASK 0x40 /end MEASUREMENT
/begin MEASUREMENT fmy_stat_v_egrv_1_rng.err_info_stat.lv_end_diag "end of diagnosis of the diagnosis instance V_EGRV_1_RNG" UWORD _CNV_S_2_RANGE______380_CM 1 0. 0. 1. DISPLAY_IDENTIFIER LV_END_DIAG_V_EGRV_1_RNG ECU_ADDRESS 0x7f9a8a BYTE_ORDER MSB_LAST BIT_MASK 0x20 /end MEASUREMENT
/begin MEASUREMENT fmy_stat_v_egrv_1_rng.err_info_stat.lv_cdn_diag "diagnosis condition of the diagnosis instance V_EGRV_1_RNG" UWORD _CNV_S_2_RANGE______380_CM 1 0. 0. 1. DISPLAY_IDENTIFIER LV_CDN_DIAG_V_EGRV_1_RNG ECU_ADDRESS 0x7f9a8a BYTE_ORDER MSB_LAST BIT_MASK 0x10 /end MEASUREMENT
/begin MEASUREMENT fmy_stat_v_egrv_1_rng.err_info_stat.err_sym "symptoms of the diagnosis instance V_EGRV_1_RNG" UWORD _CNV_S_6_CONV_ERRM__27_CM 1 0. 0. 15. DISPLAY_IDENTIFIER ERR_SYM_V_EGRV_1_RNG ECU_ADDRESS 0x7f9a8a BYTE_ORDER MSB_LAST BIT_MASK 0xF /end MEASUREMENT
/begin MEASUREMENT lv_err_v_egrv_0_grd "Error flag of diagnosis instance V_EGRV_0_GRD" UBYTE _CNV_S_2_RANGE______28_CM 1 0. 0. 1. DISPLAY_IDENTIFIER LV_ERR_V_EGRV_0_GRD ECU_ADDRESS 0x7fb528 /end MEASUREMENT
/begin MEASUREMENT fmy_stat_v_egrv_0_grd.ctr_abc "anti bounce counter for diagnosis instance V_EGRV_0_GRD" UBYTE _CNV_A_R_LINEAR_____1_CM 1 0. 0. 255. DISPLAY_IDENTIFIER CTR_ABC_V_EGRV_0_GRD ECU_ADDRESS 0x7f9a91 FORMAT "%3.0" /end MEASUREMENT
/begin MEASUREMENT fmy_stat_v_egrv_0_grd.ctr_end_diag "counter for end of diagnosis for diagnosis instance V_EGRV_0_GRD" UBYTE _CNV_A_R_LINEAR_____1_CM 1 0. 0. 255. DISPLAY_IDENTIFIER CTR_ABC_END_DIAG_V_EGRV_0_GRD ECU_ADDRESS 0x7f9a90 FORMAT "%3.0" /end MEASUREMENT
/begin MEASUREMENT fmy_stat_v_egrv_0_grd.err_info_stat.reserved "" UWORD _CNV_A_R_LINEAR_____0_CM 1 0. 0. 65535. DISPLAY_IDENTIFIER FMY_STAT_V_EGRV_0_GRD_ERR_INFO_S ECU_ADDRESS 0x7f9a8e BYTE_ORDER MSB_LAST BIT_MASK 0xF800 /end MEASUREMENT
/begin MEASUREMENT fmy_stat_v_egrv_0_grd.err_info_stat.lv_cdn_diag_stc "Statistical flag for condition of diagnosis of the diagnosis instance V_EGRV_0_GRD" UWORD _CNV_S_2_RANGE______380_CM 1 0. 0. 1. DISPLAY_IDENTIFIER LV_CDN_DIAG_STC_V_EGRV_0_GRD ECU_ADDRESS 0x7f9a8e BYTE_ORDER MSB_LAST BIT_MASK 0x400 /end MEASUREMENT
/begin MEASUREMENT fmy_stat_v_egrv_0_grd.err_info_stat.lv_lock_diag "lock flag (CPU load optimisation) of the diagnosis instance V_EGRV_0_GRD" UWORD _CNV_S_2_RANGE______380_CM 1 0. 0. 1. DISPLAY_IDENTIFIER LV_LOCK_DIAG_V_EGRV_0_GRD ECU_ADDRESS 0x7f9a8e BYTE_ORDER MSB_LAST BIT_MASK 0x200 /end MEASUREMENT
/begin MEASUREMENT fmy_stat_v_egrv_0_grd.err_info_stat.lv_err_mem "storage in dynamic failure memory of the diagnosis instance V_EGRV_0_GRD" UWORD _CNV_S_2_RANGE______380_CM 1 0. 0. 1. DISPLAY_IDENTIFIER LV_ERR_MEM_V_EGRV_0_GRD ECU_ADDRESS 0x7f9a8e BYTE_ORDER MSB_LAST BIT_MASK 0x80 /end MEASUREMENT
/begin MEASUREMENT fmy_stat_v_egrv_0_grd.err_info_stat.lv_ready "readiness status of the diagnosis instance V_EGRV_0_GRD" UWORD _CNV_S_2_RANGE______380_CM 1 0. 0. 1. DISPLAY_IDENTIFIER LV_READY_V_EGRV_0_GRD ECU_ADDRESS 0x7f9a8e BYTE_ORDER MSB_LAST BIT_MASK 0x40 /end MEASUREMENT
/begin MEASUREMENT fmy_stat_v_egrv_0_grd.err_info_stat.lv_end_diag "end of diagnosis of the diagnosis instance V_EGRV_0_GRD" UWORD _CNV_S_2_RANGE______380_CM 1 0. 0. 1. DISPLAY_IDENTIFIER LV_END_DIAG_V_EGRV_0_GRD ECU_ADDRESS 0x7f9a8e BYTE_ORDER MSB_LAST BIT_MASK 0x20 /end MEASUREMENT
/begin MEASUREMENT fmy_stat_v_egrv_0_grd.err_info_stat.lv_cdn_diag "diagnosis condition of the diagnosis instance V_EGRV_0_GRD" UWORD _CNV_S_2_RANGE______380_CM 1 0. 0. 1. DISPLAY_IDENTIFIER LV_CDN_DIAG_V_EGRV_0_GRD ECU_ADDRESS 0x7f9a8e BYTE_ORDER MSB_LAST BIT_MASK 0x10 /end MEASUREMENT
/begin MEASUREMENT fmy_stat_v_egrv_0_grd.err_info_stat.err_sym "symptoms of the diagnosis instance V_EGRV_0_GRD" UWORD _CNV_S_6_CONV_ERRM__27_CM 1 0. 0. 15. DISPLAY_IDENTIFIER ERR_SYM_V_EGRV_0_GRD ECU_ADDRESS 0x7f9a8e BYTE_ORDER MSB_LAST BIT_MASK 0xF /end MEASUREMENT
/begin MEASUREMENT lv_err_v_egrv_1_grd "Error flag of diagnosis instance V_EGRV_1_GRD" UBYTE _CNV_S_2_RANGE______28_CM 1 0. 0. 1. DISPLAY_IDENTIFIER LV_ERR_V_EGRV_1_GRD ECU_ADDRESS 0x7fb529 /end MEASUREMENT
/begin MEASUREMENT fmy_stat_v_egrv_1_grd.ctr_abc "anti bounce counter for diagnosis instance V_EGRV_1_GRD" UBYTE _CNV_A_R_LINEAR_____1_CM 1 0. 0. 255. DISPLAY_IDENTIFIER CTR_ABC_V_EGRV_1_GRD ECU_ADDRESS 0x7f9a95 FORMAT "%3.0" /end MEASUREMENT
/begin MEASUREMENT fmy_stat_v_egrv_1_grd.ctr_end_diag "counter for end of diagnosis for diagnosis instance V_EGRV_1_GRD" UBYTE _CNV_A_R_LINEAR_____1_CM 1 0. 0. 255. DISPLAY_IDENTIFIER CTR_ABC_END_DIAG_V_EGRV_1_GRD ECU_ADDRESS 0x7f9a94 FORMAT "%3.0" /end MEASUREMENT
/begin MEASUREMENT fmy_stat_v_egrv_1_grd.err_info_stat.reserved "" UWORD _CNV_A_R_LINEAR_____0_CM 1 0. 0. 65535. DISPLAY_IDENTIFIER FMY_STAT_V_EGRV_1_GRD_ERR_INFO_S ECU_ADDRESS 0x7f9a92 BYTE_ORDER MSB_LAST BIT_MASK 0xF800 /end MEASUREMENT
/begin MEASUREMENT fmy_stat_v_egrv_1_grd.err_info_stat.lv_cdn_diag_stc "Statistical flag for condition of diagnosis of the diagnosis instance V_EGRV_1_GRD" UWORD _CNV_S_2_RANGE______380_CM 1 0. 0. 1. DISPLAY_IDENTIFIER LV_CDN_DIAG_STC_V_EGRV_1_GRD ECU_ADDRESS 0x7f9a92 BYTE_ORDER MSB_LAST BIT_MASK 0x400 /end MEASUREMENT
/begin MEASUREMENT fmy_stat_v_egrv_1_grd.err_info_stat.lv_lock_diag "lock flag (CPU load optimisation) of the diagnosis instance V_EGRV_1_GRD" UWORD _CNV_S_2_RANGE______380_CM 1 0. 0. 1. DISPLAY_IDENTIFIER LV_LOCK_DIAG_V_EGRV_1_GRD ECU_ADDRESS 0x7f9a92 BYTE_ORDER MSB_LAST BIT_MASK 0x200 /end MEASUREMENT
/begin MEASUREMENT fmy_stat_v_egrv_1_grd.err_info_stat.lv_err_mem "storage in dynamic failure memory of the diagnosis instance V_EGRV_1_GRD" UWORD _CNV_S_2_RANGE______380_CM 1 0. 0. 1. DISPLAY_IDENTIFIER LV_ERR_MEM_V_EGRV_1_GRD ECU_ADDRESS 0x7f9a92 BYTE_ORDER MSB_LAST BIT_MASK 0x80 /end MEASUREMENT
/begin MEASUREMENT fmy_stat_v_egrv_1_grd.err_info_stat.lv_ready "readiness status of the diagnosis instance V_EGRV_1_GRD" UWORD _CNV_S_2_RANGE______380_CM 1 0. 0. 1. DISPLAY_IDENTIFIER LV_READY_V_EGRV_1_GRD ECU_ADDRESS 0x7f9a92 BYTE_ORDER MSB_LAST BIT_MASK 0x40 /end MEASUREMENT
/begin MEASUREMENT fmy_stat_v_egrv_1_grd.err_info_stat.lv_end_diag "end of diagnosis of the diagnosis instance V_EGRV_1_GRD" UWORD _CNV_S_2_RANGE______380_CM 1 0. 0. 1. DISPLAY_IDENTIFIER LV_END_DIAG_V_EGRV_1_GRD ECU_ADDRESS 0x7f9a92 BYTE_ORDER MSB_LAST BIT_MASK 0x20 /end MEASUREMENT
/begin MEASUREMENT fmy_stat_v_egrv_1_grd.err_info_stat.lv_cdn_diag "diagnosis condition of the diagnosis instance V_EGRV_1_GRD" UWORD _CNV_S_2_RANGE______380_CM 1 0. 0. 1. DISPLAY_IDENTIFIER LV_CDN_DIAG_V_EGRV_1_GRD ECU_ADDRESS 0x7f9a92 BYTE_ORDER MSB_LAST BIT_MASK 0x10 /end MEASUREMENT
/begin MEASUREMENT fmy_stat_v_egrv_1_grd.err_info_stat.err_sym "symptoms of the diagnosis instance V_EGRV_1_GRD" UWORD _CNV_S_6_CONV_ERRM__27_CM 1 0. 0. 15. DISPLAY_IDENTIFIER ERR_SYM_V_EGRV_1_GRD ECU_ADDRESS 0x7f9a92 BYTE_ORDER MSB_LAST BIT_MASK 0xF /end MEASUREMENT
/begin MEASUREMENT lv_err_ges_maf_0_max "Error flag of diagnosis instance GES_MAF_0_MAX" UBYTE _CNV_S_2_RANGE______28_CM 1 0. 0. 1. DISPLAY_IDENTIFIER LV_ERR_GES_MAF_0_MAX ECU_ADDRESS 0x7fb52a /end MEASUREMENT
/begin MEASUREMENT fmy_stat_ges_maf_0_max.ctr_abc "anti bounce counter for diagnosis instance GES_MAF_0_MAX" UBYTE _CNV_A_R_LINEAR_____1_CM 1 0. 0. 255. DISPLAY_IDENTIFIER CTR_ABC_GES_MAF_0_MAX ECU_ADDRESS 0x7f9a99 FORMAT "%3.0" /end MEASUREMENT
/begin MEASUREMENT fmy_stat_ges_maf_0_max.ctr_end_diag "counter for end of diagnosis for diagnosis instance GES_MAF_0_MAX" UBYTE _CNV_A_R_LINEAR_____1_CM 1 0. 0. 255. DISPLAY_IDENTIFIER CTR_ABC_END_DIAG_GES_MAF_0_MAX ECU_ADDRESS 0x7f9a98 FORMAT "%3.0" /end MEASUREMENT
/begin MEASUREMENT fmy_stat_ges_maf_0_max.err_info_stat.reserved "" UWORD _CNV_A_R_LINEAR_____0_CM 1 0. 0. 65535. DISPLAY_IDENTIFIER FMY_STAT_GES_MAF_0_MAX_ERR_INFO_ ECU_ADDRESS 0x7f9a96 BYTE_ORDER MSB_LAST BIT_MASK 0xF800 /end MEASUREMENT
/begin MEASUREMENT fmy_stat_ges_maf_0_max.err_info_stat.lv_cdn_diag_stc "Statistical flag for condition of diagnosis of the diagnosis instance GES_MAF_0_MAX" UWORD _CNV_S_2_RANGE______380_CM 1 0. 0. 1. DISPLAY_IDENTIFIER LV_CDN_DIAG_STC_GES_MAF_0_MAX ECU_ADDRESS 0x7f9a96 BYTE_ORDER MSB_LAST BIT_MASK 0x400 /end MEASUREMENT
/begin MEASUREMENT fmy_stat_ges_maf_0_max.err_info_stat.lv_lock_diag "lock flag (CPU load optimisation) of the diagnosis instance GES_MAF_0_MAX" UWORD _CNV_S_2_RANGE______380_CM 1 0. 0. 1. DISPLAY_IDENTIFIER LV_LOCK_DIAG_GES_MAF_0_MAX ECU_ADDRESS 0x7f9a96 BYTE_ORDER MSB_LAST BIT_MASK 0x200 /end MEASUREMENT
/begin MEASUREMENT fmy_stat_ges_maf_0_max.err_info_stat.lv_err_mem "storage in dynamic failure memory of the diagnosis instance GES_MAF_0_MAX" UWORD _CNV_S_2_RANGE______380_CM 1 0. 0. 1. DISPLAY_IDENTIFIER LV_ERR_MEM_GES_MAF_0_MAX ECU_ADDRESS 0x7f9a96 BYTE_ORDER MSB_LAST BIT_MASK 0x80 /end MEASUREMENT
/begin MEASUREMENT fmy_stat_ges_maf_0_max.err_info_stat.lv_ready "readiness status of the diagnosis instance GES_MAF_0_MAX" UWORD _CNV_S_2_RANGE______380_CM 1 0. 0. 1. DISPLAY_IDENTIFIER LV_READY_GES_MAF_0_MAX ECU_ADDRESS 0x7f9a96 BYTE_ORDER MSB_LAST BIT_MASK 0x40 /end MEASUREMENT
/begin MEASUREMENT fmy_stat_ges_maf_0_max.err_info_stat.lv_end_diag "end of diagnosis of the diagnosis instance GES_MAF_0_MAX" UWORD _CNV_S_2_RANGE______380_CM 1 0. 0. 1. DISPLAY_IDENTIFIER LV_END_DIAG_GES_MAF_0_MAX ECU_ADDRESS 0x7f9a96 BYTE_ORDER MSB_LAST BIT_MASK 0x20 /end MEASUREMENT
/begin MEASUREMENT fmy_stat_ges_maf_0_max.err_info_stat.lv_cdn_diag "diagnosis condition of the diagnosis instance GES_MAF_0_MAX" UWORD _CNV_S_2_RANGE______380_CM 1 0. 0. 1. DISPLAY_IDENTIFIER LV_CDN_DIAG_GES_MAF_0_MAX ECU_ADDRESS 0x7f9a96 BYTE_ORDER MSB_LAST BIT_MASK 0x10 /end MEASUREMENT
/begin MEASUREMENT fmy_stat_ges_maf_0_max.err_info_stat.err_sym "symptoms of the diagnosis instance GES_MAF_0_MAX" UWORD _CNV_S_6_CONV_ERRM__27_CM 1 0. 0. 15. DISPLAY_IDENTIFIER ERR_SYM_GES_MAF_0_MAX ECU_ADDRESS 0x7f9a96 BYTE_ORDER MSB_LAST BIT_MASK 0xF /end MEASUREMENT
/begin MEASUREMENT lv_err_tco_1_2_plaus "Error flag of diagnosis instance TCO_1_2_PLAUS" UBYTE _CNV_S_2_RANGE______28_CM 1 0. 0. 1. DISPLAY_IDENTIFIER LV_ERR_TCO_1_2_PLAUS ECU_ADDRESS 0x7fb52b /end MEASUREMENT
/begin MEASUREMENT fmy_stat_tco_1_2_plaus.ctr_abc "anti bounce counter for diagnosis instance TCO_1_2_PLAUS" UBYTE _CNV_A_R_LINEAR_____1_CM 1 0. 0. 255. DISPLAY_IDENTIFIER CTR_ABC_TCO_1_2_PLAUS ECU_ADDRESS 0x7f9a9d FORMAT "%3.0" /end MEASUREMENT
/begin MEASUREMENT fmy_stat_tco_1_2_plaus.ctr_end_diag "counter for end of diagnosis for diagnosis instance TCO_1_2_PLAUS" UBYTE _CNV_A_R_LINEAR_____1_CM 1 0. 0. 255. DISPLAY_IDENTIFIER CTR_ABC_END_DIAG_TCO_1_2_PLAUS ECU_ADDRESS 0x7f9a9c FORMAT "%3.0" /end MEASUREMENT
/begin MEASUREMENT fmy_stat_tco_1_2_plaus.err_info_stat.reserved "" UWORD _CNV_A_R_LINEAR_____0_CM 1 0. 0. 65535. DISPLAY_IDENTIFIER FMY_STAT_TCO_1_2_PLAUS_ERR_INFO_ ECU_ADDRESS 0x7f9a9a BYTE_ORDER MSB_LAST BIT_MASK 0xF800 /end MEASUREMENT
/begin MEASUREMENT fmy_stat_tco_1_2_plaus.err_info_stat.lv_cdn_diag_stc "Statistical flag for condition of diagnosis of the diagnosis instance TCO_1_2_PLAUS" UWORD _CNV_S_2_RANGE______380_CM 1 0. 0. 1. DISPLAY_IDENTIFIER LV_CDN_DIAG_STC_TCO_1_2_PLAUS ECU_ADDRESS 0x7f9a9a BYTE_ORDER MSB_LAST BIT_MASK 0x400 /end MEASUREMENT
/begin MEASUREMENT fmy_stat_tco_1_2_plaus.err_info_stat.lv_lock_diag "lock flag (CPU load optimisation) of the diagnosis instance TCO_1_2_PLAUS" UWORD _CNV_S_2_RANGE______380_CM 1 0. 0. 1. DISPLAY_IDENTIFIER LV_LOCK_DIAG_TCO_1_2_PLAUS ECU_ADDRESS 0x7f9a9a BYTE_ORDER MSB_LAST BIT_MASK 0x200 /end MEASUREMENT
/begin MEASUREMENT fmy_stat_tco_1_2_plaus.err_info_stat.lv_err_mem "storage in dynamic failure memory of the diagnosis instance TCO_1_2_PLAUS" UWORD _CNV_S_2_RANGE______380_CM 1 0. 0. 1. DISPLAY_IDENTIFIER LV_ERR_MEM_TCO_1_2_PLAUS ECU_ADDRESS 0x7f9a9a BYTE_ORDER MSB_LAST BIT_MASK 0x80 /end MEASUREMENT
/begin MEASUREMENT fmy_stat_tco_1_2_plaus.err_info_stat.lv_ready "readiness status of the diagnosis instance TCO_1_2_PLAUS" UWORD _CNV_S_2_RANGE______380_CM 1 0. 0. 1. DISPLAY_IDENTIFIER LV_READY_TCO_1_2_PLAUS ECU_ADDRESS 0x7f9a9a BYTE_ORDER MSB_LAST BIT_MASK 0x40 /end MEASUREMENT
/begin MEASUREMENT fmy_stat_tco_1_2_plaus.err_info_stat.lv_end_diag "end of diagnosis of the diagnosis instance TCO_1_2_PLAUS" UWORD _CNV_S_2_RANGE______380_CM 1 0. 0. 1. DISPLAY_IDENTIFIER LV_END_DIAG_TCO_1_2_PLAUS ECU_ADDRESS 0x7f9a9a BYTE_ORDER MSB_LAST BIT_MASK 0x20 /end MEASUREMENT
/begin MEASUREMENT fmy_stat_tco_1_2_plaus.err_info_stat.lv_cdn_diag "diagnosis condition of the diagnosis instance TCO_1_2_PLAUS" UWORD _CNV_S_2_RANGE______380_CM 1 0. 0. 1. DISPLAY_IDENTIFIER LV_CDN_DIAG_TCO_1_2_PLAUS ECU_ADDRESS 0x7f9a9a BYTE_ORDER MSB_LAST BIT_MASK 0x10 /end MEASUREMENT
/begin MEASUREMENT fmy_stat_tco_1_2_plaus.err_info_stat.err_sym "symptoms of the diagnosis instance TCO_1_2_PLAUS" UWORD _CNV_S_6_CONV_ERRM__27_CM 1 0. 0. 15. DISPLAY_IDENTIFIER ERR_SYM_TCO_1_2_PLAUS ECU_ADDRESS 0x7f9a9a BYTE_ORDER MSB_LAST BIT_MASK 0xF /end MEASUREMENT
/begin MEASUREMENT lv_err_efp_rly_dps "Error flag of diagnosis instance EFP_RLY_DPS" UBYTE _CNV_S_2_RANGE______28_CM 1 0. 0. 1. DISPLAY_IDENTIFIER LV_ERR_EFP_RLY_DPS ECU_ADDRESS 0x7fb52c /end MEASUREMENT
/begin MEASUREMENT fmy_stat_efp_rly_dps.ctr_abc "anti bounce counter for diagnosis instance EFP_RLY_DPS" UBYTE _CNV_A_R_LINEAR_____1_CM 1 0. 0. 255. DISPLAY_IDENTIFIER CTR_ABC_EFP_RLY_DPS ECU_ADDRESS 0x7f9aa1 FORMAT "%3.0" /end MEASUREMENT
/begin MEASUREMENT fmy_stat_efp_rly_dps.ctr_end_diag "counter for end of diagnosis for diagnosis instance EFP_RLY_DPS" UBYTE _CNV_A_R_LINEAR_____1_CM 1 0. 0. 255. DISPLAY_IDENTIFIER CTR_ABC_END_DIAG_EFP_RLY_DPS ECU_ADDRESS 0x7f9aa0 FORMAT "%3.0" /end MEASUREMENT
/begin MEASUREMENT fmy_stat_efp_rly_dps.err_info_stat.reserved "" UWORD _CNV_A_R_LINEAR_____0_CM 1 0. 0. 65535. DISPLAY_IDENTIFIER FMY_STAT_EFP_RLY_DPS_ERR_INFO_ST ECU_ADDRESS 0x7f9a9e BYTE_ORDER MSB_LAST BIT_MASK 0xF800 /end MEASUREMENT
/begin MEASUREMENT fmy_stat_efp_rly_dps.err_info_stat.lv_cdn_diag_stc "Statistical flag for condition of diagnosis of the diagnosis instance EFP_RLY_DPS" UWORD _CNV_S_2_RANGE______380_CM 1 0. 0. 1. DISPLAY_IDENTIFIER LV_CDN_DIAG_STC_EFP_RLY_DPS ECU_ADDRESS 0x7f9a9e BYTE_ORDER MSB_LAST BIT_MASK 0x400 /end MEASUREMENT
/begin MEASUREMENT fmy_stat_efp_rly_dps.err_info_stat.lv_lock_diag "lock flag (CPU load optimisation) of the diagnosis instance EFP_RLY_DPS" UWORD _CNV_S_2_RANGE______380_CM 1 0. 0. 1. DISPLAY_IDENTIFIER LV_LOCK_DIAG_EFP_RLY_DPS ECU_ADDRESS 0x7f9a9e BYTE_ORDER MSB_LAST BIT_MASK 0x200 /end MEASUREMENT
/begin MEASUREMENT fmy_stat_efp_rly_dps.err_info_stat.lv_err_mem "storage in dynamic failure memory of the diagnosis instance EFP_RLY_DPS" UWORD _CNV_S_2_RANGE______380_CM 1 0. 0. 1. DISPLAY_IDENTIFIER LV_ERR_MEM_EFP_RLY_DPS ECU_ADDRESS 0x7f9a9e BYTE_ORDER MSB_LAST BIT_MASK 0x80 /end MEASUREMENT
/begin MEASUREMENT fmy_stat_efp_rly_dps.err_info_stat.lv_ready "readiness status of the diagnosis instance EFP_RLY_DPS" UWORD _CNV_S_2_RANGE______380_CM 1 0. 0. 1. DISPLAY_IDENTIFIER LV_READY_EFP_RLY_DPS ECU_ADDRESS 0x7f9a9e BYTE_ORDER MSB_LAST BIT_MASK 0x40 /end MEASUREMENT
/begin MEASUREMENT fmy_stat_efp_rly_dps.err_info_stat.lv_end_diag "end of diagnosis of the diagnosis instance EFP_RLY_DPS" UWORD _CNV_S_2_RANGE______380_CM 1 0. 0. 1. DISPLAY_IDENTIFIER LV_END_DIAG_EFP_RLY_DPS ECU_ADDRESS 0x7f9a9e BYTE_ORDER MSB_LAST BIT_MASK 0x20 /end MEASUREMENT
/begin MEASUREMENT fmy_stat_efp_rly_dps.err_info_stat.lv_cdn_diag "diagnosis condition of the diagnosis instance EFP_RLY_DPS" UWORD _CNV_S_2_RANGE______380_CM 1 0. 0. 1. DISPLAY_IDENTIFIER LV_CDN_DIAG_EFP_RLY_DPS ECU_ADDRESS 0x7f9a9e BYTE_ORDER MSB_LAST BIT_MASK 0x10 /end MEASUREMENT
/begin MEASUREMENT fmy_stat_efp_rly_dps.err_info_stat.err_sym "symptoms of the diagnosis instance EFP_RLY_DPS" UWORD _CNV_S_6_CONV_ERRM__27_CM 1 0. 0. 15. DISPLAY_IDENTIFIER ERR_SYM_EFP_RLY_DPS ECU_ADDRESS 0x7f9a9e BYTE_ORDER MSB_LAST BIT_MASK 0xF /end MEASUREMENT
/begin MEASUREMENT lv_err_efp_rly_plaus_1 "Error flag of diagnosis instance EFP_RLY_PLAUS_1" UBYTE _CNV_S_2_RANGE______28_CM 1 0. 0. 1. DISPLAY_IDENTIFIER LV_ERR_EFP_RLY_PLAUS_1 ECU_ADDRESS 0x7fb52d /end MEASUREMENT
/begin MEASUREMENT fmy_stat_efp_rly_plaus_1.ctr_abc "anti bounce counter for diagnosis instance EFP_RLY_PLAUS_1" UBYTE _CNV_A_R_LINEAR_____1_CM 1 0. 0. 255. DISPLAY_IDENTIFIER CTR_ABC_EFP_RLY_PLAUS_1 ECU_ADDRESS 0x7f9aa5 FORMAT "%3.0" /end MEASUREMENT
/begin MEASUREMENT fmy_stat_efp_rly_plaus_1.ctr_end_diag "counter for end of diagnosis for diagnosis instance EFP_RLY_PLAUS_1" UBYTE _CNV_A_R_LINEAR_____1_CM 1 0. 0. 255. DISPLAY_IDENTIFIER CTR_ABC_END_DIAG_EFP_RLY_PLAUS_1 ECU_ADDRESS 0x7f9aa4 FORMAT "%3.0" /end MEASUREMENT
/begin MEASUREMENT fmy_stat_efp_rly_plaus_1.err_info_stat.reserved "" UWORD _CNV_A_R_LINEAR_____0_CM 1 0. 0. 65535. DISPLAY_IDENTIFIER FMY_STAT_EFP_RLY_PLAUS_1_ERR_INF ECU_ADDRESS 0x7f9aa2 BYTE_ORDER MSB_LAST BIT_MASK 0xF800 /end MEASUREMENT
/begin MEASUREMENT fmy_stat_efp_rly_plaus_1.err_info_stat.lv_cdn_diag_stc "Statistical flag for condition of diagnosis of the diagnosis instance EFP_RLY_PLAUS_1" UWORD _CNV_S_2_RANGE______380_CM 1 0. 0. 1. DISPLAY_IDENTIFIER LV_CDN_DIAG_STC_EFP_RLY_PLAUS_1 ECU_ADDRESS 0x7f9aa2 BYTE_ORDER MSB_LAST BIT_MASK 0x400 /end MEASUREMENT
/begin MEASUREMENT fmy_stat_efp_rly_plaus_1.err_info_stat.lv_lock_diag "lock flag (CPU load optimisation) of the diagnosis instance EFP_RLY_PLAUS_1" UWORD _CNV_S_2_RANGE______380_CM 1 0. 0. 1. DISPLAY_IDENTIFIER LV_LOCK_DIAG_EFP_RLY_PLAUS_1 ECU_ADDRESS 0x7f9aa2 BYTE_ORDER MSB_LAST BIT_MASK 0x200 /end MEASUREMENT
/begin MEASUREMENT fmy_stat_efp_rly_plaus_1.err_info_stat.lv_err_mem "storage in dynamic failure memory of the diagnosis instance EFP_RLY_PLAUS_1" UWORD _CNV_S_2_RANGE______380_CM 1 0. 0. 1. DISPLAY_IDENTIFIER LV_ERR_MEM_EFP_RLY_PLAUS_1 ECU_ADDRESS 0x7f9aa2 BYTE_ORDER MSB_LAST BIT_MASK 0x80 /end MEASUREMENT
/begin MEASUREMENT fmy_stat_efp_rly_plaus_1.err_info_stat.lv_ready "readiness status of the diagnosis instance EFP_RLY_PLAUS_1" UWORD _CNV_S_2_RANGE______380_CM 1 0. 0. 1. DISPLAY_IDENTIFIER LV_READY_EFP_RLY_PLAUS_1 ECU_ADDRESS 0x7f9aa2 BYTE_ORDER MSB_LAST BIT_MASK 0x40 /end MEASUREMENT
/begin MEASUREMENT fmy_stat_efp_rly_plaus_1.err_info_stat.lv_end_diag "end of diagnosis of the diagnosis instance EFP_RLY_PLAUS_1" UWORD _CNV_S_2_RANGE______380_CM 1 0. 0. 1. DISPLAY_IDENTIFIER LV_END_DIAG_EFP_RLY_PLAUS_1 ECU_ADDRESS 0x7f9aa2 BYTE_ORDER MSB_LAST BIT_MASK 0x20 /end MEASUREMENT
/begin MEASUREMENT fmy_stat_efp_rly_plaus_1.err_info_stat.lv_cdn_diag "diagnosis condition of the diagnosis instance EFP_RLY_PLAUS_1" UWORD _CNV_S_2_RANGE______380_CM 1 0. 0. 1. DISPLAY_IDENTIFIER LV_CDN_DIAG_EFP_RLY_PLAUS_1 ECU_ADDRESS 0x7f9aa2 BYTE_ORDER MSB_LAST BIT_MASK 0x10 /end MEASUREMENT
/begin MEASUREMENT fmy_stat_efp_rly_plaus_1.err_info_stat.err_sym "symptoms of the diagnosis instance EFP_RLY_PLAUS_1" UWORD _CNV_S_6_CONV_ERRM__27_CM 1 0. 0. 15. DISPLAY_IDENTIFIER ERR_SYM_EFP_RLY_PLAUS_1 ECU_ADDRESS 0x7f9aa2 BYTE_ORDER MSB_LAST BIT_MASK 0xF /end MEASUREMENT
/begin MEASUREMENT lv_err_efp_rly_plaus_2 "Error flag of diagnosis instance EFP_RLY_PLAUS_2" UBYTE _CNV_S_2_RANGE______28_CM 1 0. 0. 1. DISPLAY_IDENTIFIER LV_ERR_EFP_RLY_PLAUS_2 ECU_ADDRESS 0x7fb52e /end MEASUREMENT
/begin MEASUREMENT fmy_stat_efp_rly_plaus_2.ctr_abc "anti bounce counter for diagnosis instance EFP_RLY_PLAUS_2" UBYTE _CNV_A_R_LINEAR_____1_CM 1 0. 0. 255. DISPLAY_IDENTIFIER CTR_ABC_EFP_RLY_PLAUS_2 ECU_ADDRESS 0x7f9aa9 FORMAT "%3.0" /end MEASUREMENT
/begin MEASUREMENT fmy_stat_efp_rly_plaus_2.ctr_end_diag "counter for end of diagnosis for diagnosis instance EFP_RLY_PLAUS_2" UBYTE _CNV_A_R_LINEAR_____1_CM 1 0. 0. 255. DISPLAY_IDENTIFIER CTR_ABC_END_DIAG_EFP_RLY_PLAUS_2 ECU_ADDRESS 0x7f9aa8 FORMAT "%3.0" /end MEASUREMENT
/begin MEASUREMENT fmy_stat_efp_rly_plaus_2.err_info_stat.reserved "" UWORD _CNV_A_R_LINEAR_____0_CM 1 0. 0. 65535. DISPLAY_IDENTIFIER FMY_STAT_EFP_RLY_PLAUS_2_ERR_INF ECU_ADDRESS 0x7f9aa6 BYTE_ORDER MSB_LAST BIT_MASK 0xF800 /end MEASUREMENT
/begin MEASUREMENT fmy_stat_efp_rly_plaus_2.err_info_stat.lv_cdn_diag_stc "Statistical flag for condition of diagnosis of the diagnosis instance EFP_RLY_PLAUS_2" UWORD _CNV_S_2_RANGE______380_CM 1 0. 0. 1. DISPLAY_IDENTIFIER LV_CDN_DIAG_STC_EFP_RLY_PLAUS_2 ECU_ADDRESS 0x7f9aa6 BYTE_ORDER MSB_LAST BIT_MASK 0x400 /end MEASUREMENT
/begin MEASUREMENT fmy_stat_efp_rly_plaus_2.err_info_stat.lv_lock_diag "lock flag (CPU load optimisation) of the diagnosis instance EFP_RLY_PLAUS_2" UWORD _CNV_S_2_RANGE______380_CM 1 0. 0. 1. DISPLAY_IDENTIFIER LV_LOCK_DIAG_EFP_RLY_PLAUS_2 ECU_ADDRESS 0x7f9aa6 BYTE_ORDER MSB_LAST BIT_MASK 0x200 /end MEASUREMENT
/begin MEASUREMENT fmy_stat_efp_rly_plaus_2.err_info_stat.lv_err_mem "storage in dynamic failure memory of the diagnosis instance EFP_RLY_PLAUS_2" UWORD _CNV_S_2_RANGE______380_CM 1 0. 0. 1. DISPLAY_IDENTIFIER LV_ERR_MEM_EFP_RLY_PLAUS_2 ECU_ADDRESS 0x7f9aa6 BYTE_ORDER MSB_LAST BIT_MASK 0x80 /end MEASUREMENT
/begin MEASUREMENT fmy_stat_efp_rly_plaus_2.err_info_stat.lv_ready "readiness status of the diagnosis instance EFP_RLY_PLAUS_2" UWORD _CNV_S_2_RANGE______380_CM 1 0. 0. 1. DISPLAY_IDENTIFIER LV_READY_EFP_RLY_PLAUS_2 ECU_ADDRESS 0x7f9aa6 BYTE_ORDER MSB_LAST BIT_MASK 0x40 /end MEASUREMENT
/begin MEASUREMENT fmy_stat_efp_rly_plaus_2.err_info_stat.lv_end_diag "end of diagnosis of the diagnosis instance EFP_RLY_PLAUS_2" UWORD _CNV_S_2_RANGE______380_CM 1 0. 0. 1. DISPLAY_IDENTIFIER LV_END_DIAG_EFP_RLY_PLAUS_2 ECU_ADDRESS 0x7f9aa6 BYTE_ORDER MSB_LAST BIT_MASK 0x20 /end MEASUREMENT
/begin MEASUREMENT fmy_stat_efp_rly_plaus_2.err_info_stat.lv_cdn_diag "diagnosis condition of the diagnosis instance EFP_RLY_PLAUS_2" UWORD _CNV_S_2_RANGE______380_CM 1 0. 0. 1. DISPLAY_IDENTIFIER LV_CDN_DIAG_EFP_RLY_PLAUS_2 ECU_ADDRESS 0x7f9aa6 BYTE_ORDER MSB_LAST BIT_MASK 0x10 /end MEASUREMENT
/begin MEASUREMENT fmy_stat_efp_rly_plaus_2.err_info_stat.err_sym "symptoms of the diagnosis instance EFP_RLY_PLAUS_2" UWORD _CNV_S_6_CONV_ERRM__27_CM 1 0. 0. 15. DISPLAY_IDENTIFIER ERR_SYM_EFP_RLY_PLAUS_2 ECU_ADDRESS 0x7f9aa6 BYTE_ORDER MSB_LAST BIT_MASK 0xF /end MEASUREMENT
/begin MEASUREMENT lv_err_spi_mps "Error flag of diagnosis instance SPI_MPS" UBYTE _CNV_S_2_RANGE______28_CM 1 0. 0. 1. DISPLAY_IDENTIFIER LV_ERR_SPI_MPS ECU_ADDRESS 0x7fb52f /end MEASUREMENT
/begin MEASUREMENT fmy_stat_spi_mps.ctr_abc "anti bounce counter for diagnosis instance SPI_MPS" UBYTE _CNV_A_R_LINEAR_____1_CM 1 0. 0. 255. DISPLAY_IDENTIFIER CTR_ABC_SPI_MPS ECU_ADDRESS 0x7f9aad FORMAT "%3.0" /end MEASUREMENT
/begin MEASUREMENT fmy_stat_spi_mps.ctr_end_diag "counter for end of diagnosis for diagnosis instance SPI_MPS" UBYTE _CNV_A_R_LINEAR_____1_CM 1 0. 0. 255. DISPLAY_IDENTIFIER CTR_ABC_END_DIAG_SPI_MPS ECU_ADDRESS 0x7f9aac FORMAT "%3.0" /end MEASUREMENT
/begin MEASUREMENT fmy_stat_spi_mps.err_info_stat.reserved "" UWORD _CNV_A_R_LINEAR_____0_CM 1 0. 0. 65535. DISPLAY_IDENTIFIER FMY_STAT_SPI_MPS_ERR_INFO_STAT_R ECU_ADDRESS 0x7f9aaa BYTE_ORDER MSB_LAST BIT_MASK 0xF800 /end MEASUREMENT
/begin MEASUREMENT fmy_stat_spi_mps.err_info_stat.lv_cdn_diag_stc "Statistical flag for condition of diagnosis of the diagnosis instance SPI_MPS" UWORD _CNV_S_2_RANGE______380_CM 1 0. 0. 1. DISPLAY_IDENTIFIER LV_CDN_DIAG_STC_SPI_MPS ECU_ADDRESS 0x7f9aaa BYTE_ORDER MSB_LAST BIT_MASK 0x400 /end MEASUREMENT
/begin MEASUREMENT fmy_stat_spi_mps.err_info_stat.lv_lock_diag "lock flag (CPU load optimisation) of the diagnosis instance SPI_MPS" UWORD _CNV_S_2_RANGE______380_CM 1 0. 0. 1. DISPLAY_IDENTIFIER LV_LOCK_DIAG_SPI_MPS ECU_ADDRESS 0x7f9aaa BYTE_ORDER MSB_LAST BIT_MASK 0x200 /end MEASUREMENT
/begin MEASUREMENT fmy_stat_spi_mps.err_info_stat.lv_err_mem "storage in dynamic failure memory of the diagnosis instance SPI_MPS" UWORD _CNV_S_2_RANGE______380_CM 1 0. 0. 1. DISPLAY_IDENTIFIER LV_ERR_MEM_SPI_MPS ECU_ADDRESS 0x7f9aaa BYTE_ORDER MSB_LAST BIT_MASK 0x80 /end MEASUREMENT
/begin MEASUREMENT fmy_stat_spi_mps.err_info_stat.lv_ready "readiness status of the diagnosis instance SPI_MPS" UWORD _CNV_S_2_RANGE______380_CM 1 0. 0. 1. DISPLAY_IDENTIFIER LV_READY_SPI_MPS ECU_ADDRESS 0x7f9aaa BYTE_ORDER MSB_LAST BIT_MASK 0x40 /end MEASUREMENT
/begin MEASUREMENT fmy_stat_spi_mps.err_info_stat.lv_end_diag "end of diagnosis of the diagnosis instance SPI_MPS" UWORD _CNV_S_2_RANGE______380_CM 1 0. 0. 1. DISPLAY_IDENTIFIER LV_END_DIAG_SPI_MPS ECU_ADDRESS 0x7f9aaa BYTE_ORDER MSB_LAST BIT_MASK 0x20 /end MEASUREMENT
/begin MEASUREMENT fmy_stat_spi_mps.err_info_stat.lv_cdn_diag "diagnosis condition of the diagnosis instance SPI_MPS" UWORD _CNV_S_2_RANGE______380_CM 1 0. 0. 1. DISPLAY_IDENTIFIER LV_CDN_DIAG_SPI_MPS ECU_ADDRESS 0x7f9aaa BYTE_ORDER MSB_LAST BIT_MASK 0x10 /end MEASUREMENT
/begin MEASUREMENT fmy_stat_spi_mps.err_info_stat.err_sym "symptoms of the diagnosis instance SPI_MPS" UWORD _CNV_S_6_CONV_ERRM__27_CM 1 0. 0. 15. DISPLAY_IDENTIFIER ERR_SYM_SPI_MPS ECU_ADDRESS 0x7f9aaa BYTE_ORDER MSB_LAST BIT_MASK 0xF /end MEASUREMENT
/begin MEASUREMENT lv_err_spi_oct "Error flag of diagnosis instance SPI_OCT" UBYTE _CNV_S_2_RANGE______28_CM 1 0. 0. 1. DISPLAY_IDENTIFIER LV_ERR_SPI_OCT ECU_ADDRESS 0x7fb530 /end MEASUREMENT
/begin MEASUREMENT fmy_stat_spi_oct.ctr_abc "anti bounce counter for diagnosis instance SPI_OCT" UBYTE _CNV_A_R_LINEAR_____1_CM 1 0. 0. 255. DISPLAY_IDENTIFIER CTR_ABC_SPI_OCT ECU_ADDRESS 0x7f9ab1 FORMAT "%3.0" /end MEASUREMENT
/begin MEASUREMENT fmy_stat_spi_oct.ctr_end_diag "counter for end of diagnosis for diagnosis instance SPI_OCT" UBYTE _CNV_A_R_LINEAR_____1_CM 1 0. 0. 255. DISPLAY_IDENTIFIER CTR_ABC_END_DIAG_SPI_OCT ECU_ADDRESS 0x7f9ab0 FORMAT "%3.0" /end MEASUREMENT
/begin MEASUREMENT fmy_stat_spi_oct.err_info_stat.reserved "" UWORD _CNV_A_R_LINEAR_____0_CM 1 0. 0. 65535. DISPLAY_IDENTIFIER FMY_STAT_SPI_OCT_ERR_INFO_STAT_R ECU_ADDRESS 0x7f9aae BYTE_ORDER MSB_LAST BIT_MASK 0xF800 /end MEASUREMENT
/begin MEASUREMENT fmy_stat_spi_oct.err_info_stat.lv_cdn_diag_stc "Statistical flag for condition of diagnosis of the diagnosis instance SPI_OCT" UWORD _CNV_S_2_RANGE______380_CM 1 0. 0. 1. DISPLAY_IDENTIFIER LV_CDN_DIAG_STC_SPI_OCT ECU_ADDRESS 0x7f9aae BYTE_ORDER MSB_LAST BIT_MASK 0x400 /end MEASUREMENT
/begin MEASUREMENT fmy_stat_spi_oct.err_info_stat.lv_lock_diag "lock flag (CPU load optimisation) of the diagnosis instance SPI_OCT" UWORD _CNV_S_2_RANGE______380_CM 1 0. 0. 1. DISPLAY_IDENTIFIER LV_LOCK_DIAG_SPI_OCT ECU_ADDRESS 0x7f9aae BYTE_ORDER MSB_LAST BIT_MASK 0x200 /end MEASUREMENT
/begin MEASUREMENT fmy_stat_spi_oct.err_info_stat.lv_err_mem "storage in dynamic failure memory of the diagnosis instance SPI_OCT" UWORD _CNV_S_2_RANGE______380_CM 1 0. 0. 1. DISPLAY_IDENTIFIER LV_ERR_MEM_SPI_OCT ECU_ADDRESS 0x7f9aae BYTE_ORDER MSB_LAST BIT_MASK 0x80 /end MEASUREMENT
/begin MEASUREMENT fmy_stat_spi_oct.err_info_stat.lv_ready "readiness status of the diagnosis instance SPI_OCT" UWORD _CNV_S_2_RANGE______380_CM 1 0. 0. 1. DISPLAY_IDENTIFIER LV_READY_SPI_OCT ECU_ADDRESS 0x7f9aae BYTE_ORDER MSB_LAST BIT_MASK 0x40 /end MEASUREMENT
/begin MEASUREMENT fmy_stat_spi_oct.err_info_stat.lv_end_diag "end of diagnosis of the diagnosis instance SPI_OCT" UWORD _CNV_S_2_RANGE______380_CM 1 0. 0. 1. DISPLAY_IDENTIFIER LV_END_DIAG_SPI_OCT ECU_ADDRESS 0x7f9aae BYTE_ORDER MSB_LAST BIT_MASK 0x20 /end MEASUREMENT
/begin MEASUREMENT fmy_stat_spi_oct.err_info_stat.lv_cdn_diag "diagnosis condition of the diagnosis instance SPI_OCT" UWORD _CNV_S_2_RANGE______380_CM 1 0. 0. 1. DISPLAY_IDENTIFIER LV_CDN_DIAG_SPI_OCT ECU_ADDRESS 0x7f9aae BYTE_ORDER MSB_LAST BIT_MASK 0x10 /end MEASUREMENT
/begin MEASUREMENT fmy_stat_spi_oct.err_info_stat.err_sym "symptoms of the diagnosis instance SPI_OCT" UWORD _CNV_S_6_CONV_ERRM__27_CM 1 0. 0. 15. DISPLAY_IDENTIFIER ERR_SYM_SPI_OCT ECU_ADDRESS 0x7f9aae BYTE_ORDER MSB_LAST BIT_MASK 0xF /end MEASUREMENT
/begin MEASUREMENT lv_err_spi_qps "Error flag of diagnosis instance SPI_QPS" UBYTE _CNV_S_2_RANGE______28_CM 1 0. 0. 1. DISPLAY_IDENTIFIER LV_ERR_SPI_QPS ECU_ADDRESS 0x7fb531 /end MEASUREMENT
/begin MEASUREMENT fmy_stat_spi_qps.ctr_abc "anti bounce counter for diagnosis instance SPI_QPS" UBYTE _CNV_A_R_LINEAR_____1_CM 1 0. 0. 255. DISPLAY_IDENTIFIER CTR_ABC_SPI_QPS ECU_ADDRESS 0x7f9ab5 FORMAT "%3.0" /end MEASUREMENT
/begin MEASUREMENT fmy_stat_spi_qps.ctr_end_diag "counter for end of diagnosis for diagnosis instance SPI_QPS" UBYTE _CNV_A_R_LINEAR_____1_CM 1 0. 0. 255. DISPLAY_IDENTIFIER CTR_ABC_END_DIAG_SPI_QPS ECU_ADDRESS 0x7f9ab4 FORMAT "%3.0" /end MEASUREMENT
/begin MEASUREMENT fmy_stat_spi_qps.err_info_stat.reserved "" UWORD _CNV_A_R_LINEAR_____0_CM 1 0. 0. 65535. DISPLAY_IDENTIFIER FMY_STAT_SPI_QPS_ERR_INFO_STAT_R ECU_ADDRESS 0x7f9ab2 BYTE_ORDER MSB_LAST BIT_MASK 0xF800 /end MEASUREMENT
/begin MEASUREMENT fmy_stat_spi_qps.err_info_stat.lv_cdn_diag_stc "Statistical flag for condition of diagnosis of the diagnosis instance SPI_QPS" UWORD _CNV_S_2_RANGE______380_CM 1 0. 0. 1. DISPLAY_IDENTIFIER LV_CDN_DIAG_STC_SPI_QPS ECU_ADDRESS 0x7f9ab2 BYTE_ORDER MSB_LAST BIT_MASK 0x400 /end MEASUREMENT
/begin MEASUREMENT fmy_stat_spi_qps.err_info_stat.lv_lock_diag "lock flag (CPU load optimisation) of the diagnosis instance SPI_QPS" UWORD _CNV_S_2_RANGE______380_CM 1 0. 0. 1. DISPLAY_IDENTIFIER LV_LOCK_DIAG_SPI_QPS ECU_ADDRESS 0x7f9ab2 BYTE_ORDER MSB_LAST BIT_MASK 0x200 /end MEASUREMENT
/begin MEASUREMENT fmy_stat_spi_qps.err_info_stat.lv_err_mem "storage in dynamic failure memory of the diagnosis instance SPI_QPS" UWORD _CNV_S_2_RANGE______380_CM 1 0. 0. 1. DISPLAY_IDENTIFIER LV_ERR_MEM_SPI_QPS ECU_ADDRESS 0x7f9ab2 BYTE_ORDER MSB_LAST BIT_MASK 0x80 /end MEASUREMENT
/begin MEASUREMENT fmy_stat_spi_qps.err_info_stat.lv_ready "readiness status of the diagnosis instance SPI_QPS" UWORD _CNV_S_2_RANGE______380_CM 1 0. 0. 1. DISPLAY_IDENTIFIER LV_READY_SPI_QPS ECU_ADDRESS 0x7f9ab2 BYTE_ORDER MSB_LAST BIT_MASK 0x40 /end MEASUREMENT
/begin MEASUREMENT fmy_stat_spi_qps.err_info_stat.lv_end_diag "end of diagnosis of the diagnosis instance SPI_QPS" UWORD _CNV_S_2_RANGE______380_CM 1 0. 0. 1. DISPLAY_IDENTIFIER LV_END_DIAG_SPI_QPS ECU_ADDRESS 0x7f9ab2 BYTE_ORDER MSB_LAST BIT_MASK 0x20 /end MEASUREMENT
/begin MEASUREMENT fmy_stat_spi_qps.err_info_stat.lv_cdn_diag "diagnosis condition of the diagnosis instance SPI_QPS" UWORD _CNV_S_2_RANGE______380_CM 1 0. 0. 1. DISPLAY_IDENTIFIER LV_CDN_DIAG_SPI_QPS ECU_ADDRESS 0x7f9ab2 BYTE_ORDER MSB_LAST BIT_MASK 0x10 /end MEASUREMENT
/begin MEASUREMENT fmy_stat_spi_qps.err_info_stat.err_sym "symptoms of the diagnosis instance SPI_QPS" UWORD _CNV_S_6_CONV_ERRM__27_CM 1 0. 0. 15. DISPLAY_IDENTIFIER ERR_SYM_SPI_QPS ECU_ADDRESS 0x7f9ab2 BYTE_ORDER MSB_LAST BIT_MASK 0xF /end MEASUREMENT
/begin MEASUREMENT lv_err_egr_byp_dps "Error flag of diagnosis instance EGR_BYP_DPS" UBYTE _CNV_S_2_RANGE______28_CM 1 0. 0. 1. DISPLAY_IDENTIFIER LV_ERR_EGR_BYP_DPS ECU_ADDRESS 0x7fb532 /end MEASUREMENT
/begin MEASUREMENT fmy_stat_egr_byp_dps.ctr_abc "anti bounce counter for diagnosis instance EGR_BYP_DPS" UBYTE _CNV_A_R_LINEAR_____1_CM 1 0. 0. 255. DISPLAY_IDENTIFIER CTR_ABC_EGR_BYP_DPS ECU_ADDRESS 0x7f9ab9 FORMAT "%3.0" /end MEASUREMENT
/begin MEASUREMENT fmy_stat_egr_byp_dps.ctr_end_diag "counter for end of diagnosis for diagnosis instance EGR_BYP_DPS" UBYTE _CNV_A_R_LINEAR_____1_CM 1 0. 0. 255. DISPLAY_IDENTIFIER CTR_ABC_END_DIAG_EGR_BYP_DPS ECU_ADDRESS 0x7f9ab8 FORMAT "%3.0" /end MEASUREMENT
/begin MEASUREMENT fmy_stat_egr_byp_dps.err_info_stat.reserved "" UWORD _CNV_A_R_LINEAR_____0_CM 1 0. 0. 65535. DISPLAY_IDENTIFIER FMY_STAT_EGR_BYP_DPS_ERR_INFO_ST ECU_ADDRESS 0x7f9ab6 BYTE_ORDER MSB_LAST BIT_MASK 0xF800 /end MEASUREMENT
/begin MEASUREMENT fmy_stat_egr_byp_dps.err_info_stat.lv_cdn_diag_stc "Statistical flag for condition of diagnosis of the diagnosis instance EGR_BYP_DPS" UWORD _CNV_S_2_RANGE______380_CM 1 0. 0. 1. DISPLAY_IDENTIFIER LV_CDN_DIAG_STC_EGR_BYP_DPS ECU_ADDRESS 0x7f9ab6 BYTE_ORDER MSB_LAST BIT_MASK 0x400 /end MEASUREMENT
/begin MEASUREMENT fmy_stat_egr_byp_dps.err_info_stat.lv_lock_diag "lock flag (CPU load optimisation) of the diagnosis instance EGR_BYP_DPS" UWORD _CNV_S_2_RANGE______380_CM 1 0. 0. 1. DISPLAY_IDENTIFIER LV_LOCK_DIAG_EGR_BYP_DPS ECU_ADDRESS 0x7f9ab6 BYTE_ORDER MSB_LAST BIT_MASK 0x200 /end MEASUREMENT
/begin MEASUREMENT fmy_stat_egr_byp_dps.err_info_stat.lv_err_mem "storage in dynamic failure memory of the diagnosis instance EGR_BYP_DPS" UWORD _CNV_S_2_RANGE______380_CM 1 0. 0. 1. DISPLAY_IDENTIFIER LV_ERR_MEM_EGR_BYP_DPS ECU_ADDRESS 0x7f9ab6 BYTE_ORDER MSB_LAST BIT_MASK 0x80 /end MEASUREMENT
/begin MEASUREMENT fmy_stat_egr_byp_dps.err_info_stat.lv_ready "readiness status of the diagnosis instance EGR_BYP_DPS" UWORD _CNV_S_2_RANGE______380_CM 1 0. 0. 1. DISPLAY_IDENTIFIER LV_READY_EGR_BYP_DPS ECU_ADDRESS 0x7f9ab6 BYTE_ORDER MSB_LAST BIT_MASK 0x40 /end MEASUREMENT
/begin MEASUREMENT fmy_stat_egr_byp_dps.err_info_stat.lv_end_diag "end of diagnosis of the diagnosis instance EGR_BYP_DPS" UWORD _CNV_S_2_RANGE______380_CM 1 0. 0. 1. DISPLAY_IDENTIFIER LV_END_DIAG_EGR_BYP_DPS ECU_ADDRESS 0x7f9ab6 BYTE_ORDER MSB_LAST BIT_MASK 0x20 /end MEASUREMENT
/begin MEASUREMENT fmy_stat_egr_byp_dps.err_info_stat.lv_cdn_diag "diagnosis condition of the diagnosis instance EGR_BYP_DPS" UWORD _CNV_S_2_RANGE______380_CM 1 0. 0. 1. DISPLAY_IDENTIFIER LV_CDN_DIAG_EGR_BYP_DPS ECU_ADDRESS 0x7f9ab6 BYTE_ORDER MSB_LAST BIT_MASK 0x10 /end MEASUREMENT
/begin MEASUREMENT fmy_stat_egr_byp_dps.err_info_stat.err_sym "symptoms of the diagnosis instance EGR_BYP_DPS" UWORD _CNV_S_6_CONV_ERRM__27_CM 1 0. 0. 15. DISPLAY_IDENTIFIER ERR_SYM_EGR_BYP_DPS ECU_ADDRESS 0x7f9ab6 BYTE_ORDER MSB_LAST BIT_MASK 0xF /end MEASUREMENT
/begin MEASUREMENT lv_err_egrv_0 "Error flag of diagnosis instance EGRV_0" UBYTE _CNV_S_2_RANGE______28_CM 1 0. 0. 1. DISPLAY_IDENTIFIER LV_ERR_EGRV_0 ECU_ADDRESS 0x7fb533 /end MEASUREMENT
/begin MEASUREMENT fmy_stat_egrv_0.ctr_abc "anti bounce counter for diagnosis instance EGRV_0" UBYTE _CNV_A_R_LINEAR_____1_CM 1 0. 0. 255. DISPLAY_IDENTIFIER CTR_ABC_EGRV_0 ECU_ADDRESS 0x7f9abd FORMAT "%3.0" /end MEASUREMENT
/begin MEASUREMENT fmy_stat_egrv_0.ctr_end_diag "counter for end of diagnosis for diagnosis instance EGRV_0" UBYTE _CNV_A_R_LINEAR_____1_CM 1 0. 0. 255. DISPLAY_IDENTIFIER CTR_ABC_END_DIAG_EGRV_0 ECU_ADDRESS 0x7f9abc FORMAT "%3.0" /end MEASUREMENT
/begin MEASUREMENT fmy_stat_egrv_0.err_info_stat.reserved "" UWORD _CNV_A_R_LINEAR_____0_CM 1 0. 0. 65535. DISPLAY_IDENTIFIER FMY_STAT_EGRV_0_ERR_INFO_STAT_RE ECU_ADDRESS 0x7f9aba BYTE_ORDER MSB_LAST BIT_MASK 0xF800 /end MEASUREMENT
/begin MEASUREMENT fmy_stat_egrv_0.err_info_stat.lv_cdn_diag_stc "Statistical flag for condition of diagnosis of the diagnosis instance EGRV_0" UWORD _CNV_S_2_RANGE______380_CM 1 0. 0. 1. DISPLAY_IDENTIFIER LV_CDN_DIAG_STC_EGRV_0 ECU_ADDRESS 0x7f9aba BYTE_ORDER MSB_LAST BIT_MASK 0x400 /end MEASUREMENT
/begin MEASUREMENT fmy_stat_egrv_0.err_info_stat.lv_lock_diag "lock flag (CPU load optimisation) of the diagnosis instance EGRV_0" UWORD _CNV_S_2_RANGE______380_CM 1 0. 0. 1. DISPLAY_IDENTIFIER LV_LOCK_DIAG_EGRV_0 ECU_ADDRESS 0x7f9aba BYTE_ORDER MSB_LAST BIT_MASK 0x200 /end MEASUREMENT
/begin MEASUREMENT fmy_stat_egrv_0.err_info_stat.lv_err_mem "storage in dynamic failure memory of the diagnosis instance EGRV_0" UWORD _CNV_S_2_RANGE______380_CM 1 0. 0. 1. DISPLAY_IDENTIFIER LV_ERR_MEM_EGRV_0 ECU_ADDRESS 0x7f9aba BYTE_ORDER MSB_LAST BIT_MASK 0x80 /end MEASUREMENT
/begin MEASUREMENT fmy_stat_egrv_0.err_info_stat.lv_ready "readiness status of the diagnosis instance EGRV_0" UWORD _CNV_S_2_RANGE______380_CM 1 0. 0. 1. DISPLAY_IDENTIFIER LV_READY_EGRV_0 ECU_ADDRESS 0x7f9aba BYTE_ORDER MSB_LAST BIT_MASK 0x40 /end MEASUREMENT
/begin MEASUREMENT fmy_stat_egrv_0.err_info_stat.lv_end_diag "end of diagnosis of the diagnosis instance EGRV_0" UWORD _CNV_S_2_RANGE______380_CM 1 0. 0. 1. DISPLAY_IDENTIFIER LV_END_DIAG_EGRV_0 ECU_ADDRESS 0x7f9aba BYTE_ORDER MSB_LAST BIT_MASK 0x20 /end MEASUREMENT
/begin MEASUREMENT fmy_stat_egrv_0.err_info_stat.lv_cdn_diag "diagnosis condition of the diagnosis instance EGRV_0" UWORD _CNV_S_2_RANGE______380_CM 1 0. 0. 1. DISPLAY_IDENTIFIER LV_CDN_DIAG_EGRV_0 ECU_ADDRESS 0x7f9aba BYTE_ORDER MSB_LAST BIT_MASK 0x10 /end MEASUREMENT
/begin MEASUREMENT fmy_stat_egrv_0.err_info_stat.err_sym "symptoms of the diagnosis instance EGRV_0" UWORD _CNV_S_6_CONV_ERRM__27_CM 1 0. 0. 15. DISPLAY_IDENTIFIER ERR_SYM_EGRV_0 ECU_ADDRESS 0x7f9aba BYTE_ORDER MSB_LAST BIT_MASK 0xF /end MEASUREMENT
/begin MEASUREMENT lv_err_pps_ini_0 "Error flag of diagnosis instance PPS_INI_0" UBYTE _CNV_S_2_RANGE______28_CM 1 0. 0. 1. DISPLAY_IDENTIFIER LV_ERR_PPS_INI_0 ECU_ADDRESS 0x7fb534 /end MEASUREMENT
/begin MEASUREMENT fmy_stat_pps_ini_0.ctr_abc "anti bounce counter for diagnosis instance PPS_INI_0" UBYTE _CNV_A_R_LINEAR_____1_CM 1 0. 0. 255. DISPLAY_IDENTIFIER CTR_ABC_PPS_INI_0 ECU_ADDRESS 0x7f9ac1 FORMAT "%3.0" /end MEASUREMENT
/begin MEASUREMENT fmy_stat_pps_ini_0.ctr_end_diag "counter for end of diagnosis for diagnosis instance PPS_INI_0" UBYTE _CNV_A_R_LINEAR_____1_CM 1 0. 0. 255. DISPLAY_IDENTIFIER CTR_ABC_END_DIAG_PPS_INI_0 ECU_ADDRESS 0x7f9ac0 FORMAT "%3.0" /end MEASUREMENT
/begin MEASUREMENT fmy_stat_pps_ini_0.err_info_stat.reserved "" UWORD _CNV_A_R_LINEAR_____0_CM 1 0. 0. 65535. DISPLAY_IDENTIFIER FMY_STAT_PPS_INI_0_ERR_INFO_STAT ECU_ADDRESS 0x7f9abe BYTE_ORDER MSB_LAST BIT_MASK 0xF800 /end MEASUREMENT
/begin MEASUREMENT fmy_stat_pps_ini_0.err_info_stat.lv_cdn_diag_stc "Statistical flag for condition of diagnosis of the diagnosis instance PPS_INI_0" UWORD _CNV_S_2_RANGE______380_CM 1 0. 0. 1. DISPLAY_IDENTIFIER LV_CDN_DIAG_STC_PPS_INI_0 ECU_ADDRESS 0x7f9abe BYTE_ORDER MSB_LAST BIT_MASK 0x400 /end MEASUREMENT
/begin MEASUREMENT fmy_stat_pps_ini_0.err_info_stat.lv_lock_diag "lock flag (CPU load optimisation) of the diagnosis instance PPS_INI_0" UWORD _CNV_S_2_RANGE______380_CM 1 0. 0. 1. DISPLAY_IDENTIFIER LV_LOCK_DIAG_PPS_INI_0 ECU_ADDRESS 0x7f9abe BYTE_ORDER MSB_LAST BIT_MASK 0x200 /end MEASUREMENT
/begin MEASUREMENT fmy_stat_pps_ini_0.err_info_stat.lv_err_mem "storage in dynamic failure memory of the diagnosis instance PPS_INI_0" UWORD _CNV_S_2_RANGE______380_CM 1 0. 0. 1. DISPLAY_IDENTIFIER LV_ERR_MEM_PPS_INI_0 ECU_ADDRESS 0x7f9abe BYTE_ORDER MSB_LAST BIT_MASK 0x80 /end MEASUREMENT
/begin MEASUREMENT fmy_stat_pps_ini_0.err_info_stat.lv_ready "readiness status of the diagnosis instance PPS_INI_0" UWORD _CNV_S_2_RANGE______380_CM 1 0. 0. 1. DISPLAY_IDENTIFIER LV_READY_PPS_INI_0 ECU_ADDRESS 0x7f9abe BYTE_ORDER MSB_LAST BIT_MASK 0x40 /end MEASUREMENT
/begin MEASUREMENT fmy_stat_pps_ini_0.err_info_stat.lv_end_diag "end of diagnosis of the diagnosis instance PPS_INI_0" UWORD _CNV_S_2_RANGE______380_CM 1 0. 0. 1. DISPLAY_IDENTIFIER LV_END_DIAG_PPS_INI_0 ECU_ADDRESS 0x7f9abe BYTE_ORDER MSB_LAST BIT_MASK 0x20 /end MEASUREMENT
/begin MEASUREMENT fmy_stat_pps_ini_0.err_info_stat.lv_cdn_diag "diagnosis condition of the diagnosis instance PPS_INI_0" UWORD _CNV_S_2_RANGE______380_CM 1 0. 0. 1. DISPLAY_IDENTIFIER LV_CDN_DIAG_PPS_INI_0 ECU_ADDRESS 0x7f9abe BYTE_ORDER MSB_LAST BIT_MASK 0x10 /end MEASUREMENT
/begin MEASUREMENT fmy_stat_pps_ini_0.err_info_stat.err_sym "symptoms of the diagnosis instance PPS_INI_0" UWORD _CNV_S_6_CONV_ERRM__27_CM 1 0. 0. 15. DISPLAY_IDENTIFIER ERR_SYM_PPS_INI_0 ECU_ADDRESS 0x7f9abe BYTE_ORDER MSB_LAST BIT_MASK 0xF /end MEASUREMENT
/begin MEASUREMENT lv_err_pps_ini_tout_0 "Error flag of diagnosis instance PPS_INI_TOUT_0" UBYTE _CNV_S_2_RANGE______28_CM 1 0. 0. 1. DISPLAY_IDENTIFIER LV_ERR_PPS_INI_TOUT_0 ECU_ADDRESS 0x7fb535 /end MEASUREMENT
/begin MEASUREMENT fmy_stat_pps_ini_tout_0.ctr_abc "anti bounce counter for diagnosis instance PPS_INI_TOUT_0" UBYTE _CNV_A_R_LINEAR_____1_CM 1 0. 0. 255. DISPLAY_IDENTIFIER CTR_ABC_PPS_INI_TOUT_0 ECU_ADDRESS 0x7f9ac5 FORMAT "%3.0" /end MEASUREMENT
/begin MEASUREMENT fmy_stat_pps_ini_tout_0.ctr_end_diag "counter for end of diagnosis for diagnosis instance PPS_INI_TOUT_0" UBYTE _CNV_A_R_LINEAR_____1_CM 1 0. 0. 255. DISPLAY_IDENTIFIER CTR_ABC_END_DIAG_PPS_INI_TOUT_0 ECU_ADDRESS 0x7f9ac4 FORMAT "%3.0" /end MEASUREMENT
/begin MEASUREMENT fmy_stat_pps_ini_tout_0.err_info_stat.reserved "" UWORD _CNV_A_R_LINEAR_____0_CM 1 0. 0. 65535. DISPLAY_IDENTIFIER FMY_STAT_PPS_INI_TOUT_0_ERR_INFO ECU_ADDRESS 0x7f9ac2 BYTE_ORDER MSB_LAST BIT_MASK 0xF800 /end MEASUREMENT
/begin MEASUREMENT fmy_stat_pps_ini_tout_0.err_info_stat.lv_cdn_diag_stc "Statistical flag for condition of diagnosis of the diagnosis instance PPS_INI_TOUT_0" UWORD _CNV_S_2_RANGE______380_CM 1 0. 0. 1. DISPLAY_IDENTIFIER LV_CDN_DIAG_STC_PPS_INI_TOUT_0 ECU_ADDRESS 0x7f9ac2 BYTE_ORDER MSB_LAST BIT_MASK 0x400 /end MEASUREMENT
/begin MEASUREMENT fmy_stat_pps_ini_tout_0.err_info_stat.lv_lock_diag "lock flag (CPU load optimisation) of the diagnosis instance PPS_INI_TOUT_0" UWORD _CNV_S_2_RANGE______380_CM 1 0. 0. 1. DISPLAY_IDENTIFIER LV_LOCK_DIAG_PPS_INI_TOUT_0 ECU_ADDRESS 0x7f9ac2 BYTE_ORDER MSB_LAST BIT_MASK 0x200 /end MEASUREMENT
/begin MEASUREMENT fmy_stat_pps_ini_tout_0.err_info_stat.lv_err_mem "storage in dynamic failure memory of the diagnosis instance PPS_INI_TOUT_0" UWORD _CNV_S_2_RANGE______380_CM 1 0. 0. 1. DISPLAY_IDENTIFIER LV_ERR_MEM_PPS_INI_TOUT_0 ECU_ADDRESS 0x7f9ac2 BYTE_ORDER MSB_LAST BIT_MASK 0x80 /end MEASUREMENT
/begin MEASUREMENT fmy_stat_pps_ini_tout_0.err_info_stat.lv_ready "readiness status of the diagnosis instance PPS_INI_TOUT_0" UWORD _CNV_S_2_RANGE______380_CM 1 0. 0. 1. DISPLAY_IDENTIFIER LV_READY_PPS_INI_TOUT_0 ECU_ADDRESS 0x7f9ac2 BYTE_ORDER MSB_LAST BIT_MASK 0x40 /end MEASUREMENT
/begin MEASUREMENT fmy_stat_pps_ini_tout_0.err_info_stat.lv_end_diag "end of diagnosis of the diagnosis instance PPS_INI_TOUT_0" UWORD _CNV_S_2_RANGE______380_CM 1 0. 0. 1. DISPLAY_IDENTIFIER LV_END_DIAG_PPS_INI_TOUT_0 ECU_ADDRESS 0x7f9ac2 BYTE_ORDER MSB_LAST BIT_MASK 0x20 /end MEASUREMENT
/begin MEASUREMENT fmy_stat_pps_ini_tout_0.err_info_stat.lv_cdn_diag "diagnosis condition of the diagnosis instance PPS_INI_TOUT_0" UWORD _CNV_S_2_RANGE______380_CM 1 0. 0. 1. DISPLAY_IDENTIFIER LV_CDN_DIAG_PPS_INI_TOUT_0 ECU_ADDRESS 0x7f9ac2 BYTE_ORDER MSB_LAST BIT_MASK 0x10 /end MEASUREMENT
/begin MEASUREMENT fmy_stat_pps_ini_tout_0.err_info_stat.err_sym "symptoms of the diagnosis instance PPS_INI_TOUT_0" UWORD _CNV_S_6_CONV_ERRM__27_CM 1 0. 0. 15. DISPLAY_IDENTIFIER ERR_SYM_PPS_INI_TOUT_0 ECU_ADDRESS 0x7f9ac2 BYTE_ORDER MSB_LAST BIT_MASK 0xF /end MEASUREMENT
/begin MEASUREMENT lv_err_pps_plaus_0 "Error flag of diagnosis instance PPS_PLAUS_0" UBYTE _CNV_S_2_RANGE______28_CM 1 0. 0. 1. DISPLAY_IDENTIFIER LV_ERR_PPS_PLAUS_0 ECU_ADDRESS 0x7fb536 /end MEASUREMENT
/begin MEASUREMENT fmy_stat_pps_plaus_0.ctr_abc "anti bounce counter for diagnosis instance PPS_PLAUS_0" UBYTE _CNV_A_R_LINEAR_____1_CM 1 0. 0. 255. DISPLAY_IDENTIFIER CTR_ABC_PPS_PLAUS_0 ECU_ADDRESS 0x7f9ac9 FORMAT "%3.0" /end MEASUREMENT
/begin MEASUREMENT fmy_stat_pps_plaus_0.ctr_end_diag "counter for end of diagnosis for diagnosis instance PPS_PLAUS_0" UBYTE _CNV_A_R_LINEAR_____1_CM 1 0. 0. 255. DISPLAY_IDENTIFIER CTR_ABC_END_DIAG_PPS_PLAUS_0 ECU_ADDRESS 0x7f9ac8 FORMAT "%3.0" /end MEASUREMENT
/begin MEASUREMENT fmy_stat_pps_plaus_0.err_info_stat.reserved "" UWORD _CNV_A_R_LINEAR_____0_CM 1 0. 0. 65535. DISPLAY_IDENTIFIER FMY_STAT_PPS_PLAUS_0_ERR_INFO_ST ECU_ADDRESS 0x7f9ac6 BYTE_ORDER MSB_LAST BIT_MASK 0xF800 /end MEASUREMENT
/begin MEASUREMENT fmy_stat_pps_plaus_0.err_info_stat.lv_cdn_diag_stc "Statistical flag for condition of diagnosis of the diagnosis instance PPS_PLAUS_0" UWORD _CNV_S_2_RANGE______380_CM 1 0. 0. 1. DISPLAY_IDENTIFIER LV_CDN_DIAG_STC_PPS_PLAUS_0 ECU_ADDRESS 0x7f9ac6 BYTE_ORDER MSB_LAST BIT_MASK 0x400 /end MEASUREMENT
/begin MEASUREMENT fmy_stat_pps_plaus_0.err_info_stat.lv_lock_diag "lock flag (CPU load optimisation) of the diagnosis instance PPS_PLAUS_0" UWORD _CNV_S_2_RANGE______380_CM 1 0. 0. 1. DISPLAY_IDENTIFIER LV_LOCK_DIAG_PPS_PLAUS_0 ECU_ADDRESS 0x7f9ac6 BYTE_ORDER MSB_LAST BIT_MASK 0x200 /end MEASUREMENT
/begin MEASUREMENT fmy_stat_pps_plaus_0.err_info_stat.lv_err_mem "storage in dynamic failure memory of the diagnosis instance PPS_PLAUS_0" UWORD _CNV_S_2_RANGE______380_CM 1 0. 0. 1. DISPLAY_IDENTIFIER LV_ERR_MEM_PPS_PLAUS_0 ECU_ADDRESS 0x7f9ac6 BYTE_ORDER MSB_LAST BIT_MASK 0x80 /end MEASUREMENT
/begin MEASUREMENT fmy_stat_pps_plaus_0.err_info_stat.lv_ready "readiness status of the diagnosis instance PPS_PLAUS_0" UWORD _CNV_S_2_RANGE______380_CM 1 0. 0. 1. DISPLAY_IDENTIFIER LV_READY_PPS_PLAUS_0 ECU_ADDRESS 0x7f9ac6 BYTE_ORDER MSB_LAST BIT_MASK 0x40 /end MEASUREMENT
/begin MEASUREMENT fmy_stat_pps_plaus_0.err_info_stat.lv_end_diag "end of diagnosis of the diagnosis instance PPS_PLAUS_0" UWORD _CNV_S_2_RANGE______380_CM 1 0. 0. 1. DISPLAY_IDENTIFIER LV_END_DIAG_PPS_PLAUS_0 ECU_ADDRESS 0x7f9ac6 BYTE_ORDER MSB_LAST BIT_MASK 0x20 /end MEASUREMENT
/begin MEASUREMENT fmy_stat_pps_plaus_0.err_info_stat.lv_cdn_diag "diagnosis condition of the diagnosis instance PPS_PLAUS_0" UWORD _CNV_S_2_RANGE______380_CM 1 0. 0. 1. DISPLAY_IDENTIFIER LV_CDN_DIAG_PPS_PLAUS_0 ECU_ADDRESS 0x7f9ac6 BYTE_ORDER MSB_LAST BIT_MASK 0x10 /end MEASUREMENT
/begin MEASUREMENT fmy_stat_pps_plaus_0.err_info_stat.err_sym "symptoms of the diagnosis instance PPS_PLAUS_0" UWORD _CNV_S_6_CONV_ERRM__27_CM 1 0. 0. 15. DISPLAY_IDENTIFIER ERR_SYM_PPS_PLAUS_0 ECU_ADDRESS 0x7f9ac6 BYTE_ORDER MSB_LAST BIT_MASK 0xF /end MEASUREMENT
/begin MEASUREMENT lv_err_pps_cal_0 "Error flag of diagnosis instance PPS_CAL_0" UBYTE _CNV_S_2_RANGE______28_CM 1 0. 0. 1. DISPLAY_IDENTIFIER LV_ERR_PPS_CAL_0 ECU_ADDRESS 0x7fb537 /end MEASUREMENT
/begin MEASUREMENT fmy_stat_pps_cal_0.ctr_abc "anti bounce counter for diagnosis instance PPS_CAL_0" UBYTE _CNV_A_R_LINEAR_____1_CM 1 0. 0. 255. DISPLAY_IDENTIFIER CTR_ABC_PPS_CAL_0 ECU_ADDRESS 0x7f9acd FORMAT "%3.0" /end MEASUREMENT
/begin MEASUREMENT fmy_stat_pps_cal_0.ctr_end_diag "counter for end of diagnosis for diagnosis instance PPS_CAL_0" UBYTE _CNV_A_R_LINEAR_____1_CM 1 0. 0. 255. DISPLAY_IDENTIFIER CTR_ABC_END_DIAG_PPS_CAL_0 ECU_ADDRESS 0x7f9acc FORMAT "%3.0" /end MEASUREMENT
/begin MEASUREMENT fmy_stat_pps_cal_0.err_info_stat.reserved "" UWORD _CNV_A_R_LINEAR_____0_CM 1 0. 0. 65535. DISPLAY_IDENTIFIER FMY_STAT_PPS_CAL_0_ERR_INFO_STAT ECU_ADDRESS 0x7f9aca BYTE_ORDER MSB_LAST BIT_MASK 0xF800 /end MEASUREMENT
/begin MEASUREMENT fmy_stat_pps_cal_0.err_info_stat.lv_cdn_diag_stc "Statistical flag for condition of diagnosis of the diagnosis instance PPS_CAL_0" UWORD _CNV_S_2_RANGE______380_CM 1 0. 0. 1. DISPLAY_IDENTIFIER LV_CDN_DIAG_STC_PPS_CAL_0 ECU_ADDRESS 0x7f9aca BYTE_ORDER MSB_LAST BIT_MASK 0x400 /end MEASUREMENT
/begin MEASUREMENT fmy_stat_pps_cal_0.err_info_stat.lv_lock_diag "lock flag (CPU load optimisation) of the diagnosis instance PPS_CAL_0" UWORD _CNV_S_2_RANGE______380_CM 1 0. 0. 1. DISPLAY_IDENTIFIER LV_LOCK_DIAG_PPS_CAL_0 ECU_ADDRESS 0x7f9aca BYTE_ORDER MSB_LAST BIT_MASK 0x200 /end MEASUREMENT
/begin MEASUREMENT fmy_stat_pps_cal_0.err_info_stat.lv_err_mem "storage in dynamic failure memory of the diagnosis instance PPS_CAL_0" UWORD _CNV_S_2_RANGE______380_CM 1 0. 0. 1. DISPLAY_IDENTIFIER LV_ERR_MEM_PPS_CAL_0 ECU_ADDRESS 0x7f9aca BYTE_ORDER MSB_LAST BIT_MASK 0x80 /end MEASUREMENT
/begin MEASUREMENT fmy_stat_pps_cal_0.err_info_stat.lv_ready "readiness status of the diagnosis instance PPS_CAL_0" UWORD _CNV_S_2_RANGE______380_CM 1 0. 0. 1. DISPLAY_IDENTIFIER LV_READY_PPS_CAL_0 ECU_ADDRESS 0x7f9aca BYTE_ORDER MSB_LAST BIT_MASK 0x40 /end MEASUREMENT
/begin MEASUREMENT fmy_stat_pps_cal_0.err_info_stat.lv_end_diag "end of diagnosis of the diagnosis instance PPS_CAL_0" UWORD _CNV_S_2_RANGE______380_CM 1 0. 0. 1. DISPLAY_IDENTIFIER LV_END_DIAG_PPS_CAL_0 ECU_ADDRESS 0x7f9aca BYTE_ORDER MSB_LAST BIT_MASK 0x20 /end MEASUREMENT
/begin MEASUREMENT fmy_stat_pps_cal_0.err_info_stat.lv_cdn_diag "diagnosis condition of the diagnosis instance PPS_CAL_0" UWORD _CNV_S_2_RANGE______380_CM 1 0. 0. 1. DISPLAY_IDENTIFIER LV_CDN_DIAG_PPS_CAL_0 ECU_ADDRESS 0x7f9aca BYTE_ORDER MSB_LAST BIT_MASK 0x10 /end MEASUREMENT
/begin MEASUREMENT fmy_stat_pps_cal_0.err_info_stat.err_sym "symptoms of the diagnosis instance PPS_CAL_0" UWORD _CNV_S_6_CONV_ERRM__27_CM 1 0. 0. 15. DISPLAY_IDENTIFIER ERR_SYM_PPS_CAL_0 ECU_ADDRESS 0x7f9aca BYTE_ORDER MSB_LAST BIT_MASK 0xF /end MEASUREMENT
/begin MEASUREMENT lv_err_pps_v_inj_0 "Error flag of diagnosis instance PPS_V_INJ_0" UBYTE _CNV_S_2_RANGE______28_CM 1 0. 0. 1. DISPLAY_IDENTIFIER LV_ERR_PPS_V_INJ_0 ECU_ADDRESS 0x7fb538 /end MEASUREMENT
/begin MEASUREMENT fmy_stat_pps_v_inj_0.ctr_abc "anti bounce counter for diagnosis instance PPS_V_INJ_0" UBYTE _CNV_A_R_LINEAR_____1_CM 1 0. 0. 255. DISPLAY_IDENTIFIER CTR_ABC_PPS_V_INJ_0 ECU_ADDRESS 0x7f9ad1 FORMAT "%3.0" /end MEASUREMENT
/begin MEASUREMENT fmy_stat_pps_v_inj_0.ctr_end_diag "counter for end of diagnosis for diagnosis instance PPS_V_INJ_0" UBYTE _CNV_A_R_LINEAR_____1_CM 1 0. 0. 255. DISPLAY_IDENTIFIER CTR_ABC_END_DIAG_PPS_V_INJ_0 ECU_ADDRESS 0x7f9ad0 FORMAT "%3.0" /end MEASUREMENT
/begin MEASUREMENT fmy_stat_pps_v_inj_0.err_info_stat.reserved "" UWORD _CNV_A_R_LINEAR_____0_CM 1 0. 0. 65535. DISPLAY_IDENTIFIER FMY_STAT_PPS_V_INJ_0_ERR_INFO_ST ECU_ADDRESS 0x7f9ace BYTE_ORDER MSB_LAST BIT_MASK 0xF800 /end MEASUREMENT
/begin MEASUREMENT fmy_stat_pps_v_inj_0.err_info_stat.lv_cdn_diag_stc "Statistical flag for condition of diagnosis of the diagnosis instance PPS_V_INJ_0" UWORD _CNV_S_2_RANGE______380_CM 1 0. 0. 1. DISPLAY_IDENTIFIER LV_CDN_DIAG_STC_PPS_V_INJ_0 ECU_ADDRESS 0x7f9ace BYTE_ORDER MSB_LAST BIT_MASK 0x400 /end MEASUREMENT
/begin MEASUREMENT fmy_stat_pps_v_inj_0.err_info_stat.lv_lock_diag "lock flag (CPU load optimisation) of the diagnosis instance PPS_V_INJ_0" UWORD _CNV_S_2_RANGE______380_CM 1 0. 0. 1. DISPLAY_IDENTIFIER LV_LOCK_DIAG_PPS_V_INJ_0 ECU_ADDRESS 0x7f9ace BYTE_ORDER MSB_LAST BIT_MASK 0x200 /end MEASUREMENT
/begin MEASUREMENT fmy_stat_pps_v_inj_0.err_info_stat.lv_err_mem "storage in dynamic failure memory of the diagnosis instance PPS_V_INJ_0" UWORD _CNV_S_2_RANGE______380_CM 1 0. 0. 1. DISPLAY_IDENTIFIER LV_ERR_MEM_PPS_V_INJ_0 ECU_ADDRESS 0x7f9ace BYTE_ORDER MSB_LAST BIT_MASK 0x80 /end MEASUREMENT
/begin MEASUREMENT fmy_stat_pps_v_inj_0.err_info_stat.lv_ready "readiness status of the diagnosis instance PPS_V_INJ_0" UWORD _CNV_S_2_RANGE______380_CM 1 0. 0. 1. DISPLAY_IDENTIFIER LV_READY_PPS_V_INJ_0 ECU_ADDRESS 0x7f9ace BYTE_ORDER MSB_LAST BIT_MASK 0x40 /end MEASUREMENT
/begin MEASUREMENT fmy_stat_pps_v_inj_0.err_info_stat.lv_end_diag "end of diagnosis of the diagnosis instance PPS_V_INJ_0" UWORD _CNV_S_2_RANGE______380_CM 1 0. 0. 1. DISPLAY_IDENTIFIER LV_END_DIAG_PPS_V_INJ_0 ECU_ADDRESS 0x7f9ace BYTE_ORDER MSB_LAST BIT_MASK 0x20 /end MEASUREMENT
/begin MEASUREMENT fmy_stat_pps_v_inj_0.err_info_stat.lv_cdn_diag "diagnosis condition of the diagnosis instance PPS_V_INJ_0" UWORD _CNV_S_2_RANGE______380_CM 1 0. 0. 1. DISPLAY_IDENTIFIER LV_CDN_DIAG_PPS_V_INJ_0 ECU_ADDRESS 0x7f9ace BYTE_ORDER MSB_LAST BIT_MASK 0x10 /end MEASUREMENT
/begin MEASUREMENT fmy_stat_pps_v_inj_0.err_info_stat.err_sym "symptoms of the diagnosis instance PPS_V_INJ_0" UWORD _CNV_S_6_CONV_ERRM__27_CM 1 0. 0. 15. DISPLAY_IDENTIFIER ERR_SYM_PPS_V_INJ_0 ECU_ADDRESS 0x7f9ace BYTE_ORDER MSB_LAST BIT_MASK 0xF /end MEASUREMENT
/begin MEASUREMENT lv_err_pps_wdt_0 "Error flag of diagnosis instance PPS_WDT_0" UBYTE _CNV_S_2_RANGE______28_CM 1 0. 0. 1. DISPLAY_IDENTIFIER LV_ERR_PPS_WDT_0 ECU_ADDRESS 0x7fb539 /end MEASUREMENT
/begin MEASUREMENT fmy_stat_pps_wdt_0.ctr_abc "anti bounce counter for diagnosis instance PPS_WDT_0" UBYTE _CNV_A_R_LINEAR_____1_CM 1 0. 0. 255. DISPLAY_IDENTIFIER CTR_ABC_PPS_WDT_0 ECU_ADDRESS 0x7f9ad5 FORMAT "%3.0" /end MEASUREMENT
/begin MEASUREMENT fmy_stat_pps_wdt_0.ctr_end_diag "counter for end of diagnosis for diagnosis instance PPS_WDT_0" UBYTE _CNV_A_R_LINEAR_____1_CM 1 0. 0. 255. DISPLAY_IDENTIFIER CTR_ABC_END_DIAG_PPS_WDT_0 ECU_ADDRESS 0x7f9ad4 FORMAT "%3.0" /end MEASUREMENT
/begin MEASUREMENT fmy_stat_pps_wdt_0.err_info_stat.reserved "" UWORD _CNV_A_R_LINEAR_____0_CM 1 0. 0. 65535. DISPLAY_IDENTIFIER FMY_STAT_PPS_WDT_0_ERR_INFO_STAT ECU_ADDRESS 0x7f9ad2 BYTE_ORDER MSB_LAST BIT_MASK 0xF800 /end MEASUREMENT
/begin MEASUREMENT fmy_stat_pps_wdt_0.err_info_stat.lv_cdn_diag_stc "Statistical flag for condition of diagnosis of the diagnosis instance PPS_WDT_0" UWORD _CNV_S_2_RANGE______380_CM 1 0. 0. 1. DISPLAY_IDENTIFIER LV_CDN_DIAG_STC_PPS_WDT_0 ECU_ADDRESS 0x7f9ad2 BYTE_ORDER MSB_LAST BIT_MASK 0x400 /end MEASUREMENT
/begin MEASUREMENT fmy_stat_pps_wdt_0.err_info_stat.lv_lock_diag "lock flag (CPU load optimisation) of the diagnosis instance PPS_WDT_0" UWORD _CNV_S_2_RANGE______380_CM 1 0. 0. 1. DISPLAY_IDENTIFIER LV_LOCK_DIAG_PPS_WDT_0 ECU_ADDRESS 0x7f9ad2 BYTE_ORDER MSB_LAST BIT_MASK 0x200 /end MEASUREMENT
/begin MEASUREMENT fmy_stat_pps_wdt_0.err_info_stat.lv_err_mem "storage in dynamic failure memory of the diagnosis instance PPS_WDT_0" UWORD _CNV_S_2_RANGE______380_CM 1 0. 0. 1. DISPLAY_IDENTIFIER LV_ERR_MEM_PPS_WDT_0 ECU_ADDRESS 0x7f9ad2 BYTE_ORDER MSB_LAST BIT_MASK 0x80 /end MEASUREMENT
/begin MEASUREMENT fmy_stat_pps_wdt_0.err_info_stat.lv_ready "readiness status of the diagnosis instance PPS_WDT_0" UWORD _CNV_S_2_RANGE______380_CM 1 0. 0. 1. DISPLAY_IDENTIFIER LV_READY_PPS_WDT_0 ECU_ADDRESS 0x7f9ad2 BYTE_ORDER MSB_LAST BIT_MASK 0x40 /end MEASUREMENT
/begin MEASUREMENT fmy_stat_pps_wdt_0.err_info_stat.lv_end_diag "end of diagnosis of the diagnosis instance PPS_WDT_0" UWORD _CNV_S_2_RANGE______380_CM 1 0. 0. 1. DISPLAY_IDENTIFIER LV_END_DIAG_PPS_WDT_0 ECU_ADDRESS 0x7f9ad2 BYTE_ORDER MSB_LAST BIT_MASK 0x20 /end MEASUREMENT
/begin MEASUREMENT fmy_stat_pps_wdt_0.err_info_stat.lv_cdn_diag "diagnosis condition of the diagnosis instance PPS_WDT_0" UWORD _CNV_S_2_RANGE______380_CM 1 0. 0. 1. DISPLAY_IDENTIFIER LV_CDN_DIAG_PPS_WDT_0 ECU_ADDRESS 0x7f9ad2 BYTE_ORDER MSB_LAST BIT_MASK 0x10 /end MEASUREMENT
/begin MEASUREMENT fmy_stat_pps_wdt_0.err_info_stat.err_sym "symptoms of the diagnosis instance PPS_WDT_0" UWORD _CNV_S_6_CONV_ERRM__27_CM 1 0. 0. 15. DISPLAY_IDENTIFIER ERR_SYM_PPS_WDT_0 ECU_ADDRESS 0x7f9ad2 BYTE_ORDER MSB_LAST BIT_MASK 0xF /end MEASUREMENT
/begin MEASUREMENT lv_err_pps_fsm_0 "Error flag of diagnosis instance PPS_FSM_0" UBYTE _CNV_S_2_RANGE______28_CM 1 0. 0. 1. DISPLAY_IDENTIFIER LV_ERR_PPS_FSM_0 ECU_ADDRESS 0x7fb53a /end MEASUREMENT
/begin MEASUREMENT fmy_stat_pps_fsm_0.ctr_abc "anti bounce counter for diagnosis instance PPS_FSM_0" UBYTE _CNV_A_R_LINEAR_____1_CM 1 0. 0. 255. DISPLAY_IDENTIFIER CTR_ABC_PPS_FSM_0 ECU_ADDRESS 0x7f9ad9 FORMAT "%3.0" /end MEASUREMENT
/begin MEASUREMENT fmy_stat_pps_fsm_0.ctr_end_diag "counter for end of diagnosis for diagnosis instance PPS_FSM_0" UBYTE _CNV_A_R_LINEAR_____1_CM 1 0. 0. 255. DISPLAY_IDENTIFIER CTR_ABC_END_DIAG_PPS_FSM_0 ECU_ADDRESS 0x7f9ad8 FORMAT "%3.0" /end MEASUREMENT
/begin MEASUREMENT fmy_stat_pps_fsm_0.err_info_stat.reserved "" UWORD _CNV_A_R_LINEAR_____0_CM 1 0. 0. 65535. DISPLAY_IDENTIFIER FMY_STAT_PPS_FSM_0_ERR_INFO_STAT ECU_ADDRESS 0x7f9ad6 BYTE_ORDER MSB_LAST BIT_MASK 0xF800 /end MEASUREMENT
/begin MEASUREMENT fmy_stat_pps_fsm_0.err_info_stat.lv_cdn_diag_stc "Statistical flag for condition of diagnosis of the diagnosis instance PPS_FSM_0" UWORD _CNV_S_2_RANGE______380_CM 1 0. 0. 1. DISPLAY_IDENTIFIER LV_CDN_DIAG_STC_PPS_FSM_0 ECU_ADDRESS 0x7f9ad6 BYTE_ORDER MSB_LAST BIT_MASK 0x400 /end MEASUREMENT
/begin MEASUREMENT fmy_stat_pps_fsm_0.err_info_stat.lv_lock_diag "lock flag (CPU load optimisation) of the diagnosis instance PPS_FSM_0" UWORD _CNV_S_2_RANGE______380_CM 1 0. 0. 1. DISPLAY_IDENTIFIER LV_LOCK_DIAG_PPS_FSM_0 ECU_ADDRESS 0x7f9ad6 BYTE_ORDER MSB_LAST BIT_MASK 0x200 /end MEASUREMENT
/begin MEASUREMENT fmy_stat_pps_fsm_0.err_info_stat.lv_err_mem "storage in dynamic failure memory of the diagnosis instance PPS_FSM_0" UWORD _CNV_S_2_RANGE______380_CM 1 0. 0. 1. DISPLAY_IDENTIFIER LV_ERR_MEM_PPS_FSM_0 ECU_ADDRESS 0x7f9ad6 BYTE_ORDER MSB_LAST BIT_MASK 0x80 /end MEASUREMENT
/begin MEASUREMENT fmy_stat_pps_fsm_0.err_info_stat.lv_ready "readiness status of the diagnosis instance PPS_FSM_0" UWORD _CNV_S_2_RANGE______380_CM 1 0. 0. 1. DISPLAY_IDENTIFIER LV_READY_PPS_FSM_0 ECU_ADDRESS 0x7f9ad6 BYTE_ORDER MSB_LAST BIT_MASK 0x40 /end MEASUREMENT
/begin MEASUREMENT fmy_stat_pps_fsm_0.err_info_stat.lv_end_diag "end of diagnosis of the diagnosis instance PPS_FSM_0" UWORD _CNV_S_2_RANGE______380_CM 1 0. 0. 1. DISPLAY_IDENTIFIER LV_END_DIAG_PPS_FSM_0 ECU_ADDRESS 0x7f9ad6 BYTE_ORDER MSB_LAST BIT_MASK 0x20 /end MEASUREMENT
/begin MEASUREMENT fmy_stat_pps_fsm_0.err_info_stat.lv_cdn_diag "diagnosis condition of the diagnosis instance PPS_FSM_0" UWORD _CNV_S_2_RANGE______380_CM 1 0. 0. 1. DISPLAY_IDENTIFIER LV_CDN_DIAG_PPS_FSM_0 ECU_ADDRESS 0x7f9ad6 BYTE_ORDER MSB_LAST BIT_MASK 0x10 /end MEASUREMENT
/begin MEASUREMENT fmy_stat_pps_fsm_0.err_info_stat.err_sym "symptoms of the diagnosis instance PPS_FSM_0" UWORD _CNV_S_6_CONV_ERRM__27_CM 1 0. 0. 15. DISPLAY_IDENTIFIER ERR_SYM_PPS_FSM_0 ECU_ADDRESS 0x7f9ad6 BYTE_ORDER MSB_LAST BIT_MASK 0xF /end MEASUREMENT
/begin MEASUREMENT lv_err_pps_oc_0 "Error flag of diagnosis instance PPS_OC_0" UBYTE _CNV_S_2_RANGE______28_CM 1 0. 0. 1. DISPLAY_IDENTIFIER LV_ERR_PPS_OC_0 ECU_ADDRESS 0x7fb53b /end MEASUREMENT
/begin MEASUREMENT fmy_stat_pps_oc_0.ctr_abc "anti bounce counter for diagnosis instance PPS_OC_0" UBYTE _CNV_A_R_LINEAR_____1_CM 1 0. 0. 255. DISPLAY_IDENTIFIER CTR_ABC_PPS_OC_0 ECU_ADDRESS 0x7f9add FORMAT "%3.0" /end MEASUREMENT
/begin MEASUREMENT fmy_stat_pps_oc_0.ctr_end_diag "counter for end of diagnosis for diagnosis instance PPS_OC_0" UBYTE _CNV_A_R_LINEAR_____1_CM 1 0. 0. 255. DISPLAY_IDENTIFIER CTR_ABC_END_DIAG_PPS_OC_0 ECU_ADDRESS 0x7f9adc FORMAT "%3.0" /end MEASUREMENT
/begin MEASUREMENT fmy_stat_pps_oc_0.err_info_stat.reserved "" UWORD _CNV_A_R_LINEAR_____0_CM 1 0. 0. 65535. DISPLAY_IDENTIFIER FMY_STAT_PPS_OC_0_ERR_INFO_STAT_ ECU_ADDRESS 0x7f9ada BYTE_ORDER MSB_LAST BIT_MASK 0xF800 /end MEASUREMENT
/begin MEASUREMENT fmy_stat_pps_oc_0.err_info_stat.lv_cdn_diag_stc "Statistical flag for condition of diagnosis of the diagnosis instance PPS_OC_0" UWORD _CNV_S_2_RANGE______380_CM 1 0. 0. 1. DISPLAY_IDENTIFIER LV_CDN_DIAG_STC_PPS_OC_0 ECU_ADDRESS 0x7f9ada BYTE_ORDER MSB_LAST BIT_MASK 0x400 /end MEASUREMENT
/begin MEASUREMENT fmy_stat_pps_oc_0.err_info_stat.lv_lock_diag "lock flag (CPU load optimisation) of the diagnosis instance PPS_OC_0" UWORD _CNV_S_2_RANGE______380_CM 1 0. 0. 1. DISPLAY_IDENTIFIER LV_LOCK_DIAG_PPS_OC_0 ECU_ADDRESS 0x7f9ada BYTE_ORDER MSB_LAST BIT_MASK 0x200 /end MEASUREMENT
/begin MEASUREMENT fmy_stat_pps_oc_0.err_info_stat.lv_err_mem "storage in dynamic failure memory of the diagnosis instance PPS_OC_0" UWORD _CNV_S_2_RANGE______380_CM 1 0. 0. 1. DISPLAY_IDENTIFIER LV_ERR_MEM_PPS_OC_0 ECU_ADDRESS 0x7f9ada BYTE_ORDER MSB_LAST BIT_MASK 0x80 /end MEASUREMENT
/begin MEASUREMENT fmy_stat_pps_oc_0.err_info_stat.lv_ready "readiness status of the diagnosis instance PPS_OC_0" UWORD _CNV_S_2_RANGE______380_CM 1 0. 0. 1. DISPLAY_IDENTIFIER LV_READY_PPS_OC_0 ECU_ADDRESS 0x7f9ada BYTE_ORDER MSB_LAST BIT_MASK 0x40 /end MEASUREMENT
/begin MEASUREMENT fmy_stat_pps_oc_0.err_info_stat.lv_end_diag "end of diagnosis of the diagnosis instance PPS_OC_0" UWORD _CNV_S_2_RANGE______380_CM 1 0. 0. 1. DISPLAY_IDENTIFIER LV_END_DIAG_PPS_OC_0 ECU_ADDRESS 0x7f9ada BYTE_ORDER MSB_LAST BIT_MASK 0x20 /end MEASUREMENT
/begin MEASUREMENT fmy_stat_pps_oc_0.err_info_stat.lv_cdn_diag "diagnosis condition of the diagnosis instance PPS_OC_0" UWORD _CNV_S_2_RANGE______380_CM 1 0. 0. 1. DISPLAY_IDENTIFIER LV_CDN_DIAG_PPS_OC_0 ECU_ADDRESS 0x7f9ada BYTE_ORDER MSB_LAST BIT_MASK 0x10 /end MEASUREMENT
/begin MEASUREMENT fmy_stat_pps_oc_0.err_info_stat.err_sym "symptoms of the diagnosis instance PPS_OC_0" UWORD _CNV_S_6_CONV_ERRM__27_CM 1 0. 0. 15. DISPLAY_IDENTIFIER ERR_SYM_PPS_OC_0 ECU_ADDRESS 0x7f9ada BYTE_ORDER MSB_LAST BIT_MASK 0xF /end MEASUREMENT
/begin MEASUREMENT lv_err_pps_oc_1 "Error flag of diagnosis instance PPS_OC_1" UBYTE _CNV_S_2_RANGE______28_CM 1 0. 0. 1. DISPLAY_IDENTIFIER LV_ERR_PPS_OC_1 ECU_ADDRESS 0x7fb53c /end MEASUREMENT
/begin MEASUREMENT fmy_stat_pps_oc_1.ctr_abc "anti bounce counter for diagnosis instance PPS_OC_1" UBYTE _CNV_A_R_LINEAR_____1_CM 1 0. 0. 255. DISPLAY_IDENTIFIER CTR_ABC_PPS_OC_1 ECU_ADDRESS 0x7f9ae1 FORMAT "%3.0" /end MEASUREMENT
/begin MEASUREMENT fmy_stat_pps_oc_1.ctr_end_diag "counter for end of diagnosis for diagnosis instance PPS_OC_1" UBYTE _CNV_A_R_LINEAR_____1_CM 1 0. 0. 255. DISPLAY_IDENTIFIER CTR_ABC_END_DIAG_PPS_OC_1 ECU_ADDRESS 0x7f9ae0 FORMAT "%3.0" /end MEASUREMENT
/begin MEASUREMENT fmy_stat_pps_oc_1.err_info_stat.reserved "" UWORD _CNV_A_R_LINEAR_____0_CM 1 0. 0. 65535. DISPLAY_IDENTIFIER FMY_STAT_PPS_OC_1_ERR_INFO_STAT_ ECU_ADDRESS 0x7f9ade BYTE_ORDER MSB_LAST BIT_MASK 0xF800 /end MEASUREMENT
/begin MEASUREMENT fmy_stat_pps_oc_1.err_info_stat.lv_cdn_diag_stc "Statistical flag for condition of diagnosis of the diagnosis instance PPS_OC_1" UWORD _CNV_S_2_RANGE______380_CM 1 0. 0. 1. DISPLAY_IDENTIFIER LV_CDN_DIAG_STC_PPS_OC_1 ECU_ADDRESS 0x7f9ade BYTE_ORDER MSB_LAST BIT_MASK 0x400 /end MEASUREMENT
/begin MEASUREMENT fmy_stat_pps_oc_1.err_info_stat.lv_lock_diag "lock flag (CPU load optimisation) of the diagnosis instance PPS_OC_1" UWORD _CNV_S_2_RANGE______380_CM 1 0. 0. 1. DISPLAY_IDENTIFIER LV_LOCK_DIAG_PPS_OC_1 ECU_ADDRESS 0x7f9ade BYTE_ORDER MSB_LAST BIT_MASK 0x200 /end MEASUREMENT
/begin MEASUREMENT fmy_stat_pps_oc_1.err_info_stat.lv_err_mem "storage in dynamic failure memory of the diagnosis instance PPS_OC_1" UWORD _CNV_S_2_RANGE______380_CM 1 0. 0. 1. DISPLAY_IDENTIFIER LV_ERR_MEM_PPS_OC_1 ECU_ADDRESS 0x7f9ade BYTE_ORDER MSB_LAST BIT_MASK 0x80 /end MEASUREMENT
/begin MEASUREMENT fmy_stat_pps_oc_1.err_info_stat.lv_ready "readiness status of the diagnosis instance PPS_OC_1" UWORD _CNV_S_2_RANGE______380_CM 1 0. 0. 1. DISPLAY_IDENTIFIER LV_READY_PPS_OC_1 ECU_ADDRESS 0x7f9ade BYTE_ORDER MSB_LAST BIT_MASK 0x40 /end MEASUREMENT
/begin MEASUREMENT fmy_stat_pps_oc_1.err_info_stat.lv_end_diag "end of diagnosis of the diagnosis instance PPS_OC_1" UWORD _CNV_S_2_RANGE______380_CM 1 0. 0. 1. DISPLAY_IDENTIFIER LV_END_DIAG_PPS_OC_1 ECU_ADDRESS 0x7f9ade BYTE_ORDER MSB_LAST BIT_MASK 0x20 /end MEASUREMENT
/begin MEASUREMENT fmy_stat_pps_oc_1.err_info_stat.lv_cdn_diag "diagnosis condition of the diagnosis instance PPS_OC_1" UWORD _CNV_S_2_RANGE______380_CM 1 0. 0. 1. DISPLAY_IDENTIFIER LV_CDN_DIAG_PPS_OC_1 ECU_ADDRESS 0x7f9ade BYTE_ORDER MSB_LAST BIT_MASK 0x10 /end MEASUREMENT
/begin MEASUREMENT fmy_stat_pps_oc_1.err_info_stat.err_sym "symptoms of the diagnosis instance PPS_OC_1" UWORD _CNV_S_6_CONV_ERRM__27_CM 1 0. 0. 15. DISPLAY_IDENTIFIER ERR_SYM_PPS_OC_1 ECU_ADDRESS 0x7f9ade BYTE_ORDER MSB_LAST BIT_MASK 0xF /end MEASUREMENT
/begin MEASUREMENT lv_err_pps_oc_2 "Error flag of diagnosis instance PPS_OC_2" UBYTE _CNV_S_2_RANGE______28_CM 1 0. 0. 1. DISPLAY_IDENTIFIER LV_ERR_PPS_OC_2 ECU_ADDRESS 0x7fb53d /end MEASUREMENT
/begin MEASUREMENT fmy_stat_pps_oc_2.ctr_abc "anti bounce counter for diagnosis instance PPS_OC_2" UBYTE _CNV_A_R_LINEAR_____1_CM 1 0. 0. 255. DISPLAY_IDENTIFIER CTR_ABC_PPS_OC_2 ECU_ADDRESS 0x7f9ae5 FORMAT "%3.0" /end MEASUREMENT
/begin MEASUREMENT fmy_stat_pps_oc_2.ctr_end_diag "counter for end of diagnosis for diagnosis instance PPS_OC_2" UBYTE _CNV_A_R_LINEAR_____1_CM 1 0. 0. 255. DISPLAY_IDENTIFIER CTR_ABC_END_DIAG_PPS_OC_2 ECU_ADDRESS 0x7f9ae4 FORMAT "%3.0" /end MEASUREMENT
/begin MEASUREMENT fmy_stat_pps_oc_2.err_info_stat.reserved "" UWORD _CNV_A_R_LINEAR_____0_CM 1 0. 0. 65535. DISPLAY_IDENTIFIER FMY_STAT_PPS_OC_2_ERR_INFO_STAT_ ECU_ADDRESS 0x7f9ae2 BYTE_ORDER MSB_LAST BIT_MASK 0xF800 /end MEASUREMENT
/begin MEASUREMENT fmy_stat_pps_oc_2.err_info_stat.lv_cdn_diag_stc "Statistical flag for condition of diagnosis of the diagnosis instance PPS_OC_2" UWORD _CNV_S_2_RANGE______380_CM 1 0. 0. 1. DISPLAY_IDENTIFIER LV_CDN_DIAG_STC_PPS_OC_2 ECU_ADDRESS 0x7f9ae2 BYTE_ORDER MSB_LAST BIT_MASK 0x400 /end MEASUREMENT
/begin MEASUREMENT fmy_stat_pps_oc_2.err_info_stat.lv_lock_diag "lock flag (CPU load optimisation) of the diagnosis instance PPS_OC_2" UWORD _CNV_S_2_RANGE______380_CM 1 0. 0. 1. DISPLAY_IDENTIFIER LV_LOCK_DIAG_PPS_OC_2 ECU_ADDRESS 0x7f9ae2 BYTE_ORDER MSB_LAST BIT_MASK 0x200 /end MEASUREMENT
/begin MEASUREMENT fmy_stat_pps_oc_2.err_info_stat.lv_err_mem "storage in dynamic failure memory of the diagnosis instance PPS_OC_2" UWORD _CNV_S_2_RANGE______380_CM 1 0. 0. 1. DISPLAY_IDENTIFIER LV_ERR_MEM_PPS_OC_2 ECU_ADDRESS 0x7f9ae2 BYTE_ORDER MSB_LAST BIT_MASK 0x80 /end MEASUREMENT
/begin MEASUREMENT fmy_stat_pps_oc_2.err_info_stat.lv_ready "readiness status of the diagnosis instance PPS_OC_2" UWORD _CNV_S_2_RANGE______380_CM 1 0. 0. 1. DISPLAY_IDENTIFIER LV_READY_PPS_OC_2 ECU_ADDRESS 0x7f9ae2 BYTE_ORDER MSB_LAST BIT_MASK 0x40 /end MEASUREMENT
/begin MEASUREMENT fmy_stat_pps_oc_2.err_info_stat.lv_end_diag "end of diagnosis of the diagnosis instance PPS_OC_2" UWORD _CNV_S_2_RANGE______380_CM 1 0. 0. 1. DISPLAY_IDENTIFIER LV_END_DIAG_PPS_OC_2 ECU_ADDRESS 0x7f9ae2 BYTE_ORDER MSB_LAST BIT_MASK 0x20 /end MEASUREMENT
/begin MEASUREMENT fmy_stat_pps_oc_2.err_info_stat.lv_cdn_diag "diagnosis condition of the diagnosis instance PPS_OC_2" UWORD _CNV_S_2_RANGE______380_CM 1 0. 0. 1. DISPLAY_IDENTIFIER LV_CDN_DIAG_PPS_OC_2 ECU_ADDRESS 0x7f9ae2 BYTE_ORDER MSB_LAST BIT_MASK 0x10 /end MEASUREMENT
/begin MEASUREMENT fmy_stat_pps_oc_2.err_info_stat.err_sym "symptoms of the diagnosis instance PPS_OC_2" UWORD _CNV_S_6_CONV_ERRM__27_CM 1 0. 0. 15. DISPLAY_IDENTIFIER ERR_SYM_PPS_OC_2 ECU_ADDRESS 0x7f9ae2 BYTE_ORDER MSB_LAST BIT_MASK 0xF /end MEASUREMENT
/begin MEASUREMENT lv_err_pps_oc_3 "Error flag of diagnosis instance PPS_OC_3" UBYTE _CNV_S_2_RANGE______28_CM 1 0. 0. 1. DISPLAY_IDENTIFIER LV_ERR_PPS_OC_3 ECU_ADDRESS 0x7fb53e /end MEASUREMENT
/begin MEASUREMENT fmy_stat_pps_oc_3.ctr_abc "anti bounce counter for diagnosis instance PPS_OC_3" UBYTE _CNV_A_R_LINEAR_____1_CM 1 0. 0. 255. DISPLAY_IDENTIFIER CTR_ABC_PPS_OC_3 ECU_ADDRESS 0x7f9ae9 FORMAT "%3.0" /end MEASUREMENT
/begin MEASUREMENT fmy_stat_pps_oc_3.ctr_end_diag "counter for end of diagnosis for diagnosis instance PPS_OC_3" UBYTE _CNV_A_R_LINEAR_____1_CM 1 0. 0. 255. DISPLAY_IDENTIFIER CTR_ABC_END_DIAG_PPS_OC_3 ECU_ADDRESS 0x7f9ae8 FORMAT "%3.0" /end MEASUREMENT
/begin MEASUREMENT fmy_stat_pps_oc_3.err_info_stat.reserved "" UWORD _CNV_A_R_LINEAR_____0_CM 1 0. 0. 65535. DISPLAY_IDENTIFIER FMY_STAT_PPS_OC_3_ERR_INFO_STAT_ ECU_ADDRESS 0x7f9ae6 BYTE_ORDER MSB_LAST BIT_MASK 0xF800 /end MEASUREMENT
/begin MEASUREMENT fmy_stat_pps_oc_3.err_info_stat.lv_cdn_diag_stc "Statistical flag for condition of diagnosis of the diagnosis instance PPS_OC_3" UWORD _CNV_S_2_RANGE______380_CM 1 0. 0. 1. DISPLAY_IDENTIFIER LV_CDN_DIAG_STC_PPS_OC_3 ECU_ADDRESS 0x7f9ae6 BYTE_ORDER MSB_LAST BIT_MASK 0x400 /end MEASUREMENT
/begin MEASUREMENT fmy_stat_pps_oc_3.err_info_stat.lv_lock_diag "lock flag (CPU load optimisation) of the diagnosis instance PPS_OC_3" UWORD _CNV_S_2_RANGE______380_CM 1 0. 0. 1. DISPLAY_IDENTIFIER LV_LOCK_DIAG_PPS_OC_3 ECU_ADDRESS 0x7f9ae6 BYTE_ORDER MSB_LAST BIT_MASK 0x200 /end MEASUREMENT
/begin MEASUREMENT fmy_stat_pps_oc_3.err_info_stat.lv_err_mem "storage in dynamic failure memory of the diagnosis instance PPS_OC_3" UWORD _CNV_S_2_RANGE______380_CM 1 0. 0. 1. DISPLAY_IDENTIFIER LV_ERR_MEM_PPS_OC_3 ECU_ADDRESS 0x7f9ae6 BYTE_ORDER MSB_LAST BIT_MASK 0x80 /end MEASUREMENT
/begin MEASUREMENT fmy_stat_pps_oc_3.err_info_stat.lv_ready "readiness status of the diagnosis instance PPS_OC_3" UWORD _CNV_S_2_RANGE______380_CM 1 0. 0. 1. DISPLAY_IDENTIFIER LV_READY_PPS_OC_3 ECU_ADDRESS 0x7f9ae6 BYTE_ORDER MSB_LAST BIT_MASK 0x40 /end MEASUREMENT
/begin MEASUREMENT fmy_stat_pps_oc_3.err_info_stat.lv_end_diag "end of diagnosis of the diagnosis instance PPS_OC_3" UWORD _CNV_S_2_RANGE______380_CM 1 0. 0. 1. DISPLAY_IDENTIFIER LV_END_DIAG_PPS_OC_3 ECU_ADDRESS 0x7f9ae6 BYTE_ORDER MSB_LAST BIT_MASK 0x20 /end MEASUREMENT
/begin MEASUREMENT fmy_stat_pps_oc_3.err_info_stat.lv_cdn_diag "diagnosis condition of the diagnosis instance PPS_OC_3" UWORD _CNV_S_2_RANGE______380_CM 1 0. 0. 1. DISPLAY_IDENTIFIER LV_CDN_DIAG_PPS_OC_3 ECU_ADDRESS 0x7f9ae6 BYTE_ORDER MSB_LAST BIT_MASK 0x10 /end MEASUREMENT
/begin MEASUREMENT fmy_stat_pps_oc_3.err_info_stat.err_sym "symptoms of the diagnosis instance PPS_OC_3" UWORD _CNV_S_6_CONV_ERRM__27_CM 1 0. 0. 15. DISPLAY_IDENTIFIER ERR_SYM_PPS_OC_3 ECU_ADDRESS 0x7f9ae6 BYTE_ORDER MSB_LAST BIT_MASK 0xF /end MEASUREMENT
/begin MEASUREMENT lv_err_pps_sc_h_l_0 "Error flag of diagnosis instance PPS_SC_H_L_0" UBYTE _CNV_S_2_RANGE______28_CM 1 0. 0. 1. DISPLAY_IDENTIFIER LV_ERR_PPS_SC_H_L_0 ECU_ADDRESS 0x7fb53f /end MEASUREMENT
/begin MEASUREMENT fmy_stat_pps_sc_h_l_0.ctr_abc "anti bounce counter for diagnosis instance PPS_SC_H_L_0" UBYTE _CNV_A_R_LINEAR_____1_CM 1 0. 0. 255. DISPLAY_IDENTIFIER CTR_ABC_PPS_SC_H_L_0 ECU_ADDRESS 0x7f9aed FORMAT "%3.0" /end MEASUREMENT
/begin MEASUREMENT fmy_stat_pps_sc_h_l_0.ctr_end_diag "counter for end of diagnosis for diagnosis instance PPS_SC_H_L_0" UBYTE _CNV_A_R_LINEAR_____1_CM 1 0. 0. 255. DISPLAY_IDENTIFIER CTR_ABC_END_DIAG_PPS_SC_H_L_0 ECU_ADDRESS 0x7f9aec FORMAT "%3.0" /end MEASUREMENT
/begin MEASUREMENT fmy_stat_pps_sc_h_l_0.err_info_stat.reserved "" UWORD _CNV_A_R_LINEAR_____0_CM 1 0. 0. 65535. DISPLAY_IDENTIFIER FMY_STAT_PPS_SC_H_L_0_ERR_INFO_S ECU_ADDRESS 0x7f9aea BYTE_ORDER MSB_LAST BIT_MASK 0xF800 /end MEASUREMENT
/begin MEASUREMENT fmy_stat_pps_sc_h_l_0.err_info_stat.lv_cdn_diag_stc "Statistical flag for condition of diagnosis of the diagnosis instance PPS_SC_H_L_0" UWORD _CNV_S_2_RANGE______380_CM 1 0. 0. 1. DISPLAY_IDENTIFIER LV_CDN_DIAG_STC_PPS_SC_H_L_0 ECU_ADDRESS 0x7f9aea BYTE_ORDER MSB_LAST BIT_MASK 0x400 /end MEASUREMENT
/begin MEASUREMENT fmy_stat_pps_sc_h_l_0.err_info_stat.lv_lock_diag "lock flag (CPU load optimisation) of the diagnosis instance PPS_SC_H_L_0" UWORD _CNV_S_2_RANGE______380_CM 1 0. 0. 1. DISPLAY_IDENTIFIER LV_LOCK_DIAG_PPS_SC_H_L_0 ECU_ADDRESS 0x7f9aea BYTE_ORDER MSB_LAST BIT_MASK 0x200 /end MEASUREMENT
/begin MEASUREMENT fmy_stat_pps_sc_h_l_0.err_info_stat.lv_err_mem "storage in dynamic failure memory of the diagnosis instance PPS_SC_H_L_0" UWORD _CNV_S_2_RANGE______380_CM 1 0. 0. 1. DISPLAY_IDENTIFIER LV_ERR_MEM_PPS_SC_H_L_0 ECU_ADDRESS 0x7f9aea BYTE_ORDER MSB_LAST BIT_MASK 0x80 /end MEASUREMENT
/begin MEASUREMENT fmy_stat_pps_sc_h_l_0.err_info_stat.lv_ready "readiness status of the diagnosis instance PPS_SC_H_L_0" UWORD _CNV_S_2_RANGE______380_CM 1 0. 0. 1. DISPLAY_IDENTIFIER LV_READY_PPS_SC_H_L_0 ECU_ADDRESS 0x7f9aea BYTE_ORDER MSB_LAST BIT_MASK 0x40 /end MEASUREMENT
/begin MEASUREMENT fmy_stat_pps_sc_h_l_0.err_info_stat.lv_end_diag "end of diagnosis of the diagnosis instance PPS_SC_H_L_0" UWORD _CNV_S_2_RANGE______380_CM 1 0. 0. 1. DISPLAY_IDENTIFIER LV_END_DIAG_PPS_SC_H_L_0 ECU_ADDRESS 0x7f9aea BYTE_ORDER MSB_LAST BIT_MASK 0x20 /end MEASUREMENT
/begin MEASUREMENT fmy_stat_pps_sc_h_l_0.err_info_stat.lv_cdn_diag "diagnosis condition of the diagnosis instance PPS_SC_H_L_0" UWORD _CNV_S_2_RANGE______380_CM 1 0. 0. 1. DISPLAY_IDENTIFIER LV_CDN_DIAG_PPS_SC_H_L_0 ECU_ADDRESS 0x7f9aea BYTE_ORDER MSB_LAST BIT_MASK 0x10 /end MEASUREMENT
/begin MEASUREMENT fmy_stat_pps_sc_h_l_0.err_info_stat.err_sym "symptoms of the diagnosis instance PPS_SC_H_L_0" UWORD _CNV_S_6_CONV_ERRM__27_CM 1 0. 0. 15. DISPLAY_IDENTIFIER ERR_SYM_PPS_SC_H_L_0 ECU_ADDRESS 0x7f9aea BYTE_ORDER MSB_LAST BIT_MASK 0xF /end MEASUREMENT
/begin MEASUREMENT lv_err_pps_sc_h_l_1 "Error flag of diagnosis instance PPS_SC_H_L_1" UBYTE _CNV_S_2_RANGE______28_CM 1 0. 0. 1. DISPLAY_IDENTIFIER LV_ERR_PPS_SC_H_L_1 ECU_ADDRESS 0x7fb540 /end MEASUREMENT
/begin MEASUREMENT fmy_stat_pps_sc_h_l_1.ctr_abc "anti bounce counter for diagnosis instance PPS_SC_H_L_1" UBYTE _CNV_A_R_LINEAR_____1_CM 1 0. 0. 255. DISPLAY_IDENTIFIER CTR_ABC_PPS_SC_H_L_1 ECU_ADDRESS 0x7f9af1 FORMAT "%3.0" /end MEASUREMENT
/begin MEASUREMENT fmy_stat_pps_sc_h_l_1.ctr_end_diag "counter for end of diagnosis for diagnosis instance PPS_SC_H_L_1" UBYTE _CNV_A_R_LINEAR_____1_CM 1 0. 0. 255. DISPLAY_IDENTIFIER CTR_ABC_END_DIAG_PPS_SC_H_L_1 ECU_ADDRESS 0x7f9af0 FORMAT "%3.0" /end MEASUREMENT
/begin MEASUREMENT fmy_stat_pps_sc_h_l_1.err_info_stat.reserved "" UWORD _CNV_A_R_LINEAR_____0_CM 1 0. 0. 65535. DISPLAY_IDENTIFIER FMY_STAT_PPS_SC_H_L_1_ERR_INFO_S ECU_ADDRESS 0x7f9aee BYTE_ORDER MSB_LAST BIT_MASK 0xF800 /end MEASUREMENT
/begin MEASUREMENT fmy_stat_pps_sc_h_l_1.err_info_stat.lv_cdn_diag_stc "Statistical flag for condition of diagnosis of the diagnosis instance PPS_SC_H_L_1" UWORD _CNV_S_2_RANGE______380_CM 1 0. 0. 1. DISPLAY_IDENTIFIER LV_CDN_DIAG_STC_PPS_SC_H_L_1 ECU_ADDRESS 0x7f9aee BYTE_ORDER MSB_LAST BIT_MASK 0x400 /end MEASUREMENT
/begin MEASUREMENT fmy_stat_pps_sc_h_l_1.err_info_stat.lv_lock_diag "lock flag (CPU load optimisation) of the diagnosis instance PPS_SC_H_L_1" UWORD _CNV_S_2_RANGE______380_CM 1 0. 0. 1. DISPLAY_IDENTIFIER LV_LOCK_DIAG_PPS_SC_H_L_1 ECU_ADDRESS 0x7f9aee BYTE_ORDER MSB_LAST BIT_MASK 0x200 /end MEASUREMENT
/begin MEASUREMENT fmy_stat_pps_sc_h_l_1.err_info_stat.lv_err_mem "storage in dynamic failure memory of the diagnosis instance PPS_SC_H_L_1" UWORD _CNV_S_2_RANGE______380_CM 1 0. 0. 1. DISPLAY_IDENTIFIER LV_ERR_MEM_PPS_SC_H_L_1 ECU_ADDRESS 0x7f9aee BYTE_ORDER MSB_LAST BIT_MASK 0x80 /end MEASUREMENT
/begin MEASUREMENT fmy_stat_pps_sc_h_l_1.err_info_stat.lv_ready "readiness status of the diagnosis instance PPS_SC_H_L_1" UWORD _CNV_S_2_RANGE______380_CM 1 0. 0. 1. DISPLAY_IDENTIFIER LV_READY_PPS_SC_H_L_1 ECU_ADDRESS 0x7f9aee BYTE_ORDER MSB_LAST BIT_MASK 0x40 /end MEASUREMENT
/begin MEASUREMENT fmy_stat_pps_sc_h_l_1.err_info_stat.lv_end_diag "end of diagnosis of the diagnosis instance PPS_SC_H_L_1" UWORD _CNV_S_2_RANGE______380_CM 1 0. 0. 1. DISPLAY_IDENTIFIER LV_END_DIAG_PPS_SC_H_L_1 ECU_ADDRESS 0x7f9aee BYTE_ORDER MSB_LAST BIT_MASK 0x20 /end MEASUREMENT
/begin MEASUREMENT fmy_stat_pps_sc_h_l_1.err_info_stat.lv_cdn_diag "diagnosis condition of the diagnosis instance PPS_SC_H_L_1" UWORD _CNV_S_2_RANGE______380_CM 1 0. 0. 1. DISPLAY_IDENTIFIER LV_CDN_DIAG_PPS_SC_H_L_1 ECU_ADDRESS 0x7f9aee BYTE_ORDER MSB_LAST BIT_MASK 0x10 /end MEASUREMENT
/begin MEASUREMENT fmy_stat_pps_sc_h_l_1.err_info_stat.err_sym "symptoms of the diagnosis instance PPS_SC_H_L_1" UWORD _CNV_S_6_CONV_ERRM__27_CM 1 0. 0. 15. DISPLAY_IDENTIFIER ERR_SYM_PPS_SC_H_L_1 ECU_ADDRESS 0x7f9aee BYTE_ORDER MSB_LAST BIT_MASK 0xF /end MEASUREMENT
/begin MEASUREMENT lv_err_pps_sc_h_l_2 "Error flag of diagnosis instance PPS_SC_H_L_2" UBYTE _CNV_S_2_RANGE______28_CM 1 0. 0. 1. DISPLAY_IDENTIFIER LV_ERR_PPS_SC_H_L_2 ECU_ADDRESS 0x7fb541 /end MEASUREMENT
/begin MEASUREMENT fmy_stat_pps_sc_h_l_2.ctr_abc "anti bounce counter for diagnosis instance PPS_SC_H_L_2" UBYTE _CNV_A_R_LINEAR_____1_CM 1 0. 0. 255. DISPLAY_IDENTIFIER CTR_ABC_PPS_SC_H_L_2 ECU_ADDRESS 0x7f9af5 FORMAT "%3.0" /end MEASUREMENT
/begin MEASUREMENT fmy_stat_pps_sc_h_l_2.ctr_end_diag "counter for end of diagnosis for diagnosis instance PPS_SC_H_L_2" UBYTE _CNV_A_R_LINEAR_____1_CM 1 0. 0. 255. DISPLAY_IDENTIFIER CTR_ABC_END_DIAG_PPS_SC_H_L_2 ECU_ADDRESS 0x7f9af4 FORMAT "%3.0" /end MEASUREMENT
/begin MEASUREMENT fmy_stat_pps_sc_h_l_2.err_info_stat.reserved "" UWORD _CNV_A_R_LINEAR_____0_CM 1 0. 0. 65535. DISPLAY_IDENTIFIER FMY_STAT_PPS_SC_H_L_2_ERR_INFO_S ECU_ADDRESS 0x7f9af2 BYTE_ORDER MSB_LAST BIT_MASK 0xF800 /end MEASUREMENT
/begin MEASUREMENT fmy_stat_pps_sc_h_l_2.err_info_stat.lv_cdn_diag_stc "Statistical flag for condition of diagnosis of the diagnosis instance PPS_SC_H_L_2" UWORD _CNV_S_2_RANGE______380_CM 1 0. 0. 1. DISPLAY_IDENTIFIER LV_CDN_DIAG_STC_PPS_SC_H_L_2 ECU_ADDRESS 0x7f9af2 BYTE_ORDER MSB_LAST BIT_MASK 0x400 /end MEASUREMENT
/begin MEASUREMENT fmy_stat_pps_sc_h_l_2.err_info_stat.lv_lock_diag "lock flag (CPU load optimisation) of the diagnosis instance PPS_SC_H_L_2" UWORD _CNV_S_2_RANGE______380_CM 1 0. 0. 1. DISPLAY_IDENTIFIER LV_LOCK_DIAG_PPS_SC_H_L_2 ECU_ADDRESS 0x7f9af2 BYTE_ORDER MSB_LAST BIT_MASK 0x200 /end MEASUREMENT
/begin MEASUREMENT fmy_stat_pps_sc_h_l_2.err_info_stat.lv_err_mem "storage in dynamic failure memory of the diagnosis instance PPS_SC_H_L_2" UWORD _CNV_S_2_RANGE______380_CM 1 0. 0. 1. DISPLAY_IDENTIFIER LV_ERR_MEM_PPS_SC_H_L_2 ECU_ADDRESS 0x7f9af2 BYTE_ORDER MSB_LAST BIT_MASK 0x80 /end MEASUREMENT
/begin MEASUREMENT fmy_stat_pps_sc_h_l_2.err_info_stat.lv_ready "readiness status of the diagnosis instance PPS_SC_H_L_2" UWORD _CNV_S_2_RANGE______380_CM 1 0. 0. 1. DISPLAY_IDENTIFIER LV_READY_PPS_SC_H_L_2 ECU_ADDRESS 0x7f9af2 BYTE_ORDER MSB_LAST BIT_MASK 0x40 /end MEASUREMENT
/begin MEASUREMENT fmy_stat_pps_sc_h_l_2.err_info_stat.lv_end_diag "end of diagnosis of the diagnosis instance PPS_SC_H_L_2" UWORD _CNV_S_2_RANGE______380_CM 1 0. 0. 1. DISPLAY_IDENTIFIER LV_END_DIAG_PPS_SC_H_L_2 ECU_ADDRESS 0x7f9af2 BYTE_ORDER MSB_LAST BIT_MASK 0x20 /end MEASUREMENT
/begin MEASUREMENT fmy_stat_pps_sc_h_l_2.err_info_stat.lv_cdn_diag "diagnosis condition of the diagnosis instance PPS_SC_H_L_2" UWORD _CNV_S_2_RANGE______380_CM 1 0. 0. 1. DISPLAY_IDENTIFIER LV_CDN_DIAG_PPS_SC_H_L_2 ECU_ADDRESS 0x7f9af2 BYTE_ORDER MSB_LAST BIT_MASK 0x10 /end MEASUREMENT
/begin MEASUREMENT fmy_stat_pps_sc_h_l_2.err_info_stat.err_sym "symptoms of the diagnosis instance PPS_SC_H_L_2" UWORD _CNV_S_6_CONV_ERRM__27_CM 1 0. 0. 15. DISPLAY_IDENTIFIER ERR_SYM_PPS_SC_H_L_2 ECU_ADDRESS 0x7f9af2 BYTE_ORDER MSB_LAST BIT_MASK 0xF /end MEASUREMENT
/begin MEASUREMENT lv_err_pps_sc_h_l_3 "Error flag of diagnosis instance PPS_SC_H_L_3" UBYTE _CNV_S_2_RANGE______28_CM 1 0. 0. 1. DISPLAY_IDENTIFIER LV_ERR_PPS_SC_H_L_3 ECU_ADDRESS 0x7fb542 /end MEASUREMENT
/begin MEASUREMENT fmy_stat_pps_sc_h_l_3.ctr_abc "anti bounce counter for diagnosis instance PPS_SC_H_L_3" UBYTE _CNV_A_R_LINEAR_____1_CM 1 0. 0. 255. DISPLAY_IDENTIFIER CTR_ABC_PPS_SC_H_L_3 ECU_ADDRESS 0x7f9af9 FORMAT "%3.0" /end MEASUREMENT
/begin MEASUREMENT fmy_stat_pps_sc_h_l_3.ctr_end_diag "counter for end of diagnosis for diagnosis instance PPS_SC_H_L_3" UBYTE _CNV_A_R_LINEAR_____1_CM 1 0. 0. 255. DISPLAY_IDENTIFIER CTR_ABC_END_DIAG_PPS_SC_H_L_3 ECU_ADDRESS 0x7f9af8 FORMAT "%3.0" /end MEASUREMENT
/begin MEASUREMENT fmy_stat_pps_sc_h_l_3.err_info_stat.reserved "" UWORD _CNV_A_R_LINEAR_____0_CM 1 0. 0. 65535. DISPLAY_IDENTIFIER FMY_STAT_PPS_SC_H_L_3_ERR_INFO_S ECU_ADDRESS 0x7f9af6 BYTE_ORDER MSB_LAST BIT_MASK 0xF800 /end MEASUREMENT
/begin MEASUREMENT fmy_stat_pps_sc_h_l_3.err_info_stat.lv_cdn_diag_stc "Statistical flag for condition of diagnosis of the diagnosis instance PPS_SC_H_L_3" UWORD _CNV_S_2_RANGE______380_CM 1 0. 0. 1. DISPLAY_IDENTIFIER LV_CDN_DIAG_STC_PPS_SC_H_L_3 ECU_ADDRESS 0x7f9af6 BYTE_ORDER MSB_LAST BIT_MASK 0x400 /end MEASUREMENT
/begin MEASUREMENT fmy_stat_pps_sc_h_l_3.err_info_stat.lv_lock_diag "lock flag (CPU load optimisation) of the diagnosis instance PPS_SC_H_L_3" UWORD _CNV_S_2_RANGE______380_CM 1 0. 0. 1. DISPLAY_IDENTIFIER LV_LOCK_DIAG_PPS_SC_H_L_3 ECU_ADDRESS 0x7f9af6 BYTE_ORDER MSB_LAST BIT_MASK 0x200 /end MEASUREMENT
/begin MEASUREMENT fmy_stat_pps_sc_h_l_3.err_info_stat.lv_err_mem "storage in dynamic failure memory of the diagnosis instance PPS_SC_H_L_3" UWORD _CNV_S_2_RANGE______380_CM 1 0. 0. 1. DISPLAY_IDENTIFIER LV_ERR_MEM_PPS_SC_H_L_3 ECU_ADDRESS 0x7f9af6 BYTE_ORDER MSB_LAST BIT_MASK 0x80 /end MEASUREMENT
/begin MEASUREMENT fmy_stat_pps_sc_h_l_3.err_info_stat.lv_ready "readiness status of the diagnosis instance PPS_SC_H_L_3" UWORD _CNV_S_2_RANGE______380_CM 1 0. 0. 1. DISPLAY_IDENTIFIER LV_READY_PPS_SC_H_L_3 ECU_ADDRESS 0x7f9af6 BYTE_ORDER MSB_LAST BIT_MASK 0x40 /end MEASUREMENT
/begin MEASUREMENT fmy_stat_pps_sc_h_l_3.err_info_stat.lv_end_diag "end of diagnosis of the diagnosis instance PPS_SC_H_L_3" UWORD _CNV_S_2_RANGE______380_CM 1 0. 0. 1. DISPLAY_IDENTIFIER LV_END_DIAG_PPS_SC_H_L_3 ECU_ADDRESS 0x7f9af6 BYTE_ORDER MSB_LAST BIT_MASK 0x20 /end MEASUREMENT
/begin MEASUREMENT fmy_stat_pps_sc_h_l_3.err_info_stat.lv_cdn_diag "diagnosis condition of the diagnosis instance PPS_SC_H_L_3" UWORD _CNV_S_2_RANGE______380_CM 1 0. 0. 1. DISPLAY_IDENTIFIER LV_CDN_DIAG_PPS_SC_H_L_3 ECU_ADDRESS 0x7f9af6 BYTE_ORDER MSB_LAST BIT_MASK 0x10 /end MEASUREMENT
/begin MEASUREMENT fmy_stat_pps_sc_h_l_3.err_info_stat.err_sym "symptoms of the diagnosis instance PPS_SC_H_L_3" UWORD _CNV_S_6_CONV_ERRM__27_CM 1 0. 0. 15. DISPLAY_IDENTIFIER ERR_SYM_PPS_SC_H_L_3 ECU_ADDRESS 0x7f9af6 BYTE_ORDER MSB_LAST BIT_MASK 0xF /end MEASUREMENT
/begin MEASUREMENT lv_err_pps_sc_h_0 "Error flag of diagnosis instance PPS_SC_H_0" UBYTE _CNV_S_2_RANGE______28_CM 1 0. 0. 1. DISPLAY_IDENTIFIER LV_ERR_PPS_SC_H_0 ECU_ADDRESS 0x7fb543 /end MEASUREMENT
/begin MEASUREMENT fmy_stat_pps_sc_h_0.ctr_abc "anti bounce counter for diagnosis instance PPS_SC_H_0" UBYTE _CNV_A_R_LINEAR_____1_CM 1 0. 0. 255. DISPLAY_IDENTIFIER CTR_ABC_PPS_SC_H_0 ECU_ADDRESS 0x7f9afd FORMAT "%3.0" /end MEASUREMENT
/begin MEASUREMENT fmy_stat_pps_sc_h_0.ctr_end_diag "counter for end of diagnosis for diagnosis instance PPS_SC_H_0" UBYTE _CNV_A_R_LINEAR_____1_CM 1 0. 0. 255. DISPLAY_IDENTIFIER CTR_ABC_END_DIAG_PPS_SC_H_0 ECU_ADDRESS 0x7f9afc FORMAT "%3.0" /end MEASUREMENT
/begin MEASUREMENT fmy_stat_pps_sc_h_0.err_info_stat.reserved "" UWORD _CNV_A_R_LINEAR_____0_CM 1 0. 0. 65535. DISPLAY_IDENTIFIER FMY_STAT_PPS_SC_H_0_ERR_INFO_STA ECU_ADDRESS 0x7f9afa BYTE_ORDER MSB_LAST BIT_MASK 0xF800 /end MEASUREMENT
/begin MEASUREMENT fmy_stat_pps_sc_h_0.err_info_stat.lv_cdn_diag_stc "Statistical flag for condition of diagnosis of the diagnosis instance PPS_SC_H_0" UWORD _CNV_S_2_RANGE______380_CM 1 0. 0. 1. DISPLAY_IDENTIFIER LV_CDN_DIAG_STC_PPS_SC_H_0 ECU_ADDRESS 0x7f9afa BYTE_ORDER MSB_LAST BIT_MASK 0x400 /end MEASUREMENT
/begin MEASUREMENT fmy_stat_pps_sc_h_0.err_info_stat.lv_lock_diag "lock flag (CPU load optimisation) of the diagnosis instance PPS_SC_H_0" UWORD _CNV_S_2_RANGE______380_CM 1 0. 0. 1. DISPLAY_IDENTIFIER LV_LOCK_DIAG_PPS_SC_H_0 ECU_ADDRESS 0x7f9afa BYTE_ORDER MSB_LAST BIT_MASK 0x200 /end MEASUREMENT
/begin MEASUREMENT fmy_stat_pps_sc_h_0.err_info_stat.lv_err_mem "storage in dynamic failure memory of the diagnosis instance PPS_SC_H_0" UWORD _CNV_S_2_RANGE______380_CM 1 0. 0. 1. DISPLAY_IDENTIFIER LV_ERR_MEM_PPS_SC_H_0 ECU_ADDRESS 0x7f9afa BYTE_ORDER MSB_LAST BIT_MASK 0x80 /end MEASUREMENT
/begin MEASUREMENT fmy_stat_pps_sc_h_0.err_info_stat.lv_ready "readiness status of the diagnosis instance PPS_SC_H_0" UWORD _CNV_S_2_RANGE______380_CM 1 0. 0. 1. DISPLAY_IDENTIFIER LV_READY_PPS_SC_H_0 ECU_ADDRESS 0x7f9afa BYTE_ORDER MSB_LAST BIT_MASK 0x40 /end MEASUREMENT
/begin MEASUREMENT fmy_stat_pps_sc_h_0.err_info_stat.lv_end_diag "end of diagnosis of the diagnosis instance PPS_SC_H_0" UWORD _CNV_S_2_RANGE______380_CM 1 0. 0. 1. DISPLAY_IDENTIFIER LV_END_DIAG_PPS_SC_H_0 ECU_ADDRESS 0x7f9afa BYTE_ORDER MSB_LAST BIT_MASK 0x20 /end MEASUREMENT
/begin MEASUREMENT fmy_stat_pps_sc_h_0.err_info_stat.lv_cdn_diag "diagnosis condition of the diagnosis instance PPS_SC_H_0" UWORD _CNV_S_2_RANGE______380_CM 1 0. 0. 1. DISPLAY_IDENTIFIER LV_CDN_DIAG_PPS_SC_H_0 ECU_ADDRESS 0x7f9afa BYTE_ORDER MSB_LAST BIT_MASK 0x10 /end MEASUREMENT
/begin MEASUREMENT fmy_stat_pps_sc_h_0.err_info_stat.err_sym "symptoms of the diagnosis instance PPS_SC_H_0" UWORD _CNV_S_6_CONV_ERRM__27_CM 1 0. 0. 15. DISPLAY_IDENTIFIER ERR_SYM_PPS_SC_H_0 ECU_ADDRESS 0x7f9afa BYTE_ORDER MSB_LAST BIT_MASK 0xF /end MEASUREMENT
/begin MEASUREMENT lv_err_pps_sc_l_0 "Error flag of diagnosis instance PPS_SC_L_0" UBYTE _CNV_S_2_RANGE______28_CM 1 0. 0. 1. DISPLAY_IDENTIFIER LV_ERR_PPS_SC_L_0 ECU_ADDRESS 0x7fb544 /end MEASUREMENT
/begin MEASUREMENT fmy_stat_pps_sc_l_0.ctr_abc "anti bounce counter for diagnosis instance PPS_SC_L_0" UBYTE _CNV_A_R_LINEAR_____1_CM 1 0. 0. 255. DISPLAY_IDENTIFIER CTR_ABC_PPS_SC_L_0 ECU_ADDRESS 0x7f9b01 FORMAT "%3.0" /end MEASUREMENT
/begin MEASUREMENT fmy_stat_pps_sc_l_0.ctr_end_diag "counter for end of diagnosis for diagnosis instance PPS_SC_L_0" UBYTE _CNV_A_R_LINEAR_____1_CM 1 0. 0. 255. DISPLAY_IDENTIFIER CTR_ABC_END_DIAG_PPS_SC_L_0 ECU_ADDRESS 0x7f9b00 FORMAT "%3.0" /end MEASUREMENT
/begin MEASUREMENT fmy_stat_pps_sc_l_0.err_info_stat.reserved "" UWORD _CNV_A_R_LINEAR_____0_CM 1 0. 0. 65535. DISPLAY_IDENTIFIER FMY_STAT_PPS_SC_L_0_ERR_INFO_STA ECU_ADDRESS 0x7f9afe BYTE_ORDER MSB_LAST BIT_MASK 0xF800 /end MEASUREMENT
/begin MEASUREMENT fmy_stat_pps_sc_l_0.err_info_stat.lv_cdn_diag_stc "Statistical flag for condition of diagnosis of the diagnosis instance PPS_SC_L_0" UWORD _CNV_S_2_RANGE______380_CM 1 0. 0. 1. DISPLAY_IDENTIFIER LV_CDN_DIAG_STC_PPS_SC_L_0 ECU_ADDRESS 0x7f9afe BYTE_ORDER MSB_LAST BIT_MASK 0x400 /end MEASUREMENT
/begin MEASUREMENT fmy_stat_pps_sc_l_0.err_info_stat.lv_lock_diag "lock flag (CPU load optimisation) of the diagnosis instance PPS_SC_L_0" UWORD _CNV_S_2_RANGE______380_CM 1 0. 0. 1. DISPLAY_IDENTIFIER LV_LOCK_DIAG_PPS_SC_L_0 ECU_ADDRESS 0x7f9afe BYTE_ORDER MSB_LAST BIT_MASK 0x200 /end MEASUREMENT
/begin MEASUREMENT fmy_stat_pps_sc_l_0.err_info_stat.lv_err_mem "storage in dynamic failure memory of the diagnosis instance PPS_SC_L_0" UWORD _CNV_S_2_RANGE______380_CM 1 0. 0. 1. DISPLAY_IDENTIFIER LV_ERR_MEM_PPS_SC_L_0 ECU_ADDRESS 0x7f9afe BYTE_ORDER MSB_LAST BIT_MASK 0x80 /end MEASUREMENT
/begin MEASUREMENT fmy_stat_pps_sc_l_0.err_info_stat.lv_ready "readiness status of the diagnosis instance PPS_SC_L_0" UWORD _CNV_S_2_RANGE______380_CM 1 0. 0. 1. DISPLAY_IDENTIFIER LV_READY_PPS_SC_L_0 ECU_ADDRESS 0x7f9afe BYTE_ORDER MSB_LAST BIT_MASK 0x40 /end MEASUREMENT
/begin MEASUREMENT fmy_stat_pps_sc_l_0.err_info_stat.lv_end_diag "end of diagnosis of the diagnosis instance PPS_SC_L_0" UWORD _CNV_S_2_RANGE______380_CM 1 0. 0. 1. DISPLAY_IDENTIFIER LV_END_DIAG_PPS_SC_L_0 ECU_ADDRESS 0x7f9afe BYTE_ORDER MSB_LAST BIT_MASK 0x20 /end MEASUREMENT
/begin MEASUREMENT fmy_stat_pps_sc_l_0.err_info_stat.lv_cdn_diag "diagnosis condition of the diagnosis instance PPS_SC_L_0" UWORD _CNV_S_2_RANGE______380_CM 1 0. 0. 1. DISPLAY_IDENTIFIER LV_CDN_DIAG_PPS_SC_L_0 ECU_ADDRESS 0x7f9afe BYTE_ORDER MSB_LAST BIT_MASK 0x10 /end MEASUREMENT
/begin MEASUREMENT fmy_stat_pps_sc_l_0.err_info_stat.err_sym "symptoms of the diagnosis instance PPS_SC_L_0" UWORD _CNV_S_6_CONV_ERRM__27_CM 1 0. 0. 15. DISPLAY_IDENTIFIER ERR_SYM_PPS_SC_L_0 ECU_ADDRESS 0x7f9afe BYTE_ORDER MSB_LAST BIT_MASK 0xF /end MEASUREMENT
/begin COMPU_METHOD _CNV_A_R_LINEAR_____0_CM "" RAT_FUNC "%6.3" "[-]" COEFFS 0 1. 0. 0 0 1 /end COMPU_METHOD
/begin COMPU_METHOD _CNV_A_R_LINEAR_____1_CM "" RAT_FUNC "%6.3" "-" COEFFS 0 1. 0. 0 0 1 /end COMPU_METHOD
/begin COMPU_METHOD _CNV_S_6_CONV_ERRM__27_CM "" TAB_VERB "%6.3" "[-]" COMPU_TAB_REF _CNV_S_6_CONV_ERRM__27 /end COMPU_METHOD
/begin COMPU_VTAB _CNV_S_6_CONV_ERRM__27 "" TAB_VERB 6 0 "NO_SYM" 1 "SYM_0" 2 "SYM_1" 4 "SYM_2" 8 "SYM_3" 15 "BENCH_MODE" /end COMPU_VTAB
/begin COMPU_METHOD _CNV_S_2_RANGE______28_CM "" TAB_VERB "%6.3" "[-]" COMPU_TAB_REF _CNV_S_2_RANGE______28 /end COMPU_METHOD
/begin COMPU_VTAB _CNV_S_2_RANGE______28 "" TAB_VERB 2 0 "passive" 1 "active" /end COMPU_VTAB
/begin COMPU_METHOD _CNV_S_2_RANGE______380_CM "" TAB_VERB "%6.3" "-" COMPU_TAB_REF _CNV_S_2_RANGE______380 /end COMPU_METHOD
/begin COMPU_VTAB _CNV_S_2_RANGE______380 "" TAB_VERB 2 0 "passive" 1 "active" /end COMPU_VTAB
/begin FUNCTION ERRM_ACANDGO "Error Management data for diagnosis ACANDGO"
 /begin OUT_MEASUREMENT fmy_stat_can_tcs.ctr_abc fmy_stat_can_tcs.ctr_end_diag fmy_stat_can_tcs.err_info_stat.reserved fmy_stat_can_tcs.err_info_stat.lv_cdn_diag_stc fmy_stat_can_tcs.err_info_stat.lv_lock_diag fmy_stat_can_tcs.err_info_stat.lv_err_mem fmy_stat_can_tcs.err_info_stat.lv_ready fmy_stat_can_tcs.err_info_stat.lv_end_diag fmy_stat_can_tcs.err_info_stat.lv_cdn_diag fmy_stat_can_tcs.err_info_stat.err_sym fmy_stat_can_tcu.ctr_abc fmy_stat_can_tcu.ctr_end_diag fmy_stat_can_tcu.err_info_stat.reserved fmy_stat_can_tcu.err_info_stat.lv_cdn_diag_stc fmy_stat_can_tcu.err_info_stat.lv_lock_diag fmy_stat_can_tcu.err_info_stat.lv_err_mem fmy_stat_can_tcu.err_info_stat.lv_ready fmy_stat_can_tcu.err_info_stat.lv_end_diag fmy_stat_can_tcu.err_info_stat.lv_cdn_diag fmy_stat_can_tcu.err_info_stat.err_sym fmy_stat_can_acu.ctr_abc fmy_stat_can_acu.ctr_end_diag fmy_stat_can_acu.err_info_stat.reserved fmy_stat_can_acu.err_info_stat.lv_cdn_diag_stc fmy_stat_can_acu.err_info_stat.lv_lock_diag fmy_stat_can_acu.err_info_stat.lv_err_mem fmy_stat_can_acu.err_info_stat.lv_ready fmy_stat_can_acu.err_info_stat.lv_end_diag fmy_stat_can_acu.err_info_stat.lv_cdn_diag fmy_stat_can_acu.err_info_stat.err_sym fmy_stat_can_ccu.ctr_abc fmy_stat_can_ccu.ctr_end_diag fmy_stat_can_ccu.err_info_stat.reserved fmy_stat_can_ccu.err_info_stat.lv_cdn_diag_stc fmy_stat_can_ccu.err_info_stat.lv_lock_diag fmy_stat_can_ccu.err_info_stat.lv_err_mem fmy_stat_can_ccu.err_info_stat.lv_ready fmy_stat_can_ccu.err_info_stat.lv_end_diag fmy_stat_can_ccu.err_info_stat.lv_cdn_diag fmy_stat_can_ccu.err_info_stat.err_sym fmy_stat_can_icl.ctr_abc fmy_stat_can_icl.ctr_end_diag fmy_stat_can_icl.err_info_stat.reserved fmy_stat_can_icl.err_info_stat.lv_cdn_diag_stc fmy_stat_can_icl.err_info_stat.lv_lock_diag fmy_stat_can_icl.err_info_stat.lv_err_mem fmy_stat_can_icl.err_info_stat.lv_ready fmy_stat_can_icl.err_info_stat.lv_end_diag fmy_stat_can_icl.err_info_stat.lv_cdn_diag fmy_stat_can_icl.err_info_stat.err_sym fmy_stat_can_vecu.ctr_abc fmy_stat_can_vecu.ctr_end_diag fmy_stat_can_vecu.err_info_stat.reserved fmy_stat_can_vecu.err_info_stat.lv_cdn_diag_stc fmy_stat_can_vecu.err_info_stat.lv_lock_diag fmy_stat_can_vecu.err_info_stat.lv_err_mem fmy_stat_can_vecu.err_info_stat.lv_ready fmy_stat_can_vecu.err_info_stat.lv_end_diag fmy_stat_can_vecu.err_info_stat.lv_cdn_diag fmy_stat_can_vecu.err_info_stat.err_sym fmy_stat_can_smls.ctr_abc fmy_stat_can_smls.ctr_end_diag fmy_stat_can_smls.err_info_stat.reserved fmy_stat_can_smls.err_info_stat.lv_cdn_diag_stc fmy_stat_can_smls.err_info_stat.lv_lock_diag fmy_stat_can_smls.err_info_stat.lv_err_mem fmy_stat_can_smls.err_info_stat.lv_ready fmy_stat_can_smls.err_info_stat.lv_end_diag fmy_stat_can_smls.err_info_stat.lv_cdn_diag fmy_stat_can_smls.err_info_stat.err_sym fmy_stat_can_boff.ctr_abc fmy_stat_can_boff.ctr_end_diag fmy_stat_can_boff.err_info_stat.reserved fmy_stat_can_boff.err_info_stat.lv_cdn_diag_stc fmy_stat_can_boff.err_info_stat.lv_lock_diag fmy_stat_can_boff.err_info_stat.lv_err_mem fmy_stat_can_boff.err_info_stat.lv_ready fmy_stat_can_boff.err_info_stat.lv_end_diag fmy_stat_can_boff.err_info_stat.lv_cdn_diag fmy_stat_can_boff.err_info_stat.err_sym fmy_stat_can_bem.ctr_abc fmy_stat_can_bem.ctr_end_diag fmy_stat_can_bem.err_info_stat.reserved fmy_stat_can_bem.err_info_stat.lv_cdn_diag_stc fmy_stat_can_bem.err_info_stat.lv_lock_diag fmy_stat_can_bem.err_info_stat.lv_err_mem fmy_stat_can_bem.err_info_stat.lv_ready fmy_stat_can_bem.err_info_stat.lv_end_diag fmy_stat_can_bem.err_info_stat.lv_cdn_diag fmy_stat_can_bem.err_info_stat.err_sym fmy_stat_can_if_cft.ctr_abc fmy_stat_can_if_cft.ctr_end_diag fmy_stat_can_if_cft.err_info_stat.reserved fmy_stat_can_if_cft.err_info_stat.lv_cdn_diag_stc fmy_stat_can_if_cft.err_info_stat.lv_lock_diag fmy_stat_can_if_cft.err_info_stat.lv_err_mem fmy_stat_can_if_cft.err_info_stat.lv_ready fmy_stat_can_if_cft.err_info_stat.lv_end_diag fmy_stat_can_if_cft.err_info_stat.lv_cdn_diag fmy_stat_can_if_cft.err_info_stat.err_sym fmy_stat_can_tot.ctr_abc fmy_stat_can_tot.ctr_end_diag fmy_stat_can_tot.err_info_stat.reserved fmy_stat_can_tot.err_info_stat.lv_cdn_diag_stc fmy_stat_can_tot.err_info_stat.lv_lock_diag fmy_stat_can_tot.err_info_stat.lv_err_mem fmy_stat_can_tot.err_info_stat.lv_ready fmy_stat_can_tot.err_info_stat.lv_end_diag fmy_stat_can_tot.err_info_stat.lv_cdn_diag fmy_stat_can_tot.err_info_stat.err_sym /end OUT_MEASUREMENT
/end FUNCTION
/begin FUNCTION ERRM_AVARDIAG "Error Management data for diagnosis AVARDIAG"
 /begin OUT_MEASUREMENT fmy_stat_varcod.ctr_abc fmy_stat_varcod.ctr_end_diag fmy_stat_varcod.err_info_stat.reserved fmy_stat_varcod.err_info_stat.lv_cdn_diag_stc fmy_stat_varcod.err_info_stat.lv_lock_diag fmy_stat_varcod.err_info_stat.lv_err_mem fmy_stat_varcod.err_info_stat.lv_ready fmy_stat_varcod.err_info_stat.lv_end_diag fmy_stat_varcod.err_info_stat.lv_cdn_diag fmy_stat_varcod.err_info_stat.err_sym /end OUT_MEASUREMENT
/end FUNCTION
/begin FUNCTION ERRM_AAC_DIAG "Error Management data for diagnosis AAC_DIAG"
 /begin OUT_MEASUREMENT lv_err_acp_mes_rng fmy_stat_acp_mes_rng.ctr_abc fmy_stat_acp_mes_rng.ctr_end_diag fmy_stat_acp_mes_rng.err_info_stat.reserved fmy_stat_acp_mes_rng.err_info_stat.lv_cdn_diag_stc fmy_stat_acp_mes_rng.err_info_stat.lv_lock_diag fmy_stat_acp_mes_rng.err_info_stat.lv_err_mem fmy_stat_acp_mes_rng.err_info_stat.lv_ready fmy_stat_acp_mes_rng.err_info_stat.lv_end_diag fmy_stat_acp_mes_rng.err_info_stat.lv_cdn_diag fmy_stat_acp_mes_rng.err_info_stat.err_sym lv_err_acp_mes_grd fmy_stat_acp_mes_grd.ctr_abc fmy_stat_acp_mes_grd.ctr_end_diag fmy_stat_acp_mes_grd.err_info_stat.reserved fmy_stat_acp_mes_grd.err_info_stat.lv_cdn_diag_stc fmy_stat_acp_mes_grd.err_info_stat.lv_lock_diag fmy_stat_acp_mes_grd.err_info_stat.lv_err_mem fmy_stat_acp_mes_grd.err_info_stat.lv_ready fmy_stat_acp_mes_grd.err_info_stat.lv_end_diag fmy_stat_acp_mes_grd.err_info_stat.lv_cdn_diag fmy_stat_acp_mes_grd.err_info_stat.err_sym /end OUT_MEASUREMENT
/end FUNCTION
/begin FUNCTION ERRM_ATBADIAG "Error Management data for diagnosis ATBADIAG"
 /begin OUT_MEASUREMENT lv_err_v_tba_rng fmy_stat_v_tba_rng.ctr_abc fmy_stat_v_tba_rng.ctr_end_diag fmy_stat_v_tba_rng.err_info_stat.reserved fmy_stat_v_tba_rng.err_info_stat.lv_cdn_diag_stc fmy_stat_v_tba_rng.err_info_stat.lv_lock_diag fmy_stat_v_tba_rng.err_info_stat.lv_err_mem fmy_stat_v_tba_rng.err_info_stat.lv_ready fmy_stat_v_tba_rng.err_info_stat.lv_end_diag fmy_stat_v_tba_rng.err_info_stat.lv_cdn_diag fmy_stat_v_tba_rng.err_info_stat.err_sym lv_err_tba_mes_grd fmy_stat_tba_mes_grd.ctr_abc fmy_stat_tba_mes_grd.ctr_end_diag fmy_stat_tba_mes_grd.err_info_stat.reserved fmy_stat_tba_mes_grd.err_info_stat.lv_cdn_diag_stc fmy_stat_tba_mes_grd.err_info_stat.lv_lock_diag fmy_stat_tba_mes_grd.err_info_stat.lv_err_mem fmy_stat_tba_mes_grd.err_info_stat.lv_ready fmy_stat_tba_mes_grd.err_info_stat.lv_end_diag fmy_stat_tba_mes_grd.err_info_stat.lv_cdn_diag fmy_stat_tba_mes_grd.err_info_stat.err_sym /end OUT_MEASUREMENT
/end FUNCTION
/begin FUNCTION ERRM_AALTDIAG "Error Management data for diagnosis AALTDIAG"
 /begin OUT_MEASUREMENT lv_err_ducy_alter_pwm_rng fmy_stat_ducy_alter_pwm_rng.ctr_abc fmy_stat_ducy_alter_pwm_rng.ctr_end_diag fmy_stat_ducy_alter_pwm_rng.err_info_stat.reserved fmy_stat_ducy_alter_pwm_rng.err_info_stat.lv_cdn_diag_stc fmy_stat_ducy_alter_pwm_rng.err_info_stat.lv_lock_diag fmy_stat_ducy_alter_pwm_rng.err_info_stat.lv_err_mem fmy_stat_ducy_alter_pwm_rng.err_info_stat.lv_ready fmy_stat_ducy_alter_pwm_rng.err_info_stat.lv_end_diag fmy_stat_ducy_alter_pwm_rng.err_info_stat.lv_cdn_diag fmy_stat_ducy_alter_pwm_rng.err_info_stat.err_sym lv_err_ducy_alter_pwm_grd fmy_stat_ducy_alter_pwm_grd.ctr_abc fmy_stat_ducy_alter_pwm_grd.ctr_end_diag fmy_stat_ducy_alter_pwm_grd.err_info_stat.reserved fmy_stat_ducy_alter_pwm_grd.err_info_stat.lv_cdn_diag_stc fmy_stat_ducy_alter_pwm_grd.err_info_stat.lv_lock_diag fmy_stat_ducy_alter_pwm_grd.err_info_stat.lv_err_mem fmy_stat_ducy_alter_pwm_grd.err_info_stat.lv_ready fmy_stat_ducy_alter_pwm_grd.err_info_stat.lv_end_diag fmy_stat_ducy_alter_pwm_grd.err_info_stat.lv_cdn_diag fmy_stat_ducy_alter_pwm_grd.err_info_stat.err_sym /end OUT_MEASUREMENT
/end FUNCTION
/begin FUNCTION ERRM_AVEGRVDG "Error Management data for diagnosis AVEGRVDG"
 /begin OUT_MEASUREMENT lv_err_v_egrv_0_rng fmy_stat_v_egrv_0_rng.ctr_abc fmy_stat_v_egrv_0_rng.ctr_end_diag fmy_stat_v_egrv_0_rng.err_info_stat.reserved fmy_stat_v_egrv_0_rng.err_info_stat.lv_cdn_diag_stc fmy_stat_v_egrv_0_rng.err_info_stat.lv_lock_diag fmy_stat_v_egrv_0_rng.err_info_stat.lv_err_mem fmy_stat_v_egrv_0_rng.err_info_stat.lv_ready fmy_stat_v_egrv_0_rng.err_info_stat.lv_end_diag fmy_stat_v_egrv_0_rng.err_info_stat.lv_cdn_diag fmy_stat_v_egrv_0_rng.err_info_stat.err_sym lv_err_v_egrv_1_rng fmy_stat_v_egrv_1_rng.ctr_abc fmy_stat_v_egrv_1_rng.ctr_end_diag fmy_stat_v_egrv_1_rng.err_info_stat.reserved fmy_stat_v_egrv_1_rng.err_info_stat.lv_cdn_diag_stc fmy_stat_v_egrv_1_rng.err_info_stat.lv_lock_diag fmy_stat_v_egrv_1_rng.err_info_stat.lv_err_mem fmy_stat_v_egrv_1_rng.err_info_stat.lv_ready fmy_stat_v_egrv_1_rng.err_info_stat.lv_end_diag fmy_stat_v_egrv_1_rng.err_info_stat.lv_cdn_diag fmy_stat_v_egrv_1_rng.err_info_stat.err_sym lv_err_v_egrv_0_grd fmy_stat_v_egrv_0_grd.ctr_abc fmy_stat_v_egrv_0_grd.ctr_end_diag fmy_stat_v_egrv_0_grd.err_info_stat.reserved fmy_stat_v_egrv_0_grd.err_info_stat.lv_cdn_diag_stc fmy_stat_v_egrv_0_grd.err_info_stat.lv_lock_diag fmy_stat_v_egrv_0_grd.err_info_stat.lv_err_mem fmy_stat_v_egrv_0_grd.err_info_stat.lv_ready fmy_stat_v_egrv_0_grd.err_info_stat.lv_end_diag fmy_stat_v_egrv_0_grd.err_info_stat.lv_cdn_diag fmy_stat_v_egrv_0_grd.err_info_stat.err_sym lv_err_v_egrv_1_grd fmy_stat_v_egrv_1_grd.ctr_abc fmy_stat_v_egrv_1_grd.ctr_end_diag fmy_stat_v_egrv_1_grd.err_info_stat.reserved fmy_stat_v_egrv_1_grd.err_info_stat.lv_cdn_diag_stc fmy_stat_v_egrv_1_grd.err_info_stat.lv_lock_diag fmy_stat_v_egrv_1_grd.err_info_stat.lv_err_mem fmy_stat_v_egrv_1_grd.err_info_stat.lv_ready fmy_stat_v_egrv_1_grd.err_info_stat.lv_end_diag fmy_stat_v_egrv_1_grd.err_info_stat.lv_cdn_diag fmy_stat_v_egrv_1_grd.err_info_stat.err_sym /end OUT_MEASUREMENT
/end FUNCTION
/begin FUNCTION ERRM_ACAPDIAG "Error Management data for diagnosis ACAPDIAG"
 /begin OUT_MEASUREMENT lv_err_ges_maf_0_max fmy_stat_ges_maf_0_max.ctr_abc fmy_stat_ges_maf_0_max.ctr_end_diag fmy_stat_ges_maf_0_max.err_info_stat.reserved fmy_stat_ges_maf_0_max.err_info_stat.lv_cdn_diag_stc fmy_stat_ges_maf_0_max.err_info_stat.lv_lock_diag fmy_stat_ges_maf_0_max.err_info_stat.lv_err_mem fmy_stat_ges_maf_0_max.err_info_stat.lv_ready fmy_stat_ges_maf_0_max.err_info_stat.lv_end_diag fmy_stat_ges_maf_0_max.err_info_stat.lv_cdn_diag fmy_stat_ges_maf_0_max.err_info_stat.err_sym /end OUT_MEASUREMENT
/end FUNCTION
/begin FUNCTION ERRM_ATCOPLAD "Error Management data for diagnosis ATCOPLAD"
 /begin OUT_MEASUREMENT lv_err_tco_1_2_plaus fmy_stat_tco_1_2_plaus.ctr_abc fmy_stat_tco_1_2_plaus.ctr_end_diag fmy_stat_tco_1_2_plaus.err_info_stat.reserved fmy_stat_tco_1_2_plaus.err_info_stat.lv_cdn_diag_stc fmy_stat_tco_1_2_plaus.err_info_stat.lv_lock_diag fmy_stat_tco_1_2_plaus.err_info_stat.lv_err_mem fmy_stat_tco_1_2_plaus.err_info_stat.lv_ready fmy_stat_tco_1_2_plaus.err_info_stat.lv_end_diag fmy_stat_tco_1_2_plaus.err_info_stat.lv_cdn_diag fmy_stat_tco_1_2_plaus.err_info_stat.err_sym /end OUT_MEASUREMENT
/end FUNCTION
/begin FUNCTION ERRM_AEFPDIAG "Error Management data for diagnosis AEFPDIAG"
 /begin OUT_MEASUREMENT lv_err_efp_rly_dps fmy_stat_efp_rly_dps.ctr_abc fmy_stat_efp_rly_dps.ctr_end_diag fmy_stat_efp_rly_dps.err_info_stat.reserved fmy_stat_efp_rly_dps.err_info_stat.lv_cdn_diag_stc fmy_stat_efp_rly_dps.err_info_stat.lv_lock_diag fmy_stat_efp_rly_dps.err_info_stat.lv_err_mem fmy_stat_efp_rly_dps.err_info_stat.lv_ready fmy_stat_efp_rly_dps.err_info_stat.lv_end_diag fmy_stat_efp_rly_dps.err_info_stat.lv_cdn_diag fmy_stat_efp_rly_dps.err_info_stat.err_sym lv_err_efp_rly_plaus_1 fmy_stat_efp_rly_plaus_1.ctr_abc fmy_stat_efp_rly_plaus_1.ctr_end_diag fmy_stat_efp_rly_plaus_1.err_info_stat.reserved fmy_stat_efp_rly_plaus_1.err_info_stat.lv_cdn_diag_stc fmy_stat_efp_rly_plaus_1.err_info_stat.lv_lock_diag fmy_stat_efp_rly_plaus_1.err_info_stat.lv_err_mem fmy_stat_efp_rly_plaus_1.err_info_stat.lv_ready fmy_stat_efp_rly_plaus_1.err_info_stat.lv_end_diag fmy_stat_efp_rly_plaus_1.err_info_stat.lv_cdn_diag fmy_stat_efp_rly_plaus_1.err_info_stat.err_sym lv_err_efp_rly_plaus_2 fmy_stat_efp_rly_plaus_2.ctr_abc fmy_stat_efp_rly_plaus_2.ctr_end_diag fmy_stat_efp_rly_plaus_2.err_info_stat.reserved fmy_stat_efp_rly_plaus_2.err_info_stat.lv_cdn_diag_stc fmy_stat_efp_rly_plaus_2.err_info_stat.lv_lock_diag fmy_stat_efp_rly_plaus_2.err_info_stat.lv_err_mem fmy_stat_efp_rly_plaus_2.err_info_stat.lv_ready fmy_stat_efp_rly_plaus_2.err_info_stat.lv_end_diag fmy_stat_efp_rly_plaus_2.err_info_stat.lv_cdn_diag fmy_stat_efp_rly_plaus_2.err_info_stat.err_sym /end OUT_MEASUREMENT
/end FUNCTION
/begin FUNCTION ERRM_ASPIDIAG "Error Management data for diagnosis ASPIDIAG"
 /begin OUT_MEASUREMENT lv_err_spi_mps fmy_stat_spi_mps.ctr_abc fmy_stat_spi_mps.ctr_end_diag fmy_stat_spi_mps.err_info_stat.reserved fmy_stat_spi_mps.err_info_stat.lv_cdn_diag_stc fmy_stat_spi_mps.err_info_stat.lv_lock_diag fmy_stat_spi_mps.err_info_stat.lv_err_mem fmy_stat_spi_mps.err_info_stat.lv_ready fmy_stat_spi_mps.err_info_stat.lv_end_diag fmy_stat_spi_mps.err_info_stat.lv_cdn_diag fmy_stat_spi_mps.err_info_stat.err_sym lv_err_spi_oct fmy_stat_spi_oct.ctr_abc fmy_stat_spi_oct.ctr_end_diag fmy_stat_spi_oct.err_info_stat.reserved fmy_stat_spi_oct.err_info_stat.lv_cdn_diag_stc fmy_stat_spi_oct.err_info_stat.lv_lock_diag fmy_stat_spi_oct.err_info_stat.lv_err_mem fmy_stat_spi_oct.err_info_stat.lv_ready fmy_stat_spi_oct.err_info_stat.lv_end_diag fmy_stat_spi_oct.err_info_stat.lv_cdn_diag fmy_stat_spi_oct.err_info_stat.err_sym lv_err_spi_qps fmy_stat_spi_qps.ctr_abc fmy_stat_spi_qps.ctr_end_diag fmy_stat_spi_qps.err_info_stat.reserved fmy_stat_spi_qps.err_info_stat.lv_cdn_diag_stc fmy_stat_spi_qps.err_info_stat.lv_lock_diag fmy_stat_spi_qps.err_info_stat.lv_err_mem fmy_stat_spi_qps.err_info_stat.lv_ready fmy_stat_spi_qps.err_info_stat.lv_end_diag fmy_stat_spi_qps.err_info_stat.lv_cdn_diag fmy_stat_spi_qps.err_info_stat.err_sym /end OUT_MEASUREMENT
/end FUNCTION
/begin FUNCTION ERRM_AEGRBYPD "Error Management data for diagnosis AEGRBYPD"
 /begin OUT_MEASUREMENT lv_err_egr_byp_dps fmy_stat_egr_byp_dps.ctr_abc fmy_stat_egr_byp_dps.ctr_end_diag fmy_stat_egr_byp_dps.err_info_stat.reserved fmy_stat_egr_byp_dps.err_info_stat.lv_cdn_diag_stc fmy_stat_egr_byp_dps.err_info_stat.lv_lock_diag fmy_stat_egr_byp_dps.err_info_stat.lv_err_mem fmy_stat_egr_byp_dps.err_info_stat.lv_ready fmy_stat_egr_byp_dps.err_info_stat.lv_end_diag fmy_stat_egr_byp_dps.err_info_stat.lv_cdn_diag fmy_stat_egr_byp_dps.err_info_stat.err_sym /end OUT_MEASUREMENT
/end FUNCTION
/begin FUNCTION ERRM_AEGRVDHB "Error Management data for diagnosis AEGRVDHB"
 /begin OUT_MEASUREMENT lv_err_egrv_0 fmy_stat_egrv_0.ctr_abc fmy_stat_egrv_0.ctr_end_diag fmy_stat_egrv_0.err_info_stat.reserved fmy_stat_egrv_0.err_info_stat.lv_cdn_diag_stc fmy_stat_egrv_0.err_info_stat.lv_lock_diag fmy_stat_egrv_0.err_info_stat.lv_err_mem fmy_stat_egrv_0.err_info_stat.lv_ready fmy_stat_egrv_0.err_info_stat.lv_end_diag fmy_stat_egrv_0.err_info_stat.lv_cdn_diag fmy_stat_egrv_0.err_info_stat.err_sym /end OUT_MEASUREMENT
/end FUNCTION
/begin FUNCTION ERRM_AINJDIAG "Error Management data for diagnosis AINJDIAG"
 /begin OUT_MEASUREMENT lv_err_pps_ini_0 fmy_stat_pps_ini_0.ctr_abc fmy_stat_pps_ini_0.ctr_end_diag fmy_stat_pps_ini_0.err_info_stat.reserved fmy_stat_pps_ini_0.err_info_stat.lv_cdn_diag_stc fmy_stat_pps_ini_0.err_info_stat.lv_lock_diag fmy_stat_pps_ini_0.err_info_stat.lv_err_mem fmy_stat_pps_ini_0.err_info_stat.lv_ready fmy_stat_pps_ini_0.err_info_stat.lv_end_diag fmy_stat_pps_ini_0.err_info_stat.lv_cdn_diag fmy_stat_pps_ini_0.err_info_stat.err_sym lv_err_pps_ini_tout_0 fmy_stat_pps_ini_tout_0.ctr_abc fmy_stat_pps_ini_tout_0.ctr_end_diag fmy_stat_pps_ini_tout_0.err_info_stat.reserved fmy_stat_pps_ini_tout_0.err_info_stat.lv_cdn_diag_stc fmy_stat_pps_ini_tout_0.err_info_stat.lv_lock_diag fmy_stat_pps_ini_tout_0.err_info_stat.lv_err_mem fmy_stat_pps_ini_tout_0.err_info_stat.lv_ready fmy_stat_pps_ini_tout_0.err_info_stat.lv_end_diag fmy_stat_pps_ini_tout_0.err_info_stat.lv_cdn_diag fmy_stat_pps_ini_tout_0.err_info_stat.err_sym lv_err_pps_plaus_0 fmy_stat_pps_plaus_0.ctr_abc fmy_stat_pps_plaus_0.ctr_end_diag fmy_stat_pps_plaus_0.err_info_stat.reserved fmy_stat_pps_plaus_0.err_info_stat.lv_cdn_diag_stc fmy_stat_pps_plaus_0.err_info_stat.lv_lock_diag fmy_stat_pps_plaus_0.err_info_stat.lv_err_mem fmy_stat_pps_plaus_0.err_info_stat.lv_ready fmy_stat_pps_plaus_0.err_info_stat.lv_end_diag fmy_stat_pps_plaus_0.err_info_stat.lv_cdn_diag fmy_stat_pps_plaus_0.err_info_stat.err_sym lv_err_pps_cal_0 fmy_stat_pps_cal_0.ctr_abc fmy_stat_pps_cal_0.ctr_end_diag fmy_stat_pps_cal_0.err_info_stat.reserved fmy_stat_pps_cal_0.err_info_stat.lv_cdn_diag_stc fmy_stat_pps_cal_0.err_info_stat.lv_lock_diag fmy_stat_pps_cal_0.err_info_stat.lv_err_mem fmy_stat_pps_cal_0.err_info_stat.lv_ready fmy_stat_pps_cal_0.err_info_stat.lv_end_diag fmy_stat_pps_cal_0.err_info_stat.lv_cdn_diag fmy_stat_pps_cal_0.err_info_stat.err_sym lv_err_pps_v_inj_0 fmy_stat_pps_v_inj_0.ctr_abc fmy_stat_pps_v_inj_0.ctr_end_diag fmy_stat_pps_v_inj_0.err_info_stat.reserved fmy_stat_pps_v_inj_0.err_info_stat.lv_cdn_diag_stc fmy_stat_pps_v_inj_0.err_info_stat.lv_lock_diag fmy_stat_pps_v_inj_0.err_info_stat.lv_err_mem fmy_stat_pps_v_inj_0.err_info_stat.lv_ready fmy_stat_pps_v_inj_0.err_info_stat.lv_end_diag fmy_stat_pps_v_inj_0.err_info_stat.lv_cdn_diag fmy_stat_pps_v_inj_0.err_info_stat.err_sym lv_err_pps_wdt_0 fmy_stat_pps_wdt_0.ctr_abc fmy_stat_pps_wdt_0.ctr_end_diag fmy_stat_pps_wdt_0.err_info_stat.reserved fmy_stat_pps_wdt_0.err_info_stat.lv_cdn_diag_stc fmy_stat_pps_wdt_0.err_info_stat.lv_lock_diag fmy_stat_pps_wdt_0.err_info_stat.lv_err_mem fmy_stat_pps_wdt_0.err_info_stat.lv_ready fmy_stat_pps_wdt_0.err_info_stat.lv_end_diag fmy_stat_pps_wdt_0.err_info_stat.lv_cdn_diag fmy_stat_pps_wdt_0.err_info_stat.err_sym lv_err_pps_fsm_0 fmy_stat_pps_fsm_0.ctr_abc fmy_stat_pps_fsm_0.ctr_end_diag fmy_stat_pps_fsm_0.err_info_stat.reserved fmy_stat_pps_fsm_0.err_info_stat.lv_cdn_diag_stc fmy_stat_pps_fsm_0.err_info_stat.lv_lock_diag fmy_stat_pps_fsm_0.err_info_stat.lv_err_mem fmy_stat_pps_fsm_0.err_info_stat.lv_ready fmy_stat_pps_fsm_0.err_info_stat.lv_end_diag fmy_stat_pps_fsm_0.err_info_stat.lv_cdn_diag fmy_stat_pps_fsm_0.err_info_stat.err_sym lv_err_pps_oc_0 fmy_stat_pps_oc_0.ctr_abc fmy_stat_pps_oc_0.ctr_end_diag fmy_stat_pps_oc_0.err_info_stat.reserved fmy_stat_pps_oc_0.err_info_stat.lv_cdn_diag_stc fmy_stat_pps_oc_0.err_info_stat.lv_lock_diag fmy_stat_pps_oc_0.err_info_stat.lv_err_mem fmy_stat_pps_oc_0.err_info_stat.lv_ready fmy_stat_pps_oc_0.err_info_stat.lv_end_diag fmy_stat_pps_oc_0.err_info_stat.lv_cdn_diag fmy_stat_pps_oc_0.err_info_stat.err_sym lv_err_pps_oc_1 fmy_stat_pps_oc_1.ctr_abc fmy_stat_pps_oc_1.ctr_end_diag fmy_stat_pps_oc_1.err_info_stat.reserved fmy_stat_pps_oc_1.err_info_stat.lv_cdn_diag_stc fmy_stat_pps_oc_1.err_info_stat.lv_lock_diag fmy_stat_pps_oc_1.err_info_stat.lv_err_mem fmy_stat_pps_oc_1.err_info_stat.lv_ready fmy_stat_pps_oc_1.err_info_stat.lv_end_diag fmy_stat_pps_oc_1.err_info_stat.lv_cdn_diag fmy_stat_pps_oc_1.err_info_stat.err_sym lv_err_pps_oc_2 fmy_stat_pps_oc_2.ctr_abc fmy_stat_pps_oc_2.ctr_end_diag fmy_stat_pps_oc_2.err_info_stat.reserved fmy_stat_pps_oc_2.err_info_stat.lv_cdn_diag_stc fmy_stat_pps_oc_2.err_info_stat.lv_lock_diag fmy_stat_pps_oc_2.err_info_stat.lv_err_mem fmy_stat_pps_oc_2.err_info_stat.lv_ready fmy_stat_pps_oc_2.err_info_stat.lv_end_diag fmy_stat_pps_oc_2.err_info_stat.lv_cdn_diag fmy_stat_pps_oc_2.err_info_stat.err_sym lv_err_pps_oc_3 fmy_stat_pps_oc_3.ctr_abc fmy_stat_pps_oc_3.ctr_end_diag fmy_stat_pps_oc_3.err_info_stat.reserved fmy_stat_pps_oc_3.err_info_stat.lv_cdn_diag_stc fmy_stat_pps_oc_3.err_info_stat.lv_lock_diag fmy_stat_pps_oc_3.err_info_stat.lv_err_mem fmy_stat_pps_oc_3.err_info_stat.lv_ready fmy_stat_pps_oc_3.err_info_stat.lv_end_diag fmy_stat_pps_oc_3.err_info_stat.lv_cdn_diag fmy_stat_pps_oc_3.err_info_stat.err_sym lv_err_pps_sc_h_l_0 fmy_stat_pps_sc_h_l_0.ctr_abc fmy_stat_pps_sc_h_l_0.ctr_end_diag fmy_stat_pps_sc_h_l_0.err_info_stat.reserved fmy_stat_pps_sc_h_l_0.err_info_stat.lv_cdn_diag_stc fmy_stat_pps_sc_h_l_0.err_info_stat.lv_lock_diag fmy_stat_pps_sc_h_l_0.err_info_stat.lv_err_mem fmy_stat_pps_sc_h_l_0.err_info_stat.lv_ready fmy_stat_pps_sc_h_l_0.err_info_stat.lv_end_diag fmy_stat_pps_sc_h_l_0.err_info_stat.lv_cdn_diag fmy_stat_pps_sc_h_l_0.err_info_stat.err_sym lv_err_pps_sc_h_l_1 fmy_stat_pps_sc_h_l_1.ctr_abc fmy_stat_pps_sc_h_l_1.ctr_end_diag fmy_stat_pps_sc_h_l_1.err_info_stat.reserved fmy_stat_pps_sc_h_l_1.err_info_stat.lv_cdn_diag_stc fmy_stat_pps_sc_h_l_1.err_info_stat.lv_lock_diag fmy_stat_pps_sc_h_l_1.err_info_stat.lv_err_mem fmy_stat_pps_sc_h_l_1.err_info_stat.lv_ready fmy_stat_pps_sc_h_l_1.err_info_stat.lv_end_diag fmy_stat_pps_sc_h_l_1.err_info_stat.lv_cdn_diag fmy_stat_pps_sc_h_l_1.err_info_stat.err_sym lv_err_pps_sc_h_l_2 fmy_stat_pps_sc_h_l_2.ctr_abc fmy_stat_pps_sc_h_l_2.ctr_end_diag fmy_stat_pps_sc_h_l_2.err_info_stat.reserved fmy_stat_pps_sc_h_l_2.err_info_stat.lv_cdn_diag_stc fmy_stat_pps_sc_h_l_2.err_info_stat.lv_lock_diag fmy_stat_pps_sc_h_l_2.err_info_stat.lv_err_mem fmy_stat_pps_sc_h_l_2.err_info_stat.lv_ready fmy_stat_pps_sc_h_l_2.err_info_stat.lv_end_diag fmy_stat_pps_sc_h_l_2.err_info_stat.lv_cdn_diag fmy_stat_pps_sc_h_l_2.err_info_stat.err_sym lv_err_pps_sc_h_l_3 fmy_stat_pps_sc_h_l_3.ctr_abc fmy_stat_pps_sc_h_l_3.ctr_end_diag fmy_stat_pps_sc_h_l_3.err_info_stat.reserved fmy_stat_pps_sc_h_l_3.err_info_stat.lv_cdn_diag_stc fmy_stat_pps_sc_h_l_3.err_info_stat.lv_lock_diag fmy_stat_pps_sc_h_l_3.err_info_stat.lv_err_mem fmy_stat_pps_sc_h_l_3.err_info_stat.lv_ready fmy_stat_pps_sc_h_l_3.err_info_stat.lv_end_diag fmy_stat_pps_sc_h_l_3.err_info_stat.lv_cdn_diag fmy_stat_pps_sc_h_l_3.err_info_stat.err_sym lv_err_pps_sc_h_0 fmy_stat_pps_sc_h_0.ctr_abc fmy_stat_pps_sc_h_0.ctr_end_diag fmy_stat_pps_sc_h_0.err_info_stat.reserved fmy_stat_pps_sc_h_0.err_info_stat.lv_cdn_diag_stc fmy_stat_pps_sc_h_0.err_info_stat.lv_lock_diag fmy_stat_pps_sc_h_0.err_info_stat.lv_err_mem fmy_stat_pps_sc_h_0.err_info_stat.lv_ready fmy_stat_pps_sc_h_0.err_info_stat.lv_end_diag fmy_stat_pps_sc_h_0.err_info_stat.lv_cdn_diag fmy_stat_pps_sc_h_0.err_info_stat.err_sym lv_err_pps_sc_l_0 fmy_stat_pps_sc_l_0.ctr_abc fmy_stat_pps_sc_l_0.ctr_end_diag fmy_stat_pps_sc_l_0.err_info_stat.reserved fmy_stat_pps_sc_l_0.err_info_stat.lv_cdn_diag_stc fmy_stat_pps_sc_l_0.err_info_stat.lv_lock_diag fmy_stat_pps_sc_l_0.err_info_stat.lv_err_mem fmy_stat_pps_sc_l_0.err_info_stat.lv_ready fmy_stat_pps_sc_l_0.err_info_stat.lv_end_diag fmy_stat_pps_sc_l_0.err_info_stat.lv_cdn_diag fmy_stat_pps_sc_l_0.err_info_stat.err_sym /end OUT_MEASUREMENT
/end FUNCTION
/end MODULE
/end PROJECT
