ASAP2_VERSION 1 41
/begin PROJECT SN0 "SIMOS PPD"
/begin HEADER "_default_HeaderComment" PROJECT_NO PRJ_NUM /end HEADER
/begin MODULE _default_ModuleName "_default_ModuleLongIdentifier"
/begin MOD_COMMON "_default_ModCommonComment" DEPOSIT ABSOLUTE BYTE_ORDER MSB_FIRST ALIGNMENT_BYTE 1 ALIGNMENT_WORD 2 ALIGNMENT_LONG 4 ALIGNMENT_FLOAT32_IEEE 4 ALIGNMENT_FLOAT64_IEEE 8 /end MOD_COMMON
/begin AXIS_PTS ldp_fmy_dtc "" 0x8416ac online_dummy _REC_AXS_20_u2 5. _CNV_A_R_LINEAR_____0_CM 6 0. 5. FORMAT "%2.0" /end AXIS_PTS
/begin AXIS_PTS ldp_fmy_envd "" 0x8416ba online_dummy _REC_AXS_20_u1 7. _CNV_A_R_LINEAR_____0_CM 8 0. 7. READ_ONLY FORMAT "%2.0" /end AXIS_PTS
/begin CHARACTERISTIC fmy_id_pvs_l_1.dtc[0] "diagnostic trouble codes for diagnosis instance PVS_L_1" CURVE 0x85c596 _REC_CUR_20_u2_u2 65535. _CNV_A_R_LINEAR_____1_CM 0. 65535. DISPLAY_IDENTIFIER ID_ERR_DTC_PVS_L_1 FORMAT "%5.0"
 /begin AXIS_DESCR COM_AXIS online_dummy _CNV_A_R_LINEAR_____0_CM 6 0. 5. FORMAT "%2.0" AXIS_PTS_REF ldp_fmy_dtc /end AXIS_DESCR
/end CHARACTERISTIC
/begin CHARACTERISTIC fmy_id_pvs_l_1.envd "environmental data contents of customer specific freeze frame for diagnosis instance PVS_L_1" CURVE 0x85c5a2 _REC_CUR_20_u1_u1 255. _CNV_A_R_LINEAR_____1_CM 0. 255. DISPLAY_IDENTIFIER ID_ERR_ENVD_PVS_L_1 FORMAT "%3.0"
 /begin AXIS_DESCR COM_AXIS online_dummy _CNV_A_R_LINEAR_____0_CM 8 0. 7. READ_ONLY FORMAT "%2.0" AXIS_PTS_REF ldp_fmy_envd /end AXIS_DESCR
/end CHARACTERISTIC
/begin CHARACTERISTIC fmy_id_pvs_l_1.c_err_clas "error class for diagnosis instance PVS_L_1" VALUE 0x85c5aa _REC_VAL_20_u1 255. _CNV_A_R_LINEAR_____1_CM 0. 255. DISPLAY_IDENTIFIER C_ERR_CLAS_PVS_L_1 FORMAT "%3.0" /end CHARACTERISTIC
/begin CHARACTERISTIC fmy_id_pvs_l_2.dtc[0] "diagnostic trouble codes for diagnosis instance PVS_L_2" CURVE 0x85c5ac _REC_CUR_20_u2_u2 65535. _CNV_A_R_LINEAR_____1_CM 0. 65535. DISPLAY_IDENTIFIER ID_ERR_DTC_PVS_L_2 FORMAT "%5.0"
 /begin AXIS_DESCR COM_AXIS online_dummy _CNV_A_R_LINEAR_____0_CM 6 0. 5. FORMAT "%2.0" AXIS_PTS_REF ldp_fmy_dtc /end AXIS_DESCR
/end CHARACTERISTIC
/begin CHARACTERISTIC fmy_id_pvs_l_2.envd "environmental data contents of customer specific freeze frame for diagnosis instance PVS_L_2" CURVE 0x85c5b8 _REC_CUR_20_u1_u1 255. _CNV_A_R_LINEAR_____1_CM 0. 255. DISPLAY_IDENTIFIER ID_ERR_ENVD_PVS_L_2 FORMAT "%3.0"
 /begin AXIS_DESCR COM_AXIS online_dummy _CNV_A_R_LINEAR_____0_CM 8 0. 7. READ_ONLY FORMAT "%2.0" AXIS_PTS_REF ldp_fmy_envd /end AXIS_DESCR
/end CHARACTERISTIC
/begin CHARACTERISTIC fmy_id_pvs_l_2.c_err_clas "error class for diagnosis instance PVS_L_2" VALUE 0x85c5c0 _REC_VAL_20_u1 255. _CNV_A_R_LINEAR_____1_CM 0. 255. DISPLAY_IDENTIFIER C_ERR_CLAS_PVS_L_2 FORMAT "%3.0" /end CHARACTERISTIC
/begin CHARACTERISTIC fmy_id_pvs_h_1.dtc[0] "diagnostic trouble codes for diagnosis instance PVS_H_1" CURVE 0x85c5c2 _REC_CUR_20_u2_u2 65535. _CNV_A_R_LINEAR_____1_CM 0. 65535. DISPLAY_IDENTIFIER ID_ERR_DTC_PVS_H_1 FORMAT "%5.0"
 /begin AXIS_DESCR COM_AXIS online_dummy _CNV_A_R_LINEAR_____0_CM 6 0. 5. FORMAT "%2.0" AXIS_PTS_REF ldp_fmy_dtc /end AXIS_DESCR
/end CHARACTERISTIC
/begin CHARACTERISTIC fmy_id_pvs_h_1.envd "environmental data contents of customer specific freeze frame for diagnosis instance PVS_H_1" CURVE 0x85c5ce _REC_CUR_20_u1_u1 255. _CNV_A_R_LINEAR_____1_CM 0. 255. DISPLAY_IDENTIFIER ID_ERR_ENVD_PVS_H_1 FORMAT "%3.0"
 /begin AXIS_DESCR COM_AXIS online_dummy _CNV_A_R_LINEAR_____0_CM 8 0. 7. READ_ONLY FORMAT "%2.0" AXIS_PTS_REF ldp_fmy_envd /end AXIS_DESCR
/end CHARACTERISTIC
/begin CHARACTERISTIC fmy_id_pvs_h_1.c_err_clas "error class for diagnosis instance PVS_H_1" VALUE 0x85c5d6 _REC_VAL_20_u1 255. _CNV_A_R_LINEAR_____1_CM 0. 255. DISPLAY_IDENTIFIER C_ERR_CLAS_PVS_H_1 FORMAT "%3.0" /end CHARACTERISTIC
/begin CHARACTERISTIC fmy_id_pvs_h_2.dtc[0] "diagnostic trouble codes for diagnosis instance PVS_H_2" CURVE 0x85c5d8 _REC_CUR_20_u2_u2 65535. _CNV_A_R_LINEAR_____1_CM 0. 65535. DISPLAY_IDENTIFIER ID_ERR_DTC_PVS_H_2 FORMAT "%5.0"
 /begin AXIS_DESCR COM_AXIS online_dummy _CNV_A_R_LINEAR_____0_CM 6 0. 5. FORMAT "%2.0" AXIS_PTS_REF ldp_fmy_dtc /end AXIS_DESCR
/end CHARACTERISTIC
/begin CHARACTERISTIC fmy_id_pvs_h_2.envd "environmental data contents of customer specific freeze frame for diagnosis instance PVS_H_2" CURVE 0x85c5e4 _REC_CUR_20_u1_u1 255. _CNV_A_R_LINEAR_____1_CM 0. 255. DISPLAY_IDENTIFIER ID_ERR_ENVD_PVS_H_2 FORMAT "%3.0"
 /begin AXIS_DESCR COM_AXIS online_dummy _CNV_A_R_LINEAR_____0_CM 8 0. 7. READ_ONLY FORMAT "%2.0" AXIS_PTS_REF ldp_fmy_envd /end AXIS_DESCR
/end CHARACTERISTIC
/begin CHARACTERISTIC fmy_id_pvs_h_2.c_err_clas "error class for diagnosis instance PVS_H_2" VALUE 0x85c5ec _REC_VAL_20_u1 255. _CNV_A_R_LINEAR_____1_CM 0. 255. DISPLAY_IDENTIFIER C_ERR_CLAS_PVS_H_2 FORMAT "%3.0" /end CHARACTERISTIC
/begin CHARACTERISTIC fmy_id_pvs_ratio.dtc[0] "diagnostic trouble codes for diagnosis instance PVS_RATIO" CURVE 0x85c5ee _REC_CUR_20_u2_u2 65535. _CNV_A_R_LINEAR_____1_CM 0. 65535. DISPLAY_IDENTIFIER ID_ERR_DTC_PVS_RATIO FORMAT "%5.0"
 /begin AXIS_DESCR COM_AXIS online_dummy _CNV_A_R_LINEAR_____0_CM 6 0. 5. FORMAT "%2.0" AXIS_PTS_REF ldp_fmy_dtc /end AXIS_DESCR
/end CHARACTERISTIC
/begin CHARACTERISTIC fmy_id_pvs_ratio.envd "environmental data contents of customer specific freeze frame for diagnosis instance PVS_RATIO" CURVE 0x85c5fa _REC_CUR_20_u1_u1 255. _CNV_A_R_LINEAR_____1_CM 0. 255. DISPLAY_IDENTIFIER ID_ERR_ENVD_PVS_RATIO FORMAT "%3.0"
 /begin AXIS_DESCR COM_AXIS online_dummy _CNV_A_R_LINEAR_____0_CM 8 0. 7. READ_ONLY FORMAT "%2.0" AXIS_PTS_REF ldp_fmy_envd /end AXIS_DESCR
/end CHARACTERISTIC
/begin CHARACTERISTIC fmy_id_pvs_ratio.c_err_clas "error class for diagnosis instance PVS_RATIO" VALUE 0x85c602 _REC_VAL_20_u1 255. _CNV_A_R_LINEAR_____1_CM 0. 255. DISPLAY_IDENTIFIER C_ERR_CLAS_PVS_RATIO FORMAT "%3.0" /end CHARACTERISTIC
/begin CHARACTERISTIC fmy_id_pvs_move.dtc[0] "diagnostic trouble codes for diagnosis instance PVS_MOVE" CURVE 0x85c604 _REC_CUR_20_u2_u2 65535. _CNV_A_R_LINEAR_____1_CM 0. 65535. DISPLAY_IDENTIFIER ID_ERR_DTC_PVS_MOVE FORMAT "%5.0"
 /begin AXIS_DESCR COM_AXIS online_dummy _CNV_A_R_LINEAR_____0_CM 6 0. 5. FORMAT "%2.0" AXIS_PTS_REF ldp_fmy_dtc /end AXIS_DESCR
/end CHARACTERISTIC
/begin CHARACTERISTIC fmy_id_pvs_move.envd "environmental data contents of customer specific freeze frame for diagnosis instance PVS_MOVE" CURVE 0x85c610 _REC_CUR_20_u1_u1 255. _CNV_A_R_LINEAR_____1_CM 0. 255. DISPLAY_IDENTIFIER ID_ERR_ENVD_PVS_MOVE FORMAT "%3.0"
 /begin AXIS_DESCR COM_AXIS online_dummy _CNV_A_R_LINEAR_____0_CM 8 0. 7. READ_ONLY FORMAT "%2.0" AXIS_PTS_REF ldp_fmy_envd /end AXIS_DESCR
/end CHARACTERISTIC
/begin CHARACTERISTIC fmy_id_pvs_move.c_err_clas "error class for diagnosis instance PVS_MOVE" VALUE 0x85c618 _REC_VAL_20_u1 255. _CNV_A_R_LINEAR_____1_CM 0. 255. DISPLAY_IDENTIFIER C_ERR_CLAS_PVS_MOVE FORMAT "%3.0" /end CHARACTERISTIC
/begin CHARACTERISTIC fmy_id_pvs_bls_bts.dtc[0] "diagnostic trouble codes for diagnosis instance PVS_BLS_BTS" CURVE 0x85c61a _REC_CUR_20_u2_u2 65535. _CNV_A_R_LINEAR_____1_CM 0. 65535. DISPLAY_IDENTIFIER ID_ERR_DTC_PVS_BLS_BTS FORMAT "%5.0"
 /begin AXIS_DESCR COM_AXIS online_dummy _CNV_A_R_LINEAR_____0_CM 6 0. 5. FORMAT "%2.0" AXIS_PTS_REF ldp_fmy_dtc /end AXIS_DESCR
/end CHARACTERISTIC
/begin CHARACTERISTIC fmy_id_pvs_bls_bts.envd "environmental data contents of customer specific freeze frame for diagnosis instance PVS_BLS_BTS" CURVE 0x85c626 _REC_CUR_20_u1_u1 255. _CNV_A_R_LINEAR_____1_CM 0. 255. DISPLAY_IDENTIFIER ID_ERR_ENVD_PVS_BLS_BTS FORMAT "%3.0"
 /begin AXIS_DESCR COM_AXIS online_dummy _CNV_A_R_LINEAR_____0_CM 8 0. 7. READ_ONLY FORMAT "%2.0" AXIS_PTS_REF ldp_fmy_envd /end AXIS_DESCR
/end CHARACTERISTIC
/begin CHARACTERISTIC fmy_id_pvs_bls_bts.c_err_clas "error class for diagnosis instance PVS_BLS_BTS" VALUE 0x85c62e _REC_VAL_20_u1 255. _CNV_A_R_LINEAR_____1_CM 0. 255. DISPLAY_IDENTIFIER C_ERR_CLAS_PVS_BLS_BTS FORMAT "%3.0" /end CHARACTERISTIC
/begin CHARACTERISTIC fmy_id_vcc_1.dtc[0] "diagnostic trouble codes for diagnosis instance VCC_1" CURVE 0x85c630 _REC_CUR_20_u2_u2 65535. _CNV_A_R_LINEAR_____1_CM 0. 65535. DISPLAY_IDENTIFIER ID_ERR_DTC_VCC_1 FORMAT "%5.0"
 /begin AXIS_DESCR COM_AXIS online_dummy _CNV_A_R_LINEAR_____0_CM 6 0. 5. FORMAT "%2.0" AXIS_PTS_REF ldp_fmy_dtc /end AXIS_DESCR
/end CHARACTERISTIC
/begin CHARACTERISTIC fmy_id_vcc_1.envd "environmental data contents of customer specific freeze frame for diagnosis instance VCC_1" CURVE 0x85c63c _REC_CUR_20_u1_u1 255. _CNV_A_R_LINEAR_____1_CM 0. 255. DISPLAY_IDENTIFIER ID_ERR_ENVD_VCC_1 FORMAT "%3.0"
 /begin AXIS_DESCR COM_AXIS online_dummy _CNV_A_R_LINEAR_____0_CM 8 0. 7. READ_ONLY FORMAT "%2.0" AXIS_PTS_REF ldp_fmy_envd /end AXIS_DESCR
/end CHARACTERISTIC
/begin CHARACTERISTIC fmy_id_vcc_1.c_err_clas "error class for diagnosis instance VCC_1" VALUE 0x85c644 _REC_VAL_20_u1 255. _CNV_A_R_LINEAR_____1_CM 0. 255. DISPLAY_IDENTIFIER C_ERR_CLAS_VCC_1 FORMAT "%3.0" /end CHARACTERISTIC
/begin CHARACTERISTIC fmy_id_vcc_2.dtc[0] "diagnostic trouble codes for diagnosis instance VCC_2" CURVE 0x85c646 _REC_CUR_20_u2_u2 65535. _CNV_A_R_LINEAR_____1_CM 0. 65535. DISPLAY_IDENTIFIER ID_ERR_DTC_VCC_2 FORMAT "%5.0"
 /begin AXIS_DESCR COM_AXIS online_dummy _CNV_A_R_LINEAR_____0_CM 6 0. 5. FORMAT "%2.0" AXIS_PTS_REF ldp_fmy_dtc /end AXIS_DESCR
/end CHARACTERISTIC
/begin CHARACTERISTIC fmy_id_vcc_2.envd "environmental data contents of customer specific freeze frame for diagnosis instance VCC_2" CURVE 0x85c652 _REC_CUR_20_u1_u1 255. _CNV_A_R_LINEAR_____1_CM 0. 255. DISPLAY_IDENTIFIER ID_ERR_ENVD_VCC_2 FORMAT "%3.0"
 /begin AXIS_DESCR COM_AXIS online_dummy _CNV_A_R_LINEAR_____0_CM 8 0. 7. READ_ONLY FORMAT "%2.0" AXIS_PTS_REF ldp_fmy_envd /end AXIS_DESCR
/end CHARACTERISTIC
/begin CHARACTERISTIC fmy_id_vcc_2.c_err_clas "error class for diagnosis instance VCC_2" VALUE 0x85c65a _REC_VAL_20_u1 255. _CNV_A_R_LINEAR_____1_CM 0. 255. DISPLAY_IDENTIFIER C_ERR_CLAS_VCC_2 FORMAT "%3.0" /end CHARACTERISTIC
/begin CHARACTERISTIC fmy_id_v_dip_pf_rng.dtc[0] "diagnostic trouble codes for diagnosis instance V_DIP_PF_RNG" CURVE 0x85c65c _REC_CUR_20_u2_u2 65535. _CNV_A_R_LINEAR_____1_CM 0. 65535. DISPLAY_IDENTIFIER ID_ERR_DTC_V_DIP_PF_RNG FORMAT "%5.0"
 /begin AXIS_DESCR COM_AXIS online_dummy _CNV_A_R_LINEAR_____0_CM 6 0. 5. FORMAT "%2.0" AXIS_PTS_REF ldp_fmy_dtc /end AXIS_DESCR
/end CHARACTERISTIC
/begin CHARACTERISTIC fmy_id_v_dip_pf_rng.envd "environmental data contents of customer specific freeze frame for diagnosis instance V_DIP_PF_RNG" CURVE 0x85c668 _REC_CUR_20_u1_u1 255. _CNV_A_R_LINEAR_____1_CM 0. 255. DISPLAY_IDENTIFIER ID_ERR_ENVD_V_DIP_PF_RNG FORMAT "%3.0"
 /begin AXIS_DESCR COM_AXIS online_dummy _CNV_A_R_LINEAR_____0_CM 8 0. 7. READ_ONLY FORMAT "%2.0" AXIS_PTS_REF ldp_fmy_envd /end AXIS_DESCR
/end CHARACTERISTIC
/begin CHARACTERISTIC fmy_id_v_dip_pf_rng.c_err_clas "error class for diagnosis instance V_DIP_PF_RNG" VALUE 0x85c670 _REC_VAL_20_u1 255. _CNV_A_R_LINEAR_____1_CM 0. 255. DISPLAY_IDENTIFIER C_ERR_CLAS_V_DIP_PF_RNG FORMAT "%3.0" /end CHARACTERISTIC
/begin CHARACTERISTIC fmy_id_dip_pf_mes_es.dtc[0] "diagnostic trouble codes for diagnosis instance DIP_PF_MES_ES" CURVE 0x85c672 _REC_CUR_20_u2_u2 65535. _CNV_A_R_LINEAR_____1_CM 0. 65535. DISPLAY_IDENTIFIER ID_ERR_DTC_DIP_PF_MES_ES FORMAT "%5.0"
 /begin AXIS_DESCR COM_AXIS online_dummy _CNV_A_R_LINEAR_____0_CM 6 0. 5. FORMAT "%2.0" AXIS_PTS_REF ldp_fmy_dtc /end AXIS_DESCR
/end CHARACTERISTIC
/begin CHARACTERISTIC fmy_id_dip_pf_mes_es.envd "environmental data contents of customer specific freeze frame for diagnosis instance DIP_PF_MES_ES" CURVE 0x85c67e _REC_CUR_20_u1_u1 255. _CNV_A_R_LINEAR_____1_CM 0. 255. DISPLAY_IDENTIFIER ID_ERR_ENVD_DIP_PF_MES_ES FORMAT "%3.0"
 /begin AXIS_DESCR COM_AXIS online_dummy _CNV_A_R_LINEAR_____0_CM 8 0. 7. READ_ONLY FORMAT "%2.0" AXIS_PTS_REF ldp_fmy_envd /end AXIS_DESCR
/end CHARACTERISTIC
/begin CHARACTERISTIC fmy_id_dip_pf_mes_es.c_err_clas "error class for diagnosis instance DIP_PF_MES_ES" VALUE 0x85c686 _REC_VAL_20_u1 255. _CNV_A_R_LINEAR_____1_CM 0. 255. DISPLAY_IDENTIFIER C_ERR_CLAS_DIP_PF_MES_ES FORMAT "%3.0" /end CHARACTERISTIC
/begin CHARACTERISTIC fmy_id_dip_pf_mes_eru.dtc[0] "diagnostic trouble codes for diagnosis instance DIP_PF_MES_ERU" CURVE 0x85c688 _REC_CUR_20_u2_u2 65535. _CNV_A_R_LINEAR_____1_CM 0. 65535. DISPLAY_IDENTIFIER ID_ERR_DTC_DIP_PF_MES_ERU FORMAT "%5.0"
 /begin AXIS_DESCR COM_AXIS online_dummy _CNV_A_R_LINEAR_____0_CM 6 0. 5. FORMAT "%2.0" AXIS_PTS_REF ldp_fmy_dtc /end AXIS_DESCR
/end CHARACTERISTIC
/begin CHARACTERISTIC fmy_id_dip_pf_mes_eru.envd "environmental data contents of customer specific freeze frame for diagnosis instance DIP_PF_MES_ERU" CURVE 0x85c694 _REC_CUR_20_u1_u1 255. _CNV_A_R_LINEAR_____1_CM 0. 255. DISPLAY_IDENTIFIER ID_ERR_ENVD_DIP_PF_MES_ERU FORMAT "%3.0"
 /begin AXIS_DESCR COM_AXIS online_dummy _CNV_A_R_LINEAR_____0_CM 8 0. 7. READ_ONLY FORMAT "%2.0" AXIS_PTS_REF ldp_fmy_envd /end AXIS_DESCR
/end CHARACTERISTIC
/begin CHARACTERISTIC fmy_id_dip_pf_mes_eru.c_err_clas "error class for diagnosis instance DIP_PF_MES_ERU" VALUE 0x85c69c _REC_VAL_20_u1 255. _CNV_A_R_LINEAR_____1_CM 0. 255. DISPLAY_IDENTIFIER C_ERR_CLAS_DIP_PF_MES_ERU FORMAT "%3.0" /end CHARACTERISTIC
/begin CHARACTERISTIC fmy_id_v_tco_1_rng.dtc[0] "diagnostic trouble codes for diagnosis instance V_TCO_1_RNG" CURVE 0x85c69e _REC_CUR_20_u2_u2 65535. _CNV_A_R_LINEAR_____1_CM 0. 65535. DISPLAY_IDENTIFIER ID_ERR_DTC_V_TCO_1_RNG FORMAT "%5.0"
 /begin AXIS_DESCR COM_AXIS online_dummy _CNV_A_R_LINEAR_____0_CM 6 0. 5. FORMAT "%2.0" AXIS_PTS_REF ldp_fmy_dtc /end AXIS_DESCR
/end CHARACTERISTIC
/begin CHARACTERISTIC fmy_id_v_tco_1_rng.envd "environmental data contents of customer specific freeze frame for diagnosis instance V_TCO_1_RNG" CURVE 0x85c6aa _REC_CUR_20_u1_u1 255. _CNV_A_R_LINEAR_____1_CM 0. 255. DISPLAY_IDENTIFIER ID_ERR_ENVD_V_TCO_1_RNG FORMAT "%3.0"
 /begin AXIS_DESCR COM_AXIS online_dummy _CNV_A_R_LINEAR_____0_CM 8 0. 7. READ_ONLY FORMAT "%2.0" AXIS_PTS_REF ldp_fmy_envd /end AXIS_DESCR
/end CHARACTERISTIC
/begin CHARACTERISTIC fmy_id_v_tco_1_rng.c_err_clas "error class for diagnosis instance V_TCO_1_RNG" VALUE 0x85c6b2 _REC_VAL_20_u1 255. _CNV_A_R_LINEAR_____1_CM 0. 255. DISPLAY_IDENTIFIER C_ERR_CLAS_V_TCO_1_RNG FORMAT "%3.0" /end CHARACTERISTIC
/begin CHARACTERISTIC fmy_id_v_tco_2_rng.dtc[0] "diagnostic trouble codes for diagnosis instance V_TCO_2_RNG" CURVE 0x85c6b4 _REC_CUR_20_u2_u2 65535. _CNV_A_R_LINEAR_____1_CM 0. 65535. DISPLAY_IDENTIFIER ID_ERR_DTC_V_TCO_2_RNG FORMAT "%5.0"
 /begin AXIS_DESCR COM_AXIS online_dummy _CNV_A_R_LINEAR_____0_CM 6 0. 5. FORMAT "%2.0" AXIS_PTS_REF ldp_fmy_dtc /end AXIS_DESCR
/end CHARACTERISTIC
/begin CHARACTERISTIC fmy_id_v_tco_2_rng.envd "environmental data contents of customer specific freeze frame for diagnosis instance V_TCO_2_RNG" CURVE 0x85c6c0 _REC_CUR_20_u1_u1 255. _CNV_A_R_LINEAR_____1_CM 0. 255. DISPLAY_IDENTIFIER ID_ERR_ENVD_V_TCO_2_RNG FORMAT "%3.0"
 /begin AXIS_DESCR COM_AXIS online_dummy _CNV_A_R_LINEAR_____0_CM 8 0. 7. READ_ONLY FORMAT "%2.0" AXIS_PTS_REF ldp_fmy_envd /end AXIS_DESCR
/end CHARACTERISTIC
/begin CHARACTERISTIC fmy_id_v_tco_2_rng.c_err_clas "error class for diagnosis instance V_TCO_2_RNG" VALUE 0x85c6c8 _REC_VAL_20_u1 255. _CNV_A_R_LINEAR_____1_CM 0. 255. DISPLAY_IDENTIFIER C_ERR_CLAS_V_TCO_2_RNG FORMAT "%3.0" /end CHARACTERISTIC
/begin CHARACTERISTIC fmy_id_tco_1_mes_grd.dtc[0] "diagnostic trouble codes for diagnosis instance TCO_1_MES_GRD" CURVE 0x85c6ca _REC_CUR_20_u2_u2 65535. _CNV_A_R_LINEAR_____1_CM 0. 65535. DISPLAY_IDENTIFIER ID_ERR_DTC_TCO_1_MES_GRD FORMAT "%5.0"
 /begin AXIS_DESCR COM_AXIS online_dummy _CNV_A_R_LINEAR_____0_CM 6 0. 5. FORMAT "%2.0" AXIS_PTS_REF ldp_fmy_dtc /end AXIS_DESCR
/end CHARACTERISTIC
/begin CHARACTERISTIC fmy_id_tco_1_mes_grd.envd "environmental data contents of customer specific freeze frame for diagnosis instance TCO_1_MES_GRD" CURVE 0x85c6d6 _REC_CUR_20_u1_u1 255. _CNV_A_R_LINEAR_____1_CM 0. 255. DISPLAY_IDENTIFIER ID_ERR_ENVD_TCO_1_MES_GRD FORMAT "%3.0"
 /begin AXIS_DESCR COM_AXIS online_dummy _CNV_A_R_LINEAR_____0_CM 8 0. 7. READ_ONLY FORMAT "%2.0" AXIS_PTS_REF ldp_fmy_envd /end AXIS_DESCR
/end CHARACTERISTIC
/begin CHARACTERISTIC fmy_id_tco_1_mes_grd.c_err_clas "error class for diagnosis instance TCO_1_MES_GRD" VALUE 0x85c6de _REC_VAL_20_u1 255. _CNV_A_R_LINEAR_____1_CM 0. 255. DISPLAY_IDENTIFIER C_ERR_CLAS_TCO_1_MES_GRD FORMAT "%3.0" /end CHARACTERISTIC
/begin CHARACTERISTIC fmy_id_tco_2_mes_grd.dtc[0] "diagnostic trouble codes for diagnosis instance TCO_2_MES_GRD" CURVE 0x85c6e0 _REC_CUR_20_u2_u2 65535. _CNV_A_R_LINEAR_____1_CM 0. 65535. DISPLAY_IDENTIFIER ID_ERR_DTC_TCO_2_MES_GRD FORMAT "%5.0"
 /begin AXIS_DESCR COM_AXIS online_dummy _CNV_A_R_LINEAR_____0_CM 6 0. 5. FORMAT "%2.0" AXIS_PTS_REF ldp_fmy_dtc /end AXIS_DESCR
/end CHARACTERISTIC
/begin CHARACTERISTIC fmy_id_tco_2_mes_grd.envd "environmental data contents of customer specific freeze frame for diagnosis instance TCO_2_MES_GRD" CURVE 0x85c6ec _REC_CUR_20_u1_u1 255. _CNV_A_R_LINEAR_____1_CM 0. 255. DISPLAY_IDENTIFIER ID_ERR_ENVD_TCO_2_MES_GRD FORMAT "%3.0"
 /begin AXIS_DESCR COM_AXIS online_dummy _CNV_A_R_LINEAR_____0_CM 8 0. 7. READ_ONLY FORMAT "%2.0" AXIS_PTS_REF ldp_fmy_envd /end AXIS_DESCR
/end CHARACTERISTIC
/begin CHARACTERISTIC fmy_id_tco_2_mes_grd.c_err_clas "error class for diagnosis instance TCO_2_MES_GRD" VALUE 0x85c6f4 _REC_VAL_20_u1 255. _CNV_A_R_LINEAR_____1_CM 0. 255. DISPLAY_IDENTIFIER C_ERR_CLAS_TCO_2_MES_GRD FORMAT "%3.0" /end CHARACTERISTIC
/begin CHARACTERISTIC fmy_id_tco_mes_plaus.dtc[0] "diagnostic trouble codes for diagnosis instance TCO_MES_PLAUS" CURVE 0x85c6f6 _REC_CUR_20_u2_u2 65535. _CNV_A_R_LINEAR_____1_CM 0. 65535. DISPLAY_IDENTIFIER ID_ERR_DTC_TCO_MES_PLAUS FORMAT "%5.0"
 /begin AXIS_DESCR COM_AXIS online_dummy _CNV_A_R_LINEAR_____0_CM 6 0. 5. FORMAT "%2.0" AXIS_PTS_REF ldp_fmy_dtc /end AXIS_DESCR
/end CHARACTERISTIC
/begin CHARACTERISTIC fmy_id_tco_mes_plaus.envd "environmental data contents of customer specific freeze frame for diagnosis instance TCO_MES_PLAUS" CURVE 0x85c702 _REC_CUR_20_u1_u1 255. _CNV_A_R_LINEAR_____1_CM 0. 255. DISPLAY_IDENTIFIER ID_ERR_ENVD_TCO_MES_PLAUS FORMAT "%3.0"
 /begin AXIS_DESCR COM_AXIS online_dummy _CNV_A_R_LINEAR_____0_CM 8 0. 7. READ_ONLY FORMAT "%2.0" AXIS_PTS_REF ldp_fmy_envd /end AXIS_DESCR
/end CHARACTERISTIC
/begin CHARACTERISTIC fmy_id_tco_mes_plaus.c_err_clas "error class for diagnosis instance TCO_MES_PLAUS" VALUE 0x85c70a _REC_VAL_20_u1 255. _CNV_A_R_LINEAR_____1_CM 0. 255. DISPLAY_IDENTIFIER C_ERR_CLAS_TCO_MES_PLAUS FORMAT "%3.0" /end CHARACTERISTIC
/begin CHARACTERISTIC fmy_id_egr_ctl_min.dtc[0] "diagnostic trouble codes for diagnosis instance EGR_CTL_MIN" CURVE 0x85c70c _REC_CUR_20_u2_u2 65535. _CNV_A_R_LINEAR_____1_CM 0. 65535. DISPLAY_IDENTIFIER ID_ERR_DTC_EGR_CTL_MIN FORMAT "%5.0"
 /begin AXIS_DESCR COM_AXIS online_dummy _CNV_A_R_LINEAR_____0_CM 6 0. 5. FORMAT "%2.0" AXIS_PTS_REF ldp_fmy_dtc /end AXIS_DESCR
/end CHARACTERISTIC
/begin CHARACTERISTIC fmy_id_egr_ctl_min.envd "environmental data contents of customer specific freeze frame for diagnosis instance EGR_CTL_MIN" CURVE 0x85c718 _REC_CUR_20_u1_u1 255. _CNV_A_R_LINEAR_____1_CM 0. 255. DISPLAY_IDENTIFIER ID_ERR_ENVD_EGR_CTL_MIN FORMAT "%3.0"
 /begin AXIS_DESCR COM_AXIS online_dummy _CNV_A_R_LINEAR_____0_CM 8 0. 7. READ_ONLY FORMAT "%2.0" AXIS_PTS_REF ldp_fmy_envd /end AXIS_DESCR
/end CHARACTERISTIC
/begin CHARACTERISTIC fmy_id_egr_ctl_min.c_err_clas "error class for diagnosis instance EGR_CTL_MIN" VALUE 0x85c720 _REC_VAL_20_u1 255. _CNV_A_R_LINEAR_____1_CM 0. 255. DISPLAY_IDENTIFIER C_ERR_CLAS_EGR_CTL_MIN FORMAT "%3.0" /end CHARACTERISTIC
/begin CHARACTERISTIC fmy_id_egr_ctl_max.dtc[0] "diagnostic trouble codes for diagnosis instance EGR_CTL_MAX" CURVE 0x85c722 _REC_CUR_20_u2_u2 65535. _CNV_A_R_LINEAR_____1_CM 0. 65535. DISPLAY_IDENTIFIER ID_ERR_DTC_EGR_CTL_MAX FORMAT "%5.0"
 /begin AXIS_DESCR COM_AXIS online_dummy _CNV_A_R_LINEAR_____0_CM 6 0. 5. FORMAT "%2.0" AXIS_PTS_REF ldp_fmy_dtc /end AXIS_DESCR
/end CHARACTERISTIC
/begin CHARACTERISTIC fmy_id_egr_ctl_max.envd "environmental data contents of customer specific freeze frame for diagnosis instance EGR_CTL_MAX" CURVE 0x85c72e _REC_CUR_20_u1_u1 255. _CNV_A_R_LINEAR_____1_CM 0. 255. DISPLAY_IDENTIFIER ID_ERR_ENVD_EGR_CTL_MAX FORMAT "%3.0"
 /begin AXIS_DESCR COM_AXIS online_dummy _CNV_A_R_LINEAR_____0_CM 8 0. 7. READ_ONLY FORMAT "%2.0" AXIS_PTS_REF ldp_fmy_envd /end AXIS_DESCR
/end CHARACTERISTIC
/begin CHARACTERISTIC fmy_id_egr_ctl_max.c_err_clas "error class for diagnosis instance EGR_CTL_MAX" VALUE 0x85c736 _REC_VAL_20_u1 255. _CNV_A_R_LINEAR_____1_CM 0. 255. DISPLAY_IDENTIFIER C_ERR_CLAS_EGR_CTL_MAX FORMAT "%3.0" /end CHARACTERISTIC
/begin CHARACTERISTIC fmy_id_v_amp_rng.dtc[0] "diagnostic trouble codes for diagnosis instance V_AMP_RNG" CURVE 0x85c738 _REC_CUR_20_u2_u2 65535. _CNV_A_R_LINEAR_____1_CM 0. 65535. DISPLAY_IDENTIFIER ID_ERR_DTC_V_AMP_RNG FORMAT "%5.0"
 /begin AXIS_DESCR COM_AXIS online_dummy _CNV_A_R_LINEAR_____0_CM 6 0. 5. FORMAT "%2.0" AXIS_PTS_REF ldp_fmy_dtc /end AXIS_DESCR
/end CHARACTERISTIC
/begin CHARACTERISTIC fmy_id_v_amp_rng.envd "environmental data contents of customer specific freeze frame for diagnosis instance V_AMP_RNG" CURVE 0x85c744 _REC_CUR_20_u1_u1 255. _CNV_A_R_LINEAR_____1_CM 0. 255. DISPLAY_IDENTIFIER ID_ERR_ENVD_V_AMP_RNG FORMAT "%3.0"
 /begin AXIS_DESCR COM_AXIS online_dummy _CNV_A_R_LINEAR_____0_CM 8 0. 7. READ_ONLY FORMAT "%2.0" AXIS_PTS_REF ldp_fmy_envd /end AXIS_DESCR
/end CHARACTERISTIC
/begin CHARACTERISTIC fmy_id_v_amp_rng.c_err_clas "error class for diagnosis instance V_AMP_RNG" VALUE 0x85c74c _REC_VAL_20_u1 255. _CNV_A_R_LINEAR_____1_CM 0. 255. DISPLAY_IDENTIFIER C_ERR_CLAS_V_AMP_RNG FORMAT "%3.0" /end CHARACTERISTIC
/begin CHARACTERISTIC fmy_id_amp_mes_grd.dtc[0] "diagnostic trouble codes for diagnosis instance AMP_MES_GRD" CURVE 0x85c74e _REC_CUR_20_u2_u2 65535. _CNV_A_R_LINEAR_____1_CM 0. 65535. DISPLAY_IDENTIFIER ID_ERR_DTC_AMP_MES_GRD FORMAT "%5.0"
 /begin AXIS_DESCR COM_AXIS online_dummy _CNV_A_R_LINEAR_____0_CM 6 0. 5. FORMAT "%2.0" AXIS_PTS_REF ldp_fmy_dtc /end AXIS_DESCR
/end CHARACTERISTIC
/begin CHARACTERISTIC fmy_id_amp_mes_grd.envd "environmental data contents of customer specific freeze frame for diagnosis instance AMP_MES_GRD" CURVE 0x85c75a _REC_CUR_20_u1_u1 255. _CNV_A_R_LINEAR_____1_CM 0. 255. DISPLAY_IDENTIFIER ID_ERR_ENVD_AMP_MES_GRD FORMAT "%3.0"
 /begin AXIS_DESCR COM_AXIS online_dummy _CNV_A_R_LINEAR_____0_CM 8 0. 7. READ_ONLY FORMAT "%2.0" AXIS_PTS_REF ldp_fmy_envd /end AXIS_DESCR
/end CHARACTERISTIC
/begin CHARACTERISTIC fmy_id_amp_mes_grd.c_err_clas "error class for diagnosis instance AMP_MES_GRD" VALUE 0x85c762 _REC_VAL_20_u1 255. _CNV_A_R_LINEAR_____1_CM 0. 255. DISPLAY_IDENTIFIER C_ERR_CLAS_AMP_MES_GRD FORMAT "%3.0" /end CHARACTERISTIC
/begin CHARACTERISTIC fmy_id_v_tfu_rng.dtc[0] "diagnostic trouble codes for diagnosis instance V_TFU_RNG" CURVE 0x85c764 _REC_CUR_20_u2_u2 65535. _CNV_A_R_LINEAR_____1_CM 0. 65535. DISPLAY_IDENTIFIER ID_ERR_DTC_V_TFU_RNG FORMAT "%5.0"
 /begin AXIS_DESCR COM_AXIS online_dummy _CNV_A_R_LINEAR_____0_CM 6 0. 5. FORMAT "%2.0" AXIS_PTS_REF ldp_fmy_dtc /end AXIS_DESCR
/end CHARACTERISTIC
/begin CHARACTERISTIC fmy_id_v_tfu_rng.envd "environmental data contents of customer specific freeze frame for diagnosis instance V_TFU_RNG" CURVE 0x85c770 _REC_CUR_20_u1_u1 255. _CNV_A_R_LINEAR_____1_CM 0. 255. DISPLAY_IDENTIFIER ID_ERR_ENVD_V_TFU_RNG FORMAT "%3.0"
 /begin AXIS_DESCR COM_AXIS online_dummy _CNV_A_R_LINEAR_____0_CM 8 0. 7. READ_ONLY FORMAT "%2.0" AXIS_PTS_REF ldp_fmy_envd /end AXIS_DESCR
/end CHARACTERISTIC
/begin CHARACTERISTIC fmy_id_v_tfu_rng.c_err_clas "error class for diagnosis instance V_TFU_RNG" VALUE 0x85c778 _REC_VAL_20_u1 255. _CNV_A_R_LINEAR_____1_CM 0. 255. DISPLAY_IDENTIFIER C_ERR_CLAS_V_TFU_RNG FORMAT "%3.0" /end CHARACTERISTIC
/begin CHARACTERISTIC fmy_id_tfu_mes_grd.dtc[0] "diagnostic trouble codes for diagnosis instance TFU_MES_GRD" CURVE 0x85c77a _REC_CUR_20_u2_u2 65535. _CNV_A_R_LINEAR_____1_CM 0. 65535. DISPLAY_IDENTIFIER ID_ERR_DTC_TFU_MES_GRD FORMAT "%5.0"
 /begin AXIS_DESCR COM_AXIS online_dummy _CNV_A_R_LINEAR_____0_CM 6 0. 5. FORMAT "%2.0" AXIS_PTS_REF ldp_fmy_dtc /end AXIS_DESCR
/end CHARACTERISTIC
/begin CHARACTERISTIC fmy_id_tfu_mes_grd.envd "environmental data contents of customer specific freeze frame for diagnosis instance TFU_MES_GRD" CURVE 0x85c786 _REC_CUR_20_u1_u1 255. _CNV_A_R_LINEAR_____1_CM 0. 255. DISPLAY_IDENTIFIER ID_ERR_ENVD_TFU_MES_GRD FORMAT "%3.0"
 /begin AXIS_DESCR COM_AXIS online_dummy _CNV_A_R_LINEAR_____0_CM 8 0. 7. READ_ONLY FORMAT "%2.0" AXIS_PTS_REF ldp_fmy_envd /end AXIS_DESCR
/end CHARACTERISTIC
/begin CHARACTERISTIC fmy_id_tfu_mes_grd.c_err_clas "error class for diagnosis instance TFU_MES_GRD" VALUE 0x85c78e _REC_VAL_20_u1 255. _CNV_A_R_LINEAR_____1_CM 0. 255. DISPLAY_IDENTIFIER C_ERR_CLAS_TFU_MES_GRD FORMAT "%3.0" /end CHARACTERISTIC
/begin CHARACTERISTIC fmy_id_v_map_rng.dtc[0] "diagnostic trouble codes for diagnosis instance V_MAP_RNG" CURVE 0x85c790 _REC_CUR_20_u2_u2 65535. _CNV_A_R_LINEAR_____1_CM 0. 65535. DISPLAY_IDENTIFIER ID_ERR_DTC_V_MAP_RNG FORMAT "%5.0"
 /begin AXIS_DESCR COM_AXIS online_dummy _CNV_A_R_LINEAR_____0_CM 6 0. 5. FORMAT "%2.0" AXIS_PTS_REF ldp_fmy_dtc /end AXIS_DESCR
/end CHARACTERISTIC
/begin CHARACTERISTIC fmy_id_v_map_rng.envd "environmental data contents of customer specific freeze frame for diagnosis instance V_MAP_RNG" CURVE 0x85c79c _REC_CUR_20_u1_u1 255. _CNV_A_R_LINEAR_____1_CM 0. 255. DISPLAY_IDENTIFIER ID_ERR_ENVD_V_MAP_RNG FORMAT "%3.0"
 /begin AXIS_DESCR COM_AXIS online_dummy _CNV_A_R_LINEAR_____0_CM 8 0. 7. READ_ONLY FORMAT "%2.0" AXIS_PTS_REF ldp_fmy_envd /end AXIS_DESCR
/end CHARACTERISTIC
/begin CHARACTERISTIC fmy_id_v_map_rng.c_err_clas "error class for diagnosis instance V_MAP_RNG" VALUE 0x85c7a4 _REC_VAL_20_u1 255. _CNV_A_R_LINEAR_____1_CM 0. 255. DISPLAY_IDENTIFIER C_ERR_CLAS_V_MAP_RNG FORMAT "%3.0" /end CHARACTERISTIC
/begin CHARACTERISTIC fmy_id_map_amp_ofs.dtc[0] "diagnostic trouble codes for diagnosis instance MAP_AMP_OFS" CURVE 0x85c7a6 _REC_CUR_20_u2_u2 65535. _CNV_A_R_LINEAR_____1_CM 0. 65535. DISPLAY_IDENTIFIER ID_ERR_DTC_MAP_AMP_OFS FORMAT "%5.0"
 /begin AXIS_DESCR COM_AXIS online_dummy _CNV_A_R_LINEAR_____0_CM 6 0. 5. FORMAT "%2.0" AXIS_PTS_REF ldp_fmy_dtc /end AXIS_DESCR
/end CHARACTERISTIC
/begin CHARACTERISTIC fmy_id_map_amp_ofs.envd "environmental data contents of customer specific freeze frame for diagnosis instance MAP_AMP_OFS" CURVE 0x85c7b2 _REC_CUR_20_u1_u1 255. _CNV_A_R_LINEAR_____1_CM 0. 255. DISPLAY_IDENTIFIER ID_ERR_ENVD_MAP_AMP_OFS FORMAT "%3.0"
 /begin AXIS_DESCR COM_AXIS online_dummy _CNV_A_R_LINEAR_____0_CM 8 0. 7. READ_ONLY FORMAT "%2.0" AXIS_PTS_REF ldp_fmy_envd /end AXIS_DESCR
/end CHARACTERISTIC
/begin CHARACTERISTIC fmy_id_map_amp_ofs.c_err_clas "error class for diagnosis instance MAP_AMP_OFS" VALUE 0x85c7ba _REC_VAL_20_u1 255. _CNV_A_R_LINEAR_____1_CM 0. 255. DISPLAY_IDENTIFIER C_ERR_CLAS_MAP_AMP_OFS FORMAT "%3.0" /end CHARACTERISTIC
/begin CHARACTERISTIC fmy_id_map_is_ofs.dtc[0] "diagnostic trouble codes for diagnosis instance MAP_IS_OFS" CURVE 0x85c7bc _REC_CUR_20_u2_u2 65535. _CNV_A_R_LINEAR_____1_CM 0. 65535. DISPLAY_IDENTIFIER ID_ERR_DTC_MAP_IS_OFS FORMAT "%5.0"
 /begin AXIS_DESCR COM_AXIS online_dummy _CNV_A_R_LINEAR_____0_CM 6 0. 5. FORMAT "%2.0" AXIS_PTS_REF ldp_fmy_dtc /end AXIS_DESCR
/end CHARACTERISTIC
/begin CHARACTERISTIC fmy_id_map_is_ofs.envd "environmental data contents of customer specific freeze frame for diagnosis instance MAP_IS_OFS" CURVE 0x85c7c8 _REC_CUR_20_u1_u1 255. _CNV_A_R_LINEAR_____1_CM 0. 255. DISPLAY_IDENTIFIER ID_ERR_ENVD_MAP_IS_OFS FORMAT "%3.0"
 /begin AXIS_DESCR COM_AXIS online_dummy _CNV_A_R_LINEAR_____0_CM 8 0. 7. READ_ONLY FORMAT "%2.0" AXIS_PTS_REF ldp_fmy_envd /end AXIS_DESCR
/end CHARACTERISTIC
/begin CHARACTERISTIC fmy_id_map_is_ofs.c_err_clas "error class for diagnosis instance MAP_IS_OFS" VALUE 0x85c7d0 _REC_VAL_20_u1 255. _CNV_A_R_LINEAR_____1_CM 0. 255. DISPLAY_IDENTIFIER C_ERR_CLAS_MAP_IS_OFS FORMAT "%3.0" /end CHARACTERISTIC
/begin CHARACTERISTIC fmy_id_map_mes_grd.dtc[0] "diagnostic trouble codes for diagnosis instance MAP_MES_GRD" CURVE 0x85c7d2 _REC_CUR_20_u2_u2 65535. _CNV_A_R_LINEAR_____1_CM 0. 65535. DISPLAY_IDENTIFIER ID_ERR_DTC_MAP_MES_GRD FORMAT "%5.0"
 /begin AXIS_DESCR COM_AXIS online_dummy _CNV_A_R_LINEAR_____0_CM 6 0. 5. FORMAT "%2.0" AXIS_PTS_REF ldp_fmy_dtc /end AXIS_DESCR
/end CHARACTERISTIC
/begin CHARACTERISTIC fmy_id_map_mes_grd.envd "environmental data contents of customer specific freeze frame for diagnosis instance MAP_MES_GRD" CURVE 0x85c7de _REC_CUR_20_u1_u1 255. _CNV_A_R_LINEAR_____1_CM 0. 255. DISPLAY_IDENTIFIER ID_ERR_ENVD_MAP_MES_GRD FORMAT "%3.0"
 /begin AXIS_DESCR COM_AXIS online_dummy _CNV_A_R_LINEAR_____0_CM 8 0. 7. READ_ONLY FORMAT "%2.0" AXIS_PTS_REF ldp_fmy_envd /end AXIS_DESCR
/end CHARACTERISTIC
/begin CHARACTERISTIC fmy_id_map_mes_grd.c_err_clas "error class for diagnosis instance MAP_MES_GRD" VALUE 0x85c7e6 _REC_VAL_20_u1 255. _CNV_A_R_LINEAR_____1_CM 0. 255. DISPLAY_IDENTIFIER C_ERR_CLAS_MAP_MES_GRD FORMAT "%3.0" /end CHARACTERISTIC
/begin CHARACTERISTIC fmy_id_maf_kgh_plaus.dtc[0] "diagnostic trouble codes for diagnosis instance MAF_KGH_PLAUS" CURVE 0x85c7e8 _REC_CUR_20_u2_u2 65535. _CNV_A_R_LINEAR_____1_CM 0. 65535. DISPLAY_IDENTIFIER ID_ERR_DTC_MAF_KGH_PLAUS FORMAT "%5.0"
 /begin AXIS_DESCR COM_AXIS online_dummy _CNV_A_R_LINEAR_____0_CM 6 0. 5. FORMAT "%2.0" AXIS_PTS_REF ldp_fmy_dtc /end AXIS_DESCR
/end CHARACTERISTIC
/begin CHARACTERISTIC fmy_id_maf_kgh_plaus.envd "environmental data contents of customer specific freeze frame for diagnosis instance MAF_KGH_PLAUS" CURVE 0x85c7f4 _REC_CUR_20_u1_u1 255. _CNV_A_R_LINEAR_____1_CM 0. 255. DISPLAY_IDENTIFIER ID_ERR_ENVD_MAF_KGH_PLAUS FORMAT "%3.0"
 /begin AXIS_DESCR COM_AXIS online_dummy _CNV_A_R_LINEAR_____0_CM 8 0. 7. READ_ONLY FORMAT "%2.0" AXIS_PTS_REF ldp_fmy_envd /end AXIS_DESCR
/end CHARACTERISTIC
/begin CHARACTERISTIC fmy_id_maf_kgh_plaus.c_err_clas "error class for diagnosis instance MAF_KGH_PLAUS" VALUE 0x85c7fc _REC_VAL_20_u1 255. _CNV_A_R_LINEAR_____1_CM 0. 255. DISPLAY_IDENTIFIER C_ERR_CLAS_MAF_KGH_PLAUS FORMAT "%3.0" /end CHARACTERISTIC
/begin CHARACTERISTIC fmy_id_maf_0_rng.dtc[0] "diagnostic trouble codes for diagnosis instance MAF_0_RNG" CURVE 0x85c7fe _REC_CUR_20_u2_u2 65535. _CNV_A_R_LINEAR_____1_CM 0. 65535. DISPLAY_IDENTIFIER ID_ERR_DTC_MAF_0_RNG FORMAT "%5.0"
 /begin AXIS_DESCR COM_AXIS online_dummy _CNV_A_R_LINEAR_____0_CM 6 0. 5. FORMAT "%2.0" AXIS_PTS_REF ldp_fmy_dtc /end AXIS_DESCR
/end CHARACTERISTIC
/begin CHARACTERISTIC fmy_id_maf_0_rng.envd "environmental data contents of customer specific freeze frame for diagnosis instance MAF_0_RNG" CURVE 0x85c80a _REC_CUR_20_u1_u1 255. _CNV_A_R_LINEAR_____1_CM 0. 255. DISPLAY_IDENTIFIER ID_ERR_ENVD_MAF_0_RNG FORMAT "%3.0"
 /begin AXIS_DESCR COM_AXIS online_dummy _CNV_A_R_LINEAR_____0_CM 8 0. 7. READ_ONLY FORMAT "%2.0" AXIS_PTS_REF ldp_fmy_envd /end AXIS_DESCR
/end CHARACTERISTIC
/begin CHARACTERISTIC fmy_id_maf_0_rng.c_err_clas "error class for diagnosis instance MAF_0_RNG" VALUE 0x85c812 _REC_VAL_20_u1 255. _CNV_A_R_LINEAR_____1_CM 0. 255. DISPLAY_IDENTIFIER C_ERR_CLAS_MAF_0_RNG FORMAT "%3.0" /end CHARACTERISTIC
/begin CHARACTERISTIC fmy_id_v_tpc_rng.dtc[0] "diagnostic trouble codes for diagnosis instance V_TPC_RNG" CURVE 0x85c814 _REC_CUR_20_u2_u2 65535. _CNV_A_R_LINEAR_____1_CM 0. 65535. DISPLAY_IDENTIFIER ID_ERR_DTC_V_TPC_RNG FORMAT "%5.0"
 /begin AXIS_DESCR COM_AXIS online_dummy _CNV_A_R_LINEAR_____0_CM 6 0. 5. FORMAT "%2.0" AXIS_PTS_REF ldp_fmy_dtc /end AXIS_DESCR
/end CHARACTERISTIC
/begin CHARACTERISTIC fmy_id_v_tpc_rng.envd "environmental data contents of customer specific freeze frame for diagnosis instance V_TPC_RNG" CURVE 0x85c820 _REC_CUR_20_u1_u1 255. _CNV_A_R_LINEAR_____1_CM 0. 255. DISPLAY_IDENTIFIER ID_ERR_ENVD_V_TPC_RNG FORMAT "%3.0"
 /begin AXIS_DESCR COM_AXIS online_dummy _CNV_A_R_LINEAR_____0_CM 8 0. 7. READ_ONLY FORMAT "%2.0" AXIS_PTS_REF ldp_fmy_envd /end AXIS_DESCR
/end CHARACTERISTIC
/begin CHARACTERISTIC fmy_id_v_tpc_rng.c_err_clas "error class for diagnosis instance V_TPC_RNG" VALUE 0x85c828 _REC_VAL_20_u1 255. _CNV_A_R_LINEAR_____1_CM 0. 255. DISPLAY_IDENTIFIER C_ERR_CLAS_V_TPC_RNG FORMAT "%3.0" /end CHARACTERISTIC
/begin CHARACTERISTIC fmy_id_tpc_mes_plaus.dtc[0] "diagnostic trouble codes for diagnosis instance TPC_MES_PLAUS" CURVE 0x85c82a _REC_CUR_20_u2_u2 65535. _CNV_A_R_LINEAR_____1_CM 0. 65535. DISPLAY_IDENTIFIER ID_ERR_DTC_TPC_MES_PLAUS FORMAT "%5.0"
 /begin AXIS_DESCR COM_AXIS online_dummy _CNV_A_R_LINEAR_____0_CM 6 0. 5. FORMAT "%2.0" AXIS_PTS_REF ldp_fmy_dtc /end AXIS_DESCR
/end CHARACTERISTIC
/begin CHARACTERISTIC fmy_id_tpc_mes_plaus.envd "environmental data contents of customer specific freeze frame for diagnosis instance TPC_MES_PLAUS" CURVE 0x85c836 _REC_CUR_20_u1_u1 255. _CNV_A_R_LINEAR_____1_CM 0. 255. DISPLAY_IDENTIFIER ID_ERR_ENVD_TPC_MES_PLAUS FORMAT "%3.0"
 /begin AXIS_DESCR COM_AXIS online_dummy _CNV_A_R_LINEAR_____0_CM 8 0. 7. READ_ONLY FORMAT "%2.0" AXIS_PTS_REF ldp_fmy_envd /end AXIS_DESCR
/end CHARACTERISTIC
/begin CHARACTERISTIC fmy_id_tpc_mes_plaus.c_err_clas "error class for diagnosis instance TPC_MES_PLAUS" VALUE 0x85c83e _REC_VAL_20_u1 255. _CNV_A_R_LINEAR_____1_CM 0. 255. DISPLAY_IDENTIFIER C_ERR_CLAS_TPC_MES_PLAUS FORMAT "%3.0" /end CHARACTERISTIC
/begin CHARACTERISTIC fmy_id_v_tac_rng.dtc[0] "diagnostic trouble codes for diagnosis instance V_TAC_RNG" CURVE 0x85c840 _REC_CUR_20_u2_u2 65535. _CNV_A_R_LINEAR_____1_CM 0. 65535. DISPLAY_IDENTIFIER ID_ERR_DTC_V_TAC_RNG FORMAT "%5.0"
 /begin AXIS_DESCR COM_AXIS online_dummy _CNV_A_R_LINEAR_____0_CM 6 0. 5. FORMAT "%2.0" AXIS_PTS_REF ldp_fmy_dtc /end AXIS_DESCR
/end CHARACTERISTIC
/begin CHARACTERISTIC fmy_id_v_tac_rng.envd "environmental data contents of customer specific freeze frame for diagnosis instance V_TAC_RNG" CURVE 0x85c84c _REC_CUR_20_u1_u1 255. _CNV_A_R_LINEAR_____1_CM 0. 255. DISPLAY_IDENTIFIER ID_ERR_ENVD_V_TAC_RNG FORMAT "%3.0"
 /begin AXIS_DESCR COM_AXIS online_dummy _CNV_A_R_LINEAR_____0_CM 8 0. 7. READ_ONLY FORMAT "%2.0" AXIS_PTS_REF ldp_fmy_envd /end AXIS_DESCR
/end CHARACTERISTIC
/begin CHARACTERISTIC fmy_id_v_tac_rng.c_err_clas "error class for diagnosis instance V_TAC_RNG" VALUE 0x85c854 _REC_VAL_20_u1 255. _CNV_A_R_LINEAR_____1_CM 0. 255. DISPLAY_IDENTIFIER C_ERR_CLAS_V_TAC_RNG FORMAT "%3.0" /end CHARACTERISTIC
/begin CHARACTERISTIC fmy_id_tac_mes_plaus.dtc[0] "diagnostic trouble codes for diagnosis instance TAC_MES_PLAUS" CURVE 0x85c856 _REC_CUR_20_u2_u2 65535. _CNV_A_R_LINEAR_____1_CM 0. 65535. DISPLAY_IDENTIFIER ID_ERR_DTC_TAC_MES_PLAUS FORMAT "%5.0"
 /begin AXIS_DESCR COM_AXIS online_dummy _CNV_A_R_LINEAR_____0_CM 6 0. 5. FORMAT "%2.0" AXIS_PTS_REF ldp_fmy_dtc /end AXIS_DESCR
/end CHARACTERISTIC
/begin CHARACTERISTIC fmy_id_tac_mes_plaus.envd "environmental data contents of customer specific freeze frame for diagnosis instance TAC_MES_PLAUS" CURVE 0x85c862 _REC_CUR_20_u1_u1 255. _CNV_A_R_LINEAR_____1_CM 0. 255. DISPLAY_IDENTIFIER ID_ERR_ENVD_TAC_MES_PLAUS FORMAT "%3.0"
 /begin AXIS_DESCR COM_AXIS online_dummy _CNV_A_R_LINEAR_____0_CM 8 0. 7. READ_ONLY FORMAT "%2.0" AXIS_PTS_REF ldp_fmy_envd /end AXIS_DESCR
/end CHARACTERISTIC
/begin CHARACTERISTIC fmy_id_tac_mes_plaus.c_err_clas "error class for diagnosis instance TAC_MES_PLAUS" VALUE 0x85c86a _REC_VAL_20_u1 255. _CNV_A_R_LINEAR_____1_CM 0. 255. DISPLAY_IDENTIFIER C_ERR_CLAS_TAC_MES_PLAUS FORMAT "%3.0" /end CHARACTERISTIC
/begin CHARACTERISTIC fmy_id_mf_is_obd.dtc[0] "diagnostic trouble codes for diagnosis instance MF_IS_OBD" CURVE 0x85c86c _REC_CUR_20_u2_u2 65535. _CNV_A_R_LINEAR_____1_CM 0. 65535. DISPLAY_IDENTIFIER ID_ERR_DTC_MF_IS_OBD FORMAT "%5.0"
 /begin AXIS_DESCR COM_AXIS online_dummy _CNV_A_R_LINEAR_____0_CM 6 0. 5. FORMAT "%2.0" AXIS_PTS_REF ldp_fmy_dtc /end AXIS_DESCR
/end CHARACTERISTIC
/begin CHARACTERISTIC fmy_id_mf_is_obd.envd "environmental data contents of customer specific freeze frame for diagnosis instance MF_IS_OBD" CURVE 0x85c878 _REC_CUR_20_u1_u1 255. _CNV_A_R_LINEAR_____1_CM 0. 255. DISPLAY_IDENTIFIER ID_ERR_ENVD_MF_IS_OBD FORMAT "%3.0"
 /begin AXIS_DESCR COM_AXIS online_dummy _CNV_A_R_LINEAR_____0_CM 8 0. 7. READ_ONLY FORMAT "%2.0" AXIS_PTS_REF ldp_fmy_envd /end AXIS_DESCR
/end CHARACTERISTIC
/begin CHARACTERISTIC fmy_id_mf_is_obd.c_err_clas "error class for diagnosis instance MF_IS_OBD" VALUE 0x85c880 _REC_VAL_20_u1 255. _CNV_A_R_LINEAR_____1_CM 0. 255. DISPLAY_IDENTIFIER C_ERR_CLAS_MF_IS_OBD FORMAT "%3.0" /end CHARACTERISTIC
/begin CHARACTERISTIC fmy_id_cyl_bal_0.dtc[0] "diagnostic trouble codes for diagnosis instance CYL_BAL_0" CURVE 0x85c882 _REC_CUR_20_u2_u2 65535. _CNV_A_R_LINEAR_____1_CM 0. 65535. DISPLAY_IDENTIFIER ID_ERR_DTC_CYL_BAL_0 FORMAT "%5.0"
 /begin AXIS_DESCR COM_AXIS online_dummy _CNV_A_R_LINEAR_____0_CM 6 0. 5. FORMAT "%2.0" AXIS_PTS_REF ldp_fmy_dtc /end AXIS_DESCR
/end CHARACTERISTIC
/begin CHARACTERISTIC fmy_id_cyl_bal_0.envd "environmental data contents of customer specific freeze frame for diagnosis instance CYL_BAL_0" CURVE 0x85c88e _REC_CUR_20_u1_u1 255. _CNV_A_R_LINEAR_____1_CM 0. 255. DISPLAY_IDENTIFIER ID_ERR_ENVD_CYL_BAL_0 FORMAT "%3.0"
 /begin AXIS_DESCR COM_AXIS online_dummy _CNV_A_R_LINEAR_____0_CM 8 0. 7. READ_ONLY FORMAT "%2.0" AXIS_PTS_REF ldp_fmy_envd /end AXIS_DESCR
/end CHARACTERISTIC
/begin CHARACTERISTIC fmy_id_cyl_bal_0.c_err_clas "error class for diagnosis instance CYL_BAL_0" VALUE 0x85c896 _REC_VAL_20_u1 255. _CNV_A_R_LINEAR_____1_CM 0. 255. DISPLAY_IDENTIFIER C_ERR_CLAS_CYL_BAL_0 FORMAT "%3.0" /end CHARACTERISTIC
/begin CHARACTERISTIC fmy_id_cyl_bal_1.dtc[0] "diagnostic trouble codes for diagnosis instance CYL_BAL_1" CURVE 0x85c898 _REC_CUR_20_u2_u2 65535. _CNV_A_R_LINEAR_____1_CM 0. 65535. DISPLAY_IDENTIFIER ID_ERR_DTC_CYL_BAL_1 FORMAT "%5.0"
 /begin AXIS_DESCR COM_AXIS online_dummy _CNV_A_R_LINEAR_____0_CM 6 0. 5. FORMAT "%2.0" AXIS_PTS_REF ldp_fmy_dtc /end AXIS_DESCR
/end CHARACTERISTIC
/begin CHARACTERISTIC fmy_id_cyl_bal_1.envd "environmental data contents of customer specific freeze frame for diagnosis instance CYL_BAL_1" CURVE 0x85c8a4 _REC_CUR_20_u1_u1 255. _CNV_A_R_LINEAR_____1_CM 0. 255. DISPLAY_IDENTIFIER ID_ERR_ENVD_CYL_BAL_1 FORMAT "%3.0"
 /begin AXIS_DESCR COM_AXIS online_dummy _CNV_A_R_LINEAR_____0_CM 8 0. 7. READ_ONLY FORMAT "%2.0" AXIS_PTS_REF ldp_fmy_envd /end AXIS_DESCR
/end CHARACTERISTIC
/begin CHARACTERISTIC fmy_id_cyl_bal_1.c_err_clas "error class for diagnosis instance CYL_BAL_1" VALUE 0x85c8ac _REC_VAL_20_u1 255. _CNV_A_R_LINEAR_____1_CM 0. 255. DISPLAY_IDENTIFIER C_ERR_CLAS_CYL_BAL_1 FORMAT "%3.0" /end CHARACTERISTIC
/begin CHARACTERISTIC fmy_id_cyl_bal_2.dtc[0] "diagnostic trouble codes for diagnosis instance CYL_BAL_2" CURVE 0x85c8ae _REC_CUR_20_u2_u2 65535. _CNV_A_R_LINEAR_____1_CM 0. 65535. DISPLAY_IDENTIFIER ID_ERR_DTC_CYL_BAL_2 FORMAT "%5.0"
 /begin AXIS_DESCR COM_AXIS online_dummy _CNV_A_R_LINEAR_____0_CM 6 0. 5. FORMAT "%2.0" AXIS_PTS_REF ldp_fmy_dtc /end AXIS_DESCR
/end CHARACTERISTIC
/begin CHARACTERISTIC fmy_id_cyl_bal_2.envd "environmental data contents of customer specific freeze frame for diagnosis instance CYL_BAL_2" CURVE 0x85c8ba _REC_CUR_20_u1_u1 255. _CNV_A_R_LINEAR_____1_CM 0. 255. DISPLAY_IDENTIFIER ID_ERR_ENVD_CYL_BAL_2 FORMAT "%3.0"
 /begin AXIS_DESCR COM_AXIS online_dummy _CNV_A_R_LINEAR_____0_CM 8 0. 7. READ_ONLY FORMAT "%2.0" AXIS_PTS_REF ldp_fmy_envd /end AXIS_DESCR
/end CHARACTERISTIC
/begin CHARACTERISTIC fmy_id_cyl_bal_2.c_err_clas "error class for diagnosis instance CYL_BAL_2" VALUE 0x85c8c2 _REC_VAL_20_u1 255. _CNV_A_R_LINEAR_____1_CM 0. 255. DISPLAY_IDENTIFIER C_ERR_CLAS_CYL_BAL_2 FORMAT "%3.0" /end CHARACTERISTIC
/begin CHARACTERISTIC fmy_id_cyl_bal_3.dtc[0] "diagnostic trouble codes for diagnosis instance CYL_BAL_3" CURVE 0x85c8c4 _REC_CUR_20_u2_u2 65535. _CNV_A_R_LINEAR_____1_CM 0. 65535. DISPLAY_IDENTIFIER ID_ERR_DTC_CYL_BAL_3 FORMAT "%5.0"
 /begin AXIS_DESCR COM_AXIS online_dummy _CNV_A_R_LINEAR_____0_CM 6 0. 5. FORMAT "%2.0" AXIS_PTS_REF ldp_fmy_dtc /end AXIS_DESCR
/end CHARACTERISTIC
/begin CHARACTERISTIC fmy_id_cyl_bal_3.envd "environmental data contents of customer specific freeze frame for diagnosis instance CYL_BAL_3" CURVE 0x85c8d0 _REC_CUR_20_u1_u1 255. _CNV_A_R_LINEAR_____1_CM 0. 255. DISPLAY_IDENTIFIER ID_ERR_ENVD_CYL_BAL_3 FORMAT "%3.0"
 /begin AXIS_DESCR COM_AXIS online_dummy _CNV_A_R_LINEAR_____0_CM 8 0. 7. READ_ONLY FORMAT "%2.0" AXIS_PTS_REF ldp_fmy_envd /end AXIS_DESCR
/end CHARACTERISTIC
/begin CHARACTERISTIC fmy_id_cyl_bal_3.c_err_clas "error class for diagnosis instance CYL_BAL_3" VALUE 0x85c8d8 _REC_VAL_20_u1 255. _CNV_A_R_LINEAR_____1_CM 0. 255. DISPLAY_IDENTIFIER C_ERR_CLAS_CYL_BAL_3 FORMAT "%3.0" /end CHARACTERISTIC
/begin CHARACTERISTIC fmy_id_egrv_0_ctl.dtc[0] "diagnostic trouble codes for diagnosis instance EGRV_0_CTL" CURVE 0x85c8da _REC_CUR_20_u2_u2 65535. _CNV_A_R_LINEAR_____1_CM 0. 65535. DISPLAY_IDENTIFIER ID_ERR_DTC_EGRV_0_CTL FORMAT "%5.0"
 /begin AXIS_DESCR COM_AXIS online_dummy _CNV_A_R_LINEAR_____0_CM 6 0. 5. FORMAT "%2.0" AXIS_PTS_REF ldp_fmy_dtc /end AXIS_DESCR
/end CHARACTERISTIC
/begin CHARACTERISTIC fmy_id_egrv_0_ctl.envd "environmental data contents of customer specific freeze frame for diagnosis instance EGRV_0_CTL" CURVE 0x85c8e6 _REC_CUR_20_u1_u1 255. _CNV_A_R_LINEAR_____1_CM 0. 255. DISPLAY_IDENTIFIER ID_ERR_ENVD_EGRV_0_CTL FORMAT "%3.0"
 /begin AXIS_DESCR COM_AXIS online_dummy _CNV_A_R_LINEAR_____0_CM 8 0. 7. READ_ONLY FORMAT "%2.0" AXIS_PTS_REF ldp_fmy_envd /end AXIS_DESCR
/end CHARACTERISTIC
/begin CHARACTERISTIC fmy_id_egrv_0_ctl.c_err_clas "error class for diagnosis instance EGRV_0_CTL" VALUE 0x85c8ee _REC_VAL_20_u1 255. _CNV_A_R_LINEAR_____1_CM 0. 255. DISPLAY_IDENTIFIER C_ERR_CLAS_EGRV_0_CTL FORMAT "%3.0" /end CHARACTERISTIC
/begin CHARACTERISTIC fmy_id_v_egrv_0_bol_ad.dtc[0] "diagnostic trouble codes for diagnosis instance V_EGRV_0_BOL_AD" CURVE 0x85c8f0 _REC_CUR_20_u2_u2 65535. _CNV_A_R_LINEAR_____1_CM 0. 65535. DISPLAY_IDENTIFIER ID_ERR_DTC_V_EGRV_0_BOL_AD FORMAT "%5.0"
 /begin AXIS_DESCR COM_AXIS online_dummy _CNV_A_R_LINEAR_____0_CM 6 0. 5. FORMAT "%2.0" AXIS_PTS_REF ldp_fmy_dtc /end AXIS_DESCR
/end CHARACTERISTIC
/begin CHARACTERISTIC fmy_id_v_egrv_0_bol_ad.envd "environmental data contents of customer specific freeze frame for diagnosis instance V_EGRV_0_BOL_AD" CURVE 0x85c8fc _REC_CUR_20_u1_u1 255. _CNV_A_R_LINEAR_____1_CM 0. 255. DISPLAY_IDENTIFIER ID_ERR_ENVD_V_EGRV_0_BOL_AD FORMAT "%3.0"
 /begin AXIS_DESCR COM_AXIS online_dummy _CNV_A_R_LINEAR_____0_CM 8 0. 7. READ_ONLY FORMAT "%2.0" AXIS_PTS_REF ldp_fmy_envd /end AXIS_DESCR
/end CHARACTERISTIC
/begin CHARACTERISTIC fmy_id_v_egrv_0_bol_ad.c_err_clas "error class for diagnosis instance V_EGRV_0_BOL_AD" VALUE 0x85c904 _REC_VAL_20_u1 255. _CNV_A_R_LINEAR_____1_CM 0. 255. DISPLAY_IDENTIFIER C_ERR_CLAS_V_EGRV_0_BOL_AD FORMAT "%3.0" /end CHARACTERISTIC
/begin CHARACTERISTIC fmy_id_thr_0_ctl.dtc[0] "diagnostic trouble codes for diagnosis instance THR_0_CTL" CURVE 0x85c906 _REC_CUR_20_u2_u2 65535. _CNV_A_R_LINEAR_____1_CM 0. 65535. DISPLAY_IDENTIFIER ID_ERR_DTC_THR_0_CTL FORMAT "%5.0"
 /begin AXIS_DESCR COM_AXIS online_dummy _CNV_A_R_LINEAR_____0_CM 6 0. 5. FORMAT "%2.0" AXIS_PTS_REF ldp_fmy_dtc /end AXIS_DESCR
/end CHARACTERISTIC
/begin CHARACTERISTIC fmy_id_thr_0_ctl.envd "environmental data contents of customer specific freeze frame for diagnosis instance THR_0_CTL" CURVE 0x85c912 _REC_CUR_20_u1_u1 255. _CNV_A_R_LINEAR_____1_CM 0. 255. DISPLAY_IDENTIFIER ID_ERR_ENVD_THR_0_CTL FORMAT "%3.0"
 /begin AXIS_DESCR COM_AXIS online_dummy _CNV_A_R_LINEAR_____0_CM 8 0. 7. READ_ONLY FORMAT "%2.0" AXIS_PTS_REF ldp_fmy_envd /end AXIS_DESCR
/end CHARACTERISTIC
/begin CHARACTERISTIC fmy_id_thr_0_ctl.c_err_clas "error class for diagnosis instance THR_0_CTL" VALUE 0x85c91a _REC_VAL_20_u1 255. _CNV_A_R_LINEAR_____1_CM 0. 255. DISPLAY_IDENTIFIER C_ERR_CLAS_THR_0_CTL FORMAT "%3.0" /end CHARACTERISTIC
/begin CHARACTERISTIC fmy_id_v_thr_0_bol_ad.dtc[0] "diagnostic trouble codes for diagnosis instance V_THR_0_BOL_AD" CURVE 0x85c91c _REC_CUR_20_u2_u2 65535. _CNV_A_R_LINEAR_____1_CM 0. 65535. DISPLAY_IDENTIFIER ID_ERR_DTC_V_THR_0_BOL_AD FORMAT "%5.0"
 /begin AXIS_DESCR COM_AXIS online_dummy _CNV_A_R_LINEAR_____0_CM 6 0. 5. FORMAT "%2.0" AXIS_PTS_REF ldp_fmy_dtc /end AXIS_DESCR
/end CHARACTERISTIC
/begin CHARACTERISTIC fmy_id_v_thr_0_bol_ad.envd "environmental data contents of customer specific freeze frame for diagnosis instance V_THR_0_BOL_AD" CURVE 0x85c928 _REC_CUR_20_u1_u1 255. _CNV_A_R_LINEAR_____1_CM 0. 255. DISPLAY_IDENTIFIER ID_ERR_ENVD_V_THR_0_BOL_AD FORMAT "%3.0"
 /begin AXIS_DESCR COM_AXIS online_dummy _CNV_A_R_LINEAR_____0_CM 8 0. 7. READ_ONLY FORMAT "%2.0" AXIS_PTS_REF ldp_fmy_envd /end AXIS_DESCR
/end CHARACTERISTIC
/begin CHARACTERISTIC fmy_id_v_thr_0_bol_ad.c_err_clas "error class for diagnosis instance V_THR_0_BOL_AD" VALUE 0x85c930 _REC_VAL_20_u1 255. _CNV_A_R_LINEAR_____1_CM 0. 255. DISPLAY_IDENTIFIER C_ERR_CLAS_V_THR_0_BOL_AD FORMAT "%3.0" /end CHARACTERISTIC
/begin CHARACTERISTIC fmy_id_bpa_0_ctl.dtc[0] "diagnostic trouble codes for diagnosis instance BPA_0_CTL" CURVE 0x85c932 _REC_CUR_20_u2_u2 65535. _CNV_A_R_LINEAR_____1_CM 0. 65535. DISPLAY_IDENTIFIER ID_ERR_DTC_BPA_0_CTL FORMAT "%5.0"
 /begin AXIS_DESCR COM_AXIS online_dummy _CNV_A_R_LINEAR_____0_CM 6 0. 5. FORMAT "%2.0" AXIS_PTS_REF ldp_fmy_dtc /end AXIS_DESCR
/end CHARACTERISTIC
/begin CHARACTERISTIC fmy_id_bpa_0_ctl.envd "environmental data contents of customer specific freeze frame for diagnosis instance BPA_0_CTL" CURVE 0x85c93e _REC_CUR_20_u1_u1 255. _CNV_A_R_LINEAR_____1_CM 0. 255. DISPLAY_IDENTIFIER ID_ERR_ENVD_BPA_0_CTL FORMAT "%3.0"
 /begin AXIS_DESCR COM_AXIS online_dummy _CNV_A_R_LINEAR_____0_CM 8 0. 7. READ_ONLY FORMAT "%2.0" AXIS_PTS_REF ldp_fmy_envd /end AXIS_DESCR
/end CHARACTERISTIC
/begin CHARACTERISTIC fmy_id_bpa_0_ctl.c_err_clas "error class for diagnosis instance BPA_0_CTL" VALUE 0x85c946 _REC_VAL_20_u1 255. _CNV_A_R_LINEAR_____1_CM 0. 255. DISPLAY_IDENTIFIER C_ERR_CLAS_BPA_0_CTL FORMAT "%3.0" /end CHARACTERISTIC
/begin CHARACTERISTIC fmy_id_v_bpa_0_bol_ad.dtc[0] "diagnostic trouble codes for diagnosis instance V_BPA_0_BOL_AD" CURVE 0x85c948 _REC_CUR_20_u2_u2 65535. _CNV_A_R_LINEAR_____1_CM 0. 65535. DISPLAY_IDENTIFIER ID_ERR_DTC_V_BPA_0_BOL_AD FORMAT "%5.0"
 /begin AXIS_DESCR COM_AXIS online_dummy _CNV_A_R_LINEAR_____0_CM 6 0. 5. FORMAT "%2.0" AXIS_PTS_REF ldp_fmy_dtc /end AXIS_DESCR
/end CHARACTERISTIC
/begin CHARACTERISTIC fmy_id_v_bpa_0_bol_ad.envd "environmental data contents of customer specific freeze frame for diagnosis instance V_BPA_0_BOL_AD" CURVE 0x85c954 _REC_CUR_20_u1_u1 255. _CNV_A_R_LINEAR_____1_CM 0. 255. DISPLAY_IDENTIFIER ID_ERR_ENVD_V_BPA_0_BOL_AD FORMAT "%3.0"
 /begin AXIS_DESCR COM_AXIS online_dummy _CNV_A_R_LINEAR_____0_CM 8 0. 7. READ_ONLY FORMAT "%2.0" AXIS_PTS_REF ldp_fmy_envd /end AXIS_DESCR
/end CHARACTERISTIC
/begin CHARACTERISTIC fmy_id_v_bpa_0_bol_ad.c_err_clas "error class for diagnosis instance V_BPA_0_BOL_AD" VALUE 0x85c95c _REC_VAL_20_u1 255. _CNV_A_R_LINEAR_____1_CM 0. 255. DISPLAY_IDENTIFIER C_ERR_CLAS_V_BPA_0_BOL_AD FORMAT "%3.0" /end CHARACTERISTIC
/begin CHARACTERISTIC fmy_id_byp_0_ctl.dtc[0] "diagnostic trouble codes for diagnosis instance BYP_0_CTL" CURVE 0x85c95e _REC_CUR_20_u2_u2 65535. _CNV_A_R_LINEAR_____1_CM 0. 65535. DISPLAY_IDENTIFIER ID_ERR_DTC_BYP_0_CTL FORMAT "%5.0"
 /begin AXIS_DESCR COM_AXIS online_dummy _CNV_A_R_LINEAR_____0_CM 6 0. 5. FORMAT "%2.0" AXIS_PTS_REF ldp_fmy_dtc /end AXIS_DESCR
/end CHARACTERISTIC
/begin CHARACTERISTIC fmy_id_byp_0_ctl.envd "environmental data contents of customer specific freeze frame for diagnosis instance BYP_0_CTL" CURVE 0x85c96a _REC_CUR_20_u1_u1 255. _CNV_A_R_LINEAR_____1_CM 0. 255. DISPLAY_IDENTIFIER ID_ERR_ENVD_BYP_0_CTL FORMAT "%3.0"
 /begin AXIS_DESCR COM_AXIS online_dummy _CNV_A_R_LINEAR_____0_CM 8 0. 7. READ_ONLY FORMAT "%2.0" AXIS_PTS_REF ldp_fmy_envd /end AXIS_DESCR
/end CHARACTERISTIC
/begin CHARACTERISTIC fmy_id_byp_0_ctl.c_err_clas "error class for diagnosis instance BYP_0_CTL" VALUE 0x85c972 _REC_VAL_20_u1 255. _CNV_A_R_LINEAR_____1_CM 0. 255. DISPLAY_IDENTIFIER C_ERR_CLAS_BYP_0_CTL FORMAT "%3.0" /end CHARACTERISTIC
/begin CHARACTERISTIC fmy_id_v_byp_0_bol_ad.dtc[0] "diagnostic trouble codes for diagnosis instance V_BYP_0_BOL_AD" CURVE 0x85c974 _REC_CUR_20_u2_u2 65535. _CNV_A_R_LINEAR_____1_CM 0. 65535. DISPLAY_IDENTIFIER ID_ERR_DTC_V_BYP_0_BOL_AD FORMAT "%5.0"
 /begin AXIS_DESCR COM_AXIS online_dummy _CNV_A_R_LINEAR_____0_CM 6 0. 5. FORMAT "%2.0" AXIS_PTS_REF ldp_fmy_dtc /end AXIS_DESCR
/end CHARACTERISTIC
/begin CHARACTERISTIC fmy_id_v_byp_0_bol_ad.envd "environmental data contents of customer specific freeze frame for diagnosis instance V_BYP_0_BOL_AD" CURVE 0x85c980 _REC_CUR_20_u1_u1 255. _CNV_A_R_LINEAR_____1_CM 0. 255. DISPLAY_IDENTIFIER ID_ERR_ENVD_V_BYP_0_BOL_AD FORMAT "%3.0"
 /begin AXIS_DESCR COM_AXIS online_dummy _CNV_A_R_LINEAR_____0_CM 8 0. 7. READ_ONLY FORMAT "%2.0" AXIS_PTS_REF ldp_fmy_envd /end AXIS_DESCR
/end CHARACTERISTIC
/begin CHARACTERISTIC fmy_id_v_byp_0_bol_ad.c_err_clas "error class for diagnosis instance V_BYP_0_BOL_AD" VALUE 0x85c988 _REC_VAL_20_u1 255. _CNV_A_R_LINEAR_____1_CM 0. 255. DISPLAY_IDENTIFIER C_ERR_CLAS_V_BYP_0_BOL_AD FORMAT "%3.0" /end CHARACTERISTIC
/begin CHARACTERISTIC fmy_id_map_ctl_min.dtc[0] "diagnostic trouble codes for diagnosis instance MAP_CTL_MIN" CURVE 0x85c98a _REC_CUR_20_u2_u2 65535. _CNV_A_R_LINEAR_____1_CM 0. 65535. DISPLAY_IDENTIFIER ID_ERR_DTC_MAP_CTL_MIN FORMAT "%5.0"
 /begin AXIS_DESCR COM_AXIS online_dummy _CNV_A_R_LINEAR_____0_CM 6 0. 5. FORMAT "%2.0" AXIS_PTS_REF ldp_fmy_dtc /end AXIS_DESCR
/end CHARACTERISTIC
/begin CHARACTERISTIC fmy_id_map_ctl_min.envd "environmental data contents of customer specific freeze frame for diagnosis instance MAP_CTL_MIN" CURVE 0x85c996 _REC_CUR_20_u1_u1 255. _CNV_A_R_LINEAR_____1_CM 0. 255. DISPLAY_IDENTIFIER ID_ERR_ENVD_MAP_CTL_MIN FORMAT "%3.0"
 /begin AXIS_DESCR COM_AXIS online_dummy _CNV_A_R_LINEAR_____0_CM 8 0. 7. READ_ONLY FORMAT "%2.0" AXIS_PTS_REF ldp_fmy_envd /end AXIS_DESCR
/end CHARACTERISTIC
/begin CHARACTERISTIC fmy_id_map_ctl_min.c_err_clas "error class for diagnosis instance MAP_CTL_MIN" VALUE 0x85c99e _REC_VAL_20_u1 255. _CNV_A_R_LINEAR_____1_CM 0. 255. DISPLAY_IDENTIFIER C_ERR_CLAS_MAP_CTL_MIN FORMAT "%3.0" /end CHARACTERISTIC
/begin CHARACTERISTIC fmy_id_map_ctl_max.dtc[0] "diagnostic trouble codes for diagnosis instance MAP_CTL_MAX" CURVE 0x85c9a0 _REC_CUR_20_u2_u2 65535. _CNV_A_R_LINEAR_____1_CM 0. 65535. DISPLAY_IDENTIFIER ID_ERR_DTC_MAP_CTL_MAX FORMAT "%5.0"
 /begin AXIS_DESCR COM_AXIS online_dummy _CNV_A_R_LINEAR_____0_CM 6 0. 5. FORMAT "%2.0" AXIS_PTS_REF ldp_fmy_dtc /end AXIS_DESCR
/end CHARACTERISTIC
/begin CHARACTERISTIC fmy_id_map_ctl_max.envd "environmental data contents of customer specific freeze frame for diagnosis instance MAP_CTL_MAX" CURVE 0x85c9ac _REC_CUR_20_u1_u1 255. _CNV_A_R_LINEAR_____1_CM 0. 255. DISPLAY_IDENTIFIER ID_ERR_ENVD_MAP_CTL_MAX FORMAT "%3.0"
 /begin AXIS_DESCR COM_AXIS online_dummy _CNV_A_R_LINEAR_____0_CM 8 0. 7. READ_ONLY FORMAT "%2.0" AXIS_PTS_REF ldp_fmy_envd /end AXIS_DESCR
/end CHARACTERISTIC
/begin CHARACTERISTIC fmy_id_map_ctl_max.c_err_clas "error class for diagnosis instance MAP_CTL_MAX" VALUE 0x85c9b4 _REC_VAL_20_u1 255. _CNV_A_R_LINEAR_____1_CM 0. 255. DISPLAY_IDENTIFIER C_ERR_CLAS_MAP_CTL_MAX FORMAT "%3.0" /end CHARACTERISTIC
/begin CHARACTERISTIC fmy_id_egr_is_slow_obd.dtc[0] "diagnostic trouble codes for diagnosis instance EGR_IS_SLOW_OBD" CURVE 0x85c9b6 _REC_CUR_20_u2_u2 65535. _CNV_A_R_LINEAR_____1_CM 0. 65535. DISPLAY_IDENTIFIER ID_ERR_DTC_EGR_IS_SLOW_OBD FORMAT "%5.0"
 /begin AXIS_DESCR COM_AXIS online_dummy _CNV_A_R_LINEAR_____0_CM 6 0. 5. FORMAT "%2.0" AXIS_PTS_REF ldp_fmy_dtc /end AXIS_DESCR
/end CHARACTERISTIC
/begin CHARACTERISTIC fmy_id_egr_is_slow_obd.envd "environmental data contents of customer specific freeze frame for diagnosis instance EGR_IS_SLOW_OBD" CURVE 0x85c9c2 _REC_CUR_20_u1_u1 255. _CNV_A_R_LINEAR_____1_CM 0. 255. DISPLAY_IDENTIFIER ID_ERR_ENVD_EGR_IS_SLOW_OBD FORMAT "%3.0"
 /begin AXIS_DESCR COM_AXIS online_dummy _CNV_A_R_LINEAR_____0_CM 8 0. 7. READ_ONLY FORMAT "%2.0" AXIS_PTS_REF ldp_fmy_envd /end AXIS_DESCR
/end CHARACTERISTIC
/begin CHARACTERISTIC fmy_id_egr_is_slow_obd.c_err_clas "error class for diagnosis instance EGR_IS_SLOW_OBD" VALUE 0x85c9ca _REC_VAL_20_u1 255. _CNV_A_R_LINEAR_____1_CM 0. 255. DISPLAY_IDENTIFIER C_ERR_CLAS_EGR_IS_SLOW_OBD FORMAT "%3.0" /end CHARACTERISTIC
/begin CHARACTERISTIC fmy_id_maf_egr_thr_obd.dtc[0] "diagnostic trouble codes for diagnosis instance MAF_EGR_THR_OBD" CURVE 0x85c9cc _REC_CUR_20_u2_u2 65535. _CNV_A_R_LINEAR_____1_CM 0. 65535. DISPLAY_IDENTIFIER ID_ERR_DTC_MAF_EGR_THR_OBD FORMAT "%5.0"
 /begin AXIS_DESCR COM_AXIS online_dummy _CNV_A_R_LINEAR_____0_CM 6 0. 5. FORMAT "%2.0" AXIS_PTS_REF ldp_fmy_dtc /end AXIS_DESCR
/end CHARACTERISTIC
/begin CHARACTERISTIC fmy_id_maf_egr_thr_obd.envd "environmental data contents of customer specific freeze frame for diagnosis instance MAF_EGR_THR_OBD" CURVE 0x85c9d8 _REC_CUR_20_u1_u1 255. _CNV_A_R_LINEAR_____1_CM 0. 255. DISPLAY_IDENTIFIER ID_ERR_ENVD_MAF_EGR_THR_OBD FORMAT "%3.0"
 /begin AXIS_DESCR COM_AXIS online_dummy _CNV_A_R_LINEAR_____0_CM 8 0. 7. READ_ONLY FORMAT "%2.0" AXIS_PTS_REF ldp_fmy_envd /end AXIS_DESCR
/end CHARACTERISTIC
/begin CHARACTERISTIC fmy_id_maf_egr_thr_obd.c_err_clas "error class for diagnosis instance MAF_EGR_THR_OBD" VALUE 0x85c9e0 _REC_VAL_20_u1 255. _CNV_A_R_LINEAR_____1_CM 0. 255. DISPLAY_IDENTIFIER C_ERR_CLAS_MAF_EGR_THR_OBD FORMAT "%3.0" /end CHARACTERISTIC
/begin CHARACTERISTIC fmy_id_maf_dif_egr_thr_obd.dtc[0] "diagnostic trouble codes for diagnosis instance MAF_DIF_EGR_THR_OBD" CURVE 0x85c9e2 _REC_CUR_20_u2_u2 65535. _CNV_A_R_LINEAR_____1_CM 0. 65535. DISPLAY_IDENTIFIER ID_ERR_DTC_MAF_DIF_EGR_THR_OBD FORMAT "%5.0"
 /begin AXIS_DESCR COM_AXIS online_dummy _CNV_A_R_LINEAR_____0_CM 6 0. 5. FORMAT "%2.0" AXIS_PTS_REF ldp_fmy_dtc /end AXIS_DESCR
/end CHARACTERISTIC
/begin CHARACTERISTIC fmy_id_maf_dif_egr_thr_obd.envd "environmental data contents of customer specific freeze frame for diagnosis instance MAF_DIF_EGR_THR_OBD" CURVE 0x85c9ee _REC_CUR_20_u1_u1 255. _CNV_A_R_LINEAR_____1_CM 0. 255. DISPLAY_IDENTIFIER ID_ERR_ENVD_MAF_DIF_EGR_THR_OBD FORMAT "%3.0"
 /begin AXIS_DESCR COM_AXIS online_dummy _CNV_A_R_LINEAR_____0_CM 8 0. 7. READ_ONLY FORMAT "%2.0" AXIS_PTS_REF ldp_fmy_envd /end AXIS_DESCR
/end CHARACTERISTIC
/begin CHARACTERISTIC fmy_id_maf_dif_egr_thr_obd.c_err_clas "error class for diagnosis instance MAF_DIF_EGR_THR_OBD" VALUE 0x85c9f6 _REC_VAL_20_u1 255. _CNV_A_R_LINEAR_____1_CM 0. 255. DISPLAY_IDENTIFIER C_ERR_CLAS_MAF_DIF_EGR_THR_OBD FORMAT "%3.0" /end CHARACTERISTIC
/begin CHARACTERISTIC fmy_id_map_dif_egr_thr_obd.dtc[0] "diagnostic trouble codes for diagnosis instance MAP_DIF_EGR_THR_OBD" CURVE 0x85c9f8 _REC_CUR_20_u2_u2 65535. _CNV_A_R_LINEAR_____1_CM 0. 65535. DISPLAY_IDENTIFIER ID_ERR_DTC_MAP_DIF_EGR_THR_OBD FORMAT "%5.0"
 /begin AXIS_DESCR COM_AXIS online_dummy _CNV_A_R_LINEAR_____0_CM 6 0. 5. FORMAT "%2.0" AXIS_PTS_REF ldp_fmy_dtc /end AXIS_DESCR
/end CHARACTERISTIC
/begin CHARACTERISTIC fmy_id_map_dif_egr_thr_obd.envd "environmental data contents of customer specific freeze frame for diagnosis instance MAP_DIF_EGR_THR_OBD" CURVE 0x85ca04 _REC_CUR_20_u1_u1 255. _CNV_A_R_LINEAR_____1_CM 0. 255. DISPLAY_IDENTIFIER ID_ERR_ENVD_MAP_DIF_EGR_THR_OBD FORMAT "%3.0"
 /begin AXIS_DESCR COM_AXIS online_dummy _CNV_A_R_LINEAR_____0_CM 8 0. 7. READ_ONLY FORMAT "%2.0" AXIS_PTS_REF ldp_fmy_envd /end AXIS_DESCR
/end CHARACTERISTIC
/begin CHARACTERISTIC fmy_id_map_dif_egr_thr_obd.c_err_clas "error class for diagnosis instance MAP_DIF_EGR_THR_OBD" VALUE 0x85ca0c _REC_VAL_20_u1 255. _CNV_A_R_LINEAR_____1_CM 0. 255. DISPLAY_IDENTIFIER C_ERR_CLAS_MAP_DIF_EGR_THR_OBD FORMAT "%3.0" /end CHARACTERISTIC
/begin CHARACTERISTIC fmy_id_vs.dtc[0] "diagnostic trouble codes for diagnosis instance VS" CURVE 0x85ca0e _REC_CUR_20_u2_u2 65535. _CNV_A_R_LINEAR_____1_CM 0. 65535. DISPLAY_IDENTIFIER ID_ERR_DTC_VS FORMAT "%5.0"
 /begin AXIS_DESCR COM_AXIS online_dummy _CNV_A_R_LINEAR_____0_CM 6 0. 5. FORMAT "%2.0" AXIS_PTS_REF ldp_fmy_dtc /end AXIS_DESCR
/end CHARACTERISTIC
/begin CHARACTERISTIC fmy_id_vs.envd "environmental data contents of customer specific freeze frame for diagnosis instance VS" CURVE 0x85ca1a _REC_CUR_20_u1_u1 255. _CNV_A_R_LINEAR_____1_CM 0. 255. DISPLAY_IDENTIFIER ID_ERR_ENVD_VS FORMAT "%3.0"
 /begin AXIS_DESCR COM_AXIS online_dummy _CNV_A_R_LINEAR_____0_CM 8 0. 7. READ_ONLY FORMAT "%2.0" AXIS_PTS_REF ldp_fmy_envd /end AXIS_DESCR
/end CHARACTERISTIC
/begin CHARACTERISTIC fmy_id_vs.c_err_clas "error class for diagnosis instance VS" VALUE 0x85ca22 _REC_VAL_20_u1 255. _CNV_A_R_LINEAR_____1_CM 0. 255. DISPLAY_IDENTIFIER C_ERR_CLAS_VS FORMAT "%3.0" /end CHARACTERISTIC
/begin CHARACTERISTIC fmy_id_cs.dtc[0] "diagnostic trouble codes for diagnosis instance CS" CURVE 0x85ca24 _REC_CUR_20_u2_u2 65535. _CNV_A_R_LINEAR_____1_CM 0. 65535. DISPLAY_IDENTIFIER ID_ERR_DTC_CS FORMAT "%5.0"
 /begin AXIS_DESCR COM_AXIS online_dummy _CNV_A_R_LINEAR_____0_CM 6 0. 5. FORMAT "%2.0" AXIS_PTS_REF ldp_fmy_dtc /end AXIS_DESCR
/end CHARACTERISTIC
/begin CHARACTERISTIC fmy_id_cs.envd "environmental data contents of customer specific freeze frame for diagnosis instance CS" CURVE 0x85ca30 _REC_CUR_20_u1_u1 255. _CNV_A_R_LINEAR_____1_CM 0. 255. DISPLAY_IDENTIFIER ID_ERR_ENVD_CS FORMAT "%3.0"
 /begin AXIS_DESCR COM_AXIS online_dummy _CNV_A_R_LINEAR_____0_CM 8 0. 7. READ_ONLY FORMAT "%2.0" AXIS_PTS_REF ldp_fmy_envd /end AXIS_DESCR
/end CHARACTERISTIC
/begin CHARACTERISTIC fmy_id_cs.c_err_clas "error class for diagnosis instance CS" VALUE 0x85ca38 _REC_VAL_20_u1 255. _CNV_A_R_LINEAR_____1_CM 0. 255. DISPLAY_IDENTIFIER C_ERR_CLAS_CS FORMAT "%3.0" /end CHARACTERISTIC
/begin CHARACTERISTIC fmy_id_bls.dtc[0] "diagnostic trouble codes for diagnosis instance BLS" CURVE 0x85ca3a _REC_CUR_20_u2_u2 65535. _CNV_A_R_LINEAR_____1_CM 0. 65535. DISPLAY_IDENTIFIER ID_ERR_DTC_BLS FORMAT "%5.0"
 /begin AXIS_DESCR COM_AXIS online_dummy _CNV_A_R_LINEAR_____0_CM 6 0. 5. FORMAT "%2.0" AXIS_PTS_REF ldp_fmy_dtc /end AXIS_DESCR
/end CHARACTERISTIC
/begin CHARACTERISTIC fmy_id_bls.envd "environmental data contents of customer specific freeze frame for diagnosis instance BLS" CURVE 0x85ca46 _REC_CUR_20_u1_u1 255. _CNV_A_R_LINEAR_____1_CM 0. 255. DISPLAY_IDENTIFIER ID_ERR_ENVD_BLS FORMAT "%3.0"
 /begin AXIS_DESCR COM_AXIS online_dummy _CNV_A_R_LINEAR_____0_CM 8 0. 7. READ_ONLY FORMAT "%2.0" AXIS_PTS_REF ldp_fmy_envd /end AXIS_DESCR
/end CHARACTERISTIC
/begin CHARACTERISTIC fmy_id_bls.c_err_clas "error class for diagnosis instance BLS" VALUE 0x85ca4e _REC_VAL_20_u1 255. _CNV_A_R_LINEAR_____1_CM 0. 255. DISPLAY_IDENTIFIER C_ERR_CLAS_BLS FORMAT "%3.0" /end CHARACTERISTIC
/begin CHARACTERISTIC fmy_id_bls_bts_dece.dtc[0] "diagnostic trouble codes for diagnosis instance BLS_BTS_DECE" CURVE 0x85ca50 _REC_CUR_20_u2_u2 65535. _CNV_A_R_LINEAR_____1_CM 0. 65535. DISPLAY_IDENTIFIER ID_ERR_DTC_BLS_BTS_DECE FORMAT "%5.0"
 /begin AXIS_DESCR COM_AXIS online_dummy _CNV_A_R_LINEAR_____0_CM 6 0. 5. FORMAT "%2.0" AXIS_PTS_REF ldp_fmy_dtc /end AXIS_DESCR
/end CHARACTERISTIC
/begin CHARACTERISTIC fmy_id_bls_bts_dece.envd "environmental data contents of customer specific freeze frame for diagnosis instance BLS_BTS_DECE" CURVE 0x85ca5c _REC_CUR_20_u1_u1 255. _CNV_A_R_LINEAR_____1_CM 0. 255. DISPLAY_IDENTIFIER ID_ERR_ENVD_BLS_BTS_DECE FORMAT "%3.0"
 /begin AXIS_DESCR COM_AXIS online_dummy _CNV_A_R_LINEAR_____0_CM 8 0. 7. READ_ONLY FORMAT "%2.0" AXIS_PTS_REF ldp_fmy_envd /end AXIS_DESCR
/end CHARACTERISTIC
/begin CHARACTERISTIC fmy_id_bls_bts_dece.c_err_clas "error class for diagnosis instance BLS_BTS_DECE" VALUE 0x85ca64 _REC_VAL_20_u1 255. _CNV_A_R_LINEAR_____1_CM 0. 255. DISPLAY_IDENTIFIER C_ERR_CLAS_BLS_BTS_DECE FORMAT "%3.0" /end CHARACTERISTIC
/begin CHARACTERISTIC fmy_id_bls_bts_plaus.dtc[0] "diagnostic trouble codes for diagnosis instance BLS_BTS_PLAUS" CURVE 0x85ca66 _REC_CUR_20_u2_u2 65535. _CNV_A_R_LINEAR_____1_CM 0. 65535. DISPLAY_IDENTIFIER ID_ERR_DTC_BLS_BTS_PLAUS FORMAT "%5.0"
 /begin AXIS_DESCR COM_AXIS online_dummy _CNV_A_R_LINEAR_____0_CM 6 0. 5. FORMAT "%2.0" AXIS_PTS_REF ldp_fmy_dtc /end AXIS_DESCR
/end CHARACTERISTIC
/begin CHARACTERISTIC fmy_id_bls_bts_plaus.envd "environmental data contents of customer specific freeze frame for diagnosis instance BLS_BTS_PLAUS" CURVE 0x85ca72 _REC_CUR_20_u1_u1 255. _CNV_A_R_LINEAR_____1_CM 0. 255. DISPLAY_IDENTIFIER ID_ERR_ENVD_BLS_BTS_PLAUS FORMAT "%3.0"
 /begin AXIS_DESCR COM_AXIS online_dummy _CNV_A_R_LINEAR_____0_CM 8 0. 7. READ_ONLY FORMAT "%2.0" AXIS_PTS_REF ldp_fmy_envd /end AXIS_DESCR
/end CHARACTERISTIC
/begin CHARACTERISTIC fmy_id_bls_bts_plaus.c_err_clas "error class for diagnosis instance BLS_BTS_PLAUS" VALUE 0x85ca7a _REC_VAL_20_u1 255. _CNV_A_R_LINEAR_____1_CM 0. 255. DISPLAY_IDENTIFIER C_ERR_CLAS_BLS_BTS_PLAUS FORMAT "%3.0" /end CHARACTERISTIC
/begin CHARACTERISTIC fmy_id_can_tcs.dtc[0] "diagnostic trouble codes for diagnosis instance CAN_TCS" CURVE 0x85ca7c _REC_CUR_20_u2_u2 65535. _CNV_A_R_LINEAR_____1_CM 0. 65535. DISPLAY_IDENTIFIER ID_ERR_DTC_CAN_TCS FORMAT "%5.0"
 /begin AXIS_DESCR COM_AXIS online_dummy _CNV_A_R_LINEAR_____0_CM 6 0. 5. FORMAT "%2.0" AXIS_PTS_REF ldp_fmy_dtc /end AXIS_DESCR
/end CHARACTERISTIC
/begin CHARACTERISTIC fmy_id_can_tcs.envd "environmental data contents of customer specific freeze frame for diagnosis instance CAN_TCS" CURVE 0x85ca88 _REC_CUR_20_u1_u1 255. _CNV_A_R_LINEAR_____1_CM 0. 255. DISPLAY_IDENTIFIER ID_ERR_ENVD_CAN_TCS FORMAT "%3.0"
 /begin AXIS_DESCR COM_AXIS online_dummy _CNV_A_R_LINEAR_____0_CM 8 0. 7. READ_ONLY FORMAT "%2.0" AXIS_PTS_REF ldp_fmy_envd /end AXIS_DESCR
/end CHARACTERISTIC
/begin CHARACTERISTIC fmy_id_can_tcs.c_err_clas "error class for diagnosis instance CAN_TCS" VALUE 0x85ca90 _REC_VAL_20_u1 255. _CNV_A_R_LINEAR_____1_CM 0. 255. DISPLAY_IDENTIFIER C_ERR_CLAS_CAN_TCS FORMAT "%3.0" /end CHARACTERISTIC
/begin CHARACTERISTIC fmy_id_can_tcu.dtc[0] "diagnostic trouble codes for diagnosis instance CAN_TCU" CURVE 0x85ca92 _REC_CUR_20_u2_u2 65535. _CNV_A_R_LINEAR_____1_CM 0. 65535. DISPLAY_IDENTIFIER ID_ERR_DTC_CAN_TCU FORMAT "%5.0"
 /begin AXIS_DESCR COM_AXIS online_dummy _CNV_A_R_LINEAR_____0_CM 6 0. 5. FORMAT "%2.0" AXIS_PTS_REF ldp_fmy_dtc /end AXIS_DESCR
/end CHARACTERISTIC
/begin CHARACTERISTIC fmy_id_can_tcu.envd "environmental data contents of customer specific freeze frame for diagnosis instance CAN_TCU" CURVE 0x85ca9e _REC_CUR_20_u1_u1 255. _CNV_A_R_LINEAR_____1_CM 0. 255. DISPLAY_IDENTIFIER ID_ERR_ENVD_CAN_TCU FORMAT "%3.0"
 /begin AXIS_DESCR COM_AXIS online_dummy _CNV_A_R_LINEAR_____0_CM 8 0. 7. READ_ONLY FORMAT "%2.0" AXIS_PTS_REF ldp_fmy_envd /end AXIS_DESCR
/end CHARACTERISTIC
/begin CHARACTERISTIC fmy_id_can_tcu.c_err_clas "error class for diagnosis instance CAN_TCU" VALUE 0x85caa6 _REC_VAL_20_u1 255. _CNV_A_R_LINEAR_____1_CM 0. 255. DISPLAY_IDENTIFIER C_ERR_CLAS_CAN_TCU FORMAT "%3.0" /end CHARACTERISTIC
/begin CHARACTERISTIC fmy_id_can_acu.dtc[0] "diagnostic trouble codes for diagnosis instance CAN_ACU" CURVE 0x85caa8 _REC_CUR_20_u2_u2 65535. _CNV_A_R_LINEAR_____1_CM 0. 65535. DISPLAY_IDENTIFIER ID_ERR_DTC_CAN_ACU FORMAT "%5.0"
 /begin AXIS_DESCR COM_AXIS online_dummy _CNV_A_R_LINEAR_____0_CM 6 0. 5. FORMAT "%2.0" AXIS_PTS_REF ldp_fmy_dtc /end AXIS_DESCR
/end CHARACTERISTIC
/begin CHARACTERISTIC fmy_id_can_acu.envd "environmental data contents of customer specific freeze frame for diagnosis instance CAN_ACU" CURVE 0x85cab4 _REC_CUR_20_u1_u1 255. _CNV_A_R_LINEAR_____1_CM 0. 255. DISPLAY_IDENTIFIER ID_ERR_ENVD_CAN_ACU FORMAT "%3.0"
 /begin AXIS_DESCR COM_AXIS online_dummy _CNV_A_R_LINEAR_____0_CM 8 0. 7. READ_ONLY FORMAT "%2.0" AXIS_PTS_REF ldp_fmy_envd /end AXIS_DESCR
/end CHARACTERISTIC
/begin CHARACTERISTIC fmy_id_can_acu.c_err_clas "error class for diagnosis instance CAN_ACU" VALUE 0x85cabc _REC_VAL_20_u1 255. _CNV_A_R_LINEAR_____1_CM 0. 255. DISPLAY_IDENTIFIER C_ERR_CLAS_CAN_ACU FORMAT "%3.0" /end CHARACTERISTIC
/begin CHARACTERISTIC fmy_id_can_ccu.dtc[0] "diagnostic trouble codes for diagnosis instance CAN_CCU" CURVE 0x85cabe _REC_CUR_20_u2_u2 65535. _CNV_A_R_LINEAR_____1_CM 0. 65535. DISPLAY_IDENTIFIER ID_ERR_DTC_CAN_CCU FORMAT "%5.0"
 /begin AXIS_DESCR COM_AXIS online_dummy _CNV_A_R_LINEAR_____0_CM 6 0. 5. FORMAT "%2.0" AXIS_PTS_REF ldp_fmy_dtc /end AXIS_DESCR
/end CHARACTERISTIC
/begin CHARACTERISTIC fmy_id_can_ccu.envd "environmental data contents of customer specific freeze frame for diagnosis instance CAN_CCU" CURVE 0x85caca _REC_CUR_20_u1_u1 255. _CNV_A_R_LINEAR_____1_CM 0. 255. DISPLAY_IDENTIFIER ID_ERR_ENVD_CAN_CCU FORMAT "%3.0"
 /begin AXIS_DESCR COM_AXIS online_dummy _CNV_A_R_LINEAR_____0_CM 8 0. 7. READ_ONLY FORMAT "%2.0" AXIS_PTS_REF ldp_fmy_envd /end AXIS_DESCR
/end CHARACTERISTIC
/begin CHARACTERISTIC fmy_id_can_ccu.c_err_clas "error class for diagnosis instance CAN_CCU" VALUE 0x85cad2 _REC_VAL_20_u1 255. _CNV_A_R_LINEAR_____1_CM 0. 255. DISPLAY_IDENTIFIER C_ERR_CLAS_CAN_CCU FORMAT "%3.0" /end CHARACTERISTIC
/begin CHARACTERISTIC fmy_id_can_icl.dtc[0] "diagnostic trouble codes for diagnosis instance CAN_ICL" CURVE 0x85cad4 _REC_CUR_20_u2_u2 65535. _CNV_A_R_LINEAR_____1_CM 0. 65535. DISPLAY_IDENTIFIER ID_ERR_DTC_CAN_ICL FORMAT "%5.0"
 /begin AXIS_DESCR COM_AXIS online_dummy _CNV_A_R_LINEAR_____0_CM 6 0. 5. FORMAT "%2.0" AXIS_PTS_REF ldp_fmy_dtc /end AXIS_DESCR
/end CHARACTERISTIC
/begin CHARACTERISTIC fmy_id_can_icl.envd "environmental data contents of customer specific freeze frame for diagnosis instance CAN_ICL" CURVE 0x85cae0 _REC_CUR_20_u1_u1 255. _CNV_A_R_LINEAR_____1_CM 0. 255. DISPLAY_IDENTIFIER ID_ERR_ENVD_CAN_ICL FORMAT "%3.0"
 /begin AXIS_DESCR COM_AXIS online_dummy _CNV_A_R_LINEAR_____0_CM 8 0. 7. READ_ONLY FORMAT "%2.0" AXIS_PTS_REF ldp_fmy_envd /end AXIS_DESCR
/end CHARACTERISTIC
/begin CHARACTERISTIC fmy_id_can_icl.c_err_clas "error class for diagnosis instance CAN_ICL" VALUE 0x85cae8 _REC_VAL_20_u1 255. _CNV_A_R_LINEAR_____1_CM 0. 255. DISPLAY_IDENTIFIER C_ERR_CLAS_CAN_ICL FORMAT "%3.0" /end CHARACTERISTIC
/begin CHARACTERISTIC fmy_id_can_vecu.dtc[0] "diagnostic trouble codes for diagnosis instance CAN_VECU" CURVE 0x85caea _REC_CUR_20_u2_u2 65535. _CNV_A_R_LINEAR_____1_CM 0. 65535. DISPLAY_IDENTIFIER ID_ERR_DTC_CAN_VECU FORMAT "%5.0"
 /begin AXIS_DESCR COM_AXIS online_dummy _CNV_A_R_LINEAR_____0_CM 6 0. 5. FORMAT "%2.0" AXIS_PTS_REF ldp_fmy_dtc /end AXIS_DESCR
/end CHARACTERISTIC
/begin CHARACTERISTIC fmy_id_can_vecu.envd "environmental data contents of customer specific freeze frame for diagnosis instance CAN_VECU" CURVE 0x85caf6 _REC_CUR_20_u1_u1 255. _CNV_A_R_LINEAR_____1_CM 0. 255. DISPLAY_IDENTIFIER ID_ERR_ENVD_CAN_VECU FORMAT "%3.0"
 /begin AXIS_DESCR COM_AXIS online_dummy _CNV_A_R_LINEAR_____0_CM 8 0. 7. READ_ONLY FORMAT "%2.0" AXIS_PTS_REF ldp_fmy_envd /end AXIS_DESCR
/end CHARACTERISTIC
/begin CHARACTERISTIC fmy_id_can_vecu.c_err_clas "error class for diagnosis instance CAN_VECU" VALUE 0x85cafe _REC_VAL_20_u1 255. _CNV_A_R_LINEAR_____1_CM 0. 255. DISPLAY_IDENTIFIER C_ERR_CLAS_CAN_VECU FORMAT "%3.0" /end CHARACTERISTIC
/begin CHARACTERISTIC fmy_id_can_smls.dtc[0] "diagnostic trouble codes for diagnosis instance CAN_SMLS" CURVE 0x85cb00 _REC_CUR_20_u2_u2 65535. _CNV_A_R_LINEAR_____1_CM 0. 65535. DISPLAY_IDENTIFIER ID_ERR_DTC_CAN_SMLS FORMAT "%5.0"
 /begin AXIS_DESCR COM_AXIS online_dummy _CNV_A_R_LINEAR_____0_CM 6 0. 5. FORMAT "%2.0" AXIS_PTS_REF ldp_fmy_dtc /end AXIS_DESCR
/end CHARACTERISTIC
/begin CHARACTERISTIC fmy_id_can_smls.envd "environmental data contents of customer specific freeze frame for diagnosis instance CAN_SMLS" CURVE 0x85cb0c _REC_CUR_20_u1_u1 255. _CNV_A_R_LINEAR_____1_CM 0. 255. DISPLAY_IDENTIFIER ID_ERR_ENVD_CAN_SMLS FORMAT "%3.0"
 /begin AXIS_DESCR COM_AXIS online_dummy _CNV_A_R_LINEAR_____0_CM 8 0. 7. READ_ONLY FORMAT "%2.0" AXIS_PTS_REF ldp_fmy_envd /end AXIS_DESCR
/end CHARACTERISTIC
/begin CHARACTERISTIC fmy_id_can_smls.c_err_clas "error class for diagnosis instance CAN_SMLS" VALUE 0x85cb14 _REC_VAL_20_u1 255. _CNV_A_R_LINEAR_____1_CM 0. 255. DISPLAY_IDENTIFIER C_ERR_CLAS_CAN_SMLS FORMAT "%3.0" /end CHARACTERISTIC
/begin CHARACTERISTIC fmy_id_can_boff.dtc[0] "diagnostic trouble codes for diagnosis instance CAN_BOFF" CURVE 0x85cb16 _REC_CUR_20_u2_u2 65535. _CNV_A_R_LINEAR_____1_CM 0. 65535. DISPLAY_IDENTIFIER ID_ERR_DTC_CAN_BOFF FORMAT "%5.0"
 /begin AXIS_DESCR COM_AXIS online_dummy _CNV_A_R_LINEAR_____0_CM 6 0. 5. FORMAT "%2.0" AXIS_PTS_REF ldp_fmy_dtc /end AXIS_DESCR
/end CHARACTERISTIC
/begin CHARACTERISTIC fmy_id_can_boff.envd "environmental data contents of customer specific freeze frame for diagnosis instance CAN_BOFF" CURVE 0x85cb22 _REC_CUR_20_u1_u1 255. _CNV_A_R_LINEAR_____1_CM 0. 255. DISPLAY_IDENTIFIER ID_ERR_ENVD_CAN_BOFF FORMAT "%3.0"
 /begin AXIS_DESCR COM_AXIS online_dummy _CNV_A_R_LINEAR_____0_CM 8 0. 7. READ_ONLY FORMAT "%2.0" AXIS_PTS_REF ldp_fmy_envd /end AXIS_DESCR
/end CHARACTERISTIC
/begin CHARACTERISTIC fmy_id_can_boff.c_err_clas "error class for diagnosis instance CAN_BOFF" VALUE 0x85cb2a _REC_VAL_20_u1 255. _CNV_A_R_LINEAR_____1_CM 0. 255. DISPLAY_IDENTIFIER C_ERR_CLAS_CAN_BOFF FORMAT "%3.0" /end CHARACTERISTIC
/begin CHARACTERISTIC fmy_id_can_bem.dtc[0] "diagnostic trouble codes for diagnosis instance CAN_BEM" CURVE 0x85cb2c _REC_CUR_20_u2_u2 65535. _CNV_A_R_LINEAR_____1_CM 0. 65535. DISPLAY_IDENTIFIER ID_ERR_DTC_CAN_BEM FORMAT "%5.0"
 /begin AXIS_DESCR COM_AXIS online_dummy _CNV_A_R_LINEAR_____0_CM 6 0. 5. FORMAT "%2.0" AXIS_PTS_REF ldp_fmy_dtc /end AXIS_DESCR
/end CHARACTERISTIC
/begin CHARACTERISTIC fmy_id_can_bem.envd "environmental data contents of customer specific freeze frame for diagnosis instance CAN_BEM" CURVE 0x85cb38 _REC_CUR_20_u1_u1 255. _CNV_A_R_LINEAR_____1_CM 0. 255. DISPLAY_IDENTIFIER ID_ERR_ENVD_CAN_BEM FORMAT "%3.0"
 /begin AXIS_DESCR COM_AXIS online_dummy _CNV_A_R_LINEAR_____0_CM 8 0. 7. READ_ONLY FORMAT "%2.0" AXIS_PTS_REF ldp_fmy_envd /end AXIS_DESCR
/end CHARACTERISTIC
/begin CHARACTERISTIC fmy_id_can_bem.c_err_clas "error class for diagnosis instance CAN_BEM" VALUE 0x85cb40 _REC_VAL_20_u1 255. _CNV_A_R_LINEAR_____1_CM 0. 255. DISPLAY_IDENTIFIER C_ERR_CLAS_CAN_BEM FORMAT "%3.0" /end CHARACTERISTIC
/begin CHARACTERISTIC fmy_id_can_if_cft.dtc[0] "diagnostic trouble codes for diagnosis instance CAN_IF_CFT" CURVE 0x85cb42 _REC_CUR_20_u2_u2 65535. _CNV_A_R_LINEAR_____1_CM 0. 65535. DISPLAY_IDENTIFIER ID_ERR_DTC_CAN_IF_CFT FORMAT "%5.0"
 /begin AXIS_DESCR COM_AXIS online_dummy _CNV_A_R_LINEAR_____0_CM 6 0. 5. FORMAT "%2.0" AXIS_PTS_REF ldp_fmy_dtc /end AXIS_DESCR
/end CHARACTERISTIC
/begin CHARACTERISTIC fmy_id_can_if_cft.envd "environmental data contents of customer specific freeze frame for diagnosis instance CAN_IF_CFT" CURVE 0x85cb4e _REC_CUR_20_u1_u1 255. _CNV_A_R_LINEAR_____1_CM 0. 255. DISPLAY_IDENTIFIER ID_ERR_ENVD_CAN_IF_CFT FORMAT "%3.0"
 /begin AXIS_DESCR COM_AXIS online_dummy _CNV_A_R_LINEAR_____0_CM 8 0. 7. READ_ONLY FORMAT "%2.0" AXIS_PTS_REF ldp_fmy_envd /end AXIS_DESCR
/end CHARACTERISTIC
/begin CHARACTERISTIC fmy_id_can_if_cft.c_err_clas "error class for diagnosis instance CAN_IF_CFT" VALUE 0x85cb56 _REC_VAL_20_u1 255. _CNV_A_R_LINEAR_____1_CM 0. 255. DISPLAY_IDENTIFIER C_ERR_CLAS_CAN_IF_CFT FORMAT "%3.0" /end CHARACTERISTIC
/begin CHARACTERISTIC fmy_id_can_tot.dtc[0] "diagnostic trouble codes for diagnosis instance CAN_TOT" CURVE 0x85cb58 _REC_CUR_20_u2_u2 65535. _CNV_A_R_LINEAR_____1_CM 0. 65535. DISPLAY_IDENTIFIER ID_ERR_DTC_CAN_TOT FORMAT "%5.0"
 /begin AXIS_DESCR COM_AXIS online_dummy _CNV_A_R_LINEAR_____0_CM 6 0. 5. FORMAT "%2.0" AXIS_PTS_REF ldp_fmy_dtc /end AXIS_DESCR
/end CHARACTERISTIC
/begin CHARACTERISTIC fmy_id_can_tot.envd "environmental data contents of customer specific freeze frame for diagnosis instance CAN_TOT" CURVE 0x85cb64 _REC_CUR_20_u1_u1 255. _CNV_A_R_LINEAR_____1_CM 0. 255. DISPLAY_IDENTIFIER ID_ERR_ENVD_CAN_TOT FORMAT "%3.0"
 /begin AXIS_DESCR COM_AXIS online_dummy _CNV_A_R_LINEAR_____0_CM 8 0. 7. READ_ONLY FORMAT "%2.0" AXIS_PTS_REF ldp_fmy_envd /end AXIS_DESCR
/end CHARACTERISTIC
/begin CHARACTERISTIC fmy_id_can_tot.c_err_clas "error class for diagnosis instance CAN_TOT" VALUE 0x85cb6c _REC_VAL_20_u1 255. _CNV_A_R_LINEAR_____1_CM 0. 255. DISPLAY_IDENTIFIER C_ERR_CLAS_CAN_TOT FORMAT "%3.0" /end CHARACTERISTIC
/begin CHARACTERISTIC fmy_id_varcod.dtc[0] "diagnostic trouble codes for diagnosis instance VARCOD" CURVE 0x85cb6e _REC_CUR_20_u2_u2 65535. _CNV_A_R_LINEAR_____1_CM 0. 65535. DISPLAY_IDENTIFIER ID_ERR_DTC_VARCOD FORMAT "%5.0"
 /begin AXIS_DESCR COM_AXIS online_dummy _CNV_A_R_LINEAR_____0_CM 6 0. 5. FORMAT "%2.0" AXIS_PTS_REF ldp_fmy_dtc /end AXIS_DESCR
/end CHARACTERISTIC
/begin CHARACTERISTIC fmy_id_varcod.envd "environmental data contents of customer specific freeze frame for diagnosis instance VARCOD" CURVE 0x85cb7a _REC_CUR_20_u1_u1 255. _CNV_A_R_LINEAR_____1_CM 0. 255. DISPLAY_IDENTIFIER ID_ERR_ENVD_VARCOD FORMAT "%3.0"
 /begin AXIS_DESCR COM_AXIS online_dummy _CNV_A_R_LINEAR_____0_CM 8 0. 7. READ_ONLY FORMAT "%2.0" AXIS_PTS_REF ldp_fmy_envd /end AXIS_DESCR
/end CHARACTERISTIC
/begin CHARACTERISTIC fmy_id_varcod.c_err_clas "error class for diagnosis instance VARCOD" VALUE 0x85cb82 _REC_VAL_20_u1 255. _CNV_A_R_LINEAR_____1_CM 0. 255. DISPLAY_IDENTIFIER C_ERR_CLAS_VARCOD FORMAT "%3.0" /end CHARACTERISTIC
/begin CHARACTERISTIC fmy_id_acp_mes_rng.dtc[0] "diagnostic trouble codes for diagnosis instance ACP_MES_RNG" CURVE 0x85cb84 _REC_CUR_20_u2_u2 65535. _CNV_A_R_LINEAR_____1_CM 0. 65535. DISPLAY_IDENTIFIER ID_ERR_DTC_ACP_MES_RNG FORMAT "%5.0"
 /begin AXIS_DESCR COM_AXIS online_dummy _CNV_A_R_LINEAR_____0_CM 6 0. 5. FORMAT "%2.0" AXIS_PTS_REF ldp_fmy_dtc /end AXIS_DESCR
/end CHARACTERISTIC
/begin CHARACTERISTIC fmy_id_acp_mes_rng.envd "environmental data contents of customer specific freeze frame for diagnosis instance ACP_MES_RNG" CURVE 0x85cb90 _REC_CUR_20_u1_u1 255. _CNV_A_R_LINEAR_____1_CM 0. 255. DISPLAY_IDENTIFIER ID_ERR_ENVD_ACP_MES_RNG FORMAT "%3.0"
 /begin AXIS_DESCR COM_AXIS online_dummy _CNV_A_R_LINEAR_____0_CM 8 0. 7. READ_ONLY FORMAT "%2.0" AXIS_PTS_REF ldp_fmy_envd /end AXIS_DESCR
/end CHARACTERISTIC
/begin CHARACTERISTIC fmy_id_acp_mes_rng.c_err_clas "error class for diagnosis instance ACP_MES_RNG" VALUE 0x85cb98 _REC_VAL_20_u1 255. _CNV_A_R_LINEAR_____1_CM 0. 255. DISPLAY_IDENTIFIER C_ERR_CLAS_ACP_MES_RNG FORMAT "%3.0" /end CHARACTERISTIC
/begin CHARACTERISTIC fmy_id_acp_mes_grd.dtc[0] "diagnostic trouble codes for diagnosis instance ACP_MES_GRD" CURVE 0x85cb9a _REC_CUR_20_u2_u2 65535. _CNV_A_R_LINEAR_____1_CM 0. 65535. DISPLAY_IDENTIFIER ID_ERR_DTC_ACP_MES_GRD FORMAT "%5.0"
 /begin AXIS_DESCR COM_AXIS online_dummy _CNV_A_R_LINEAR_____0_CM 6 0. 5. FORMAT "%2.0" AXIS_PTS_REF ldp_fmy_dtc /end AXIS_DESCR
/end CHARACTERISTIC
/begin CHARACTERISTIC fmy_id_acp_mes_grd.envd "environmental data contents of customer specific freeze frame for diagnosis instance ACP_MES_GRD" CURVE 0x85cba6 _REC_CUR_20_u1_u1 255. _CNV_A_R_LINEAR_____1_CM 0. 255. DISPLAY_IDENTIFIER ID_ERR_ENVD_ACP_MES_GRD FORMAT "%3.0"
 /begin AXIS_DESCR COM_AXIS online_dummy _CNV_A_R_LINEAR_____0_CM 8 0. 7. READ_ONLY FORMAT "%2.0" AXIS_PTS_REF ldp_fmy_envd /end AXIS_DESCR
/end CHARACTERISTIC
/begin CHARACTERISTIC fmy_id_acp_mes_grd.c_err_clas "error class for diagnosis instance ACP_MES_GRD" VALUE 0x85cbae _REC_VAL_20_u1 255. _CNV_A_R_LINEAR_____1_CM 0. 255. DISPLAY_IDENTIFIER C_ERR_CLAS_ACP_MES_GRD FORMAT "%3.0" /end CHARACTERISTIC
/begin CHARACTERISTIC fmy_id_v_tba_rng.dtc[0] "diagnostic trouble codes for diagnosis instance V_TBA_RNG" CURVE 0x85cbb0 _REC_CUR_20_u2_u2 65535. _CNV_A_R_LINEAR_____1_CM 0. 65535. DISPLAY_IDENTIFIER ID_ERR_DTC_V_TBA_RNG FORMAT "%5.0"
 /begin AXIS_DESCR COM_AXIS online_dummy _CNV_A_R_LINEAR_____0_CM 6 0. 5. FORMAT "%2.0" AXIS_PTS_REF ldp_fmy_dtc /end AXIS_DESCR
/end CHARACTERISTIC
/begin CHARACTERISTIC fmy_id_v_tba_rng.envd "environmental data contents of customer specific freeze frame for diagnosis instance V_TBA_RNG" CURVE 0x85cbbc _REC_CUR_20_u1_u1 255. _CNV_A_R_LINEAR_____1_CM 0. 255. DISPLAY_IDENTIFIER ID_ERR_ENVD_V_TBA_RNG FORMAT "%3.0"
 /begin AXIS_DESCR COM_AXIS online_dummy _CNV_A_R_LINEAR_____0_CM 8 0. 7. READ_ONLY FORMAT "%2.0" AXIS_PTS_REF ldp_fmy_envd /end AXIS_DESCR
/end CHARACTERISTIC
/begin CHARACTERISTIC fmy_id_v_tba_rng.c_err_clas "error class for diagnosis instance V_TBA_RNG" VALUE 0x85cbc4 _REC_VAL_20_u1 255. _CNV_A_R_LINEAR_____1_CM 0. 255. DISPLAY_IDENTIFIER C_ERR_CLAS_V_TBA_RNG FORMAT "%3.0" /end CHARACTERISTIC
/begin CHARACTERISTIC fmy_id_tba_mes_grd.dtc[0] "diagnostic trouble codes for diagnosis instance TBA_MES_GRD" CURVE 0x85cbc6 _REC_CUR_20_u2_u2 65535. _CNV_A_R_LINEAR_____1_CM 0. 65535. DISPLAY_IDENTIFIER ID_ERR_DTC_TBA_MES_GRD FORMAT "%5.0"
 /begin AXIS_DESCR COM_AXIS online_dummy _CNV_A_R_LINEAR_____0_CM 6 0. 5. FORMAT "%2.0" AXIS_PTS_REF ldp_fmy_dtc /end AXIS_DESCR
/end CHARACTERISTIC
/begin CHARACTERISTIC fmy_id_tba_mes_grd.envd "environmental data contents of customer specific freeze frame for diagnosis instance TBA_MES_GRD" CURVE 0x85cbd2 _REC_CUR_20_u1_u1 255. _CNV_A_R_LINEAR_____1_CM 0. 255. DISPLAY_IDENTIFIER ID_ERR_ENVD_TBA_MES_GRD FORMAT "%3.0"
 /begin AXIS_DESCR COM_AXIS online_dummy _CNV_A_R_LINEAR_____0_CM 8 0. 7. READ_ONLY FORMAT "%2.0" AXIS_PTS_REF ldp_fmy_envd /end AXIS_DESCR
/end CHARACTERISTIC
/begin CHARACTERISTIC fmy_id_tba_mes_grd.c_err_clas "error class for diagnosis instance TBA_MES_GRD" VALUE 0x85cbda _REC_VAL_20_u1 255. _CNV_A_R_LINEAR_____1_CM 0. 255. DISPLAY_IDENTIFIER C_ERR_CLAS_TBA_MES_GRD FORMAT "%3.0" /end CHARACTERISTIC
/begin CHARACTERISTIC fmy_id_ducy_alter_pwm_rng.dtc[0] "diagnostic trouble codes for diagnosis instance DUCY_ALTER_PWM_RNG" CURVE 0x85cbdc _REC_CUR_20_u2_u2 65535. _CNV_A_R_LINEAR_____1_CM 0. 65535. DISPLAY_IDENTIFIER ID_ERR_DTC_DUCY_ALTER_PWM_RNG FORMAT "%5.0"
 /begin AXIS_DESCR COM_AXIS online_dummy _CNV_A_R_LINEAR_____0_CM 6 0. 5. FORMAT "%2.0" AXIS_PTS_REF ldp_fmy_dtc /end AXIS_DESCR
/end CHARACTERISTIC
/begin CHARACTERISTIC fmy_id_ducy_alter_pwm_rng.envd "environmental data contents of customer specific freeze frame for diagnosis instance DUCY_ALTER_PWM_RNG" CURVE 0x85cbe8 _REC_CUR_20_u1_u1 255. _CNV_A_R_LINEAR_____1_CM 0. 255. DISPLAY_IDENTIFIER ID_ERR_ENVD_DUCY_ALTER_PWM_RNG FORMAT "%3.0"
 /begin AXIS_DESCR COM_AXIS online_dummy _CNV_A_R_LINEAR_____0_CM 8 0. 7. READ_ONLY FORMAT "%2.0" AXIS_PTS_REF ldp_fmy_envd /end AXIS_DESCR
/end CHARACTERISTIC
/begin CHARACTERISTIC fmy_id_ducy_alter_pwm_rng.c_err_clas "error class for diagnosis instance DUCY_ALTER_PWM_RNG" VALUE 0x85cbf0 _REC_VAL_20_u1 255. _CNV_A_R_LINEAR_____1_CM 0. 255. DISPLAY_IDENTIFIER C_ERR_CLAS_DUCY_ALTER_PWM_RNG FORMAT "%3.0" /end CHARACTERISTIC
/begin CHARACTERISTIC fmy_id_ducy_alter_pwm_grd.dtc[0] "diagnostic trouble codes for diagnosis instance DUCY_ALTER_PWM_GRD" CURVE 0x85cbf2 _REC_CUR_20_u2_u2 65535. _CNV_A_R_LINEAR_____1_CM 0. 65535. DISPLAY_IDENTIFIER ID_ERR_DTC_DUCY_ALTER_PWM_GRD FORMAT "%5.0"
 /begin AXIS_DESCR COM_AXIS online_dummy _CNV_A_R_LINEAR_____0_CM 6 0. 5. FORMAT "%2.0" AXIS_PTS_REF ldp_fmy_dtc /end AXIS_DESCR
/end CHARACTERISTIC
/begin CHARACTERISTIC fmy_id_ducy_alter_pwm_grd.envd "environmental data contents of customer specific freeze frame for diagnosis instance DUCY_ALTER_PWM_GRD" CURVE 0x85cbfe _REC_CUR_20_u1_u1 255. _CNV_A_R_LINEAR_____1_CM 0. 255. DISPLAY_IDENTIFIER ID_ERR_ENVD_DUCY_ALTER_PWM_GRD FORMAT "%3.0"
 /begin AXIS_DESCR COM_AXIS online_dummy _CNV_A_R_LINEAR_____0_CM 8 0. 7. READ_ONLY FORMAT "%2.0" AXIS_PTS_REF ldp_fmy_envd /end AXIS_DESCR
/end CHARACTERISTIC
/begin CHARACTERISTIC fmy_id_ducy_alter_pwm_grd.c_err_clas "error class for diagnosis instance DUCY_ALTER_PWM_GRD" VALUE 0x85cc06 _REC_VAL_20_u1 255. _CNV_A_R_LINEAR_____1_CM 0. 255. DISPLAY_IDENTIFIER C_ERR_CLAS_DUCY_ALTER_PWM_GRD FORMAT "%3.0" /end CHARACTERISTIC
/begin CHARACTERISTIC fmy_id_v_egrv_0_rng.dtc[0] "diagnostic trouble codes for diagnosis instance V_EGRV_0_RNG" CURVE 0x85cc08 _REC_CUR_20_u2_u2 65535. _CNV_A_R_LINEAR_____1_CM 0. 65535. DISPLAY_IDENTIFIER ID_ERR_DTC_V_EGRV_0_RNG FORMAT "%5.0"
 /begin AXIS_DESCR COM_AXIS online_dummy _CNV_A_R_LINEAR_____0_CM 6 0. 5. FORMAT "%2.0" AXIS_PTS_REF ldp_fmy_dtc /end AXIS_DESCR
/end CHARACTERISTIC
/begin CHARACTERISTIC fmy_id_v_egrv_0_rng.envd "environmental data contents of customer specific freeze frame for diagnosis instance V_EGRV_0_RNG" CURVE 0x85cc14 _REC_CUR_20_u1_u1 255. _CNV_A_R_LINEAR_____1_CM 0. 255. DISPLAY_IDENTIFIER ID_ERR_ENVD_V_EGRV_0_RNG FORMAT "%3.0"
 /begin AXIS_DESCR COM_AXIS online_dummy _CNV_A_R_LINEAR_____0_CM 8 0. 7. READ_ONLY FORMAT "%2.0" AXIS_PTS_REF ldp_fmy_envd /end AXIS_DESCR
/end CHARACTERISTIC
/begin CHARACTERISTIC fmy_id_v_egrv_0_rng.c_err_clas "error class for diagnosis instance V_EGRV_0_RNG" VALUE 0x85cc1c _REC_VAL_20_u1 255. _CNV_A_R_LINEAR_____1_CM 0. 255. DISPLAY_IDENTIFIER C_ERR_CLAS_V_EGRV_0_RNG FORMAT "%3.0" /end CHARACTERISTIC
/begin CHARACTERISTIC fmy_id_v_egrv_1_rng.dtc[0] "diagnostic trouble codes for diagnosis instance V_EGRV_1_RNG" CURVE 0x85cc1e _REC_CUR_20_u2_u2 65535. _CNV_A_R_LINEAR_____1_CM 0. 65535. DISPLAY_IDENTIFIER ID_ERR_DTC_V_EGRV_1_RNG FORMAT "%5.0"
 /begin AXIS_DESCR COM_AXIS online_dummy _CNV_A_R_LINEAR_____0_CM 6 0. 5. FORMAT "%2.0" AXIS_PTS_REF ldp_fmy_dtc /end AXIS_DESCR
/end CHARACTERISTIC
/begin CHARACTERISTIC fmy_id_v_egrv_1_rng.envd "environmental data contents of customer specific freeze frame for diagnosis instance V_EGRV_1_RNG" CURVE 0x85cc2a _REC_CUR_20_u1_u1 255. _CNV_A_R_LINEAR_____1_CM 0. 255. DISPLAY_IDENTIFIER ID_ERR_ENVD_V_EGRV_1_RNG FORMAT "%3.0"
 /begin AXIS_DESCR COM_AXIS online_dummy _CNV_A_R_LINEAR_____0_CM 8 0. 7. READ_ONLY FORMAT "%2.0" AXIS_PTS_REF ldp_fmy_envd /end AXIS_DESCR
/end CHARACTERISTIC
/begin CHARACTERISTIC fmy_id_v_egrv_1_rng.c_err_clas "error class for diagnosis instance V_EGRV_1_RNG" VALUE 0x85cc32 _REC_VAL_20_u1 255. _CNV_A_R_LINEAR_____1_CM 0. 255. DISPLAY_IDENTIFIER C_ERR_CLAS_V_EGRV_1_RNG FORMAT "%3.0" /end CHARACTERISTIC
/begin CHARACTERISTIC fmy_id_v_egrv_0_grd.dtc[0] "diagnostic trouble codes for diagnosis instance V_EGRV_0_GRD" CURVE 0x85cc34 _REC_CUR_20_u2_u2 65535. _CNV_A_R_LINEAR_____1_CM 0. 65535. DISPLAY_IDENTIFIER ID_ERR_DTC_V_EGRV_0_GRD FORMAT "%5.0"
 /begin AXIS_DESCR COM_AXIS online_dummy _CNV_A_R_LINEAR_____0_CM 6 0. 5. FORMAT "%2.0" AXIS_PTS_REF ldp_fmy_dtc /end AXIS_DESCR
/end CHARACTERISTIC
/begin CHARACTERISTIC fmy_id_v_egrv_0_grd.envd "environmental data contents of customer specific freeze frame for diagnosis instance V_EGRV_0_GRD" CURVE 0x85cc40 _REC_CUR_20_u1_u1 255. _CNV_A_R_LINEAR_____1_CM 0. 255. DISPLAY_IDENTIFIER ID_ERR_ENVD_V_EGRV_0_GRD FORMAT "%3.0"
 /begin AXIS_DESCR COM_AXIS online_dummy _CNV_A_R_LINEAR_____0_CM 8 0. 7. READ_ONLY FORMAT "%2.0" AXIS_PTS_REF ldp_fmy_envd /end AXIS_DESCR
/end CHARACTERISTIC
/begin CHARACTERISTIC fmy_id_v_egrv_0_grd.c_err_clas "error class for diagnosis instance V_EGRV_0_GRD" VALUE 0x85cc48 _REC_VAL_20_u1 255. _CNV_A_R_LINEAR_____1_CM 0. 255. DISPLAY_IDENTIFIER C_ERR_CLAS_V_EGRV_0_GRD FORMAT "%3.0" /end CHARACTERISTIC
/begin CHARACTERISTIC fmy_id_v_egrv_1_grd.dtc[0] "diagnostic trouble codes for diagnosis instance V_EGRV_1_GRD" CURVE 0x85cc4a _REC_CUR_20_u2_u2 65535. _CNV_A_R_LINEAR_____1_CM 0. 65535. DISPLAY_IDENTIFIER ID_ERR_DTC_V_EGRV_1_GRD FORMAT "%5.0"
 /begin AXIS_DESCR COM_AXIS online_dummy _CNV_A_R_LINEAR_____0_CM 6 0. 5. FORMAT "%2.0" AXIS_PTS_REF ldp_fmy_dtc /end AXIS_DESCR
/end CHARACTERISTIC
/begin CHARACTERISTIC fmy_id_v_egrv_1_grd.envd "environmental data contents of customer specific freeze frame for diagnosis instance V_EGRV_1_GRD" CURVE 0x85cc56 _REC_CUR_20_u1_u1 255. _CNV_A_R_LINEAR_____1_CM 0. 255. DISPLAY_IDENTIFIER ID_ERR_ENVD_V_EGRV_1_GRD FORMAT "%3.0"
 /begin AXIS_DESCR COM_AXIS online_dummy _CNV_A_R_LINEAR_____0_CM 8 0. 7. READ_ONLY FORMAT "%2.0" AXIS_PTS_REF ldp_fmy_envd /end AXIS_DESCR
/end CHARACTERISTIC
/begin CHARACTERISTIC fmy_id_v_egrv_1_grd.c_err_clas "error class for diagnosis instance V_EGRV_1_GRD" VALUE 0x85cc5e _REC_VAL_20_u1 255. _CNV_A_R_LINEAR_____1_CM 0. 255. DISPLAY_IDENTIFIER C_ERR_CLAS_V_EGRV_1_GRD FORMAT "%3.0" /end CHARACTERISTIC
/begin CHARACTERISTIC fmy_id_ges_maf_0_max.dtc[0] "diagnostic trouble codes for diagnosis instance GES_MAF_0_MAX" CURVE 0x85cc60 _REC_CUR_20_u2_u2 65535. _CNV_A_R_LINEAR_____1_CM 0. 65535. DISPLAY_IDENTIFIER ID_ERR_DTC_GES_MAF_0_MAX FORMAT "%5.0"
 /begin AXIS_DESCR COM_AXIS online_dummy _CNV_A_R_LINEAR_____0_CM 6 0. 5. FORMAT "%2.0" AXIS_PTS_REF ldp_fmy_dtc /end AXIS_DESCR
/end CHARACTERISTIC
/begin CHARACTERISTIC fmy_id_ges_maf_0_max.envd "environmental data contents of customer specific freeze frame for diagnosis instance GES_MAF_0_MAX" CURVE 0x85cc6c _REC_CUR_20_u1_u1 255. _CNV_A_R_LINEAR_____1_CM 0. 255. DISPLAY_IDENTIFIER ID_ERR_ENVD_GES_MAF_0_MAX FORMAT "%3.0"
 /begin AXIS_DESCR COM_AXIS online_dummy _CNV_A_R_LINEAR_____0_CM 8 0. 7. READ_ONLY FORMAT "%2.0" AXIS_PTS_REF ldp_fmy_envd /end AXIS_DESCR
/end CHARACTERISTIC
/begin CHARACTERISTIC fmy_id_ges_maf_0_max.c_err_clas "error class for diagnosis instance GES_MAF_0_MAX" VALUE 0x85cc74 _REC_VAL_20_u1 255. _CNV_A_R_LINEAR_____1_CM 0. 255. DISPLAY_IDENTIFIER C_ERR_CLAS_GES_MAF_0_MAX FORMAT "%3.0" /end CHARACTERISTIC
/begin CHARACTERISTIC fmy_id_tco_1_2_plaus.dtc[0] "diagnostic trouble codes for diagnosis instance TCO_1_2_PLAUS" CURVE 0x85cc76 _REC_CUR_20_u2_u2 65535. _CNV_A_R_LINEAR_____1_CM 0. 65535. DISPLAY_IDENTIFIER ID_ERR_DTC_TCO_1_2_PLAUS FORMAT "%5.0"
 /begin AXIS_DESCR COM_AXIS online_dummy _CNV_A_R_LINEAR_____0_CM 6 0. 5. FORMAT "%2.0" AXIS_PTS_REF ldp_fmy_dtc /end AXIS_DESCR
/end CHARACTERISTIC
/begin CHARACTERISTIC fmy_id_tco_1_2_plaus.envd "environmental data contents of customer specific freeze frame for diagnosis instance TCO_1_2_PLAUS" CURVE 0x85cc82 _REC_CUR_20_u1_u1 255. _CNV_A_R_LINEAR_____1_CM 0. 255. DISPLAY_IDENTIFIER ID_ERR_ENVD_TCO_1_2_PLAUS FORMAT "%3.0"
 /begin AXIS_DESCR COM_AXIS online_dummy _CNV_A_R_LINEAR_____0_CM 8 0. 7. READ_ONLY FORMAT "%2.0" AXIS_PTS_REF ldp_fmy_envd /end AXIS_DESCR
/end CHARACTERISTIC
/begin CHARACTERISTIC fmy_id_tco_1_2_plaus.c_err_clas "error class for diagnosis instance TCO_1_2_PLAUS" VALUE 0x85cc8a _REC_VAL_20_u1 255. _CNV_A_R_LINEAR_____1_CM 0. 255. DISPLAY_IDENTIFIER C_ERR_CLAS_TCO_1_2_PLAUS FORMAT "%3.0" /end CHARACTERISTIC
/begin CHARACTERISTIC fmy_id_efp_rly_dps.dtc[0] "diagnostic trouble codes for diagnosis instance EFP_RLY_DPS" CURVE 0x85cc8c _REC_CUR_20_u2_u2 65535. _CNV_A_R_LINEAR_____1_CM 0. 65535. DISPLAY_IDENTIFIER ID_ERR_DTC_EFP_RLY_DPS FORMAT "%5.0"
 /begin AXIS_DESCR COM_AXIS online_dummy _CNV_A_R_LINEAR_____0_CM 6 0. 5. FORMAT "%2.0" AXIS_PTS_REF ldp_fmy_dtc /end AXIS_DESCR
/end CHARACTERISTIC
/begin CHARACTERISTIC fmy_id_efp_rly_dps.envd "environmental data contents of customer specific freeze frame for diagnosis instance EFP_RLY_DPS" CURVE 0x85cc98 _REC_CUR_20_u1_u1 255. _CNV_A_R_LINEAR_____1_CM 0. 255. DISPLAY_IDENTIFIER ID_ERR_ENVD_EFP_RLY_DPS FORMAT "%3.0"
 /begin AXIS_DESCR COM_AXIS online_dummy _CNV_A_R_LINEAR_____0_CM 8 0. 7. READ_ONLY FORMAT "%2.0" AXIS_PTS_REF ldp_fmy_envd /end AXIS_DESCR
/end CHARACTERISTIC
/begin CHARACTERISTIC fmy_id_efp_rly_dps.c_err_clas "error class for diagnosis instance EFP_RLY_DPS" VALUE 0x85cca0 _REC_VAL_20_u1 255. _CNV_A_R_LINEAR_____1_CM 0. 255. DISPLAY_IDENTIFIER C_ERR_CLAS_EFP_RLY_DPS FORMAT "%3.0" /end CHARACTERISTIC
/begin CHARACTERISTIC fmy_id_efp_rly_plaus_1.dtc[0] "diagnostic trouble codes for diagnosis instance EFP_RLY_PLAUS_1" CURVE 0x85cca2 _REC_CUR_20_u2_u2 65535. _CNV_A_R_LINEAR_____1_CM 0. 65535. DISPLAY_IDENTIFIER ID_ERR_DTC_EFP_RLY_PLAUS_1 FORMAT "%5.0"
 /begin AXIS_DESCR COM_AXIS online_dummy _CNV_A_R_LINEAR_____0_CM 6 0. 5. FORMAT "%2.0" AXIS_PTS_REF ldp_fmy_dtc /end AXIS_DESCR
/end CHARACTERISTIC
/begin CHARACTERISTIC fmy_id_efp_rly_plaus_1.envd "environmental data contents of customer specific freeze frame for diagnosis instance EFP_RLY_PLAUS_1" CURVE 0x85ccae _REC_CUR_20_u1_u1 255. _CNV_A_R_LINEAR_____1_CM 0. 255. DISPLAY_IDENTIFIER ID_ERR_ENVD_EFP_RLY_PLAUS_1 FORMAT "%3.0"
 /begin AXIS_DESCR COM_AXIS online_dummy _CNV_A_R_LINEAR_____0_CM 8 0. 7. READ_ONLY FORMAT "%2.0" AXIS_PTS_REF ldp_fmy_envd /end AXIS_DESCR
/end CHARACTERISTIC
/begin CHARACTERISTIC fmy_id_efp_rly_plaus_1.c_err_clas "error class for diagnosis instance EFP_RLY_PLAUS_1" VALUE 0x85ccb6 _REC_VAL_20_u1 255. _CNV_A_R_LINEAR_____1_CM 0. 255. DISPLAY_IDENTIFIER C_ERR_CLAS_EFP_RLY_PLAUS_1 FORMAT "%3.0" /end CHARACTERISTIC
/begin CHARACTERISTIC fmy_id_efp_rly_plaus_2.dtc[0] "diagnostic trouble codes for diagnosis instance EFP_RLY_PLAUS_2" CURVE 0x85ccb8 _REC_CUR_20_u2_u2 65535. _CNV_A_R_LINEAR_____1_CM 0. 65535. DISPLAY_IDENTIFIER ID_ERR_DTC_EFP_RLY_PLAUS_2 FORMAT "%5.0"
 /begin AXIS_DESCR COM_AXIS online_dummy _CNV_A_R_LINEAR_____0_CM 6 0. 5. FORMAT "%2.0" AXIS_PTS_REF ldp_fmy_dtc /end AXIS_DESCR
/end CHARACTERISTIC
/begin CHARACTERISTIC fmy_id_efp_rly_plaus_2.envd "environmental data contents of customer specific freeze frame for diagnosis instance EFP_RLY_PLAUS_2" CURVE 0x85ccc4 _REC_CUR_20_u1_u1 255. _CNV_A_R_LINEAR_____1_CM 0. 255. DISPLAY_IDENTIFIER ID_ERR_ENVD_EFP_RLY_PLAUS_2 FORMAT "%3.0"
 /begin AXIS_DESCR COM_AXIS online_dummy _CNV_A_R_LINEAR_____0_CM 8 0. 7. READ_ONLY FORMAT "%2.0" AXIS_PTS_REF ldp_fmy_envd /end AXIS_DESCR
/end CHARACTERISTIC
/begin CHARACTERISTIC fmy_id_efp_rly_plaus_2.c_err_clas "error class for diagnosis instance EFP_RLY_PLAUS_2" VALUE 0x85cccc _REC_VAL_20_u1 255. _CNV_A_R_LINEAR_____1_CM 0. 255. DISPLAY_IDENTIFIER C_ERR_CLAS_EFP_RLY_PLAUS_2 FORMAT "%3.0" /end CHARACTERISTIC
/begin CHARACTERISTIC fmy_id_spi_mps.dtc[0] "diagnostic trouble codes for diagnosis instance SPI_MPS" CURVE 0x85ccce _REC_CUR_20_u2_u2 65535. _CNV_A_R_LINEAR_____1_CM 0. 65535. DISPLAY_IDENTIFIER ID_ERR_DTC_SPI_MPS FORMAT "%5.0"
 /begin AXIS_DESCR COM_AXIS online_dummy _CNV_A_R_LINEAR_____0_CM 6 0. 5. FORMAT "%2.0" AXIS_PTS_REF ldp_fmy_dtc /end AXIS_DESCR
/end CHARACTERISTIC
/begin CHARACTERISTIC fmy_id_spi_mps.envd "environmental data contents of customer specific freeze frame for diagnosis instance SPI_MPS" CURVE 0x85ccda _REC_CUR_20_u1_u1 255. _CNV_A_R_LINEAR_____1_CM 0. 255. DISPLAY_IDENTIFIER ID_ERR_ENVD_SPI_MPS FORMAT "%3.0"
 /begin AXIS_DESCR COM_AXIS online_dummy _CNV_A_R_LINEAR_____0_CM 8 0. 7. READ_ONLY FORMAT "%2.0" AXIS_PTS_REF ldp_fmy_envd /end AXIS_DESCR
/end CHARACTERISTIC
/begin CHARACTERISTIC fmy_id_spi_mps.c_err_clas "error class for diagnosis instance SPI_MPS" VALUE 0x85cce2 _REC_VAL_20_u1 255. _CNV_A_R_LINEAR_____1_CM 0. 255. DISPLAY_IDENTIFIER C_ERR_CLAS_SPI_MPS FORMAT "%3.0" /end CHARACTERISTIC
/begin CHARACTERISTIC fmy_id_spi_oct.dtc[0] "diagnostic trouble codes for diagnosis instance SPI_OCT" CURVE 0x85cce4 _REC_CUR_20_u2_u2 65535. _CNV_A_R_LINEAR_____1_CM 0. 65535. DISPLAY_IDENTIFIER ID_ERR_DTC_SPI_OCT FORMAT "%5.0"
 /begin AXIS_DESCR COM_AXIS online_dummy _CNV_A_R_LINEAR_____0_CM 6 0. 5. FORMAT "%2.0" AXIS_PTS_REF ldp_fmy_dtc /end AXIS_DESCR
/end CHARACTERISTIC
/begin CHARACTERISTIC fmy_id_spi_oct.envd "environmental data contents of customer specific freeze frame for diagnosis instance SPI_OCT" CURVE 0x85ccf0 _REC_CUR_20_u1_u1 255. _CNV_A_R_LINEAR_____1_CM 0. 255. DISPLAY_IDENTIFIER ID_ERR_ENVD_SPI_OCT FORMAT "%3.0"
 /begin AXIS_DESCR COM_AXIS online_dummy _CNV_A_R_LINEAR_____0_CM 8 0. 7. READ_ONLY FORMAT "%2.0" AXIS_PTS_REF ldp_fmy_envd /end AXIS_DESCR
/end CHARACTERISTIC
/begin CHARACTERISTIC fmy_id_spi_oct.c_err_clas "error class for diagnosis instance SPI_OCT" VALUE 0x85ccf8 _REC_VAL_20_u1 255. _CNV_A_R_LINEAR_____1_CM 0. 255. DISPLAY_IDENTIFIER C_ERR_CLAS_SPI_OCT FORMAT "%3.0" /end CHARACTERISTIC
/begin CHARACTERISTIC fmy_id_spi_qps.dtc[0] "diagnostic trouble codes for diagnosis instance SPI_QPS" CURVE 0x85ccfa _REC_CUR_20_u2_u2 65535. _CNV_A_R_LINEAR_____1_CM 0. 65535. DISPLAY_IDENTIFIER ID_ERR_DTC_SPI_QPS FORMAT "%5.0"
 /begin AXIS_DESCR COM_AXIS online_dummy _CNV_A_R_LINEAR_____0_CM 6 0. 5. FORMAT "%2.0" AXIS_PTS_REF ldp_fmy_dtc /end AXIS_DESCR
/end CHARACTERISTIC
/begin CHARACTERISTIC fmy_id_spi_qps.envd "environmental data contents of customer specific freeze frame for diagnosis instance SPI_QPS" CURVE 0x85cd06 _REC_CUR_20_u1_u1 255. _CNV_A_R_LINEAR_____1_CM 0. 255. DISPLAY_IDENTIFIER ID_ERR_ENVD_SPI_QPS FORMAT "%3.0"
 /begin AXIS_DESCR COM_AXIS online_dummy _CNV_A_R_LINEAR_____0_CM 8 0. 7. READ_ONLY FORMAT "%2.0" AXIS_PTS_REF ldp_fmy_envd /end AXIS_DESCR
/end CHARACTERISTIC
/begin CHARACTERISTIC fmy_id_spi_qps.c_err_clas "error class for diagnosis instance SPI_QPS" VALUE 0x85cd0e _REC_VAL_20_u1 255. _CNV_A_R_LINEAR_____1_CM 0. 255. DISPLAY_IDENTIFIER C_ERR_CLAS_SPI_QPS FORMAT "%3.0" /end CHARACTERISTIC
/begin CHARACTERISTIC fmy_id_egr_byp_dps.dtc[0] "diagnostic trouble codes for diagnosis instance EGR_BYP_DPS" CURVE 0x85cd10 _REC_CUR_20_u2_u2 65535. _CNV_A_R_LINEAR_____1_CM 0. 65535. DISPLAY_IDENTIFIER ID_ERR_DTC_EGR_BYP_DPS FORMAT "%5.0"
 /begin AXIS_DESCR COM_AXIS online_dummy _CNV_A_R_LINEAR_____0_CM 6 0. 5. FORMAT "%2.0" AXIS_PTS_REF ldp_fmy_dtc /end AXIS_DESCR
/end CHARACTERISTIC
/begin CHARACTERISTIC fmy_id_egr_byp_dps.envd "environmental data contents of customer specific freeze frame for diagnosis instance EGR_BYP_DPS" CURVE 0x85cd1c _REC_CUR_20_u1_u1 255. _CNV_A_R_LINEAR_____1_CM 0. 255. DISPLAY_IDENTIFIER ID_ERR_ENVD_EGR_BYP_DPS FORMAT "%3.0"
 /begin AXIS_DESCR COM_AXIS online_dummy _CNV_A_R_LINEAR_____0_CM 8 0. 7. READ_ONLY FORMAT "%2.0" AXIS_PTS_REF ldp_fmy_envd /end AXIS_DESCR
/end CHARACTERISTIC
/begin CHARACTERISTIC fmy_id_egr_byp_dps.c_err_clas "error class for diagnosis instance EGR_BYP_DPS" VALUE 0x85cd24 _REC_VAL_20_u1 255. _CNV_A_R_LINEAR_____1_CM 0. 255. DISPLAY_IDENTIFIER C_ERR_CLAS_EGR_BYP_DPS FORMAT "%3.0" /end CHARACTERISTIC
/begin CHARACTERISTIC fmy_id_egrv_0.dtc[0] "diagnostic trouble codes for diagnosis instance EGRV_0" CURVE 0x85cd26 _REC_CUR_20_u2_u2 65535. _CNV_A_R_LINEAR_____1_CM 0. 65535. DISPLAY_IDENTIFIER ID_ERR_DTC_EGRV_0 FORMAT "%5.0"
 /begin AXIS_DESCR COM_AXIS online_dummy _CNV_A_R_LINEAR_____0_CM 6 0. 5. FORMAT "%2.0" AXIS_PTS_REF ldp_fmy_dtc /end AXIS_DESCR
/end CHARACTERISTIC
/begin CHARACTERISTIC fmy_id_egrv_0.envd "environmental data contents of customer specific freeze frame for diagnosis instance EGRV_0" CURVE 0x85cd32 _REC_CUR_20_u1_u1 255. _CNV_A_R_LINEAR_____1_CM 0. 255. DISPLAY_IDENTIFIER ID_ERR_ENVD_EGRV_0 FORMAT "%3.0"
 /begin AXIS_DESCR COM_AXIS online_dummy _CNV_A_R_LINEAR_____0_CM 8 0. 7. READ_ONLY FORMAT "%2.0" AXIS_PTS_REF ldp_fmy_envd /end AXIS_DESCR
/end CHARACTERISTIC
/begin CHARACTERISTIC fmy_id_egrv_0.c_err_clas "error class for diagnosis instance EGRV_0" VALUE 0x85cd3a _REC_VAL_20_u1 255. _CNV_A_R_LINEAR_____1_CM 0. 255. DISPLAY_IDENTIFIER C_ERR_CLAS_EGRV_0 FORMAT "%3.0" /end CHARACTERISTIC
/begin CHARACTERISTIC fmy_id_pps_ini_0.dtc[0] "diagnostic trouble codes for diagnosis instance PPS_INI_0" CURVE 0x85cd3c _REC_CUR_20_u2_u2 65535. _CNV_A_R_LINEAR_____1_CM 0. 65535. DISPLAY_IDENTIFIER ID_ERR_DTC_PPS_INI_0 FORMAT "%5.0"
 /begin AXIS_DESCR COM_AXIS online_dummy _CNV_A_R_LINEAR_____0_CM 6 0. 5. FORMAT "%2.0" AXIS_PTS_REF ldp_fmy_dtc /end AXIS_DESCR
/end CHARACTERISTIC
/begin CHARACTERISTIC fmy_id_pps_ini_0.envd "environmental data contents of customer specific freeze frame for diagnosis instance PPS_INI_0" CURVE 0x85cd48 _REC_CUR_20_u1_u1 255. _CNV_A_R_LINEAR_____1_CM 0. 255. DISPLAY_IDENTIFIER ID_ERR_ENVD_PPS_INI_0 FORMAT "%3.0"
 /begin AXIS_DESCR COM_AXIS online_dummy _CNV_A_R_LINEAR_____0_CM 8 0. 7. READ_ONLY FORMAT "%2.0" AXIS_PTS_REF ldp_fmy_envd /end AXIS_DESCR
/end CHARACTERISTIC
/begin CHARACTERISTIC fmy_id_pps_ini_0.c_err_clas "error class for diagnosis instance PPS_INI_0" VALUE 0x85cd50 _REC_VAL_20_u1 255. _CNV_A_R_LINEAR_____1_CM 0. 255. DISPLAY_IDENTIFIER C_ERR_CLAS_PPS_INI_0 FORMAT "%3.0" /end CHARACTERISTIC
/begin CHARACTERISTIC fmy_id_pps_ini_tout_0.dtc[0] "diagnostic trouble codes for diagnosis instance PPS_INI_TOUT_0" CURVE 0x85cd52 _REC_CUR_20_u2_u2 65535. _CNV_A_R_LINEAR_____1_CM 0. 65535. DISPLAY_IDENTIFIER ID_ERR_DTC_PPS_INI_TOUT_0 FORMAT "%5.0"
 /begin AXIS_DESCR COM_AXIS online_dummy _CNV_A_R_LINEAR_____0_CM 6 0. 5. FORMAT "%2.0" AXIS_PTS_REF ldp_fmy_dtc /end AXIS_DESCR
/end CHARACTERISTIC
/begin CHARACTERISTIC fmy_id_pps_ini_tout_0.envd "environmental data contents of customer specific freeze frame for diagnosis instance PPS_INI_TOUT_0" CURVE 0x85cd5e _REC_CUR_20_u1_u1 255. _CNV_A_R_LINEAR_____1_CM 0. 255. DISPLAY_IDENTIFIER ID_ERR_ENVD_PPS_INI_TOUT_0 FORMAT "%3.0"
 /begin AXIS_DESCR COM_AXIS online_dummy _CNV_A_R_LINEAR_____0_CM 8 0. 7. READ_ONLY FORMAT "%2.0" AXIS_PTS_REF ldp_fmy_envd /end AXIS_DESCR
/end CHARACTERISTIC
/begin CHARACTERISTIC fmy_id_pps_ini_tout_0.c_err_clas "error class for diagnosis instance PPS_INI_TOUT_0" VALUE 0x85cd66 _REC_VAL_20_u1 255. _CNV_A_R_LINEAR_____1_CM 0. 255. DISPLAY_IDENTIFIER C_ERR_CLAS_PPS_INI_TOUT_0 FORMAT "%3.0" /end CHARACTERISTIC
/begin CHARACTERISTIC fmy_id_pps_plaus_0.dtc[0] "diagnostic trouble codes for diagnosis instance PPS_PLAUS_0" CURVE 0x85cd68 _REC_CUR_20_u2_u2 65535. _CNV_A_R_LINEAR_____1_CM 0. 65535. DISPLAY_IDENTIFIER ID_ERR_DTC_PPS_PLAUS_0 FORMAT "%5.0"
 /begin AXIS_DESCR COM_AXIS online_dummy _CNV_A_R_LINEAR_____0_CM 6 0. 5. FORMAT "%2.0" AXIS_PTS_REF ldp_fmy_dtc /end AXIS_DESCR
/end CHARACTERISTIC
/begin CHARACTERISTIC fmy_id_pps_plaus_0.envd "environmental data contents of customer specific freeze frame for diagnosis instance PPS_PLAUS_0" CURVE 0x85cd74 _REC_CUR_20_u1_u1 255. _CNV_A_R_LINEAR_____1_CM 0. 255. DISPLAY_IDENTIFIER ID_ERR_ENVD_PPS_PLAUS_0 FORMAT "%3.0"
 /begin AXIS_DESCR COM_AXIS online_dummy _CNV_A_R_LINEAR_____0_CM 8 0. 7. READ_ONLY FORMAT "%2.0" AXIS_PTS_REF ldp_fmy_envd /end AXIS_DESCR
/end CHARACTERISTIC
/begin CHARACTERISTIC fmy_id_pps_plaus_0.c_err_clas "error class for diagnosis instance PPS_PLAUS_0" VALUE 0x85cd7c _REC_VAL_20_u1 255. _CNV_A_R_LINEAR_____1_CM 0. 255. DISPLAY_IDENTIFIER C_ERR_CLAS_PPS_PLAUS_0 FORMAT "%3.0" /end CHARACTERISTIC
/begin CHARACTERISTIC fmy_id_pps_cal_0.dtc[0] "diagnostic trouble codes for diagnosis instance PPS_CAL_0" CURVE 0x85cd7e _REC_CUR_20_u2_u2 65535. _CNV_A_R_LINEAR_____1_CM 0. 65535. DISPLAY_IDENTIFIER ID_ERR_DTC_PPS_CAL_0 FORMAT "%5.0"
 /begin AXIS_DESCR COM_AXIS online_dummy _CNV_A_R_LINEAR_____0_CM 6 0. 5. FORMAT "%2.0" AXIS_PTS_REF ldp_fmy_dtc /end AXIS_DESCR
/end CHARACTERISTIC
/begin CHARACTERISTIC fmy_id_pps_cal_0.envd "environmental data contents of customer specific freeze frame for diagnosis instance PPS_CAL_0" CURVE 0x85cd8a _REC_CUR_20_u1_u1 255. _CNV_A_R_LINEAR_____1_CM 0. 255. DISPLAY_IDENTIFIER ID_ERR_ENVD_PPS_CAL_0 FORMAT "%3.0"
 /begin AXIS_DESCR COM_AXIS online_dummy _CNV_A_R_LINEAR_____0_CM 8 0. 7. READ_ONLY FORMAT "%2.0" AXIS_PTS_REF ldp_fmy_envd /end AXIS_DESCR
/end CHARACTERISTIC
/begin CHARACTERISTIC fmy_id_pps_cal_0.c_err_clas "error class for diagnosis instance PPS_CAL_0" VALUE 0x85cd92 _REC_VAL_20_u1 255. _CNV_A_R_LINEAR_____1_CM 0. 255. DISPLAY_IDENTIFIER C_ERR_CLAS_PPS_CAL_0 FORMAT "%3.0" /end CHARACTERISTIC
/begin CHARACTERISTIC fmy_id_pps_v_inj_0.dtc[0] "diagnostic trouble codes for diagnosis instance PPS_V_INJ_0" CURVE 0x85cd94 _REC_CUR_20_u2_u2 65535. _CNV_A_R_LINEAR_____1_CM 0. 65535. DISPLAY_IDENTIFIER ID_ERR_DTC_PPS_V_INJ_0 FORMAT "%5.0"
 /begin AXIS_DESCR COM_AXIS online_dummy _CNV_A_R_LINEAR_____0_CM 6 0. 5. FORMAT "%2.0" AXIS_PTS_REF ldp_fmy_dtc /end AXIS_DESCR
/end CHARACTERISTIC
/begin CHARACTERISTIC fmy_id_pps_v_inj_0.envd "environmental data contents of customer specific freeze frame for diagnosis instance PPS_V_INJ_0" CURVE 0x85cda0 _REC_CUR_20_u1_u1 255. _CNV_A_R_LINEAR_____1_CM 0. 255. DISPLAY_IDENTIFIER ID_ERR_ENVD_PPS_V_INJ_0 FORMAT "%3.0"
 /begin AXIS_DESCR COM_AXIS online_dummy _CNV_A_R_LINEAR_____0_CM 8 0. 7. READ_ONLY FORMAT "%2.0" AXIS_PTS_REF ldp_fmy_envd /end AXIS_DESCR
/end CHARACTERISTIC
/begin CHARACTERISTIC fmy_id_pps_v_inj_0.c_err_clas "error class for diagnosis instance PPS_V_INJ_0" VALUE 0x85cda8 _REC_VAL_20_u1 255. _CNV_A_R_LINEAR_____1_CM 0. 255. DISPLAY_IDENTIFIER C_ERR_CLAS_PPS_V_INJ_0 FORMAT "%3.0" /end CHARACTERISTIC
/begin CHARACTERISTIC fmy_id_pps_wdt_0.dtc[0] "diagnostic trouble codes for diagnosis instance PPS_WDT_0" CURVE 0x85cdaa _REC_CUR_20_u2_u2 65535. _CNV_A_R_LINEAR_____1_CM 0. 65535. DISPLAY_IDENTIFIER ID_ERR_DTC_PPS_WDT_0 FORMAT "%5.0"
 /begin AXIS_DESCR COM_AXIS online_dummy _CNV_A_R_LINEAR_____0_CM 6 0. 5. FORMAT "%2.0" AXIS_PTS_REF ldp_fmy_dtc /end AXIS_DESCR
/end CHARACTERISTIC
/begin CHARACTERISTIC fmy_id_pps_wdt_0.envd "environmental data contents of customer specific freeze frame for diagnosis instance PPS_WDT_0" CURVE 0x85cdb6 _REC_CUR_20_u1_u1 255. _CNV_A_R_LINEAR_____1_CM 0. 255. DISPLAY_IDENTIFIER ID_ERR_ENVD_PPS_WDT_0 FORMAT "%3.0"
 /begin AXIS_DESCR COM_AXIS online_dummy _CNV_A_R_LINEAR_____0_CM 8 0. 7. READ_ONLY FORMAT "%2.0" AXIS_PTS_REF ldp_fmy_envd /end AXIS_DESCR
/end CHARACTERISTIC
/begin CHARACTERISTIC fmy_id_pps_wdt_0.c_err_clas "error class for diagnosis instance PPS_WDT_0" VALUE 0x85cdbe _REC_VAL_20_u1 255. _CNV_A_R_LINEAR_____1_CM 0. 255. DISPLAY_IDENTIFIER C_ERR_CLAS_PPS_WDT_0 FORMAT "%3.0" /end CHARACTERISTIC
/begin CHARACTERISTIC fmy_id_pps_fsm_0.dtc[0] "diagnostic trouble codes for diagnosis instance PPS_FSM_0" CURVE 0x85cdc0 _REC_CUR_20_u2_u2 65535. _CNV_A_R_LINEAR_____1_CM 0. 65535. DISPLAY_IDENTIFIER ID_ERR_DTC_PPS_FSM_0 FORMAT "%5.0"
 /begin AXIS_DESCR COM_AXIS online_dummy _CNV_A_R_LINEAR_____0_CM 6 0. 5. FORMAT "%2.0" AXIS_PTS_REF ldp_fmy_dtc /end AXIS_DESCR
/end CHARACTERISTIC
/begin CHARACTERISTIC fmy_id_pps_fsm_0.envd "environmental data contents of customer specific freeze frame for diagnosis instance PPS_FSM_0" CURVE 0x85cdcc _REC_CUR_20_u1_u1 255. _CNV_A_R_LINEAR_____1_CM 0. 255. DISPLAY_IDENTIFIER ID_ERR_ENVD_PPS_FSM_0 FORMAT "%3.0"
 /begin AXIS_DESCR COM_AXIS online_dummy _CNV_A_R_LINEAR_____0_CM 8 0. 7. READ_ONLY FORMAT "%2.0" AXIS_PTS_REF ldp_fmy_envd /end AXIS_DESCR
/end CHARACTERISTIC
/begin CHARACTERISTIC fmy_id_pps_fsm_0.c_err_clas "error class for diagnosis instance PPS_FSM_0" VALUE 0x85cdd4 _REC_VAL_20_u1 255. _CNV_A_R_LINEAR_____1_CM 0. 255. DISPLAY_IDENTIFIER C_ERR_CLAS_PPS_FSM_0 FORMAT "%3.0" /end CHARACTERISTIC
/begin CHARACTERISTIC fmy_id_pps_oc_0.dtc[0] "diagnostic trouble codes for diagnosis instance PPS_OC_0" CURVE 0x85cdd6 _REC_CUR_20_u2_u2 65535. _CNV_A_R_LINEAR_____1_CM 0. 65535. DISPLAY_IDENTIFIER ID_ERR_DTC_PPS_OC_0 FORMAT "%5.0"
 /begin AXIS_DESCR COM_AXIS online_dummy _CNV_A_R_LINEAR_____0_CM 6 0. 5. FORMAT "%2.0" AXIS_PTS_REF ldp_fmy_dtc /end AXIS_DESCR
/end CHARACTERISTIC
/begin CHARACTERISTIC fmy_id_pps_oc_0.envd "environmental data contents of customer specific freeze frame for diagnosis instance PPS_OC_0" CURVE 0x85cde2 _REC_CUR_20_u1_u1 255. _CNV_A_R_LINEAR_____1_CM 0. 255. DISPLAY_IDENTIFIER ID_ERR_ENVD_PPS_OC_0 FORMAT "%3.0"
 /begin AXIS_DESCR COM_AXIS online_dummy _CNV_A_R_LINEAR_____0_CM 8 0. 7. READ_ONLY FORMAT "%2.0" AXIS_PTS_REF ldp_fmy_envd /end AXIS_DESCR
/end CHARACTERISTIC
/begin CHARACTERISTIC fmy_id_pps_oc_0.c_err_clas "error class for diagnosis instance PPS_OC_0" VALUE 0x85cdea _REC_VAL_20_u1 255. _CNV_A_R_LINEAR_____1_CM 0. 255. DISPLAY_IDENTIFIER C_ERR_CLAS_PPS_OC_0 FORMAT "%3.0" /end CHARACTERISTIC
/begin CHARACTERISTIC fmy_id_pps_oc_1.dtc[0] "diagnostic trouble codes for diagnosis instance PPS_OC_1" CURVE 0x85cdec _REC_CUR_20_u2_u2 65535. _CNV_A_R_LINEAR_____1_CM 0. 65535. DISPLAY_IDENTIFIER ID_ERR_DTC_PPS_OC_1 FORMAT "%5.0"
 /begin AXIS_DESCR COM_AXIS online_dummy _CNV_A_R_LINEAR_____0_CM 6 0. 5. FORMAT "%2.0" AXIS_PTS_REF ldp_fmy_dtc /end AXIS_DESCR
/end CHARACTERISTIC
/begin CHARACTERISTIC fmy_id_pps_oc_1.envd "environmental data contents of customer specific freeze frame for diagnosis instance PPS_OC_1" CURVE 0x85cdf8 _REC_CUR_20_u1_u1 255. _CNV_A_R_LINEAR_____1_CM 0. 255. DISPLAY_IDENTIFIER ID_ERR_ENVD_PPS_OC_1 FORMAT "%3.0"
 /begin AXIS_DESCR COM_AXIS online_dummy _CNV_A_R_LINEAR_____0_CM 8 0. 7. READ_ONLY FORMAT "%2.0" AXIS_PTS_REF ldp_fmy_envd /end AXIS_DESCR
/end CHARACTERISTIC
/begin CHARACTERISTIC fmy_id_pps_oc_1.c_err_clas "error class for diagnosis instance PPS_OC_1" VALUE 0x85ce00 _REC_VAL_20_u1 255. _CNV_A_R_LINEAR_____1_CM 0. 255. DISPLAY_IDENTIFIER C_ERR_CLAS_PPS_OC_1 FORMAT "%3.0" /end CHARACTERISTIC
/begin CHARACTERISTIC fmy_id_pps_oc_2.dtc[0] "diagnostic trouble codes for diagnosis instance PPS_OC_2" CURVE 0x85ce02 _REC_CUR_20_u2_u2 65535. _CNV_A_R_LINEAR_____1_CM 0. 65535. DISPLAY_IDENTIFIER ID_ERR_DTC_PPS_OC_2 FORMAT "%5.0"
 /begin AXIS_DESCR COM_AXIS online_dummy _CNV_A_R_LINEAR_____0_CM 6 0. 5. FORMAT "%2.0" AXIS_PTS_REF ldp_fmy_dtc /end AXIS_DESCR
/end CHARACTERISTIC
/begin CHARACTERISTIC fmy_id_pps_oc_2.envd "environmental data contents of customer specific freeze frame for diagnosis instance PPS_OC_2" CURVE 0x85ce0e _REC_CUR_20_u1_u1 255. _CNV_A_R_LINEAR_____1_CM 0. 255. DISPLAY_IDENTIFIER ID_ERR_ENVD_PPS_OC_2 FORMAT "%3.0"
 /begin AXIS_DESCR COM_AXIS online_dummy _CNV_A_R_LINEAR_____0_CM 8 0. 7. READ_ONLY FORMAT "%2.0" AXIS_PTS_REF ldp_fmy_envd /end AXIS_DESCR
/end CHARACTERISTIC
/begin CHARACTERISTIC fmy_id_pps_oc_2.c_err_clas "error class for diagnosis instance PPS_OC_2" VALUE 0x85ce16 _REC_VAL_20_u1 255. _CNV_A_R_LINEAR_____1_CM 0. 255. DISPLAY_IDENTIFIER C_ERR_CLAS_PPS_OC_2 FORMAT "%3.0" /end CHARACTERISTIC
/begin CHARACTERISTIC fmy_id_pps_oc_3.dtc[0] "diagnostic trouble codes for diagnosis instance PPS_OC_3" CURVE 0x85ce18 _REC_CUR_20_u2_u2 65535. _CNV_A_R_LINEAR_____1_CM 0. 65535. DISPLAY_IDENTIFIER ID_ERR_DTC_PPS_OC_3 FORMAT "%5.0"
 /begin AXIS_DESCR COM_AXIS online_dummy _CNV_A_R_LINEAR_____0_CM 6 0. 5. FORMAT "%2.0" AXIS_PTS_REF ldp_fmy_dtc /end AXIS_DESCR
/end CHARACTERISTIC
/begin CHARACTERISTIC fmy_id_pps_oc_3.envd "environmental data contents of customer specific freeze frame for diagnosis instance PPS_OC_3" CURVE 0x85ce24 _REC_CUR_20_u1_u1 255. _CNV_A_R_LINEAR_____1_CM 0. 255. DISPLAY_IDENTIFIER ID_ERR_ENVD_PPS_OC_3 FORMAT "%3.0"
 /begin AXIS_DESCR COM_AXIS online_dummy _CNV_A_R_LINEAR_____0_CM 8 0. 7. READ_ONLY FORMAT "%2.0" AXIS_PTS_REF ldp_fmy_envd /end AXIS_DESCR
/end CHARACTERISTIC
/begin CHARACTERISTIC fmy_id_pps_oc_3.c_err_clas "error class for diagnosis instance PPS_OC_3" VALUE 0x85ce2c _REC_VAL_20_u1 255. _CNV_A_R_LINEAR_____1_CM 0. 255. DISPLAY_IDENTIFIER C_ERR_CLAS_PPS_OC_3 FORMAT "%3.0" /end CHARACTERISTIC
/begin CHARACTERISTIC fmy_id_pps_sc_h_l_0.dtc[0] "diagnostic trouble codes for diagnosis instance PPS_SC_H_L_0" CURVE 0x85ce2e _REC_CUR_20_u2_u2 65535. _CNV_A_R_LINEAR_____1_CM 0. 65535. DISPLAY_IDENTIFIER ID_ERR_DTC_PPS_SC_H_L_0 FORMAT "%5.0"
 /begin AXIS_DESCR COM_AXIS online_dummy _CNV_A_R_LINEAR_____0_CM 6 0. 5. FORMAT "%2.0" AXIS_PTS_REF ldp_fmy_dtc /end AXIS_DESCR
/end CHARACTERISTIC
/begin CHARACTERISTIC fmy_id_pps_sc_h_l_0.envd "environmental data contents of customer specific freeze frame for diagnosis instance PPS_SC_H_L_0" CURVE 0x85ce3a _REC_CUR_20_u1_u1 255. _CNV_A_R_LINEAR_____1_CM 0. 255. DISPLAY_IDENTIFIER ID_ERR_ENVD_PPS_SC_H_L_0 FORMAT "%3.0"
 /begin AXIS_DESCR COM_AXIS online_dummy _CNV_A_R_LINEAR_____0_CM 8 0. 7. READ_ONLY FORMAT "%2.0" AXIS_PTS_REF ldp_fmy_envd /end AXIS_DESCR
/end CHARACTERISTIC
/begin CHARACTERISTIC fmy_id_pps_sc_h_l_0.c_err_clas "error class for diagnosis instance PPS_SC_H_L_0" VALUE 0x85ce42 _REC_VAL_20_u1 255. _CNV_A_R_LINEAR_____1_CM 0. 255. DISPLAY_IDENTIFIER C_ERR_CLAS_PPS_SC_H_L_0 FORMAT "%3.0" /end CHARACTERISTIC
/begin CHARACTERISTIC fmy_id_pps_sc_h_l_1.dtc[0] "diagnostic trouble codes for diagnosis instance PPS_SC_H_L_1" CURVE 0x85ce44 _REC_CUR_20_u2_u2 65535. _CNV_A_R_LINEAR_____1_CM 0. 65535. DISPLAY_IDENTIFIER ID_ERR_DTC_PPS_SC_H_L_1 FORMAT "%5.0"
 /begin AXIS_DESCR COM_AXIS online_dummy _CNV_A_R_LINEAR_____0_CM 6 0. 5. FORMAT "%2.0" AXIS_PTS_REF ldp_fmy_dtc /end AXIS_DESCR
/end CHARACTERISTIC
/begin CHARACTERISTIC fmy_id_pps_sc_h_l_1.envd "environmental data contents of customer specific freeze frame for diagnosis instance PPS_SC_H_L_1" CURVE 0x85ce50 _REC_CUR_20_u1_u1 255. _CNV_A_R_LINEAR_____1_CM 0. 255. DISPLAY_IDENTIFIER ID_ERR_ENVD_PPS_SC_H_L_1 FORMAT "%3.0"
 /begin AXIS_DESCR COM_AXIS online_dummy _CNV_A_R_LINEAR_____0_CM 8 0. 7. READ_ONLY FORMAT "%2.0" AXIS_PTS_REF ldp_fmy_envd /end AXIS_DESCR
/end CHARACTERISTIC
/begin CHARACTERISTIC fmy_id_pps_sc_h_l_1.c_err_clas "error class for diagnosis instance PPS_SC_H_L_1" VALUE 0x85ce58 _REC_VAL_20_u1 255. _CNV_A_R_LINEAR_____1_CM 0. 255. DISPLAY_IDENTIFIER C_ERR_CLAS_PPS_SC_H_L_1 FORMAT "%3.0" /end CHARACTERISTIC
/begin CHARACTERISTIC fmy_id_pps_sc_h_l_2.dtc[0] "diagnostic trouble codes for diagnosis instance PPS_SC_H_L_2" CURVE 0x85ce5a _REC_CUR_20_u2_u2 65535. _CNV_A_R_LINEAR_____1_CM 0. 65535. DISPLAY_IDENTIFIER ID_ERR_DTC_PPS_SC_H_L_2 FORMAT "%5.0"
 /begin AXIS_DESCR COM_AXIS online_dummy _CNV_A_R_LINEAR_____0_CM 6 0. 5. FORMAT "%2.0" AXIS_PTS_REF ldp_fmy_dtc /end AXIS_DESCR
/end CHARACTERISTIC
/begin CHARACTERISTIC fmy_id_pps_sc_h_l_2.envd "environmental data contents of customer specific freeze frame for diagnosis instance PPS_SC_H_L_2" CURVE 0x85ce66 _REC_CUR_20_u1_u1 255. _CNV_A_R_LINEAR_____1_CM 0. 255. DISPLAY_IDENTIFIER ID_ERR_ENVD_PPS_SC_H_L_2 FORMAT "%3.0"
 /begin AXIS_DESCR COM_AXIS online_dummy _CNV_A_R_LINEAR_____0_CM 8 0. 7. READ_ONLY FORMAT "%2.0" AXIS_PTS_REF ldp_fmy_envd /end AXIS_DESCR
/end CHARACTERISTIC
/begin CHARACTERISTIC fmy_id_pps_sc_h_l_2.c_err_clas "error class for diagnosis instance PPS_SC_H_L_2" VALUE 0x85ce6e _REC_VAL_20_u1 255. _CNV_A_R_LINEAR_____1_CM 0. 255. DISPLAY_IDENTIFIER C_ERR_CLAS_PPS_SC_H_L_2 FORMAT "%3.0" /end CHARACTERISTIC
/begin CHARACTERISTIC fmy_id_pps_sc_h_l_3.dtc[0] "diagnostic trouble codes for diagnosis instance PPS_SC_H_L_3" CURVE 0x85ce70 _REC_CUR_20_u2_u2 65535. _CNV_A_R_LINEAR_____1_CM 0. 65535. DISPLAY_IDENTIFIER ID_ERR_DTC_PPS_SC_H_L_3 FORMAT "%5.0"
 /begin AXIS_DESCR COM_AXIS online_dummy _CNV_A_R_LINEAR_____0_CM 6 0. 5. FORMAT "%2.0" AXIS_PTS_REF ldp_fmy_dtc /end AXIS_DESCR
/end CHARACTERISTIC
/begin CHARACTERISTIC fmy_id_pps_sc_h_l_3.envd "environmental data contents of customer specific freeze frame for diagnosis instance PPS_SC_H_L_3" CURVE 0x85ce7c _REC_CUR_20_u1_u1 255. _CNV_A_R_LINEAR_____1_CM 0. 255. DISPLAY_IDENTIFIER ID_ERR_ENVD_PPS_SC_H_L_3 FORMAT "%3.0"
 /begin AXIS_DESCR COM_AXIS online_dummy _CNV_A_R_LINEAR_____0_CM 8 0. 7. READ_ONLY FORMAT "%2.0" AXIS_PTS_REF ldp_fmy_envd /end AXIS_DESCR
/end CHARACTERISTIC
/begin CHARACTERISTIC fmy_id_pps_sc_h_l_3.c_err_clas "error class for diagnosis instance PPS_SC_H_L_3" VALUE 0x85ce84 _REC_VAL_20_u1 255. _CNV_A_R_LINEAR_____1_CM 0. 255. DISPLAY_IDENTIFIER C_ERR_CLAS_PPS_SC_H_L_3 FORMAT "%3.0" /end CHARACTERISTIC
/begin CHARACTERISTIC fmy_id_pps_sc_h_0.dtc[0] "diagnostic trouble codes for diagnosis instance PPS_SC_H_0" CURVE 0x85ce86 _REC_CUR_20_u2_u2 65535. _CNV_A_R_LINEAR_____1_CM 0. 65535. DISPLAY_IDENTIFIER ID_ERR_DTC_PPS_SC_H_0 FORMAT "%5.0"
 /begin AXIS_DESCR COM_AXIS online_dummy _CNV_A_R_LINEAR_____0_CM 6 0. 5. FORMAT "%2.0" AXIS_PTS_REF ldp_fmy_dtc /end AXIS_DESCR
/end CHARACTERISTIC
/begin CHARACTERISTIC fmy_id_pps_sc_h_0.envd "environmental data contents of customer specific freeze frame for diagnosis instance PPS_SC_H_0" CURVE 0x85ce92 _REC_CUR_20_u1_u1 255. _CNV_A_R_LINEAR_____1_CM 0. 255. DISPLAY_IDENTIFIER ID_ERR_ENVD_PPS_SC_H_0 FORMAT "%3.0"
 /begin AXIS_DESCR COM_AXIS online_dummy _CNV_A_R_LINEAR_____0_CM 8 0. 7. READ_ONLY FORMAT "%2.0" AXIS_PTS_REF ldp_fmy_envd /end AXIS_DESCR
/end CHARACTERISTIC
/begin CHARACTERISTIC fmy_id_pps_sc_h_0.c_err_clas "error class for diagnosis instance PPS_SC_H_0" VALUE 0x85ce9a _REC_VAL_20_u1 255. _CNV_A_R_LINEAR_____1_CM 0. 255. DISPLAY_IDENTIFIER C_ERR_CLAS_PPS_SC_H_0 FORMAT "%3.0" /end CHARACTERISTIC
/begin CHARACTERISTIC fmy_id_pps_sc_l_0.dtc[0] "diagnostic trouble codes for diagnosis instance PPS_SC_L_0" CURVE 0x85ce9c _REC_CUR_20_u2_u2 65535. _CNV_A_R_LINEAR_____1_CM 0. 65535. DISPLAY_IDENTIFIER ID_ERR_DTC_PPS_SC_L_0 FORMAT "%5.0"
 /begin AXIS_DESCR COM_AXIS online_dummy _CNV_A_R_LINEAR_____0_CM 6 0. 5. FORMAT "%2.0" AXIS_PTS_REF ldp_fmy_dtc /end AXIS_DESCR
/end CHARACTERISTIC
/begin CHARACTERISTIC fmy_id_pps_sc_l_0.envd "environmental data contents of customer specific freeze frame for diagnosis instance PPS_SC_L_0" CURVE 0x85cea8 _REC_CUR_20_u1_u1 255. _CNV_A_R_LINEAR_____1_CM 0. 255. DISPLAY_IDENTIFIER ID_ERR_ENVD_PPS_SC_L_0 FORMAT "%3.0"
 /begin AXIS_DESCR COM_AXIS online_dummy _CNV_A_R_LINEAR_____0_CM 8 0. 7. READ_ONLY FORMAT "%2.0" AXIS_PTS_REF ldp_fmy_envd /end AXIS_DESCR
/end CHARACTERISTIC
/begin CHARACTERISTIC fmy_id_pps_sc_l_0.c_err_clas "error class for diagnosis instance PPS_SC_L_0" VALUE 0x85ceb0 _REC_VAL_20_u1 255. _CNV_A_R_LINEAR_____1_CM 0. 255. DISPLAY_IDENTIFIER C_ERR_CLAS_PPS_SC_L_0 FORMAT "%3.0" /end CHARACTERISTIC
/begin CHARACTERISTIC fmy_id_bpa.dtc[0] "diagnostic trouble codes for diagnosis instance BPA" CURVE 0x85ceb2 _REC_CUR_20_u2_u2 65535. _CNV_A_R_LINEAR_____1_CM 0. 65535. DISPLAY_IDENTIFIER ID_ERR_DTC_BPA FORMAT "%5.0"
 /begin AXIS_DESCR COM_AXIS online_dummy _CNV_A_R_LINEAR_____0_CM 6 0. 5. FORMAT "%2.0" AXIS_PTS_REF ldp_fmy_dtc /end AXIS_DESCR
/end CHARACTERISTIC
/begin CHARACTERISTIC fmy_id_bpa.envd "environmental data contents of customer specific freeze frame for diagnosis instance BPA" CURVE 0x85cebe _REC_CUR_20_u1_u1 255. _CNV_A_R_LINEAR_____1_CM 0. 255. DISPLAY_IDENTIFIER ID_ERR_ENVD_BPA FORMAT "%3.0"
 /begin AXIS_DESCR COM_AXIS online_dummy _CNV_A_R_LINEAR_____0_CM 8 0. 7. READ_ONLY FORMAT "%2.0" AXIS_PTS_REF ldp_fmy_envd /end AXIS_DESCR
/end CHARACTERISTIC
/begin CHARACTERISTIC fmy_id_bpa.c_err_clas "error class for diagnosis instance BPA" VALUE 0x85cec6 _REC_VAL_20_u1 255. _CNV_A_R_LINEAR_____1_CM 0. 255. DISPLAY_IDENTIFIER C_ERR_CLAS_BPA FORMAT "%3.0" /end CHARACTERISTIC
/begin CHARACTERISTIC fmy_id_egrv.dtc[0] "diagnostic trouble codes for diagnosis instance EGRV" CURVE 0x85cec8 _REC_CUR_20_u2_u2 65535. _CNV_A_R_LINEAR_____1_CM 0. 65535. DISPLAY_IDENTIFIER ID_ERR_DTC_EGRV FORMAT "%5.0"
 /begin AXIS_DESCR COM_AXIS online_dummy _CNV_A_R_LINEAR_____0_CM 6 0. 5. FORMAT "%2.0" AXIS_PTS_REF ldp_fmy_dtc /end AXIS_DESCR
/end CHARACTERISTIC
/begin CHARACTERISTIC fmy_id_egrv.envd "environmental data contents of customer specific freeze frame for diagnosis instance EGRV" CURVE 0x85ced4 _REC_CUR_20_u1_u1 255. _CNV_A_R_LINEAR_____1_CM 0. 255. DISPLAY_IDENTIFIER ID_ERR_ENVD_EGRV FORMAT "%3.0"
 /begin AXIS_DESCR COM_AXIS online_dummy _CNV_A_R_LINEAR_____0_CM 8 0. 7. READ_ONLY FORMAT "%2.0" AXIS_PTS_REF ldp_fmy_envd /end AXIS_DESCR
/end CHARACTERISTIC
/begin CHARACTERISTIC fmy_id_egrv.c_err_clas "error class for diagnosis instance EGRV" VALUE 0x85cedc _REC_VAL_20_u1 255. _CNV_A_R_LINEAR_____1_CM 0. 255. DISPLAY_IDENTIFIER C_ERR_CLAS_EGRV FORMAT "%3.0" /end CHARACTERISTIC
/begin CHARACTERISTIC fmy_id_fsd_1.dtc[0] "diagnostic trouble codes for diagnosis instance FSD_1" CURVE 0x85cede _REC_CUR_20_u2_u2 65535. _CNV_A_R_LINEAR_____1_CM 0. 65535. DISPLAY_IDENTIFIER ID_ERR_DTC_FSD_1 FORMAT "%5.0"
 /begin AXIS_DESCR COM_AXIS online_dummy _CNV_A_R_LINEAR_____0_CM 6 0. 5. FORMAT "%2.0" AXIS_PTS_REF ldp_fmy_dtc /end AXIS_DESCR
/end CHARACTERISTIC
/begin CHARACTERISTIC fmy_id_fsd_1.envd "environmental data contents of customer specific freeze frame for diagnosis instance FSD_1" CURVE 0x85ceea _REC_CUR_20_u1_u1 255. _CNV_A_R_LINEAR_____1_CM 0. 255. DISPLAY_IDENTIFIER ID_ERR_ENVD_FSD_1 FORMAT "%3.0"
 /begin AXIS_DESCR COM_AXIS online_dummy _CNV_A_R_LINEAR_____0_CM 8 0. 7. READ_ONLY FORMAT "%2.0" AXIS_PTS_REF ldp_fmy_envd /end AXIS_DESCR
/end CHARACTERISTIC
/begin CHARACTERISTIC fmy_id_fsd_1.c_err_clas "error class for diagnosis instance FSD_1" VALUE 0x85cef2 _REC_VAL_20_u1 255. _CNV_A_R_LINEAR_____1_CM 0. 255. DISPLAY_IDENTIFIER C_ERR_CLAS_FSD_1 FORMAT "%3.0" /end CHARACTERISTIC
/begin CHARACTERISTIC fmy_id_gl_rly_dps.dtc[0] "diagnostic trouble codes for diagnosis instance GL_RLY_DPS" CURVE 0x85cef4 _REC_CUR_20_u2_u2 65535. _CNV_A_R_LINEAR_____1_CM 0. 65535. DISPLAY_IDENTIFIER ID_ERR_DTC_GL_RLY_DPS FORMAT "%5.0"
 /begin AXIS_DESCR COM_AXIS online_dummy _CNV_A_R_LINEAR_____0_CM 6 0. 5. FORMAT "%2.0" AXIS_PTS_REF ldp_fmy_dtc /end AXIS_DESCR
/end CHARACTERISTIC
/begin CHARACTERISTIC fmy_id_gl_rly_dps.envd "environmental data contents of customer specific freeze frame for diagnosis instance GL_RLY_DPS" CURVE 0x85cf00 _REC_CUR_20_u1_u1 255. _CNV_A_R_LINEAR_____1_CM 0. 255. DISPLAY_IDENTIFIER ID_ERR_ENVD_GL_RLY_DPS FORMAT "%3.0"
 /begin AXIS_DESCR COM_AXIS online_dummy _CNV_A_R_LINEAR_____0_CM 8 0. 7. READ_ONLY FORMAT "%2.0" AXIS_PTS_REF ldp_fmy_envd /end AXIS_DESCR
/end CHARACTERISTIC
/begin CHARACTERISTIC fmy_id_gl_rly_dps.c_err_clas "error class for diagnosis instance GL_RLY_DPS" VALUE 0x85cf08 _REC_VAL_20_u1 255. _CNV_A_R_LINEAR_____1_CM 0. 255. DISPLAY_IDENTIFIER C_ERR_CLAS_GL_RLY_DPS FORMAT "%3.0" /end CHARACTERISTIC
/begin CHARACTERISTIC fmy_id_mis_a.dtc[0] "diagnostic trouble codes for diagnosis instance MIS_A" CURVE 0x85cf0a _REC_CUR_20_u2_u2 65535. _CNV_A_R_LINEAR_____1_CM 0. 65535. DISPLAY_IDENTIFIER ID_ERR_DTC_MIS_A FORMAT "%5.0"
 /begin AXIS_DESCR COM_AXIS online_dummy _CNV_A_R_LINEAR_____0_CM 6 0. 5. FORMAT "%2.0" AXIS_PTS_REF ldp_fmy_dtc /end AXIS_DESCR
/end CHARACTERISTIC
/begin CHARACTERISTIC fmy_id_mis_a.envd "environmental data contents of customer specific freeze frame for diagnosis instance MIS_A" CURVE 0x85cf16 _REC_CUR_20_u1_u1 255. _CNV_A_R_LINEAR_____1_CM 0. 255. DISPLAY_IDENTIFIER ID_ERR_ENVD_MIS_A FORMAT "%3.0"
 /begin AXIS_DESCR COM_AXIS online_dummy _CNV_A_R_LINEAR_____0_CM 8 0. 7. READ_ONLY FORMAT "%2.0" AXIS_PTS_REF ldp_fmy_envd /end AXIS_DESCR
/end CHARACTERISTIC
/begin CHARACTERISTIC fmy_id_mis_a.c_err_clas "error class for diagnosis instance MIS_A" VALUE 0x85cf1e _REC_VAL_20_u1 255. _CNV_A_R_LINEAR_____1_CM 0. 255. DISPLAY_IDENTIFIER C_ERR_CLAS_MIS_A FORMAT "%3.0" /end CHARACTERISTIC
/begin CHARACTERISTIC fmy_id_mis_b1.dtc[0] "diagnostic trouble codes for diagnosis instance MIS_B1" CURVE 0x85cf20 _REC_CUR_20_u2_u2 65535. _CNV_A_R_LINEAR_____1_CM 0. 65535. DISPLAY_IDENTIFIER ID_ERR_DTC_MIS_B1 FORMAT "%5.0"
 /begin AXIS_DESCR COM_AXIS online_dummy _CNV_A_R_LINEAR_____0_CM 6 0. 5. FORMAT "%2.0" AXIS_PTS_REF ldp_fmy_dtc /end AXIS_DESCR
/end CHARACTERISTIC
/begin CHARACTERISTIC fmy_id_mis_b1.envd "environmental data contents of customer specific freeze frame for diagnosis instance MIS_B1" CURVE 0x85cf2c _REC_CUR_20_u1_u1 255. _CNV_A_R_LINEAR_____1_CM 0. 255. DISPLAY_IDENTIFIER ID_ERR_ENVD_MIS_B1 FORMAT "%3.0"
 /begin AXIS_DESCR COM_AXIS online_dummy _CNV_A_R_LINEAR_____0_CM 8 0. 7. READ_ONLY FORMAT "%2.0" AXIS_PTS_REF ldp_fmy_envd /end AXIS_DESCR
/end CHARACTERISTIC
/begin CHARACTERISTIC fmy_id_mis_b1.c_err_clas "error class for diagnosis instance MIS_B1" VALUE 0x85cf34 _REC_VAL_20_u1 255. _CNV_A_R_LINEAR_____1_CM 0. 255. DISPLAY_IDENTIFIER C_ERR_CLAS_MIS_B1 FORMAT "%3.0" /end CHARACTERISTIC
/begin CHARACTERISTIC fmy_id_mis_b4.dtc[0] "diagnostic trouble codes for diagnosis instance MIS_B4" CURVE 0x85cf36 _REC_CUR_20_u2_u2 65535. _CNV_A_R_LINEAR_____1_CM 0. 65535. DISPLAY_IDENTIFIER ID_ERR_DTC_MIS_B4 FORMAT "%5.0"
 /begin AXIS_DESCR COM_AXIS online_dummy _CNV_A_R_LINEAR_____0_CM 6 0. 5. FORMAT "%2.0" AXIS_PTS_REF ldp_fmy_dtc /end AXIS_DESCR
/end CHARACTERISTIC
/begin CHARACTERISTIC fmy_id_mis_b4.envd "environmental data contents of customer specific freeze frame for diagnosis instance MIS_B4" CURVE 0x85cf42 _REC_CUR_20_u1_u1 255. _CNV_A_R_LINEAR_____1_CM 0. 255. DISPLAY_IDENTIFIER ID_ERR_ENVD_MIS_B4 FORMAT "%3.0"
 /begin AXIS_DESCR COM_AXIS online_dummy _CNV_A_R_LINEAR_____0_CM 8 0. 7. READ_ONLY FORMAT "%2.0" AXIS_PTS_REF ldp_fmy_envd /end AXIS_DESCR
/end CHARACTERISTIC
/begin CHARACTERISTIC fmy_id_mis_b4.c_err_clas "error class for diagnosis instance MIS_B4" VALUE 0x85cf4a _REC_VAL_20_u1 255. _CNV_A_R_LINEAR_____1_CM 0. 255. DISPLAY_IDENTIFIER C_ERR_CLAS_MIS_B4 FORMAT "%3.0" /end CHARACTERISTIC
/begin CHARACTERISTIC fmy_id_pcv_1.dtc[0] "diagnostic trouble codes for diagnosis instance PCV_1" CURVE 0x85cf4c _REC_CUR_20_u2_u2 65535. _CNV_A_R_LINEAR_____1_CM 0. 65535. DISPLAY_IDENTIFIER ID_ERR_DTC_PCV_1 FORMAT "%5.0"
 /begin AXIS_DESCR COM_AXIS online_dummy _CNV_A_R_LINEAR_____0_CM 6 0. 5. FORMAT "%2.0" AXIS_PTS_REF ldp_fmy_dtc /end AXIS_DESCR
/end CHARACTERISTIC
/begin CHARACTERISTIC fmy_id_pcv_1.envd "environmental data contents of customer specific freeze frame for diagnosis instance PCV_1" CURVE 0x85cf58 _REC_CUR_20_u1_u1 255. _CNV_A_R_LINEAR_____1_CM 0. 255. DISPLAY_IDENTIFIER ID_ERR_ENVD_PCV_1 FORMAT "%3.0"
 /begin AXIS_DESCR COM_AXIS online_dummy _CNV_A_R_LINEAR_____0_CM 8 0. 7. READ_ONLY FORMAT "%2.0" AXIS_PTS_REF ldp_fmy_envd /end AXIS_DESCR
/end CHARACTERISTIC
/begin CHARACTERISTIC fmy_id_pcv_1.c_err_clas "error class for diagnosis instance PCV_1" VALUE 0x85cf60 _REC_VAL_20_u1 255. _CNV_A_R_LINEAR_____1_CM 0. 255. DISPLAY_IDENTIFIER C_ERR_CLAS_PCV_1 FORMAT "%3.0" /end CHARACTERISTIC
/begin CHARACTERISTIC fmy_id_pcv_2.dtc[0] "diagnostic trouble codes for diagnosis instance PCV_2" CURVE 0x85cf62 _REC_CUR_20_u2_u2 65535. _CNV_A_R_LINEAR_____1_CM 0. 65535. DISPLAY_IDENTIFIER ID_ERR_DTC_PCV_2 FORMAT "%5.0"
 /begin AXIS_DESCR COM_AXIS online_dummy _CNV_A_R_LINEAR_____0_CM 6 0. 5. FORMAT "%2.0" AXIS_PTS_REF ldp_fmy_dtc /end AXIS_DESCR
/end CHARACTERISTIC
/begin CHARACTERISTIC fmy_id_pcv_2.envd "environmental data contents of customer specific freeze frame for diagnosis instance PCV_2" CURVE 0x85cf6e _REC_CUR_20_u1_u1 255. _CNV_A_R_LINEAR_____1_CM 0. 255. DISPLAY_IDENTIFIER ID_ERR_ENVD_PCV_2 FORMAT "%3.0"
 /begin AXIS_DESCR COM_AXIS online_dummy _CNV_A_R_LINEAR_____0_CM 8 0. 7. READ_ONLY FORMAT "%2.0" AXIS_PTS_REF ldp_fmy_envd /end AXIS_DESCR
/end CHARACTERISTIC
/begin CHARACTERISTIC fmy_id_pcv_2.c_err_clas "error class for diagnosis instance PCV_2" VALUE 0x85cf76 _REC_VAL_20_u1 255. _CNV_A_R_LINEAR_____1_CM 0. 255. DISPLAY_IDENTIFIER C_ERR_CLAS_PCV_2 FORMAT "%3.0" /end CHARACTERISTIC
/begin CHARACTERISTIC fmy_id_pcv_3.dtc[0] "diagnostic trouble codes for diagnosis instance PCV_3" CURVE 0x85cf78 _REC_CUR_20_u2_u2 65535. _CNV_A_R_LINEAR_____1_CM 0. 65535. DISPLAY_IDENTIFIER ID_ERR_DTC_PCV_3 FORMAT "%5.0"
 /begin AXIS_DESCR COM_AXIS online_dummy _CNV_A_R_LINEAR_____0_CM 6 0. 5. FORMAT "%2.0" AXIS_PTS_REF ldp_fmy_dtc /end AXIS_DESCR
/end CHARACTERISTIC
/begin CHARACTERISTIC fmy_id_pcv_3.envd "environmental data contents of customer specific freeze frame for diagnosis instance PCV_3" CURVE 0x85cf84 _REC_CUR_20_u1_u1 255. _CNV_A_R_LINEAR_____1_CM 0. 255. DISPLAY_IDENTIFIER ID_ERR_ENVD_PCV_3 FORMAT "%3.0"
 /begin AXIS_DESCR COM_AXIS online_dummy _CNV_A_R_LINEAR_____0_CM 8 0. 7. READ_ONLY FORMAT "%2.0" AXIS_PTS_REF ldp_fmy_envd /end AXIS_DESCR
/end CHARACTERISTIC
/begin CHARACTERISTIC fmy_id_pcv_3.c_err_clas "error class for diagnosis instance PCV_3" VALUE 0x85cf8c _REC_VAL_20_u1 255. _CNV_A_R_LINEAR_____1_CM 0. 255. DISPLAY_IDENTIFIER C_ERR_CLAS_PCV_3 FORMAT "%3.0" /end CHARACTERISTIC
/begin CHARACTERISTIC fmy_id_rly_main.dtc[0] "diagnostic trouble codes for diagnosis instance RLY_MAIN" CURVE 0x85cf8e _REC_CUR_20_u2_u2 65535. _CNV_A_R_LINEAR_____1_CM 0. 65535. DISPLAY_IDENTIFIER ID_ERR_DTC_RLY_MAIN FORMAT "%5.0"
 /begin AXIS_DESCR COM_AXIS online_dummy _CNV_A_R_LINEAR_____0_CM 6 0. 5. FORMAT "%2.0" AXIS_PTS_REF ldp_fmy_dtc /end AXIS_DESCR
/end CHARACTERISTIC
/begin CHARACTERISTIC fmy_id_rly_main.envd "environmental data contents of customer specific freeze frame for diagnosis instance RLY_MAIN" CURVE 0x85cf9a _REC_CUR_20_u1_u1 255. _CNV_A_R_LINEAR_____1_CM 0. 255. DISPLAY_IDENTIFIER ID_ERR_ENVD_RLY_MAIN FORMAT "%3.0"
 /begin AXIS_DESCR COM_AXIS online_dummy _CNV_A_R_LINEAR_____0_CM 8 0. 7. READ_ONLY FORMAT "%2.0" AXIS_PTS_REF ldp_fmy_envd /end AXIS_DESCR
/end CHARACTERISTIC
/begin CHARACTERISTIC fmy_id_rly_main.c_err_clas "error class for diagnosis instance RLY_MAIN" VALUE 0x85cfa2 _REC_VAL_20_u1 255. _CNV_A_R_LINEAR_____1_CM 0. 255. DISPLAY_IDENTIFIER C_ERR_CLAS_RLY_MAIN FORMAT "%3.0" /end CHARACTERISTIC
/begin CHARACTERISTIC fmy_id_rly_power.dtc[0] "diagnostic trouble codes for diagnosis instance RLY_POWER" CURVE 0x85cfa4 _REC_CUR_20_u2_u2 65535. _CNV_A_R_LINEAR_____1_CM 0. 65535. DISPLAY_IDENTIFIER ID_ERR_DTC_RLY_POWER FORMAT "%5.0"
 /begin AXIS_DESCR COM_AXIS online_dummy _CNV_A_R_LINEAR_____0_CM 6 0. 5. FORMAT "%2.0" AXIS_PTS_REF ldp_fmy_dtc /end AXIS_DESCR
/end CHARACTERISTIC
/begin CHARACTERISTIC fmy_id_rly_power.envd "environmental data contents of customer specific freeze frame for diagnosis instance RLY_POWER" CURVE 0x85cfb0 _REC_CUR_20_u1_u1 255. _CNV_A_R_LINEAR_____1_CM 0. 255. DISPLAY_IDENTIFIER ID_ERR_ENVD_RLY_POWER FORMAT "%3.0"
 /begin AXIS_DESCR COM_AXIS online_dummy _CNV_A_R_LINEAR_____0_CM 8 0. 7. READ_ONLY FORMAT "%2.0" AXIS_PTS_REF ldp_fmy_envd /end AXIS_DESCR
/end CHARACTERISTIC
/begin CHARACTERISTIC fmy_id_rly_power.c_err_clas "error class for diagnosis instance RLY_POWER" VALUE 0x85cfb8 _REC_VAL_20_u1 255. _CNV_A_R_LINEAR_____1_CM 0. 255. DISPLAY_IDENTIFIER C_ERR_CLAS_RLY_POWER FORMAT "%3.0" /end CHARACTERISTIC
/begin CHARACTERISTIC fmy_id_thr.dtc[0] "diagnostic trouble codes for diagnosis instance THR" CURVE 0x85cfba _REC_CUR_20_u2_u2 65535. _CNV_A_R_LINEAR_____1_CM 0. 65535. DISPLAY_IDENTIFIER ID_ERR_DTC_THR FORMAT "%5.0"
 /begin AXIS_DESCR COM_AXIS online_dummy _CNV_A_R_LINEAR_____0_CM 6 0. 5. FORMAT "%2.0" AXIS_PTS_REF ldp_fmy_dtc /end AXIS_DESCR
/end CHARACTERISTIC
/begin CHARACTERISTIC fmy_id_thr.envd "environmental data contents of customer specific freeze frame for diagnosis instance THR" CURVE 0x85cfc6 _REC_CUR_20_u1_u1 255. _CNV_A_R_LINEAR_____1_CM 0. 255. DISPLAY_IDENTIFIER ID_ERR_ENVD_THR FORMAT "%3.0"
 /begin AXIS_DESCR COM_AXIS online_dummy _CNV_A_R_LINEAR_____0_CM 8 0. 7. READ_ONLY FORMAT "%2.0" AXIS_PTS_REF ldp_fmy_envd /end AXIS_DESCR
/end CHARACTERISTIC
/begin CHARACTERISTIC fmy_id_thr.c_err_clas "error class for diagnosis instance THR" VALUE 0x85cfce _REC_VAL_20_u1 255. _CNV_A_R_LINEAR_____1_CM 0. 255. DISPLAY_IDENTIFIER C_ERR_CLAS_THR FORMAT "%3.0" /end CHARACTERISTIC
/begin CHARACTERISTIC fmy_id_var_cod.dtc[0] "diagnostic trouble codes for diagnosis instance VAR_COD" CURVE 0x85cfd0 _REC_CUR_20_u2_u2 65535. _CNV_A_R_LINEAR_____1_CM 0. 65535. DISPLAY_IDENTIFIER ID_ERR_DTC_VAR_COD FORMAT "%5.0"
 /begin AXIS_DESCR COM_AXIS online_dummy _CNV_A_R_LINEAR_____0_CM 6 0. 5. FORMAT "%2.0" AXIS_PTS_REF ldp_fmy_dtc /end AXIS_DESCR
/end CHARACTERISTIC
/begin CHARACTERISTIC fmy_id_var_cod.envd "environmental data contents of customer specific freeze frame for diagnosis instance VAR_COD" CURVE 0x85cfdc _REC_CUR_20_u1_u1 255. _CNV_A_R_LINEAR_____1_CM 0. 255. DISPLAY_IDENTIFIER ID_ERR_ENVD_VAR_COD FORMAT "%3.0"
 /begin AXIS_DESCR COM_AXIS online_dummy _CNV_A_R_LINEAR_____0_CM 8 0. 7. READ_ONLY FORMAT "%2.0" AXIS_PTS_REF ldp_fmy_envd /end AXIS_DESCR
/end CHARACTERISTIC
/begin CHARACTERISTIC fmy_id_var_cod.c_err_clas "error class for diagnosis instance VAR_COD" VALUE 0x85cfe4 _REC_VAL_20_u1 255. _CNV_A_R_LINEAR_____1_CM 0. 255. DISPLAY_IDENTIFIER C_ERR_CLAS_VAR_COD FORMAT "%3.0" /end CHARACTERISTIC
/begin CHARACTERISTIC fmy_id_vb.dtc[0] "diagnostic trouble codes for diagnosis instance VB" CURVE 0x85cfe6 _REC_CUR_20_u2_u2 65535. _CNV_A_R_LINEAR_____1_CM 0. 65535. DISPLAY_IDENTIFIER ID_ERR_DTC_VB FORMAT "%5.0"
 /begin AXIS_DESCR COM_AXIS online_dummy _CNV_A_R_LINEAR_____0_CM 6 0. 5. FORMAT "%2.0" AXIS_PTS_REF ldp_fmy_dtc /end AXIS_DESCR
/end CHARACTERISTIC
/begin CHARACTERISTIC fmy_id_vb.envd "environmental data contents of customer specific freeze frame for diagnosis instance VB" CURVE 0x85cff2 _REC_CUR_20_u1_u1 255. _CNV_A_R_LINEAR_____1_CM 0. 255. DISPLAY_IDENTIFIER ID_ERR_ENVD_VB FORMAT "%3.0"
 /begin AXIS_DESCR COM_AXIS online_dummy _CNV_A_R_LINEAR_____0_CM 8 0. 7. READ_ONLY FORMAT "%2.0" AXIS_PTS_REF ldp_fmy_envd /end AXIS_DESCR
/end CHARACTERISTIC
/begin CHARACTERISTIC fmy_id_vb.c_err_clas "error class for diagnosis instance VB" VALUE 0x85cffa _REC_VAL_20_u1 255. _CNV_A_R_LINEAR_____1_CM 0. 255. DISPLAY_IDENTIFIER C_ERR_CLAS_VB FORMAT "%3.0" /end CHARACTERISTIC
/begin CHARACTERISTIC fmy_id_vcv_1.dtc[0] "diagnostic trouble codes for diagnosis instance VCV_1" CURVE 0x85cffc _REC_CUR_20_u2_u2 65535. _CNV_A_R_LINEAR_____1_CM 0. 65535. DISPLAY_IDENTIFIER ID_ERR_DTC_VCV_1 FORMAT "%5.0"
 /begin AXIS_DESCR COM_AXIS online_dummy _CNV_A_R_LINEAR_____0_CM 6 0. 5. FORMAT "%2.0" AXIS_PTS_REF ldp_fmy_dtc /end AXIS_DESCR
/end CHARACTERISTIC
/begin CHARACTERISTIC fmy_id_vcv_1.envd "environmental data contents of customer specific freeze frame for diagnosis instance VCV_1" CURVE 0x85d008 _REC_CUR_20_u1_u1 255. _CNV_A_R_LINEAR_____1_CM 0. 255. DISPLAY_IDENTIFIER ID_ERR_ENVD_VCV_1 FORMAT "%3.0"
 /begin AXIS_DESCR COM_AXIS online_dummy _CNV_A_R_LINEAR_____0_CM 8 0. 7. READ_ONLY FORMAT "%2.0" AXIS_PTS_REF ldp_fmy_envd /end AXIS_DESCR
/end CHARACTERISTIC
/begin CHARACTERISTIC fmy_id_vcv_1.c_err_clas "error class for diagnosis instance VCV_1" VALUE 0x85d010 _REC_VAL_20_u1 255. _CNV_A_R_LINEAR_____1_CM 0. 255. DISPLAY_IDENTIFIER C_ERR_CLAS_VCV_1 FORMAT "%3.0" /end CHARACTERISTIC
/begin CHARACTERISTIC fmy_id_vcv_2.dtc[0] "diagnostic trouble codes for diagnosis instance VCV_2" CURVE 0x85d012 _REC_CUR_20_u2_u2 65535. _CNV_A_R_LINEAR_____1_CM 0. 65535. DISPLAY_IDENTIFIER ID_ERR_DTC_VCV_2 FORMAT "%5.0"
 /begin AXIS_DESCR COM_AXIS online_dummy _CNV_A_R_LINEAR_____0_CM 6 0. 5. FORMAT "%2.0" AXIS_PTS_REF ldp_fmy_dtc /end AXIS_DESCR
/end CHARACTERISTIC
/begin CHARACTERISTIC fmy_id_vcv_2.envd "environmental data contents of customer specific freeze frame for diagnosis instance VCV_2" CURVE 0x85d01e _REC_CUR_20_u1_u1 255. _CNV_A_R_LINEAR_____1_CM 0. 255. DISPLAY_IDENTIFIER ID_ERR_ENVD_VCV_2 FORMAT "%3.0"
 /begin AXIS_DESCR COM_AXIS online_dummy _CNV_A_R_LINEAR_____0_CM 8 0. 7. READ_ONLY FORMAT "%2.0" AXIS_PTS_REF ldp_fmy_envd /end AXIS_DESCR
/end CHARACTERISTIC
/begin CHARACTERISTIC fmy_id_vcv_2.c_err_clas "error class for diagnosis instance VCV_2" VALUE 0x85d026 _REC_VAL_20_u1 255. _CNV_A_R_LINEAR_____1_CM 0. 255. DISPLAY_IDENTIFIER C_ERR_CLAS_VCV_2 FORMAT "%3.0" /end CHARACTERISTIC
/begin CHARACTERISTIC fmy_id_vcv_3.dtc[0] "diagnostic trouble codes for diagnosis instance VCV_3" CURVE 0x85d028 _REC_CUR_20_u2_u2 65535. _CNV_A_R_LINEAR_____1_CM 0. 65535. DISPLAY_IDENTIFIER ID_ERR_DTC_VCV_3 FORMAT "%5.0"
 /begin AXIS_DESCR COM_AXIS online_dummy _CNV_A_R_LINEAR_____0_CM 6 0. 5. FORMAT "%2.0" AXIS_PTS_REF ldp_fmy_dtc /end AXIS_DESCR
/end CHARACTERISTIC
/begin CHARACTERISTIC fmy_id_vcv_3.envd "environmental data contents of customer specific freeze frame for diagnosis instance VCV_3" CURVE 0x85d034 _REC_CUR_20_u1_u1 255. _CNV_A_R_LINEAR_____1_CM 0. 255. DISPLAY_IDENTIFIER ID_ERR_ENVD_VCV_3 FORMAT "%3.0"
 /begin AXIS_DESCR COM_AXIS online_dummy _CNV_A_R_LINEAR_____0_CM 8 0. 7. READ_ONLY FORMAT "%2.0" AXIS_PTS_REF ldp_fmy_envd /end AXIS_DESCR
/end CHARACTERISTIC
/begin CHARACTERISTIC fmy_id_vcv_3.c_err_clas "error class for diagnosis instance VCV_3" VALUE 0x85d03c _REC_VAL_20_u1 255. _CNV_A_R_LINEAR_____1_CM 0. 255. DISPLAY_IDENTIFIER C_ERR_CLAS_VCV_3 FORMAT "%3.0" /end CHARACTERISTIC
/begin CHARACTERISTIC fmy_id_conv_mon_1.dtc[0] "diagnostic trouble codes for diagnosis instance CONV_MON_1" CURVE 0x85d03e _REC_CUR_20_u2_u2 65535. _CNV_A_R_LINEAR_____1_CM 0. 65535. DISPLAY_IDENTIFIER ID_ERR_DTC_CONV_MON_1 FORMAT "%5.0"
 /begin AXIS_DESCR COM_AXIS online_dummy _CNV_A_R_LINEAR_____0_CM 6 0. 5. FORMAT "%2.0" AXIS_PTS_REF ldp_fmy_dtc /end AXIS_DESCR
/end CHARACTERISTIC
/begin CHARACTERISTIC fmy_id_conv_mon_1.envd "environmental data contents of customer specific freeze frame for diagnosis instance CONV_MON_1" CURVE 0x85d04a _REC_CUR_20_u1_u1 255. _CNV_A_R_LINEAR_____1_CM 0. 255. DISPLAY_IDENTIFIER ID_ERR_ENVD_CONV_MON_1 FORMAT "%3.0"
 /begin AXIS_DESCR COM_AXIS online_dummy _CNV_A_R_LINEAR_____0_CM 8 0. 7. READ_ONLY FORMAT "%2.0" AXIS_PTS_REF ldp_fmy_envd /end AXIS_DESCR
/end CHARACTERISTIC
/begin CHARACTERISTIC fmy_id_conv_mon_1.c_err_clas "error class for diagnosis instance CONV_MON_1" VALUE 0x85d052 _REC_VAL_20_u1 255. _CNV_A_R_LINEAR_____1_CM 0. 255. DISPLAY_IDENTIFIER C_ERR_CLAS_CONV_MON_1 FORMAT "%3.0" /end CHARACTERISTIC
/begin CHARACTERISTIC fmy_id_n_32_mon_1.dtc[0] "diagnostic trouble codes for diagnosis instance N_32_MON_1" CURVE 0x85d054 _REC_CUR_20_u2_u2 65535. _CNV_A_R_LINEAR_____1_CM 0. 65535. DISPLAY_IDENTIFIER ID_ERR_DTC_N_32_MON_1 FORMAT "%5.0"
 /begin AXIS_DESCR COM_AXIS online_dummy _CNV_A_R_LINEAR_____0_CM 6 0. 5. FORMAT "%2.0" AXIS_PTS_REF ldp_fmy_dtc /end AXIS_DESCR
/end CHARACTERISTIC
/begin CHARACTERISTIC fmy_id_n_32_mon_1.envd "environmental data contents of customer specific freeze frame for diagnosis instance N_32_MON_1" CURVE 0x85d060 _REC_CUR_20_u1_u1 255. _CNV_A_R_LINEAR_____1_CM 0. 255. DISPLAY_IDENTIFIER ID_ERR_ENVD_N_32_MON_1 FORMAT "%3.0"
 /begin AXIS_DESCR COM_AXIS online_dummy _CNV_A_R_LINEAR_____0_CM 8 0. 7. READ_ONLY FORMAT "%2.0" AXIS_PTS_REF ldp_fmy_envd /end AXIS_DESCR
/end CHARACTERISTIC
/begin CHARACTERISTIC fmy_id_n_32_mon_1.c_err_clas "error class for diagnosis instance N_32_MON_1" VALUE 0x85d068 _REC_VAL_20_u1 255. _CNV_A_R_LINEAR_____1_CM 0. 255. DISPLAY_IDENTIFIER C_ERR_CLAS_N_32_MON_1 FORMAT "%3.0" /end CHARACTERISTIC
/begin CHARACTERISTIC fmy_id_pvs_mon_1.dtc[0] "diagnostic trouble codes for diagnosis instance PVS_MON_1" CURVE 0x85d06a _REC_CUR_20_u2_u2 65535. _CNV_A_R_LINEAR_____1_CM 0. 65535. DISPLAY_IDENTIFIER ID_ERR_DTC_PVS_MON_1 FORMAT "%5.0"
 /begin AXIS_DESCR COM_AXIS online_dummy _CNV_A_R_LINEAR_____0_CM 6 0. 5. FORMAT "%2.0" AXIS_PTS_REF ldp_fmy_dtc /end AXIS_DESCR
/end CHARACTERISTIC
/begin CHARACTERISTIC fmy_id_pvs_mon_1.envd "environmental data contents of customer specific freeze frame for diagnosis instance PVS_MON_1" CURVE 0x85d076 _REC_CUR_20_u1_u1 255. _CNV_A_R_LINEAR_____1_CM 0. 255. DISPLAY_IDENTIFIER ID_ERR_ENVD_PVS_MON_1 FORMAT "%3.0"
 /begin AXIS_DESCR COM_AXIS online_dummy _CNV_A_R_LINEAR_____0_CM 8 0. 7. READ_ONLY FORMAT "%2.0" AXIS_PTS_REF ldp_fmy_envd /end AXIS_DESCR
/end CHARACTERISTIC
/begin CHARACTERISTIC fmy_id_pvs_mon_1.c_err_clas "error class for diagnosis instance PVS_MON_1" VALUE 0x85d07e _REC_VAL_20_u1 255. _CNV_A_R_LINEAR_____1_CM 0. 255. DISPLAY_IDENTIFIER C_ERR_CLAS_PVS_MON_1 FORMAT "%3.0" /end CHARACTERISTIC
/begin CHARACTERISTIC fmy_id_fcut_mon_1.dtc[0] "diagnostic trouble codes for diagnosis instance FCUT_MON_1" CURVE 0x85d080 _REC_CUR_20_u2_u2 65535. _CNV_A_R_LINEAR_____1_CM 0. 65535. DISPLAY_IDENTIFIER ID_ERR_DTC_FCUT_MON_1 FORMAT "%5.0"
 /begin AXIS_DESCR COM_AXIS online_dummy _CNV_A_R_LINEAR_____0_CM 6 0. 5. FORMAT "%2.0" AXIS_PTS_REF ldp_fmy_dtc /end AXIS_DESCR
/end CHARACTERISTIC
/begin CHARACTERISTIC fmy_id_fcut_mon_1.envd "environmental data contents of customer specific freeze frame for diagnosis instance FCUT_MON_1" CURVE 0x85d08c _REC_CUR_20_u1_u1 255. _CNV_A_R_LINEAR_____1_CM 0. 255. DISPLAY_IDENTIFIER ID_ERR_ENVD_FCUT_MON_1 FORMAT "%3.0"
 /begin AXIS_DESCR COM_AXIS online_dummy _CNV_A_R_LINEAR_____0_CM 8 0. 7. READ_ONLY FORMAT "%2.0" AXIS_PTS_REF ldp_fmy_envd /end AXIS_DESCR
/end CHARACTERISTIC
/begin CHARACTERISTIC fmy_id_fcut_mon_1.c_err_clas "error class for diagnosis instance FCUT_MON_1" VALUE 0x85d094 _REC_VAL_20_u1 255. _CNV_A_R_LINEAR_____1_CM 0. 255. DISPLAY_IDENTIFIER C_ERR_CLAS_FCUT_MON_1 FORMAT "%3.0" /end CHARACTERISTIC
/begin CHARACTERISTIC fmy_id_tqi_n_max_mon_1.dtc[0] "diagnostic trouble codes for diagnosis instance TQI_N_MAX_MON_1" CURVE 0x85d096 _REC_CUR_20_u2_u2 65535. _CNV_A_R_LINEAR_____1_CM 0. 65535. DISPLAY_IDENTIFIER ID_ERR_DTC_TQI_N_MAX_MON_1 FORMAT "%5.0"
 /begin AXIS_DESCR COM_AXIS online_dummy _CNV_A_R_LINEAR_____0_CM 6 0. 5. FORMAT "%2.0" AXIS_PTS_REF ldp_fmy_dtc /end AXIS_DESCR
/end CHARACTERISTIC
/begin CHARACTERISTIC fmy_id_tqi_n_max_mon_1.envd "environmental data contents of customer specific freeze frame for diagnosis instance TQI_N_MAX_MON_1" CURVE 0x85d0a2 _REC_CUR_20_u1_u1 255. _CNV_A_R_LINEAR_____1_CM 0. 255. DISPLAY_IDENTIFIER ID_ERR_ENVD_TQI_N_MAX_MON_1 FORMAT "%3.0"
 /begin AXIS_DESCR COM_AXIS online_dummy _CNV_A_R_LINEAR_____0_CM 8 0. 7. READ_ONLY FORMAT "%2.0" AXIS_PTS_REF ldp_fmy_envd /end AXIS_DESCR
/end CHARACTERISTIC
/begin CHARACTERISTIC fmy_id_tqi_n_max_mon_1.c_err_clas "error class for diagnosis instance TQI_N_MAX_MON_1" VALUE 0x85d0aa _REC_VAL_20_u1 255. _CNV_A_R_LINEAR_____1_CM 0. 255. DISPLAY_IDENTIFIER C_ERR_CLAS_TQI_N_MAX_MON_1 FORMAT "%3.0" /end CHARACTERISTIC
/begin CHARACTERISTIC fmy_id_serv_mon_1.dtc[0] "diagnostic trouble codes for diagnosis instance SERV_MON_1" CURVE 0x85d0ac _REC_CUR_20_u2_u2 65535. _CNV_A_R_LINEAR_____1_CM 0. 65535. DISPLAY_IDENTIFIER ID_ERR_DTC_SERV_MON_1 FORMAT "%5.0"
 /begin AXIS_DESCR COM_AXIS online_dummy _CNV_A_R_LINEAR_____0_CM 6 0. 5. FORMAT "%2.0" AXIS_PTS_REF ldp_fmy_dtc /end AXIS_DESCR
/end CHARACTERISTIC
/begin CHARACTERISTIC fmy_id_serv_mon_1.envd "environmental data contents of customer specific freeze frame for diagnosis instance SERV_MON_1" CURVE 0x85d0b8 _REC_CUR_20_u1_u1 255. _CNV_A_R_LINEAR_____1_CM 0. 255. DISPLAY_IDENTIFIER ID_ERR_ENVD_SERV_MON_1 FORMAT "%3.0"
 /begin AXIS_DESCR COM_AXIS online_dummy _CNV_A_R_LINEAR_____0_CM 8 0. 7. READ_ONLY FORMAT "%2.0" AXIS_PTS_REF ldp_fmy_envd /end AXIS_DESCR
/end CHARACTERISTIC
/begin CHARACTERISTIC fmy_id_serv_mon_1.c_err_clas "error class for diagnosis instance SERV_MON_1" VALUE 0x85d0c0 _REC_VAL_20_u1 255. _CNV_A_R_LINEAR_____1_CM 0. 255. DISPLAY_IDENTIFIER C_ERR_CLAS_SERV_MON_1 FORMAT "%3.0" /end CHARACTERISTIC
/begin CHARACTERISTIC fmy_id_post_inh_mon.dtc[0] "diagnostic trouble codes for diagnosis instance POST_INH_MON" CURVE 0x85d0c2 _REC_CUR_20_u2_u2 65535. _CNV_A_R_LINEAR_____1_CM 0. 65535. DISPLAY_IDENTIFIER ID_ERR_DTC_POST_INH_MON FORMAT "%5.0"
 /begin AXIS_DESCR COM_AXIS online_dummy _CNV_A_R_LINEAR_____0_CM 6 0. 5. FORMAT "%2.0" AXIS_PTS_REF ldp_fmy_dtc /end AXIS_DESCR
/end CHARACTERISTIC
/begin CHARACTERISTIC fmy_id_post_inh_mon.envd "environmental data contents of customer specific freeze frame for diagnosis instance POST_INH_MON" CURVE 0x85d0ce _REC_CUR_20_u1_u1 255. _CNV_A_R_LINEAR_____1_CM 0. 255. DISPLAY_IDENTIFIER ID_ERR_ENVD_POST_INH_MON FORMAT "%3.0"
 /begin AXIS_DESCR COM_AXIS online_dummy _CNV_A_R_LINEAR_____0_CM 8 0. 7. READ_ONLY FORMAT "%2.0" AXIS_PTS_REF ldp_fmy_envd /end AXIS_DESCR
/end CHARACTERISTIC
/begin CHARACTERISTIC fmy_id_post_inh_mon.c_err_clas "error class for diagnosis instance POST_INH_MON" VALUE 0x85d0d6 _REC_VAL_20_u1 255. _CNV_A_R_LINEAR_____1_CM 0. 255. DISPLAY_IDENTIFIER C_ERR_CLAS_POST_INH_MON FORMAT "%3.0" /end CHARACTERISTIC
/begin CHARACTERISTIC fmy_id_cru_inh_mon.dtc[0] "diagnostic trouble codes for diagnosis instance CRU_INH_MON" CURVE 0x85d0d8 _REC_CUR_20_u2_u2 65535. _CNV_A_R_LINEAR_____1_CM 0. 65535. DISPLAY_IDENTIFIER ID_ERR_DTC_CRU_INH_MON FORMAT "%5.0"
 /begin AXIS_DESCR COM_AXIS online_dummy _CNV_A_R_LINEAR_____0_CM 6 0. 5. FORMAT "%2.0" AXIS_PTS_REF ldp_fmy_dtc /end AXIS_DESCR
/end CHARACTERISTIC
/begin CHARACTERISTIC fmy_id_cru_inh_mon.envd "environmental data contents of customer specific freeze frame for diagnosis instance CRU_INH_MON" CURVE 0x85d0e4 _REC_CUR_20_u1_u1 255. _CNV_A_R_LINEAR_____1_CM 0. 255. DISPLAY_IDENTIFIER ID_ERR_ENVD_CRU_INH_MON FORMAT "%3.0"
 /begin AXIS_DESCR COM_AXIS online_dummy _CNV_A_R_LINEAR_____0_CM 8 0. 7. READ_ONLY FORMAT "%2.0" AXIS_PTS_REF ldp_fmy_envd /end AXIS_DESCR
/end CHARACTERISTIC
/begin CHARACTERISTIC fmy_id_cru_inh_mon.c_err_clas "error class for diagnosis instance CRU_INH_MON" VALUE 0x85d0ec _REC_VAL_20_u1 255. _CNV_A_R_LINEAR_____1_CM 0. 255. DISPLAY_IDENTIFIER C_ERR_CLAS_CRU_INH_MON FORMAT "%3.0" /end CHARACTERISTIC
/begin CHARACTERISTIC fmy_id_can_inh_mon.dtc[0] "diagnostic trouble codes for diagnosis instance CAN_INH_MON" CURVE 0x85d0ee _REC_CUR_20_u2_u2 65535. _CNV_A_R_LINEAR_____1_CM 0. 65535. DISPLAY_IDENTIFIER ID_ERR_DTC_CAN_INH_MON FORMAT "%5.0"
 /begin AXIS_DESCR COM_AXIS online_dummy _CNV_A_R_LINEAR_____0_CM 6 0. 5. FORMAT "%2.0" AXIS_PTS_REF ldp_fmy_dtc /end AXIS_DESCR
/end CHARACTERISTIC
/begin CHARACTERISTIC fmy_id_can_inh_mon.envd "environmental data contents of customer specific freeze frame for diagnosis instance CAN_INH_MON" CURVE 0x85d0fa _REC_CUR_20_u1_u1 255. _CNV_A_R_LINEAR_____1_CM 0. 255. DISPLAY_IDENTIFIER ID_ERR_ENVD_CAN_INH_MON FORMAT "%3.0"
 /begin AXIS_DESCR COM_AXIS online_dummy _CNV_A_R_LINEAR_____0_CM 8 0. 7. READ_ONLY FORMAT "%2.0" AXIS_PTS_REF ldp_fmy_envd /end AXIS_DESCR
/end CHARACTERISTIC
/begin CHARACTERISTIC fmy_id_can_inh_mon.c_err_clas "error class for diagnosis instance CAN_INH_MON" VALUE 0x85d102 _REC_VAL_20_u1 255. _CNV_A_R_LINEAR_____1_CM 0. 255. DISPLAY_IDENTIFIER C_ERR_CLAS_CAN_INH_MON FORMAT "%3.0" /end CHARACTERISTIC
/begin CHARACTERISTIC fmy_id_mon_3.dtc[0] "diagnostic trouble codes for diagnosis instance MON_3" CURVE 0x85d104 _REC_CUR_20_u2_u2 65535. _CNV_A_R_LINEAR_____1_CM 0. 65535. DISPLAY_IDENTIFIER ID_ERR_DTC_MON_3 FORMAT "%5.0"
 /begin AXIS_DESCR COM_AXIS online_dummy _CNV_A_R_LINEAR_____0_CM 6 0. 5. FORMAT "%2.0" AXIS_PTS_REF ldp_fmy_dtc /end AXIS_DESCR
/end CHARACTERISTIC
/begin CHARACTERISTIC fmy_id_mon_3.envd "environmental data contents of customer specific freeze frame for diagnosis instance MON_3" CURVE 0x85d110 _REC_CUR_20_u1_u1 255. _CNV_A_R_LINEAR_____1_CM 0. 255. DISPLAY_IDENTIFIER ID_ERR_ENVD_MON_3 FORMAT "%3.0"
 /begin AXIS_DESCR COM_AXIS online_dummy _CNV_A_R_LINEAR_____0_CM 8 0. 7. READ_ONLY FORMAT "%2.0" AXIS_PTS_REF ldp_fmy_envd /end AXIS_DESCR
/end CHARACTERISTIC
/begin CHARACTERISTIC fmy_id_mon_3.c_err_clas "error class for diagnosis instance MON_3" VALUE 0x85d118 _REC_VAL_20_u1 255. _CNV_A_R_LINEAR_____1_CM 0. 255. DISPLAY_IDENTIFIER C_ERR_CLAS_MON_3 FORMAT "%3.0" /end CHARACTERISTIC
/begin CHARACTERISTIC fmy_id_per_cam_in_1.dtc[0] "diagnostic trouble codes for diagnosis instance PER_CAM_IN_1" CURVE 0x85d11a _REC_CUR_20_u2_u2 65535. _CNV_A_R_LINEAR_____1_CM 0. 65535. DISPLAY_IDENTIFIER ID_ERR_DTC_PER_CAM_IN_1 FORMAT "%5.0"
 /begin AXIS_DESCR COM_AXIS online_dummy _CNV_A_R_LINEAR_____0_CM 6 0. 5. FORMAT "%2.0" AXIS_PTS_REF ldp_fmy_dtc /end AXIS_DESCR
/end CHARACTERISTIC
/begin CHARACTERISTIC fmy_id_per_cam_in_1.envd "environmental data contents of customer specific freeze frame for diagnosis instance PER_CAM_IN_1" CURVE 0x85d126 _REC_CUR_20_u1_u1 255. _CNV_A_R_LINEAR_____1_CM 0. 255. DISPLAY_IDENTIFIER ID_ERR_ENVD_PER_CAM_IN_1 FORMAT "%3.0"
 /begin AXIS_DESCR COM_AXIS online_dummy _CNV_A_R_LINEAR_____0_CM 8 0. 7. READ_ONLY FORMAT "%2.0" AXIS_PTS_REF ldp_fmy_envd /end AXIS_DESCR
/end CHARACTERISTIC
/begin CHARACTERISTIC fmy_id_per_cam_in_1.c_err_clas "error class for diagnosis instance PER_CAM_IN_1" VALUE 0x85d12e _REC_VAL_20_u1 255. _CNV_A_R_LINEAR_____1_CM 0. 255. DISPLAY_IDENTIFIER C_ERR_CLAS_PER_CAM_IN_1 FORMAT "%3.0" /end CHARACTERISTIC
/begin CHARACTERISTIC fmy_id_syn_cam_in_1.dtc[0] "diagnostic trouble codes for diagnosis instance SYN_CAM_IN_1" CURVE 0x85d130 _REC_CUR_20_u2_u2 65535. _CNV_A_R_LINEAR_____1_CM 0. 65535. DISPLAY_IDENTIFIER ID_ERR_DTC_SYN_CAM_IN_1 FORMAT "%5.0"
 /begin AXIS_DESCR COM_AXIS online_dummy _CNV_A_R_LINEAR_____0_CM 6 0. 5. FORMAT "%2.0" AXIS_PTS_REF ldp_fmy_dtc /end AXIS_DESCR
/end CHARACTERISTIC
/begin CHARACTERISTIC fmy_id_syn_cam_in_1.envd "environmental data contents of customer specific freeze frame for diagnosis instance SYN_CAM_IN_1" CURVE 0x85d13c _REC_CUR_20_u1_u1 255. _CNV_A_R_LINEAR_____1_CM 0. 255. DISPLAY_IDENTIFIER ID_ERR_ENVD_SYN_CAM_IN_1 FORMAT "%3.0"
 /begin AXIS_DESCR COM_AXIS online_dummy _CNV_A_R_LINEAR_____0_CM 8 0. 7. READ_ONLY FORMAT "%2.0" AXIS_PTS_REF ldp_fmy_envd /end AXIS_DESCR
/end CHARACTERISTIC
/begin CHARACTERISTIC fmy_id_syn_cam_in_1.c_err_clas "error class for diagnosis instance SYN_CAM_IN_1" VALUE 0x85d144 _REC_VAL_20_u1 255. _CNV_A_R_LINEAR_____1_CM 0. 255. DISPLAY_IDENTIFIER C_ERR_CLAS_SYN_CAM_IN_1 FORMAT "%3.0" /end CHARACTERISTIC
/begin CHARACTERISTIC fmy_id_ref_crk_cam_in_1.dtc[0] "diagnostic trouble codes for diagnosis instance REF_CRK_CAM_IN_1" CURVE 0x85d146 _REC_CUR_20_u2_u2 65535. _CNV_A_R_LINEAR_____1_CM 0. 65535. DISPLAY_IDENTIFIER ID_ERR_DTC_REF_CRK_CAM_IN_1 FORMAT "%5.0"
 /begin AXIS_DESCR COM_AXIS online_dummy _CNV_A_R_LINEAR_____0_CM 6 0. 5. FORMAT "%2.0" AXIS_PTS_REF ldp_fmy_dtc /end AXIS_DESCR
/end CHARACTERISTIC
/begin CHARACTERISTIC fmy_id_ref_crk_cam_in_1.envd "environmental data contents of customer specific freeze frame for diagnosis instance REF_CRK_CAM_IN_1" CURVE 0x85d152 _REC_CUR_20_u1_u1 255. _CNV_A_R_LINEAR_____1_CM 0. 255. DISPLAY_IDENTIFIER ID_ERR_ENVD_REF_CRK_CAM_IN_1 FORMAT "%3.0"
 /begin AXIS_DESCR COM_AXIS online_dummy _CNV_A_R_LINEAR_____0_CM 8 0. 7. READ_ONLY FORMAT "%2.0" AXIS_PTS_REF ldp_fmy_envd /end AXIS_DESCR
/end CHARACTERISTIC
/begin CHARACTERISTIC fmy_id_ref_crk_cam_in_1.c_err_clas "error class for diagnosis instance REF_CRK_CAM_IN_1" VALUE 0x85d15a _REC_VAL_20_u1 255. _CNV_A_R_LINEAR_____1_CM 0. 255. DISPLAY_IDENTIFIER C_ERR_CLAS_REF_CRK_CAM_IN_1 FORMAT "%3.0" /end CHARACTERISTIC
/begin CHARACTERISTIC fmy_id_crk_tooth.dtc[0] "diagnostic trouble codes for diagnosis instance CRK_TOOTH" CURVE 0x85d15c _REC_CUR_20_u2_u2 65535. _CNV_A_R_LINEAR_____1_CM 0. 65535. DISPLAY_IDENTIFIER ID_ERR_DTC_CRK_TOOTH FORMAT "%5.0"
 /begin AXIS_DESCR COM_AXIS online_dummy _CNV_A_R_LINEAR_____0_CM 6 0. 5. FORMAT "%2.0" AXIS_PTS_REF ldp_fmy_dtc /end AXIS_DESCR
/end CHARACTERISTIC
/begin CHARACTERISTIC fmy_id_crk_tooth.envd "environmental data contents of customer specific freeze frame for diagnosis instance CRK_TOOTH" CURVE 0x85d168 _REC_CUR_20_u1_u1 255. _CNV_A_R_LINEAR_____1_CM 0. 255. DISPLAY_IDENTIFIER ID_ERR_ENVD_CRK_TOOTH FORMAT "%3.0"
 /begin AXIS_DESCR COM_AXIS online_dummy _CNV_A_R_LINEAR_____0_CM 8 0. 7. READ_ONLY FORMAT "%2.0" AXIS_PTS_REF ldp_fmy_envd /end AXIS_DESCR
/end CHARACTERISTIC
/begin CHARACTERISTIC fmy_id_crk_tooth.c_err_clas "error class for diagnosis instance CRK_TOOTH" VALUE 0x85d170 _REC_VAL_20_u1 255. _CNV_A_R_LINEAR_____1_CM 0. 255. DISPLAY_IDENTIFIER C_ERR_CLAS_CRK_TOOTH FORMAT "%3.0" /end CHARACTERISTIC
/begin CHARACTERISTIC fmy_id_crk_tooth_per.dtc[0] "diagnostic trouble codes for diagnosis instance CRK_TOOTH_PER" CURVE 0x85d172 _REC_CUR_20_u2_u2 65535. _CNV_A_R_LINEAR_____1_CM 0. 65535. DISPLAY_IDENTIFIER ID_ERR_DTC_CRK_TOOTH_PER FORMAT "%5.0"
 /begin AXIS_DESCR COM_AXIS online_dummy _CNV_A_R_LINEAR_____0_CM 6 0. 5. FORMAT "%2.0" AXIS_PTS_REF ldp_fmy_dtc /end AXIS_DESCR
/end CHARACTERISTIC
/begin CHARACTERISTIC fmy_id_crk_tooth_per.envd "environmental data contents of customer specific freeze frame for diagnosis instance CRK_TOOTH_PER" CURVE 0x85d17e _REC_CUR_20_u1_u1 255. _CNV_A_R_LINEAR_____1_CM 0. 255. DISPLAY_IDENTIFIER ID_ERR_ENVD_CRK_TOOTH_PER FORMAT "%3.0"
 /begin AXIS_DESCR COM_AXIS online_dummy _CNV_A_R_LINEAR_____0_CM 8 0. 7. READ_ONLY FORMAT "%2.0" AXIS_PTS_REF ldp_fmy_envd /end AXIS_DESCR
/end CHARACTERISTIC
/begin CHARACTERISTIC fmy_id_crk_tooth_per.c_err_clas "error class for diagnosis instance CRK_TOOTH_PER" VALUE 0x85d186 _REC_VAL_20_u1 255. _CNV_A_R_LINEAR_____1_CM 0. 255. DISPLAY_IDENTIFIER C_ERR_CLAS_CRK_TOOTH_PER FORMAT "%3.0" /end CHARACTERISTIC
/begin CHARACTERISTIC fmy_id_crk_syn.dtc[0] "diagnostic trouble codes for diagnosis instance CRK_SYN" CURVE 0x85d188 _REC_CUR_20_u2_u2 65535. _CNV_A_R_LINEAR_____1_CM 0. 65535. DISPLAY_IDENTIFIER ID_ERR_DTC_CRK_SYN FORMAT "%5.0"
 /begin AXIS_DESCR COM_AXIS online_dummy _CNV_A_R_LINEAR_____0_CM 6 0. 5. FORMAT "%2.0" AXIS_PTS_REF ldp_fmy_dtc /end AXIS_DESCR
/end CHARACTERISTIC
/begin CHARACTERISTIC fmy_id_crk_syn.envd "environmental data contents of customer specific freeze frame for diagnosis instance CRK_SYN" CURVE 0x85d194 _REC_CUR_20_u1_u1 255. _CNV_A_R_LINEAR_____1_CM 0. 255. DISPLAY_IDENTIFIER ID_ERR_ENVD_CRK_SYN FORMAT "%3.0"
 /begin AXIS_DESCR COM_AXIS online_dummy _CNV_A_R_LINEAR_____0_CM 8 0. 7. READ_ONLY FORMAT "%2.0" AXIS_PTS_REF ldp_fmy_envd /end AXIS_DESCR
/end CHARACTERISTIC
/begin CHARACTERISTIC fmy_id_crk_syn.c_err_clas "error class for diagnosis instance CRK_SYN" VALUE 0x85d19c _REC_VAL_20_u1 255. _CNV_A_R_LINEAR_____1_CM 0. 255. DISPLAY_IDENTIFIER C_ERR_CLAS_CRK_SYN FORMAT "%3.0" /end CHARACTERISTIC
/begin CHARACTERISTIC fmy_id_crk_plaus.dtc[0] "diagnostic trouble codes for diagnosis instance CRK_PLAUS" CURVE 0x85d19e _REC_CUR_20_u2_u2 65535. _CNV_A_R_LINEAR_____1_CM 0. 65535. DISPLAY_IDENTIFIER ID_ERR_DTC_CRK_PLAUS FORMAT "%5.0"
 /begin AXIS_DESCR COM_AXIS online_dummy _CNV_A_R_LINEAR_____0_CM 6 0. 5. FORMAT "%2.0" AXIS_PTS_REF ldp_fmy_dtc /end AXIS_DESCR
/end CHARACTERISTIC
/begin CHARACTERISTIC fmy_id_crk_plaus.envd "environmental data contents of customer specific freeze frame for diagnosis instance CRK_PLAUS" CURVE 0x85d1aa _REC_CUR_20_u1_u1 255. _CNV_A_R_LINEAR_____1_CM 0. 255. DISPLAY_IDENTIFIER ID_ERR_ENVD_CRK_PLAUS FORMAT "%3.0"
 /begin AXIS_DESCR COM_AXIS online_dummy _CNV_A_R_LINEAR_____0_CM 8 0. 7. READ_ONLY FORMAT "%2.0" AXIS_PTS_REF ldp_fmy_envd /end AXIS_DESCR
/end CHARACTERISTIC
/begin CHARACTERISTIC fmy_id_crk_plaus.c_err_clas "error class for diagnosis instance CRK_PLAUS" VALUE 0x85d1b2 _REC_VAL_20_u1 255. _CNV_A_R_LINEAR_____1_CM 0. 255. DISPLAY_IDENTIFIER C_ERR_CLAS_CRK_PLAUS FORMAT "%3.0" /end CHARACTERISTIC
/begin CHARACTERISTIC fmy_id_plaus_cam_in_1.dtc[0] "diagnostic trouble codes for diagnosis instance PLAUS_CAM_IN_1" CURVE 0x85d1b4 _REC_CUR_20_u2_u2 65535. _CNV_A_R_LINEAR_____1_CM 0. 65535. DISPLAY_IDENTIFIER ID_ERR_DTC_PLAUS_CAM_IN_1 FORMAT "%5.0"
 /begin AXIS_DESCR COM_AXIS online_dummy _CNV_A_R_LINEAR_____0_CM 6 0. 5. FORMAT "%2.0" AXIS_PTS_REF ldp_fmy_dtc /end AXIS_DESCR
/end CHARACTERISTIC
/begin CHARACTERISTIC fmy_id_plaus_cam_in_1.envd "environmental data contents of customer specific freeze frame for diagnosis instance PLAUS_CAM_IN_1" CURVE 0x85d1c0 _REC_CUR_20_u1_u1 255. _CNV_A_R_LINEAR_____1_CM 0. 255. DISPLAY_IDENTIFIER ID_ERR_ENVD_PLAUS_CAM_IN_1 FORMAT "%3.0"
 /begin AXIS_DESCR COM_AXIS online_dummy _CNV_A_R_LINEAR_____0_CM 8 0. 7. READ_ONLY FORMAT "%2.0" AXIS_PTS_REF ldp_fmy_envd /end AXIS_DESCR
/end CHARACTERISTIC
/begin CHARACTERISTIC fmy_id_plaus_cam_in_1.c_err_clas "error class for diagnosis instance PLAUS_CAM_IN_1" VALUE 0x85d1c8 _REC_VAL_20_u1 255. _CNV_A_R_LINEAR_____1_CM 0. 255. DISPLAY_IDENTIFIER C_ERR_CLAS_PLAUS_CAM_IN_1 FORMAT "%3.0" /end CHARACTERISTIC
/begin CHARACTERISTIC fmy_id_syn_crk_cam_in_1.dtc[0] "diagnostic trouble codes for diagnosis instance SYN_CRK_CAM_IN_1" CURVE 0x85d1ca _REC_CUR_20_u2_u2 65535. _CNV_A_R_LINEAR_____1_CM 0. 65535. DISPLAY_IDENTIFIER ID_ERR_DTC_SYN_CRK_CAM_IN_1 FORMAT "%5.0"
 /begin AXIS_DESCR COM_AXIS online_dummy _CNV_A_R_LINEAR_____0_CM 6 0. 5. FORMAT "%2.0" AXIS_PTS_REF ldp_fmy_dtc /end AXIS_DESCR
/end CHARACTERISTIC
/begin CHARACTERISTIC fmy_id_syn_crk_cam_in_1.envd "environmental data contents of customer specific freeze frame for diagnosis instance SYN_CRK_CAM_IN_1" CURVE 0x85d1d6 _REC_CUR_20_u1_u1 255. _CNV_A_R_LINEAR_____1_CM 0. 255. DISPLAY_IDENTIFIER ID_ERR_ENVD_SYN_CRK_CAM_IN_1 FORMAT "%3.0"
 /begin AXIS_DESCR COM_AXIS online_dummy _CNV_A_R_LINEAR_____0_CM 8 0. 7. READ_ONLY FORMAT "%2.0" AXIS_PTS_REF ldp_fmy_envd /end AXIS_DESCR
/end CHARACTERISTIC
/begin CHARACTERISTIC fmy_id_syn_crk_cam_in_1.c_err_clas "error class for diagnosis instance SYN_CRK_CAM_IN_1" VALUE 0x85d1de _REC_VAL_20_u1 255. _CNV_A_R_LINEAR_____1_CM 0. 255. DISPLAY_IDENTIFIER C_ERR_CLAS_SYN_CRK_CAM_IN_1 FORMAT "%3.0" /end CHARACTERISTIC
/begin COMPU_METHOD _CNV_A_R_LINEAR_____0_CM "" RAT_FUNC "%6.3" "[-]" COEFFS 0 1. 0. 0 0 1 /end COMPU_METHOD
/begin COMPU_METHOD _CNV_A_R_LINEAR_____1_CM "" RAT_FUNC "%6.3" "-" COEFFS 0 1. 0. 0 0 1 /end COMPU_METHOD
/begin RECORD_LAYOUT _REC_VAL_20_u1 FNC_VALUES 1 UBYTE COLUMN_DIR DIRECT /end RECORD_LAYOUT
/begin RECORD_LAYOUT _REC_AXS_20_u2 NO_AXIS_PTS_X 1 UWORD AXIS_PTS_X 2 UWORD INDEX_INCR DIRECT /end RECORD_LAYOUT
/begin RECORD_LAYOUT _REC_AXS_20_u1 NO_AXIS_PTS_X 1 UBYTE AXIS_PTS_X 2 UBYTE INDEX_INCR DIRECT /end RECORD_LAYOUT
/begin RECORD_LAYOUT _REC_CUR_20_u2_u2 FNC_VALUES 1 UWORD COLUMN_DIR DIRECT /end RECORD_LAYOUT
/begin RECORD_LAYOUT _REC_CUR_20_u1_u1 FNC_VALUES 1 UBYTE COLUMN_DIR DIRECT /end RECORD_LAYOUT
/begin FUNCTION ERRM_CAL_APVSDIAG "Error Management Calibrations for diagnosis APVSDIAG"
 /begin DEF_CHARACTERISTIC fmy_id_pvs_l_1.dtc[0] fmy_id_pvs_l_1.envd fmy_id_pvs_l_1.c_err_clas fmy_id_pvs_l_2.dtc[0] fmy_id_pvs_l_2.envd fmy_id_pvs_l_2.c_err_clas fmy_id_pvs_h_1.dtc[0] fmy_id_pvs_h_1.envd fmy_id_pvs_h_1.c_err_clas fmy_id_pvs_h_2.dtc[0] fmy_id_pvs_h_2.envd fmy_id_pvs_h_2.c_err_clas fmy_id_pvs_ratio.dtc[0] fmy_id_pvs_ratio.envd fmy_id_pvs_ratio.c_err_clas fmy_id_pvs_move.dtc[0] fmy_id_pvs_move.envd fmy_id_pvs_move.c_err_clas fmy_id_pvs_bls_bts.dtc[0] fmy_id_pvs_bls_bts.envd fmy_id_pvs_bls_bts.c_err_clas /end DEF_CHARACTERISTIC
/end FUNCTION
/begin FUNCTION ERRM_CAL_AVCCDIAG "Error Management Calibrations for diagnosis AVCCDIAG"
 /begin DEF_CHARACTERISTIC fmy_id_vcc_1.dtc[0] fmy_id_vcc_1.envd fmy_id_vcc_1.c_err_clas fmy_id_vcc_2.dtc[0] fmy_id_vcc_2.envd fmy_id_vcc_2.c_err_clas /end DEF_CHARACTERISTIC
/end FUNCTION
/begin FUNCTION ERRM_CAL_ERRM_DIAG "Error Management Calibrations for diagnosis ERRM_DIAG"
 /begin DEF_CHARACTERISTIC fmy_id_v_dip_pf_rng.dtc[0] fmy_id_v_dip_pf_rng.envd fmy_id_v_dip_pf_rng.c_err_clas fmy_id_dip_pf_mes_es.dtc[0] fmy_id_dip_pf_mes_es.envd fmy_id_dip_pf_mes_es.c_err_clas fmy_id_dip_pf_mes_eru.dtc[0] fmy_id_dip_pf_mes_eru.envd fmy_id_dip_pf_mes_eru.c_err_clas fmy_id_egr_is_slow_obd.dtc[0] fmy_id_egr_is_slow_obd.envd fmy_id_egr_is_slow_obd.c_err_clas fmy_id_egrv.dtc[0] fmy_id_egrv.envd fmy_id_egrv.c_err_clas fmy_id_fsd_1.dtc[0] fmy_id_fsd_1.envd fmy_id_fsd_1.c_err_clas fmy_id_mis_a.dtc[0] fmy_id_mis_a.envd fmy_id_mis_a.c_err_clas fmy_id_mis_b1.dtc[0] fmy_id_mis_b1.envd fmy_id_mis_b1.c_err_clas fmy_id_mis_b4.dtc[0] fmy_id_mis_b4.envd fmy_id_mis_b4.c_err_clas fmy_id_pcv_2.dtc[0] fmy_id_pcv_2.envd fmy_id_pcv_2.c_err_clas fmy_id_thr.dtc[0] fmy_id_thr.envd fmy_id_thr.c_err_clas fmy_id_var_cod.dtc[0] fmy_id_var_cod.envd fmy_id_var_cod.c_err_clas fmy_id_vcv_2.dtc[0] fmy_id_vcv_2.envd fmy_id_vcv_2.c_err_clas /end DEF_CHARACTERISTIC
/end FUNCTION
/begin FUNCTION ERRM_CAL_ATCODIAG "Error Management Calibrations for diagnosis ATCODIAG"
 /begin DEF_CHARACTERISTIC fmy_id_v_tco_1_rng.dtc[0] fmy_id_v_tco_1_rng.envd fmy_id_v_tco_1_rng.c_err_clas fmy_id_v_tco_2_rng.dtc[0] fmy_id_v_tco_2_rng.envd fmy_id_v_tco_2_rng.c_err_clas fmy_id_tco_1_mes_grd.dtc[0] fmy_id_tco_1_mes_grd.envd fmy_id_tco_1_mes_grd.c_err_clas fmy_id_tco_2_mes_grd.dtc[0] fmy_id_tco_2_mes_grd.envd fmy_id_tco_2_mes_grd.c_err_clas fmy_id_tco_mes_plaus.dtc[0] fmy_id_tco_mes_plaus.envd fmy_id_tco_mes_plaus.c_err_clas /end DEF_CHARACTERISTIC
/end FUNCTION
/begin FUNCTION ERRM_CAL_AEGRCTLD "Error Management Calibrations for diagnosis AEGRCTLD"
 /begin DEF_CHARACTERISTIC fmy_id_egr_ctl_min.dtc[0] fmy_id_egr_ctl_min.envd fmy_id_egr_ctl_min.c_err_clas fmy_id_egr_ctl_max.dtc[0] fmy_id_egr_ctl_max.envd fmy_id_egr_ctl_max.c_err_clas /end DEF_CHARACTERISTIC
/end FUNCTION
/begin FUNCTION ERRM_CAL_AAMPDIAG "Error Management Calibrations for diagnosis AAMPDIAG"
 /begin DEF_CHARACTERISTIC fmy_id_v_amp_rng.dtc[0] fmy_id_v_amp_rng.envd fmy_id_v_amp_rng.c_err_clas fmy_id_amp_mes_grd.dtc[0] fmy_id_amp_mes_grd.envd fmy_id_amp_mes_grd.c_err_clas /end DEF_CHARACTERISTIC
/end FUNCTION
/begin FUNCTION ERRM_CAL_ATFU "Error Management Calibrations for diagnosis ATFU"
 /begin DEF_CHARACTERISTIC fmy_id_v_tfu_rng.dtc[0] fmy_id_v_tfu_rng.envd fmy_id_v_tfu_rng.c_err_clas fmy_id_tfu_mes_grd.dtc[0] fmy_id_tfu_mes_grd.envd fmy_id_tfu_mes_grd.c_err_clas /end DEF_CHARACTERISTIC
/end FUNCTION
/begin FUNCTION ERRM_CAL_AMAPDIAG "Error Management Calibrations for diagnosis AMAPDIAG"
 /begin DEF_CHARACTERISTIC fmy_id_v_map_rng.dtc[0] fmy_id_v_map_rng.envd fmy_id_v_map_rng.c_err_clas fmy_id_map_amp_ofs.dtc[0] fmy_id_map_amp_ofs.envd fmy_id_map_amp_ofs.c_err_clas fmy_id_map_is_ofs.dtc[0] fmy_id_map_is_ofs.envd fmy_id_map_is_ofs.c_err_clas fmy_id_map_mes_grd.dtc[0] fmy_id_map_mes_grd.envd fmy_id_map_mes_grd.c_err_clas /end DEF_CHARACTERISTIC
/end FUNCTION
/begin FUNCTION ERRM_CAL_AMAFPLAD "Error Management Calibrations for diagnosis AMAFPLAD"
 /begin DEF_CHARACTERISTIC fmy_id_maf_kgh_plaus.dtc[0] fmy_id_maf_kgh_plaus.envd fmy_id_maf_kgh_plaus.c_err_clas /end DEF_CHARACTERISTIC
/end FUNCTION
/begin FUNCTION ERRM_CAL_AMAFANAD "Error Management Calibrations for diagnosis AMAFANAD"
 /begin DEF_CHARACTERISTIC fmy_id_maf_0_rng.dtc[0] fmy_id_maf_0_rng.envd fmy_id_maf_0_rng.c_err_clas /end DEF_CHARACTERISTIC
/end FUNCTION
/begin FUNCTION ERRM_CAL_ATPCDIAG "Error Management Calibrations for diagnosis ATPCDIAG"
 /begin DEF_CHARACTERISTIC fmy_id_v_tpc_rng.dtc[0] fmy_id_v_tpc_rng.envd fmy_id_v_tpc_rng.c_err_clas fmy_id_tpc_mes_plaus.dtc[0] fmy_id_tpc_mes_plaus.envd fmy_id_tpc_mes_plaus.c_err_clas /end DEF_CHARACTERISTIC
/end FUNCTION
/begin FUNCTION ERRM_CAL_ATACDIAG "Error Management Calibrations for diagnosis ATACDIAG"
 /begin DEF_CHARACTERISTIC fmy_id_v_tac_rng.dtc[0] fmy_id_v_tac_rng.envd fmy_id_v_tac_rng.c_err_clas fmy_id_tac_mes_plaus.dtc[0] fmy_id_tac_mes_plaus.envd fmy_id_tac_mes_plaus.c_err_clas /end DEF_CHARACTERISTIC
/end FUNCTION
/begin FUNCTION ERRM_CAL_AOBDFSD "Error Management Calibrations for diagnosis AOBDFSD"
 /begin DEF_CHARACTERISTIC fmy_id_mf_is_obd.dtc[0] fmy_id_mf_is_obd.envd fmy_id_mf_is_obd.c_err_clas /end DEF_CHARACTERISTIC
/end FUNCTION
/begin FUNCTION ERRM_CAL_ACYBDIAG "Error Management Calibrations for diagnosis ACYBDIAG"
 /begin DEF_CHARACTERISTIC fmy_id_cyl_bal_0.dtc[0] fmy_id_cyl_bal_0.envd fmy_id_cyl_bal_0.c_err_clas fmy_id_cyl_bal_1.dtc[0] fmy_id_cyl_bal_1.envd fmy_id_cyl_bal_1.c_err_clas fmy_id_cyl_bal_2.dtc[0] fmy_id_cyl_bal_2.envd fmy_id_cyl_bal_2.c_err_clas fmy_id_cyl_bal_3.dtc[0] fmy_id_cyl_bal_3.envd fmy_id_cyl_bal_3.c_err_clas /end DEF_CHARACTERISTIC
/end FUNCTION
/begin FUNCTION ERRM_CAL_AEGRVCAD "Error Management Calibrations for diagnosis AEGRVCAD"
 /begin DEF_CHARACTERISTIC fmy_id_egrv_0_ctl.dtc[0] fmy_id_egrv_0_ctl.envd fmy_id_egrv_0_ctl.c_err_clas fmy_id_v_egrv_0_bol_ad.dtc[0] fmy_id_v_egrv_0_bol_ad.envd fmy_id_v_egrv_0_bol_ad.c_err_clas /end DEF_CHARACTERISTIC
/end FUNCTION
/begin FUNCTION ERRM_CAL_ATHRCAD "Error Management Calibrations for diagnosis ATHRCAD"
 /begin DEF_CHARACTERISTIC fmy_id_thr_0_ctl.dtc[0] fmy_id_thr_0_ctl.envd fmy_id_thr_0_ctl.c_err_clas fmy_id_v_thr_0_bol_ad.dtc[0] fmy_id_v_thr_0_bol_ad.envd fmy_id_v_thr_0_bol_ad.c_err_clas /end DEF_CHARACTERISTIC
/end FUNCTION
/begin FUNCTION ERRM_CAL_ABPACAD "Error Management Calibrations for diagnosis ABPACAD"
 /begin DEF_CHARACTERISTIC fmy_id_bpa_0_ctl.dtc[0] fmy_id_bpa_0_ctl.envd fmy_id_bpa_0_ctl.c_err_clas fmy_id_v_bpa_0_bol_ad.dtc[0] fmy_id_v_bpa_0_bol_ad.envd fmy_id_v_bpa_0_bol_ad.c_err_clas /end DEF_CHARACTERISTIC
/end FUNCTION
/begin FUNCTION ERRM_CAL_ABYPCAD "Error Management Calibrations for diagnosis ABYPCAD"
 /begin DEF_CHARACTERISTIC fmy_id_byp_0_ctl.dtc[0] fmy_id_byp_0_ctl.envd fmy_id_byp_0_ctl.c_err_clas fmy_id_v_byp_0_bol_ad.dtc[0] fmy_id_v_byp_0_bol_ad.envd fmy_id_v_byp_0_bol_ad.c_err_clas /end DEF_CHARACTERISTIC
/end FUNCTION
/begin FUNCTION ERRM_CAL_AMAPCTLD "Error Management Calibrations for diagnosis AMAPCTLD"
 /begin DEF_CHARACTERISTIC fmy_id_map_ctl_min.dtc[0] fmy_id_map_ctl_min.envd fmy_id_map_ctl_min.c_err_clas fmy_id_map_ctl_max.dtc[0] fmy_id_map_ctl_max.envd fmy_id_map_ctl_max.c_err_clas /end DEF_CHARACTERISTIC
/end FUNCTION
/begin FUNCTION ERRM_CAL_AOBDEGR "Error Management Calibrations for diagnosis AOBDEGR"
 /begin DEF_CHARACTERISTIC fmy_id_maf_egr_thr_obd.dtc[0] fmy_id_maf_egr_thr_obd.envd fmy_id_maf_egr_thr_obd.c_err_clas fmy_id_maf_dif_egr_thr_obd.dtc[0] fmy_id_maf_dif_egr_thr_obd.envd fmy_id_maf_dif_egr_thr_obd.c_err_clas fmy_id_map_dif_egr_thr_obd.dtc[0] fmy_id_map_dif_egr_thr_obd.envd fmy_id_map_dif_egr_thr_obd.c_err_clas /end DEF_CHARACTERISTIC
/end FUNCTION
/begin FUNCTION ERRM_CAL_AVSDIAG "Error Management Calibrations for diagnosis AVSDIAG" /begin DEF_CHARACTERISTIC fmy_id_vs.dtc[0] fmy_id_vs.envd fmy_id_vs.c_err_clas /end DEF_CHARACTERISTIC /end FUNCTION
/begin FUNCTION ERRM_CAL_ACSDIAG "Error Management Calibrations for diagnosis ACSDIAG" /begin DEF_CHARACTERISTIC fmy_id_cs.dtc[0] fmy_id_cs.envd fmy_id_cs.c_err_clas /end DEF_CHARACTERISTIC /end FUNCTION
/begin FUNCTION ERRM_CAL_ABRAKE_D "Error Management Calibrations for diagnosis ABRAKE_D"
 /begin DEF_CHARACTERISTIC fmy_id_bls.dtc[0] fmy_id_bls.envd fmy_id_bls.c_err_clas fmy_id_bls_bts_dece.dtc[0] fmy_id_bls_bts_dece.envd fmy_id_bls_bts_dece.c_err_clas fmy_id_bls_bts_plaus.dtc[0] fmy_id_bls_bts_plaus.envd fmy_id_bls_bts_plaus.c_err_clas /end DEF_CHARACTERISTIC
/end FUNCTION
/begin FUNCTION ERRM_CAL_ACANDGO "Error Management Calibrations for diagnosis ACANDGO"
 /begin DEF_CHARACTERISTIC fmy_id_can_tcs.dtc[0] fmy_id_can_tcs.envd fmy_id_can_tcs.c_err_clas fmy_id_can_tcu.dtc[0] fmy_id_can_tcu.envd fmy_id_can_tcu.c_err_clas fmy_id_can_acu.dtc[0] fmy_id_can_acu.envd fmy_id_can_acu.c_err_clas fmy_id_can_ccu.dtc[0] fmy_id_can_ccu.envd fmy_id_can_ccu.c_err_clas fmy_id_can_icl.dtc[0] fmy_id_can_icl.envd fmy_id_can_icl.c_err_clas fmy_id_can_vecu.dtc[0] fmy_id_can_vecu.envd fmy_id_can_vecu.c_err_clas fmy_id_can_smls.dtc[0] fmy_id_can_smls.envd fmy_id_can_smls.c_err_clas fmy_id_can_boff.dtc[0] fmy_id_can_boff.envd fmy_id_can_boff.c_err_clas fmy_id_can_bem.dtc[0] fmy_id_can_bem.envd fmy_id_can_bem.c_err_clas fmy_id_can_if_cft.dtc[0] fmy_id_can_if_cft.envd fmy_id_can_if_cft.c_err_clas fmy_id_can_tot.dtc[0] fmy_id_can_tot.envd fmy_id_can_tot.c_err_clas /end DEF_CHARACTERISTIC
/end FUNCTION
/begin FUNCTION ERRM_CAL_AVARDIAG "Error Management Calibrations for diagnosis AVARDIAG"
 /begin DEF_CHARACTERISTIC fmy_id_varcod.dtc[0] fmy_id_varcod.envd fmy_id_varcod.c_err_clas /end DEF_CHARACTERISTIC
/end FUNCTION
/begin FUNCTION ERRM_CAL_AAC_DIAG "Error Management Calibrations for diagnosis AAC_DIAG"
 /begin DEF_CHARACTERISTIC fmy_id_acp_mes_rng.dtc[0] fmy_id_acp_mes_rng.envd fmy_id_acp_mes_rng.c_err_clas fmy_id_acp_mes_grd.dtc[0] fmy_id_acp_mes_grd.envd fmy_id_acp_mes_grd.c_err_clas /end DEF_CHARACTERISTIC
/end FUNCTION
/begin FUNCTION ERRM_CAL_ATBADIAG "Error Management Calibrations for diagnosis ATBADIAG"
 /begin DEF_CHARACTERISTIC fmy_id_v_tba_rng.dtc[0] fmy_id_v_tba_rng.envd fmy_id_v_tba_rng.c_err_clas fmy_id_tba_mes_grd.dtc[0] fmy_id_tba_mes_grd.envd fmy_id_tba_mes_grd.c_err_clas /end DEF_CHARACTERISTIC
/end FUNCTION
/begin FUNCTION ERRM_CAL_AALTDIAG "Error Management Calibrations for diagnosis AALTDIAG"
 /begin DEF_CHARACTERISTIC fmy_id_ducy_alter_pwm_rng.dtc[0] fmy_id_ducy_alter_pwm_rng.envd fmy_id_ducy_alter_pwm_rng.c_err_clas fmy_id_ducy_alter_pwm_grd.dtc[0] fmy_id_ducy_alter_pwm_grd.envd fmy_id_ducy_alter_pwm_grd.c_err_clas /end DEF_CHARACTERISTIC
/end FUNCTION
/begin FUNCTION ERRM_CAL_AVEGRVDG "Error Management Calibrations for diagnosis AVEGRVDG"
 /begin DEF_CHARACTERISTIC fmy_id_v_egrv_0_rng.dtc[0] fmy_id_v_egrv_0_rng.envd fmy_id_v_egrv_0_rng.c_err_clas fmy_id_v_egrv_1_rng.dtc[0] fmy_id_v_egrv_1_rng.envd fmy_id_v_egrv_1_rng.c_err_clas fmy_id_v_egrv_0_grd.dtc[0] fmy_id_v_egrv_0_grd.envd fmy_id_v_egrv_0_grd.c_err_clas fmy_id_v_egrv_1_grd.dtc[0] fmy_id_v_egrv_1_grd.envd fmy_id_v_egrv_1_grd.c_err_clas /end DEF_CHARACTERISTIC
/end FUNCTION
/begin FUNCTION ERRM_CAL_ACAPDIAG "Error Management Calibrations for diagnosis ACAPDIAG"
 /begin DEF_CHARACTERISTIC fmy_id_ges_maf_0_max.dtc[0] fmy_id_ges_maf_0_max.envd fmy_id_ges_maf_0_max.c_err_clas /end DEF_CHARACTERISTIC
/end FUNCTION
/begin FUNCTION ERRM_CAL_ATCOPLAD "Error Management Calibrations for diagnosis ATCOPLAD"
 /begin DEF_CHARACTERISTIC fmy_id_tco_1_2_plaus.dtc[0] fmy_id_tco_1_2_plaus.envd fmy_id_tco_1_2_plaus.c_err_clas /end DEF_CHARACTERISTIC
/end FUNCTION
/begin FUNCTION ERRM_CAL_AEFPDIAG "Error Management Calibrations for diagnosis AEFPDIAG"
 /begin DEF_CHARACTERISTIC fmy_id_efp_rly_dps.dtc[0] fmy_id_efp_rly_dps.envd fmy_id_efp_rly_dps.c_err_clas fmy_id_efp_rly_plaus_1.dtc[0] fmy_id_efp_rly_plaus_1.envd fmy_id_efp_rly_plaus_1.c_err_clas fmy_id_efp_rly_plaus_2.dtc[0] fmy_id_efp_rly_plaus_2.envd fmy_id_efp_rly_plaus_2.c_err_clas /end DEF_CHARACTERISTIC
/end FUNCTION
/begin FUNCTION ERRM_CAL_ASPIDIAG "Error Management Calibrations for diagnosis ASPIDIAG"
 /begin DEF_CHARACTERISTIC fmy_id_spi_mps.dtc[0] fmy_id_spi_mps.envd fmy_id_spi_mps.c_err_clas fmy_id_spi_oct.dtc[0] fmy_id_spi_oct.envd fmy_id_spi_oct.c_err_clas fmy_id_spi_qps.dtc[0] fmy_id_spi_qps.envd fmy_id_spi_qps.c_err_clas /end DEF_CHARACTERISTIC
/end FUNCTION
/begin FUNCTION ERRM_CAL_AEGRBYPD "Error Management Calibrations for diagnosis AEGRBYPD"
 /begin DEF_CHARACTERISTIC fmy_id_egr_byp_dps.dtc[0] fmy_id_egr_byp_dps.envd fmy_id_egr_byp_dps.c_err_clas /end DEF_CHARACTERISTIC
/end FUNCTION
/begin FUNCTION ERRM_CAL_AEGRVDHB "Error Management Calibrations for diagnosis AEGRVDHB"
 /begin DEF_CHARACTERISTIC fmy_id_egrv_0.dtc[0] fmy_id_egrv_0.envd fmy_id_egrv_0.c_err_clas /end DEF_CHARACTERISTIC
/end FUNCTION
/begin FUNCTION ERRM_CAL_AINJDIAG "Error Management Calibrations for diagnosis AINJDIAG"
 /begin DEF_CHARACTERISTIC fmy_id_pps_ini_0.dtc[0] fmy_id_pps_ini_0.envd fmy_id_pps_ini_0.c_err_clas fmy_id_pps_ini_tout_0.dtc[0] fmy_id_pps_ini_tout_0.envd fmy_id_pps_ini_tout_0.c_err_clas fmy_id_pps_plaus_0.dtc[0] fmy_id_pps_plaus_0.envd fmy_id_pps_plaus_0.c_err_clas fmy_id_pps_cal_0.dtc[0] fmy_id_pps_cal_0.envd fmy_id_pps_cal_0.c_err_clas fmy_id_pps_v_inj_0.dtc[0] fmy_id_pps_v_inj_0.envd fmy_id_pps_v_inj_0.c_err_clas fmy_id_pps_wdt_0.dtc[0] fmy_id_pps_wdt_0.envd fmy_id_pps_wdt_0.c_err_clas fmy_id_pps_fsm_0.dtc[0] fmy_id_pps_fsm_0.envd fmy_id_pps_fsm_0.c_err_clas fmy_id_pps_oc_0.dtc[0] fmy_id_pps_oc_0.envd fmy_id_pps_oc_0.c_err_clas fmy_id_pps_oc_1.dtc[0] fmy_id_pps_oc_1.envd fmy_id_pps_oc_1.c_err_clas fmy_id_pps_oc_2.dtc[0] fmy_id_pps_oc_2.envd fmy_id_pps_oc_2.c_err_clas fmy_id_pps_oc_3.dtc[0] fmy_id_pps_oc_3.envd fmy_id_pps_oc_3.c_err_clas fmy_id_pps_sc_h_l_0.dtc[0] fmy_id_pps_sc_h_l_0.envd fmy_id_pps_sc_h_l_0.c_err_clas fmy_id_pps_sc_h_l_1.dtc[0] fmy_id_pps_sc_h_l_1.envd fmy_id_pps_sc_h_l_1.c_err_clas fmy_id_pps_sc_h_l_2.dtc[0] fmy_id_pps_sc_h_l_2.envd fmy_id_pps_sc_h_l_2.c_err_clas fmy_id_pps_sc_h_l_3.dtc[0] fmy_id_pps_sc_h_l_3.envd fmy_id_pps_sc_h_l_3.c_err_clas fmy_id_pps_sc_h_0.dtc[0] fmy_id_pps_sc_h_0.envd fmy_id_pps_sc_h_0.c_err_clas fmy_id_pps_sc_l_0.dtc[0] fmy_id_pps_sc_l_0.envd fmy_id_pps_sc_l_0.c_err_clas /end DEF_CHARACTERISTIC
/end FUNCTION
/begin FUNCTION ERRM_CAL_ADGOSPI "Error Management Calibrations for diagnosis ADGOSPI"
 /begin DEF_CHARACTERISTIC fmy_id_bpa.dtc[0] fmy_id_bpa.envd fmy_id_bpa.c_err_clas fmy_id_gl_rly_dps.dtc[0] fmy_id_gl_rly_dps.envd fmy_id_gl_rly_dps.c_err_clas fmy_id_pcv_1.dtc[0] fmy_id_pcv_1.envd fmy_id_pcv_1.c_err_clas fmy_id_pcv_3.dtc[0] fmy_id_pcv_3.envd fmy_id_pcv_3.c_err_clas fmy_id_vcv_1.dtc[0] fmy_id_vcv_1.envd fmy_id_vcv_1.c_err_clas fmy_id_vcv_3.dtc[0] fmy_id_vcv_3.envd fmy_id_vcv_3.c_err_clas /end DEF_CHARACTERISTIC
/end FUNCTION
/begin FUNCTION ERRM_CAL_ARLYDIAG "Error Management Calibrations for diagnosis ARLYDIAG"
 /begin DEF_CHARACTERISTIC fmy_id_rly_main.dtc[0] fmy_id_rly_main.envd fmy_id_rly_main.c_err_clas fmy_id_rly_power.dtc[0] fmy_id_rly_power.envd fmy_id_rly_power.c_err_clas /end DEF_CHARACTERISTIC
/end FUNCTION
/begin FUNCTION ERRM_CAL_AVBDIAG "Error Management Calibrations for diagnosis AVBDIAG" /begin DEF_CHARACTERISTIC fmy_id_vb.dtc[0] fmy_id_vb.envd fmy_id_vb.c_err_clas /end DEF_CHARACTERISTIC /end FUNCTION
/begin FUNCTION ERRM_CAL_AERRMON "Error Management Calibrations for diagnosis AERRMON"
 /begin DEF_CHARACTERISTIC fmy_id_conv_mon_1.dtc[0] fmy_id_conv_mon_1.envd fmy_id_conv_mon_1.c_err_clas fmy_id_n_32_mon_1.dtc[0] fmy_id_n_32_mon_1.envd fmy_id_n_32_mon_1.c_err_clas fmy_id_pvs_mon_1.dtc[0] fmy_id_pvs_mon_1.envd fmy_id_pvs_mon_1.c_err_clas fmy_id_fcut_mon_1.dtc[0] fmy_id_fcut_mon_1.envd fmy_id_fcut_mon_1.c_err_clas fmy_id_tqi_n_max_mon_1.dtc[0] fmy_id_tqi_n_max_mon_1.envd fmy_id_tqi_n_max_mon_1.c_err_clas fmy_id_serv_mon_1.dtc[0] fmy_id_serv_mon_1.envd fmy_id_serv_mon_1.c_err_clas fmy_id_post_inh_mon.dtc[0] fmy_id_post_inh_mon.envd fmy_id_post_inh_mon.c_err_clas fmy_id_cru_inh_mon.dtc[0] fmy_id_cru_inh_mon.envd fmy_id_cru_inh_mon.c_err_clas fmy_id_can_inh_mon.dtc[0] fmy_id_can_inh_mon.envd fmy_id_can_inh_mon.c_err_clas /end DEF_CHARACTERISTIC
/end FUNCTION
/begin FUNCTION ERRM_CAL_TMO3ERRM "Error Management Calibrations for diagnosis TMO3ERRM"
 /begin DEF_CHARACTERISTIC fmy_id_mon_3.dtc[0] fmy_id_mon_3.envd fmy_id_mon_3.c_err_clas /end DEF_CHARACTERISTIC
/end FUNCTION
/begin FUNCTION ERRM_CAL_ENSD_DIAG "Error Management Calibrations for diagnosis ENSD_DIAG"
 /begin DEF_CHARACTERISTIC fmy_id_per_cam_in_1.dtc[0] fmy_id_per_cam_in_1.envd fmy_id_per_cam_in_1.c_err_clas fmy_id_syn_cam_in_1.dtc[0] fmy_id_syn_cam_in_1.envd fmy_id_syn_cam_in_1.c_err_clas fmy_id_ref_crk_cam_in_1.dtc[0] fmy_id_ref_crk_cam_in_1.envd fmy_id_ref_crk_cam_in_1.c_err_clas fmy_id_crk_tooth.dtc[0] fmy_id_crk_tooth.envd fmy_id_crk_tooth.c_err_clas fmy_id_crk_tooth_per.dtc[0] fmy_id_crk_tooth_per.envd fmy_id_crk_tooth_per.c_err_clas fmy_id_crk_syn.dtc[0] fmy_id_crk_syn.envd fmy_id_crk_syn.c_err_clas fmy_id_crk_plaus.dtc[0] fmy_id_crk_plaus.envd fmy_id_crk_plaus.c_err_clas fmy_id_plaus_cam_in_1.dtc[0] fmy_id_plaus_cam_in_1.envd fmy_id_plaus_cam_in_1.c_err_clas fmy_id_syn_crk_cam_in_1.dtc[0] fmy_id_syn_crk_cam_in_1.envd fmy_id_syn_crk_cam_in_1.c_err_clas /end DEF_CHARACTERISTIC
/end FUNCTION
/end MODULE
/end PROJECT
