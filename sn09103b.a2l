ASAP2_VERSION 1 41
/begin PROJECT SN0 "SIMOS PPD"
/begin HEADER "_default_HeaderComment" PROJECT_NO PRJ_NUM /end HEADER
/begin MODULE _default_ModuleName "_default_ModuleLongIdentifier"
/begin MOD_COMMON "_default_ModCommonComment" DEPOSIT ABSOLUTE BYTE_ORDER MSB_FIRST ALIGNMENT_BYTE 1 ALIGNMENT_WORD 2 ALIGNMENT_LONG 4 ALIGNMENT_FLOAT32_IEEE 4 ALIGNMENT_FLOAT64_IEEE 8 /end MOD_COMMON
/begin AXIS_PTS ldp_fmy_dtc "" 0x8416ac online_dummy _REC_AXS_20_u2 5. _CNV_A_R_LINEAR_____0_CM 6 0. 5. FORMAT "%2.0" /end AXIS_PTS
/begin AXIS_PTS ldp_fmy_envd "" 0x8416ba online_dummy _REC_AXS_20_u1 7. _CNV_A_R_LINEAR_____0_CM 8 0. 7. READ_ONLY FORMAT "%2.0" /end AXIS_PTS
/begin CHARACTERISTIC fmy_id_imob.dtc[0] "diagnostic trouble codes for diagnosis instance IMOB" CURVE 0x85c53e _REC_CUR_20_u2_u2 65535. _CNV_A_R_LINEAR_____1_CM 0. 65535. DISPLAY_IDENTIFIER ID_ERR_DTC_IMOB FORMAT "%5.0"
 /begin AXIS_DESCR COM_AXIS online_dummy _CNV_A_R_LINEAR_____0_CM 6 0. 5. FORMAT "%2.0" AXIS_PTS_REF ldp_fmy_dtc /end AXIS_DESCR
/end CHARACTERISTIC
/begin CHARACTERISTIC fmy_id_imob.envd "environmental data contents of customer specific freeze frame for diagnosis instance IMOB" CURVE 0x85c54a _REC_CUR_20_u1_u1 255. _CNV_A_R_LINEAR_____1_CM 0. 255. DISPLAY_IDENTIFIER ID_ERR_ENVD_IMOB FORMAT "%3.0"
 /begin AXIS_DESCR COM_AXIS online_dummy _CNV_A_R_LINEAR_____0_CM 8 0. 7. READ_ONLY FORMAT "%2.0" AXIS_PTS_REF ldp_fmy_envd /end AXIS_DESCR
/end CHARACTERISTIC
/begin CHARACTERISTIC fmy_id_imob.c_err_clas "error class for diagnosis instance IMOB" VALUE 0x85c552 _REC_VAL_20_u1 255. _CNV_A_R_LINEAR_____1_CM 0. 255. DISPLAY_IDENTIFIER C_ERR_CLAS_IMOB FORMAT "%3.0" /end CHARACTERISTIC
/begin CHARACTERISTIC fmy_id_ecu_4.dtc[0] "diagnostic trouble codes for diagnosis instance ECU_4" CURVE 0x85c554 _REC_CUR_20_u2_u2 65535. _CNV_A_R_LINEAR_____1_CM 0. 65535. DISPLAY_IDENTIFIER ID_ERR_DTC_ECU_4 FORMAT "%5.0"
 /begin AXIS_DESCR COM_AXIS online_dummy _CNV_A_R_LINEAR_____0_CM 6 0. 5. FORMAT "%2.0" AXIS_PTS_REF ldp_fmy_dtc /end AXIS_DESCR
/end CHARACTERISTIC
/begin CHARACTERISTIC fmy_id_ecu_4.envd "environmental data contents of customer specific freeze frame for diagnosis instance ECU_4" CURVE 0x85c560 _REC_CUR_20_u1_u1 255. _CNV_A_R_LINEAR_____1_CM 0. 255. DISPLAY_IDENTIFIER ID_ERR_ENVD_ECU_4 FORMAT "%3.0"
 /begin AXIS_DESCR COM_AXIS online_dummy _CNV_A_R_LINEAR_____0_CM 8 0. 7. READ_ONLY FORMAT "%2.0" AXIS_PTS_REF ldp_fmy_envd /end AXIS_DESCR
/end CHARACTERISTIC
/begin CHARACTERISTIC fmy_id_ecu_4.c_err_clas "error class for diagnosis instance ECU_4" VALUE 0x85c568 _REC_VAL_20_u1 255. _CNV_A_R_LINEAR_____1_CM 0. 255. DISPLAY_IDENTIFIER C_ERR_CLAS_ECU_4 FORMAT "%3.0" /end CHARACTERISTIC
/begin CHARACTERISTIC fmy_id_ecu_2.dtc[0] "diagnostic trouble codes for diagnosis instance ECU_2" CURVE 0x85c56a _REC_CUR_20_u2_u2 65535. _CNV_A_R_LINEAR_____1_CM 0. 65535. DISPLAY_IDENTIFIER ID_ERR_DTC_ECU_2 FORMAT "%5.0"
 /begin AXIS_DESCR COM_AXIS online_dummy _CNV_A_R_LINEAR_____0_CM 6 0. 5. FORMAT "%2.0" AXIS_PTS_REF ldp_fmy_dtc /end AXIS_DESCR
/end CHARACTERISTIC
/begin CHARACTERISTIC fmy_id_ecu_2.envd "environmental data contents of customer specific freeze frame for diagnosis instance ECU_2" CURVE 0x85c576 _REC_CUR_20_u1_u1 255. _CNV_A_R_LINEAR_____1_CM 0. 255. DISPLAY_IDENTIFIER ID_ERR_ENVD_ECU_2 FORMAT "%3.0"
 /begin AXIS_DESCR COM_AXIS online_dummy _CNV_A_R_LINEAR_____0_CM 8 0. 7. READ_ONLY FORMAT "%2.0" AXIS_PTS_REF ldp_fmy_envd /end AXIS_DESCR
/end CHARACTERISTIC
/begin CHARACTERISTIC fmy_id_ecu_2.c_err_clas "error class for diagnosis instance ECU_2" VALUE 0x85c57e _REC_VAL_20_u1 255. _CNV_A_R_LINEAR_____1_CM 0. 255. DISPLAY_IDENTIFIER C_ERR_CLAS_ECU_2 FORMAT "%3.0" /end CHARACTERISTIC
/begin CHARACTERISTIC fmy_id_v_dcdc_rng.dtc[0] "diagnostic trouble codes for diagnosis instance V_DCDC_RNG" CURVE 0x85c580 _REC_CUR_20_u2_u2 65535. _CNV_A_R_LINEAR_____1_CM 0. 65535. DISPLAY_IDENTIFIER ID_ERR_DTC_V_DCDC_RNG FORMAT "%5.0"
 /begin AXIS_DESCR COM_AXIS online_dummy _CNV_A_R_LINEAR_____0_CM 6 0. 5. FORMAT "%2.0" AXIS_PTS_REF ldp_fmy_dtc /end AXIS_DESCR
/end CHARACTERISTIC
/begin CHARACTERISTIC fmy_id_v_dcdc_rng.envd "environmental data contents of customer specific freeze frame for diagnosis instance V_DCDC_RNG" CURVE 0x85c58c _REC_CUR_20_u1_u1 255. _CNV_A_R_LINEAR_____1_CM 0. 255. DISPLAY_IDENTIFIER ID_ERR_ENVD_V_DCDC_RNG FORMAT "%3.0"
 /begin AXIS_DESCR COM_AXIS online_dummy _CNV_A_R_LINEAR_____0_CM 8 0. 7. READ_ONLY FORMAT "%2.0" AXIS_PTS_REF ldp_fmy_envd /end AXIS_DESCR
/end CHARACTERISTIC
/begin CHARACTERISTIC fmy_id_v_dcdc_rng.c_err_clas "error class for diagnosis instance V_DCDC_RNG" VALUE 0x85c594 _REC_VAL_20_u1 255. _CNV_A_R_LINEAR_____1_CM 0. 255. DISPLAY_IDENTIFIER C_ERR_CLAS_V_DCDC_RNG FORMAT "%3.0" /end CHARACTERISTIC
/begin MEASUREMENT lv_err_bpa "Error flag of diagnosis instance BPA" UBYTE _CNV_S_2_RANGE______28_CM 1 0. 0. 1. DISPLAY_IDENTIFIER LV_ERR_BPA ECU_ADDRESS 0x7fb545 /end MEASUREMENT
/begin MEASUREMENT fmy_stat_bpa.ctr_abc "anti bounce counter for diagnosis instance BPA" UBYTE _CNV_A_R_LINEAR_____1_CM 1 0. 0. 255. DISPLAY_IDENTIFIER CTR_ABC_BPA ECU_ADDRESS 0x7f9b05 FORMAT "%3.0" /end MEASUREMENT
/begin MEASUREMENT fmy_stat_bpa.ctr_end_diag "counter for end of diagnosis for diagnosis instance BPA" UBYTE _CNV_A_R_LINEAR_____1_CM 1 0. 0. 255. DISPLAY_IDENTIFIER CTR_ABC_END_DIAG_BPA ECU_ADDRESS 0x7f9b04 FORMAT "%3.0" /end MEASUREMENT
/begin MEASUREMENT fmy_stat_bpa.err_info_stat.reserved "" UWORD _CNV_A_R_LINEAR_____0_CM 1 0. 0. 65535. DISPLAY_IDENTIFIER FMY_STAT_BPA_ERR_INFO_STAT_RESER ECU_ADDRESS 0x7f9b02 BYTE_ORDER MSB_LAST BIT_MASK 0xF800 /end MEASUREMENT
/begin MEASUREMENT fmy_stat_bpa.err_info_stat.lv_cdn_diag_stc "Statistical flag for condition of diagnosis of the diagnosis instance BPA" UWORD _CNV_S_2_RANGE______380_CM 1 0. 0. 1. DISPLAY_IDENTIFIER LV_CDN_DIAG_STC_BPA ECU_ADDRESS 0x7f9b02 BYTE_ORDER MSB_LAST BIT_MASK 0x400 /end MEASUREMENT
/begin MEASUREMENT fmy_stat_bpa.err_info_stat.lv_lock_diag "lock flag (CPU load optimisation) of the diagnosis instance BPA" UWORD _CNV_S_2_RANGE______380_CM 1 0. 0. 1. DISPLAY_IDENTIFIER LV_LOCK_DIAG_BPA ECU_ADDRESS 0x7f9b02 BYTE_ORDER MSB_LAST BIT_MASK 0x200 /end MEASUREMENT
/begin MEASUREMENT fmy_stat_bpa.err_info_stat.lv_err_mem "storage in dynamic failure memory of the diagnosis instance BPA" UWORD _CNV_S_2_RANGE______380_CM 1 0. 0. 1. DISPLAY_IDENTIFIER LV_ERR_MEM_BPA ECU_ADDRESS 0x7f9b02 BYTE_ORDER MSB_LAST BIT_MASK 0x80 /end MEASUREMENT
/begin MEASUREMENT fmy_stat_bpa.err_info_stat.lv_ready "readiness status of the diagnosis instance BPA" UWORD _CNV_S_2_RANGE______380_CM 1 0. 0. 1. DISPLAY_IDENTIFIER LV_READY_BPA ECU_ADDRESS 0x7f9b02 BYTE_ORDER MSB_LAST BIT_MASK 0x40 /end MEASUREMENT
/begin MEASUREMENT fmy_stat_bpa.err_info_stat.lv_end_diag "end of diagnosis of the diagnosis instance BPA" UWORD _CNV_S_2_RANGE______380_CM 1 0. 0. 1. DISPLAY_IDENTIFIER LV_END_DIAG_BPA ECU_ADDRESS 0x7f9b02 BYTE_ORDER MSB_LAST BIT_MASK 0x20 /end MEASUREMENT
/begin MEASUREMENT fmy_stat_bpa.err_info_stat.lv_cdn_diag "diagnosis condition of the diagnosis instance BPA" UWORD _CNV_S_2_RANGE______380_CM 1 0. 0. 1. DISPLAY_IDENTIFIER LV_CDN_DIAG_BPA ECU_ADDRESS 0x7f9b02 BYTE_ORDER MSB_LAST BIT_MASK 0x10 /end MEASUREMENT
/begin MEASUREMENT fmy_stat_bpa.err_info_stat.err_sym "symptoms of the diagnosis instance BPA" UWORD _CNV_S_6_CONV_ERRM__27_CM 1 0. 0. 15. DISPLAY_IDENTIFIER ERR_SYM_BPA ECU_ADDRESS 0x7f9b02 BYTE_ORDER MSB_LAST BIT_MASK 0xF /end MEASUREMENT
/begin MEASUREMENT lv_err_gl_rly_dps "Error flag of diagnosis instance GL_RLY_DPS" UBYTE _CNV_S_2_RANGE______28_CM 1 0. 0. 1. DISPLAY_IDENTIFIER LV_ERR_GL_RLY_DPS ECU_ADDRESS 0x7fb548 /end MEASUREMENT
/begin MEASUREMENT fmy_stat_gl_rly_dps.ctr_abc "anti bounce counter for diagnosis instance GL_RLY_DPS" UBYTE _CNV_A_R_LINEAR_____1_CM 1 0. 0. 255. DISPLAY_IDENTIFIER CTR_ABC_GL_RLY_DPS ECU_ADDRESS 0x7f9b11 FORMAT "%3.0" /end MEASUREMENT
/begin MEASUREMENT fmy_stat_gl_rly_dps.ctr_end_diag "counter for end of diagnosis for diagnosis instance GL_RLY_DPS" UBYTE _CNV_A_R_LINEAR_____1_CM 1 0. 0. 255. DISPLAY_IDENTIFIER CTR_ABC_END_DIAG_GL_RLY_DPS ECU_ADDRESS 0x7f9b10 FORMAT "%3.0" /end MEASUREMENT
/begin MEASUREMENT fmy_stat_gl_rly_dps.err_info_stat.reserved "" UWORD _CNV_A_R_LINEAR_____0_CM 1 0. 0. 65535. DISPLAY_IDENTIFIER FMY_STAT_GL_RLY_DPS_ERR_INFO_STA ECU_ADDRESS 0x7f9b0e BYTE_ORDER MSB_LAST BIT_MASK 0xF800 /end MEASUREMENT
/begin MEASUREMENT fmy_stat_gl_rly_dps.err_info_stat.lv_cdn_diag_stc "Statistical flag for condition of diagnosis of the diagnosis instance GL_RLY_DPS" UWORD _CNV_S_2_RANGE______380_CM 1 0. 0. 1. DISPLAY_IDENTIFIER LV_CDN_DIAG_STC_GL_RLY_DPS ECU_ADDRESS 0x7f9b0e BYTE_ORDER MSB_LAST BIT_MASK 0x400 /end MEASUREMENT
/begin MEASUREMENT fmy_stat_gl_rly_dps.err_info_stat.lv_lock_diag "lock flag (CPU load optimisation) of the diagnosis instance GL_RLY_DPS" UWORD _CNV_S_2_RANGE______380_CM 1 0. 0. 1. DISPLAY_IDENTIFIER LV_LOCK_DIAG_GL_RLY_DPS ECU_ADDRESS 0x7f9b0e BYTE_ORDER MSB_LAST BIT_MASK 0x200 /end MEASUREMENT
/begin MEASUREMENT fmy_stat_gl_rly_dps.err_info_stat.lv_err_mem "storage in dynamic failure memory of the diagnosis instance GL_RLY_DPS" UWORD _CNV_S_2_RANGE______380_CM 1 0. 0. 1. DISPLAY_IDENTIFIER LV_ERR_MEM_GL_RLY_DPS ECU_ADDRESS 0x7f9b0e BYTE_ORDER MSB_LAST BIT_MASK 0x80 /end MEASUREMENT
/begin MEASUREMENT fmy_stat_gl_rly_dps.err_info_stat.lv_ready "readiness status of the diagnosis instance GL_RLY_DPS" UWORD _CNV_S_2_RANGE______380_CM 1 0. 0. 1. DISPLAY_IDENTIFIER LV_READY_GL_RLY_DPS ECU_ADDRESS 0x7f9b0e BYTE_ORDER MSB_LAST BIT_MASK 0x40 /end MEASUREMENT
/begin MEASUREMENT fmy_stat_gl_rly_dps.err_info_stat.lv_end_diag "end of diagnosis of the diagnosis instance GL_RLY_DPS" UWORD _CNV_S_2_RANGE______380_CM 1 0. 0. 1. DISPLAY_IDENTIFIER LV_END_DIAG_GL_RLY_DPS ECU_ADDRESS 0x7f9b0e BYTE_ORDER MSB_LAST BIT_MASK 0x20 /end MEASUREMENT
/begin MEASUREMENT fmy_stat_gl_rly_dps.err_info_stat.lv_cdn_diag "diagnosis condition of the diagnosis instance GL_RLY_DPS" UWORD _CNV_S_2_RANGE______380_CM 1 0. 0. 1. DISPLAY_IDENTIFIER LV_CDN_DIAG_GL_RLY_DPS ECU_ADDRESS 0x7f9b0e BYTE_ORDER MSB_LAST BIT_MASK 0x10 /end MEASUREMENT
/begin MEASUREMENT fmy_stat_gl_rly_dps.err_info_stat.err_sym "symptoms of the diagnosis instance GL_RLY_DPS" UWORD _CNV_S_6_CONV_ERRM__27_CM 1 0. 0. 15. DISPLAY_IDENTIFIER ERR_SYM_GL_RLY_DPS ECU_ADDRESS 0x7f9b0e BYTE_ORDER MSB_LAST BIT_MASK 0xF /end MEASUREMENT
/begin MEASUREMENT lv_err_pcv_1 "Error flag of diagnosis instance PCV_1" UBYTE _CNV_S_2_RANGE______28_CM 1 0. 0. 1. DISPLAY_IDENTIFIER LV_ERR_PCV_1 ECU_ADDRESS 0x7fb54c /end MEASUREMENT
/begin MEASUREMENT fmy_stat_pcv_1.ctr_abc "anti bounce counter for diagnosis instance PCV_1" UBYTE _CNV_A_R_LINEAR_____1_CM 1 0. 0. 255. DISPLAY_IDENTIFIER CTR_ABC_PCV_1 ECU_ADDRESS 0x7f9b21 FORMAT "%3.0" /end MEASUREMENT
/begin MEASUREMENT fmy_stat_pcv_1.ctr_end_diag "counter for end of diagnosis for diagnosis instance PCV_1" UBYTE _CNV_A_R_LINEAR_____1_CM 1 0. 0. 255. DISPLAY_IDENTIFIER CTR_ABC_END_DIAG_PCV_1 ECU_ADDRESS 0x7f9b20 FORMAT "%3.0" /end MEASUREMENT
/begin MEASUREMENT fmy_stat_pcv_1.err_info_stat.reserved "" UWORD _CNV_A_R_LINEAR_____0_CM 1 0. 0. 65535. DISPLAY_IDENTIFIER FMY_STAT_PCV_1_ERR_INFO_STAT_RES ECU_ADDRESS 0x7f9b1e BYTE_ORDER MSB_LAST BIT_MASK 0xF800 /end MEASUREMENT
/begin MEASUREMENT fmy_stat_pcv_1.err_info_stat.lv_cdn_diag_stc "Statistical flag for condition of diagnosis of the diagnosis instance PCV_1" UWORD _CNV_S_2_RANGE______380_CM 1 0. 0. 1. DISPLAY_IDENTIFIER LV_CDN_DIAG_STC_PCV_1 ECU_ADDRESS 0x7f9b1e BYTE_ORDER MSB_LAST BIT_MASK 0x400 /end MEASUREMENT
/begin MEASUREMENT fmy_stat_pcv_1.err_info_stat.lv_lock_diag "lock flag (CPU load optimisation) of the diagnosis instance PCV_1" UWORD _CNV_S_2_RANGE______380_CM 1 0. 0. 1. DISPLAY_IDENTIFIER LV_LOCK_DIAG_PCV_1 ECU_ADDRESS 0x7f9b1e BYTE_ORDER MSB_LAST BIT_MASK 0x200 /end MEASUREMENT
/begin MEASUREMENT fmy_stat_pcv_1.err_info_stat.lv_err_mem "storage in dynamic failure memory of the diagnosis instance PCV_1" UWORD _CNV_S_2_RANGE______380_CM 1 0. 0. 1. DISPLAY_IDENTIFIER LV_ERR_MEM_PCV_1 ECU_ADDRESS 0x7f9b1e BYTE_ORDER MSB_LAST BIT_MASK 0x80 /end MEASUREMENT
/begin MEASUREMENT fmy_stat_pcv_1.err_info_stat.lv_ready "readiness status of the diagnosis instance PCV_1" UWORD _CNV_S_2_RANGE______380_CM 1 0. 0. 1. DISPLAY_IDENTIFIER LV_READY_PCV_1 ECU_ADDRESS 0x7f9b1e BYTE_ORDER MSB_LAST BIT_MASK 0x40 /end MEASUREMENT
/begin MEASUREMENT fmy_stat_pcv_1.err_info_stat.lv_end_diag "end of diagnosis of the diagnosis instance PCV_1" UWORD _CNV_S_2_RANGE______380_CM 1 0. 0. 1. DISPLAY_IDENTIFIER LV_END_DIAG_PCV_1 ECU_ADDRESS 0x7f9b1e BYTE_ORDER MSB_LAST BIT_MASK 0x20 /end MEASUREMENT
/begin MEASUREMENT fmy_stat_pcv_1.err_info_stat.lv_cdn_diag "diagnosis condition of the diagnosis instance PCV_1" UWORD _CNV_S_2_RANGE______380_CM 1 0. 0. 1. DISPLAY_IDENTIFIER LV_CDN_DIAG_PCV_1 ECU_ADDRESS 0x7f9b1e BYTE_ORDER MSB_LAST BIT_MASK 0x10 /end MEASUREMENT
/begin MEASUREMENT fmy_stat_pcv_1.err_info_stat.err_sym "symptoms of the diagnosis instance PCV_1" UWORD _CNV_S_6_CONV_ERRM__27_CM 1 0. 0. 15. DISPLAY_IDENTIFIER ERR_SYM_PCV_1 ECU_ADDRESS 0x7f9b1e BYTE_ORDER MSB_LAST BIT_MASK 0xF /end MEASUREMENT
/begin MEASUREMENT lv_err_pcv_3 "Error flag of diagnosis instance PCV_3" UBYTE _CNV_S_2_RANGE______28_CM 1 0. 0. 1. DISPLAY_IDENTIFIER LV_ERR_PCV_3 ECU_ADDRESS 0x7fb54e /end MEASUREMENT
/begin MEASUREMENT fmy_stat_pcv_3.ctr_abc "anti bounce counter for diagnosis instance PCV_3" UBYTE _CNV_A_R_LINEAR_____1_CM 1 0. 0. 255. DISPLAY_IDENTIFIER CTR_ABC_PCV_3 ECU_ADDRESS 0x7f9b29 FORMAT "%3.0" /end MEASUREMENT
/begin MEASUREMENT fmy_stat_pcv_3.ctr_end_diag "counter for end of diagnosis for diagnosis instance PCV_3" UBYTE _CNV_A_R_LINEAR_____1_CM 1 0. 0. 255. DISPLAY_IDENTIFIER CTR_ABC_END_DIAG_PCV_3 ECU_ADDRESS 0x7f9b28 FORMAT "%3.0" /end MEASUREMENT
/begin MEASUREMENT fmy_stat_pcv_3.err_info_stat.reserved "" UWORD _CNV_A_R_LINEAR_____0_CM 1 0. 0. 65535. DISPLAY_IDENTIFIER FMY_STAT_PCV_3_ERR_INFO_STAT_RES ECU_ADDRESS 0x7f9b26 BYTE_ORDER MSB_LAST BIT_MASK 0xF800 /end MEASUREMENT
/begin MEASUREMENT fmy_stat_pcv_3.err_info_stat.lv_cdn_diag_stc "Statistical flag for condition of diagnosis of the diagnosis instance PCV_3" UWORD _CNV_S_2_RANGE______380_CM 1 0. 0. 1. DISPLAY_IDENTIFIER LV_CDN_DIAG_STC_PCV_3 ECU_ADDRESS 0x7f9b26 BYTE_ORDER MSB_LAST BIT_MASK 0x400 /end MEASUREMENT
/begin MEASUREMENT fmy_stat_pcv_3.err_info_stat.lv_lock_diag "lock flag (CPU load optimisation) of the diagnosis instance PCV_3" UWORD _CNV_S_2_RANGE______380_CM 1 0. 0. 1. DISPLAY_IDENTIFIER LV_LOCK_DIAG_PCV_3 ECU_ADDRESS 0x7f9b26 BYTE_ORDER MSB_LAST BIT_MASK 0x200 /end MEASUREMENT
/begin MEASUREMENT fmy_stat_pcv_3.err_info_stat.lv_err_mem "storage in dynamic failure memory of the diagnosis instance PCV_3" UWORD _CNV_S_2_RANGE______380_CM 1 0. 0. 1. DISPLAY_IDENTIFIER LV_ERR_MEM_PCV_3 ECU_ADDRESS 0x7f9b26 BYTE_ORDER MSB_LAST BIT_MASK 0x80 /end MEASUREMENT
/begin MEASUREMENT fmy_stat_pcv_3.err_info_stat.lv_ready "readiness status of the diagnosis instance PCV_3" UWORD _CNV_S_2_RANGE______380_CM 1 0. 0. 1. DISPLAY_IDENTIFIER LV_READY_PCV_3 ECU_ADDRESS 0x7f9b26 BYTE_ORDER MSB_LAST BIT_MASK 0x40 /end MEASUREMENT
/begin MEASUREMENT fmy_stat_pcv_3.err_info_stat.lv_end_diag "end of diagnosis of the diagnosis instance PCV_3" UWORD _CNV_S_2_RANGE______380_CM 1 0. 0. 1. DISPLAY_IDENTIFIER LV_END_DIAG_PCV_3 ECU_ADDRESS 0x7f9b26 BYTE_ORDER MSB_LAST BIT_MASK 0x20 /end MEASUREMENT
/begin MEASUREMENT fmy_stat_pcv_3.err_info_stat.lv_cdn_diag "diagnosis condition of the diagnosis instance PCV_3" UWORD _CNV_S_2_RANGE______380_CM 1 0. 0. 1. DISPLAY_IDENTIFIER LV_CDN_DIAG_PCV_3 ECU_ADDRESS 0x7f9b26 BYTE_ORDER MSB_LAST BIT_MASK 0x10 /end MEASUREMENT
/begin MEASUREMENT fmy_stat_pcv_3.err_info_stat.err_sym "symptoms of the diagnosis instance PCV_3" UWORD _CNV_S_6_CONV_ERRM__27_CM 1 0. 0. 15. DISPLAY_IDENTIFIER ERR_SYM_PCV_3 ECU_ADDRESS 0x7f9b26 BYTE_ORDER MSB_LAST BIT_MASK 0xF /end MEASUREMENT
/begin MEASUREMENT lv_err_rly_main "Error flag of diagnosis instance RLY_MAIN" UBYTE _CNV_S_2_RANGE______28_CM 1 0. 0. 1. DISPLAY_IDENTIFIER LV_ERR_RLY_MAIN ECU_ADDRESS 0x7fb54f /end MEASUREMENT
/begin MEASUREMENT fmy_stat_rly_main.ctr_abc "anti bounce counter for diagnosis instance RLY_MAIN" UBYTE _CNV_A_R_LINEAR_____1_CM 1 0. 0. 255. DISPLAY_IDENTIFIER CTR_ABC_RLY_MAIN ECU_ADDRESS 0x7f9b2d FORMAT "%3.0" /end MEASUREMENT
/begin MEASUREMENT fmy_stat_rly_main.ctr_end_diag "counter for end of diagnosis for diagnosis instance RLY_MAIN" UBYTE _CNV_A_R_LINEAR_____1_CM 1 0. 0. 255. DISPLAY_IDENTIFIER CTR_ABC_END_DIAG_RLY_MAIN ECU_ADDRESS 0x7f9b2c FORMAT "%3.0" /end MEASUREMENT
/begin MEASUREMENT fmy_stat_rly_main.err_info_stat.reserved "" UWORD _CNV_A_R_LINEAR_____0_CM 1 0. 0. 65535. DISPLAY_IDENTIFIER FMY_STAT_RLY_MAIN_ERR_INFO_STAT_ ECU_ADDRESS 0x7f9b2a BYTE_ORDER MSB_LAST BIT_MASK 0xF800 /end MEASUREMENT
/begin MEASUREMENT fmy_stat_rly_main.err_info_stat.lv_cdn_diag_stc "Statistical flag for condition of diagnosis of the diagnosis instance RLY_MAIN" UWORD _CNV_S_2_RANGE______380_CM 1 0. 0. 1. DISPLAY_IDENTIFIER LV_CDN_DIAG_STC_RLY_MAIN ECU_ADDRESS 0x7f9b2a BYTE_ORDER MSB_LAST BIT_MASK 0x400 /end MEASUREMENT
/begin MEASUREMENT fmy_stat_rly_main.err_info_stat.lv_lock_diag "lock flag (CPU load optimisation) of the diagnosis instance RLY_MAIN" UWORD _CNV_S_2_RANGE______380_CM 1 0. 0. 1. DISPLAY_IDENTIFIER LV_LOCK_DIAG_RLY_MAIN ECU_ADDRESS 0x7f9b2a BYTE_ORDER MSB_LAST BIT_MASK 0x200 /end MEASUREMENT
/begin MEASUREMENT fmy_stat_rly_main.err_info_stat.lv_err_mem "storage in dynamic failure memory of the diagnosis instance RLY_MAIN" UWORD _CNV_S_2_RANGE______380_CM 1 0. 0. 1. DISPLAY_IDENTIFIER LV_ERR_MEM_RLY_MAIN ECU_ADDRESS 0x7f9b2a BYTE_ORDER MSB_LAST BIT_MASK 0x80 /end MEASUREMENT
/begin MEASUREMENT fmy_stat_rly_main.err_info_stat.lv_ready "readiness status of the diagnosis instance RLY_MAIN" UWORD _CNV_S_2_RANGE______380_CM 1 0. 0. 1. DISPLAY_IDENTIFIER LV_READY_RLY_MAIN ECU_ADDRESS 0x7f9b2a BYTE_ORDER MSB_LAST BIT_MASK 0x40 /end MEASUREMENT
/begin MEASUREMENT fmy_stat_rly_main.err_info_stat.lv_end_diag "end of diagnosis of the diagnosis instance RLY_MAIN" UWORD _CNV_S_2_RANGE______380_CM 1 0. 0. 1. DISPLAY_IDENTIFIER LV_END_DIAG_RLY_MAIN ECU_ADDRESS 0x7f9b2a BYTE_ORDER MSB_LAST BIT_MASK 0x20 /end MEASUREMENT
/begin MEASUREMENT fmy_stat_rly_main.err_info_stat.lv_cdn_diag "diagnosis condition of the diagnosis instance RLY_MAIN" UWORD _CNV_S_2_RANGE______380_CM 1 0. 0. 1. DISPLAY_IDENTIFIER LV_CDN_DIAG_RLY_MAIN ECU_ADDRESS 0x7f9b2a BYTE_ORDER MSB_LAST BIT_MASK 0x10 /end MEASUREMENT
/begin MEASUREMENT fmy_stat_rly_main.err_info_stat.err_sym "symptoms of the diagnosis instance RLY_MAIN" UWORD _CNV_S_6_CONV_ERRM__27_CM 1 0. 0. 15. DISPLAY_IDENTIFIER ERR_SYM_RLY_MAIN ECU_ADDRESS 0x7f9b2a BYTE_ORDER MSB_LAST BIT_MASK 0xF /end MEASUREMENT
/begin MEASUREMENT lv_err_rly_power "Error flag of diagnosis instance RLY_POWER" UBYTE _CNV_S_2_RANGE______28_CM 1 0. 0. 1. DISPLAY_IDENTIFIER LV_ERR_RLY_POWER ECU_ADDRESS 0x7fb550 /end MEASUREMENT
/begin MEASUREMENT fmy_stat_rly_power.ctr_abc "anti bounce counter for diagnosis instance RLY_POWER" UBYTE _CNV_A_R_LINEAR_____1_CM 1 0. 0. 255. DISPLAY_IDENTIFIER CTR_ABC_RLY_POWER ECU_ADDRESS 0x7f9b31 FORMAT "%3.0" /end MEASUREMENT
/begin MEASUREMENT fmy_stat_rly_power.ctr_end_diag "counter for end of diagnosis for diagnosis instance RLY_POWER" UBYTE _CNV_A_R_LINEAR_____1_CM 1 0. 0. 255. DISPLAY_IDENTIFIER CTR_ABC_END_DIAG_RLY_POWER ECU_ADDRESS 0x7f9b30 FORMAT "%3.0" /end MEASUREMENT
/begin MEASUREMENT fmy_stat_rly_power.err_info_stat.reserved "" UWORD _CNV_A_R_LINEAR_____0_CM 1 0. 0. 65535. DISPLAY_IDENTIFIER FMY_STAT_RLY_POWER_ERR_INFO_STAT ECU_ADDRESS 0x7f9b2e BYTE_ORDER MSB_LAST BIT_MASK 0xF800 /end MEASUREMENT
/begin MEASUREMENT fmy_stat_rly_power.err_info_stat.lv_cdn_diag_stc "Statistical flag for condition of diagnosis of the diagnosis instance RLY_POWER" UWORD _CNV_S_2_RANGE______380_CM 1 0. 0. 1. DISPLAY_IDENTIFIER LV_CDN_DIAG_STC_RLY_POWER ECU_ADDRESS 0x7f9b2e BYTE_ORDER MSB_LAST BIT_MASK 0x400 /end MEASUREMENT
/begin MEASUREMENT fmy_stat_rly_power.err_info_stat.lv_lock_diag "lock flag (CPU load optimisation) of the diagnosis instance RLY_POWER" UWORD _CNV_S_2_RANGE______380_CM 1 0. 0. 1. DISPLAY_IDENTIFIER LV_LOCK_DIAG_RLY_POWER ECU_ADDRESS 0x7f9b2e BYTE_ORDER MSB_LAST BIT_MASK 0x200 /end MEASUREMENT
/begin MEASUREMENT fmy_stat_rly_power.err_info_stat.lv_err_mem "storage in dynamic failure memory of the diagnosis instance RLY_POWER" UWORD _CNV_S_2_RANGE______380_CM 1 0. 0. 1. DISPLAY_IDENTIFIER LV_ERR_MEM_RLY_POWER ECU_ADDRESS 0x7f9b2e BYTE_ORDER MSB_LAST BIT_MASK 0x80 /end MEASUREMENT
/begin MEASUREMENT fmy_stat_rly_power.err_info_stat.lv_ready "readiness status of the diagnosis instance RLY_POWER" UWORD _CNV_S_2_RANGE______380_CM 1 0. 0. 1. DISPLAY_IDENTIFIER LV_READY_RLY_POWER ECU_ADDRESS 0x7f9b2e BYTE_ORDER MSB_LAST BIT_MASK 0x40 /end MEASUREMENT
/begin MEASUREMENT fmy_stat_rly_power.err_info_stat.lv_end_diag "end of diagnosis of the diagnosis instance RLY_POWER" UWORD _CNV_S_2_RANGE______380_CM 1 0. 0. 1. DISPLAY_IDENTIFIER LV_END_DIAG_RLY_POWER ECU_ADDRESS 0x7f9b2e BYTE_ORDER MSB_LAST BIT_MASK 0x20 /end MEASUREMENT
/begin MEASUREMENT fmy_stat_rly_power.err_info_stat.lv_cdn_diag "diagnosis condition of the diagnosis instance RLY_POWER" UWORD _CNV_S_2_RANGE______380_CM 1 0. 0. 1. DISPLAY_IDENTIFIER LV_CDN_DIAG_RLY_POWER ECU_ADDRESS 0x7f9b2e BYTE_ORDER MSB_LAST BIT_MASK 0x10 /end MEASUREMENT
/begin MEASUREMENT fmy_stat_rly_power.err_info_stat.err_sym "symptoms of the diagnosis instance RLY_POWER" UWORD _CNV_S_6_CONV_ERRM__27_CM 1 0. 0. 15. DISPLAY_IDENTIFIER ERR_SYM_RLY_POWER ECU_ADDRESS 0x7f9b2e BYTE_ORDER MSB_LAST BIT_MASK 0xF /end MEASUREMENT
/begin MEASUREMENT fmy_stat_vb.ctr_abc "anti bounce counter for diagnosis instance VB" UBYTE _CNV_A_R_LINEAR_____1_CM 1 0. 0. 255. DISPLAY_IDENTIFIER CTR_ABC_VB ECU_ADDRESS 0x7f9b3d FORMAT "%3.0" /end MEASUREMENT
/begin MEASUREMENT fmy_stat_vb.ctr_end_diag "counter for end of diagnosis for diagnosis instance VB" UBYTE _CNV_A_R_LINEAR_____1_CM 1 0. 0. 255. DISPLAY_IDENTIFIER CTR_ABC_END_DIAG_VB ECU_ADDRESS 0x7f9b3c FORMAT "%3.0" /end MEASUREMENT
/begin MEASUREMENT fmy_stat_vb.err_info_stat.reserved "" UWORD _CNV_A_R_LINEAR_____0_CM 1 0. 0. 65535. DISPLAY_IDENTIFIER FMY_STAT_VB_ERR_INFO_STAT_RESERV ECU_ADDRESS 0x7f9b3a BYTE_ORDER MSB_LAST BIT_MASK 0xF800 /end MEASUREMENT
/begin MEASUREMENT fmy_stat_vb.err_info_stat.lv_cdn_diag_stc "Statistical flag for condition of diagnosis of the diagnosis instance VB" UWORD _CNV_S_2_RANGE______380_CM 1 0. 0. 1. DISPLAY_IDENTIFIER LV_CDN_DIAG_STC_VB ECU_ADDRESS 0x7f9b3a BYTE_ORDER MSB_LAST BIT_MASK 0x400 /end MEASUREMENT
/begin MEASUREMENT fmy_stat_vb.err_info_stat.lv_lock_diag "lock flag (CPU load optimisation) of the diagnosis instance VB" UWORD _CNV_S_2_RANGE______380_CM 1 0. 0. 1. DISPLAY_IDENTIFIER LV_LOCK_DIAG_VB ECU_ADDRESS 0x7f9b3a BYTE_ORDER MSB_LAST BIT_MASK 0x200 /end MEASUREMENT
/begin MEASUREMENT fmy_stat_vb.err_info_stat.lv_err_mem "storage in dynamic failure memory of the diagnosis instance VB" UWORD _CNV_S_2_RANGE______380_CM 1 0. 0. 1. DISPLAY_IDENTIFIER LV_ERR_MEM_VB ECU_ADDRESS 0x7f9b3a BYTE_ORDER MSB_LAST BIT_MASK 0x80 /end MEASUREMENT
/begin MEASUREMENT fmy_stat_vb.err_info_stat.lv_ready "readiness status of the diagnosis instance VB" UWORD _CNV_S_2_RANGE______380_CM 1 0. 0. 1. DISPLAY_IDENTIFIER LV_READY_VB ECU_ADDRESS 0x7f9b3a BYTE_ORDER MSB_LAST BIT_MASK 0x40 /end MEASUREMENT
/begin MEASUREMENT fmy_stat_vb.err_info_stat.lv_end_diag "end of diagnosis of the diagnosis instance VB" UWORD _CNV_S_2_RANGE______380_CM 1 0. 0. 1. DISPLAY_IDENTIFIER LV_END_DIAG_VB ECU_ADDRESS 0x7f9b3a BYTE_ORDER MSB_LAST BIT_MASK 0x20 /end MEASUREMENT
/begin MEASUREMENT fmy_stat_vb.err_info_stat.lv_cdn_diag "diagnosis condition of the diagnosis instance VB" UWORD _CNV_S_2_RANGE______380_CM 1 0. 0. 1. DISPLAY_IDENTIFIER LV_CDN_DIAG_VB ECU_ADDRESS 0x7f9b3a BYTE_ORDER MSB_LAST BIT_MASK 0x10 /end MEASUREMENT
/begin MEASUREMENT fmy_stat_vb.err_info_stat.err_sym "symptoms of the diagnosis instance VB" UWORD _CNV_S_6_CONV_ERRM__27_CM 1 0. 0. 15. DISPLAY_IDENTIFIER ERR_SYM_VB ECU_ADDRESS 0x7f9b3a BYTE_ORDER MSB_LAST BIT_MASK 0xF /end MEASUREMENT
/begin MEASUREMENT lv_err_vcv_1 "Error flag of diagnosis instance VCV_1" UBYTE _CNV_S_2_RANGE______28_CM 1 0. 0. 1. DISPLAY_IDENTIFIER LV_ERR_VCV_1 ECU_ADDRESS 0x7fb554 /end MEASUREMENT
/begin MEASUREMENT fmy_stat_vcv_1.ctr_abc "anti bounce counter for diagnosis instance VCV_1" UBYTE _CNV_A_R_LINEAR_____1_CM 1 0. 0. 255. DISPLAY_IDENTIFIER CTR_ABC_VCV_1 ECU_ADDRESS 0x7f9b41 FORMAT "%3.0" /end MEASUREMENT
/begin MEASUREMENT fmy_stat_vcv_1.ctr_end_diag "counter for end of diagnosis for diagnosis instance VCV_1" UBYTE _CNV_A_R_LINEAR_____1_CM 1 0. 0. 255. DISPLAY_IDENTIFIER CTR_ABC_END_DIAG_VCV_1 ECU_ADDRESS 0x7f9b40 FORMAT "%3.0" /end MEASUREMENT
/begin MEASUREMENT fmy_stat_vcv_1.err_info_stat.reserved "" UWORD _CNV_A_R_LINEAR_____0_CM 1 0. 0. 65535. DISPLAY_IDENTIFIER FMY_STAT_VCV_1_ERR_INFO_STAT_RES ECU_ADDRESS 0x7f9b3e BYTE_ORDER MSB_LAST BIT_MASK 0xF800 /end MEASUREMENT
/begin MEASUREMENT fmy_stat_vcv_1.err_info_stat.lv_cdn_diag_stc "Statistical flag for condition of diagnosis of the diagnosis instance VCV_1" UWORD _CNV_S_2_RANGE______380_CM 1 0. 0. 1. DISPLAY_IDENTIFIER LV_CDN_DIAG_STC_VCV_1 ECU_ADDRESS 0x7f9b3e BYTE_ORDER MSB_LAST BIT_MASK 0x400 /end MEASUREMENT
/begin MEASUREMENT fmy_stat_vcv_1.err_info_stat.lv_lock_diag "lock flag (CPU load optimisation) of the diagnosis instance VCV_1" UWORD _CNV_S_2_RANGE______380_CM 1 0. 0. 1. DISPLAY_IDENTIFIER LV_LOCK_DIAG_VCV_1 ECU_ADDRESS 0x7f9b3e BYTE_ORDER MSB_LAST BIT_MASK 0x200 /end MEASUREMENT
/begin MEASUREMENT fmy_stat_vcv_1.err_info_stat.lv_err_mem "storage in dynamic failure memory of the diagnosis instance VCV_1" UWORD _CNV_S_2_RANGE______380_CM 1 0. 0. 1. DISPLAY_IDENTIFIER LV_ERR_MEM_VCV_1 ECU_ADDRESS 0x7f9b3e BYTE_ORDER MSB_LAST BIT_MASK 0x80 /end MEASUREMENT
/begin MEASUREMENT fmy_stat_vcv_1.err_info_stat.lv_ready "readiness status of the diagnosis instance VCV_1" UWORD _CNV_S_2_RANGE______380_CM 1 0. 0. 1. DISPLAY_IDENTIFIER LV_READY_VCV_1 ECU_ADDRESS 0x7f9b3e BYTE_ORDER MSB_LAST BIT_MASK 0x40 /end MEASUREMENT
/begin MEASUREMENT fmy_stat_vcv_1.err_info_stat.lv_end_diag "end of diagnosis of the diagnosis instance VCV_1" UWORD _CNV_S_2_RANGE______380_CM 1 0. 0. 1. DISPLAY_IDENTIFIER LV_END_DIAG_VCV_1 ECU_ADDRESS 0x7f9b3e BYTE_ORDER MSB_LAST BIT_MASK 0x20 /end MEASUREMENT
/begin MEASUREMENT fmy_stat_vcv_1.err_info_stat.lv_cdn_diag "diagnosis condition of the diagnosis instance VCV_1" UWORD _CNV_S_2_RANGE______380_CM 1 0. 0. 1. DISPLAY_IDENTIFIER LV_CDN_DIAG_VCV_1 ECU_ADDRESS 0x7f9b3e BYTE_ORDER MSB_LAST BIT_MASK 0x10 /end MEASUREMENT
/begin MEASUREMENT fmy_stat_vcv_1.err_info_stat.err_sym "symptoms of the diagnosis instance VCV_1" UWORD _CNV_S_6_CONV_ERRM__27_CM 1 0. 0. 15. DISPLAY_IDENTIFIER ERR_SYM_VCV_1 ECU_ADDRESS 0x7f9b3e BYTE_ORDER MSB_LAST BIT_MASK 0xF /end MEASUREMENT
/begin MEASUREMENT lv_err_vcv_3 "Error flag of diagnosis instance VCV_3" UBYTE _CNV_S_2_RANGE______28_CM 1 0. 0. 1. DISPLAY_IDENTIFIER LV_ERR_VCV_3 ECU_ADDRESS 0x7fb556 /end MEASUREMENT
/begin MEASUREMENT fmy_stat_vcv_3.ctr_abc "anti bounce counter for diagnosis instance VCV_3" UBYTE _CNV_A_R_LINEAR_____1_CM 1 0. 0. 255. DISPLAY_IDENTIFIER CTR_ABC_VCV_3 ECU_ADDRESS 0x7f9b49 FORMAT "%3.0" /end MEASUREMENT
/begin MEASUREMENT fmy_stat_vcv_3.ctr_end_diag "counter for end of diagnosis for diagnosis instance VCV_3" UBYTE _CNV_A_R_LINEAR_____1_CM 1 0. 0. 255. DISPLAY_IDENTIFIER CTR_ABC_END_DIAG_VCV_3 ECU_ADDRESS 0x7f9b48 FORMAT "%3.0" /end MEASUREMENT
/begin MEASUREMENT fmy_stat_vcv_3.err_info_stat.reserved "" UWORD _CNV_A_R_LINEAR_____0_CM 1 0. 0. 65535. DISPLAY_IDENTIFIER FMY_STAT_VCV_3_ERR_INFO_STAT_RES ECU_ADDRESS 0x7f9b46 BYTE_ORDER MSB_LAST BIT_MASK 0xF800 /end MEASUREMENT
/begin MEASUREMENT fmy_stat_vcv_3.err_info_stat.lv_cdn_diag_stc "Statistical flag for condition of diagnosis of the diagnosis instance VCV_3" UWORD _CNV_S_2_RANGE______380_CM 1 0. 0. 1. DISPLAY_IDENTIFIER LV_CDN_DIAG_STC_VCV_3 ECU_ADDRESS 0x7f9b46 BYTE_ORDER MSB_LAST BIT_MASK 0x400 /end MEASUREMENT
/begin MEASUREMENT fmy_stat_vcv_3.err_info_stat.lv_lock_diag "lock flag (CPU load optimisation) of the diagnosis instance VCV_3" UWORD _CNV_S_2_RANGE______380_CM 1 0. 0. 1. DISPLAY_IDENTIFIER LV_LOCK_DIAG_VCV_3 ECU_ADDRESS 0x7f9b46 BYTE_ORDER MSB_LAST BIT_MASK 0x200 /end MEASUREMENT
/begin MEASUREMENT fmy_stat_vcv_3.err_info_stat.lv_err_mem "storage in dynamic failure memory of the diagnosis instance VCV_3" UWORD _CNV_S_2_RANGE______380_CM 1 0. 0. 1. DISPLAY_IDENTIFIER LV_ERR_MEM_VCV_3 ECU_ADDRESS 0x7f9b46 BYTE_ORDER MSB_LAST BIT_MASK 0x80 /end MEASUREMENT
/begin MEASUREMENT fmy_stat_vcv_3.err_info_stat.lv_ready "readiness status of the diagnosis instance VCV_3" UWORD _CNV_S_2_RANGE______380_CM 1 0. 0. 1. DISPLAY_IDENTIFIER LV_READY_VCV_3 ECU_ADDRESS 0x7f9b46 BYTE_ORDER MSB_LAST BIT_MASK 0x40 /end MEASUREMENT
/begin MEASUREMENT fmy_stat_vcv_3.err_info_stat.lv_end_diag "end of diagnosis of the diagnosis instance VCV_3" UWORD _CNV_S_2_RANGE______380_CM 1 0. 0. 1. DISPLAY_IDENTIFIER LV_END_DIAG_VCV_3 ECU_ADDRESS 0x7f9b46 BYTE_ORDER MSB_LAST BIT_MASK 0x20 /end MEASUREMENT
/begin MEASUREMENT fmy_stat_vcv_3.err_info_stat.lv_cdn_diag "diagnosis condition of the diagnosis instance VCV_3" UWORD _CNV_S_2_RANGE______380_CM 1 0. 0. 1. DISPLAY_IDENTIFIER LV_CDN_DIAG_VCV_3 ECU_ADDRESS 0x7f9b46 BYTE_ORDER MSB_LAST BIT_MASK 0x10 /end MEASUREMENT
/begin MEASUREMENT fmy_stat_vcv_3.err_info_stat.err_sym "symptoms of the diagnosis instance VCV_3" UWORD _CNV_S_6_CONV_ERRM__27_CM 1 0. 0. 15. DISPLAY_IDENTIFIER ERR_SYM_VCV_3 ECU_ADDRESS 0x7f9b46 BYTE_ORDER MSB_LAST BIT_MASK 0xF /end MEASUREMENT
/begin MEASUREMENT lv_err_conv_mon_1 "Error flag of diagnosis instance CONV_MON_1" UBYTE _CNV_S_2_RANGE______28_CM 1 0. 0. 1. DISPLAY_IDENTIFIER LV_ERR_CONV_MON_1 ECU_ADDRESS 0x7fb557 /end MEASUREMENT
/begin MEASUREMENT fmy_stat_conv_mon_1.ctr_abc "anti bounce counter for diagnosis instance CONV_MON_1" UBYTE _CNV_A_R_LINEAR_____1_CM 1 0. 0. 255. DISPLAY_IDENTIFIER CTR_ABC_CONV_MON_1 ECU_ADDRESS 0x7f9b4d FORMAT "%3.0" /end MEASUREMENT
/begin MEASUREMENT fmy_stat_conv_mon_1.ctr_end_diag "counter for end of diagnosis for diagnosis instance CONV_MON_1" UBYTE _CNV_A_R_LINEAR_____1_CM 1 0. 0. 255. DISPLAY_IDENTIFIER CTR_ABC_END_DIAG_CONV_MON_1 ECU_ADDRESS 0x7f9b4c FORMAT "%3.0" /end MEASUREMENT
/begin MEASUREMENT fmy_stat_conv_mon_1.err_info_stat.reserved "" UWORD _CNV_A_R_LINEAR_____0_CM 1 0. 0. 65535. DISPLAY_IDENTIFIER FMY_STAT_CONV_MON_1_ERR_INFO_STA ECU_ADDRESS 0x7f9b4a BYTE_ORDER MSB_LAST BIT_MASK 0xF800 /end MEASUREMENT
/begin MEASUREMENT fmy_stat_conv_mon_1.err_info_stat.lv_cdn_diag_stc "Statistical flag for condition of diagnosis of the diagnosis instance CONV_MON_1" UWORD _CNV_S_2_RANGE______380_CM 1 0. 0. 1. DISPLAY_IDENTIFIER LV_CDN_DIAG_STC_CONV_MON_1 ECU_ADDRESS 0x7f9b4a BYTE_ORDER MSB_LAST BIT_MASK 0x400 /end MEASUREMENT
/begin MEASUREMENT fmy_stat_conv_mon_1.err_info_stat.lv_lock_diag "lock flag (CPU load optimisation) of the diagnosis instance CONV_MON_1" UWORD _CNV_S_2_RANGE______380_CM 1 0. 0. 1. DISPLAY_IDENTIFIER LV_LOCK_DIAG_CONV_MON_1 ECU_ADDRESS 0x7f9b4a BYTE_ORDER MSB_LAST BIT_MASK 0x200 /end MEASUREMENT
/begin MEASUREMENT fmy_stat_conv_mon_1.err_info_stat.lv_err_mem "storage in dynamic failure memory of the diagnosis instance CONV_MON_1" UWORD _CNV_S_2_RANGE______380_CM 1 0. 0. 1. DISPLAY_IDENTIFIER LV_ERR_MEM_CONV_MON_1 ECU_ADDRESS 0x7f9b4a BYTE_ORDER MSB_LAST BIT_MASK 0x80 /end MEASUREMENT
/begin MEASUREMENT fmy_stat_conv_mon_1.err_info_stat.lv_ready "readiness status of the diagnosis instance CONV_MON_1" UWORD _CNV_S_2_RANGE______380_CM 1 0. 0. 1. DISPLAY_IDENTIFIER LV_READY_CONV_MON_1 ECU_ADDRESS 0x7f9b4a BYTE_ORDER MSB_LAST BIT_MASK 0x40 /end MEASUREMENT
/begin MEASUREMENT fmy_stat_conv_mon_1.err_info_stat.lv_end_diag "end of diagnosis of the diagnosis instance CONV_MON_1" UWORD _CNV_S_2_RANGE______380_CM 1 0. 0. 1. DISPLAY_IDENTIFIER LV_END_DIAG_CONV_MON_1 ECU_ADDRESS 0x7f9b4a BYTE_ORDER MSB_LAST BIT_MASK 0x20 /end MEASUREMENT
/begin MEASUREMENT fmy_stat_conv_mon_1.err_info_stat.lv_cdn_diag "diagnosis condition of the diagnosis instance CONV_MON_1" UWORD _CNV_S_2_RANGE______380_CM 1 0. 0. 1. DISPLAY_IDENTIFIER LV_CDN_DIAG_CONV_MON_1 ECU_ADDRESS 0x7f9b4a BYTE_ORDER MSB_LAST BIT_MASK 0x10 /end MEASUREMENT
/begin MEASUREMENT fmy_stat_conv_mon_1.err_info_stat.err_sym "symptoms of the diagnosis instance CONV_MON_1" UWORD _CNV_S_6_CONV_ERRM__27_CM 1 0. 0. 15. DISPLAY_IDENTIFIER ERR_SYM_CONV_MON_1 ECU_ADDRESS 0x7f9b4a BYTE_ORDER MSB_LAST BIT_MASK 0xF /end MEASUREMENT
/begin MEASUREMENT lv_err_n_32_mon_1 "Error flag of diagnosis instance N_32_MON_1" UBYTE _CNV_S_2_RANGE______28_CM 1 0. 0. 1. DISPLAY_IDENTIFIER LV_ERR_N_32_MON_1 ECU_ADDRESS 0x7fb558 /end MEASUREMENT
/begin MEASUREMENT fmy_stat_n_32_mon_1.ctr_abc "anti bounce counter for diagnosis instance N_32_MON_1" UBYTE _CNV_A_R_LINEAR_____1_CM 1 0. 0. 255. DISPLAY_IDENTIFIER CTR_ABC_N_32_MON_1 ECU_ADDRESS 0x7f9b51 FORMAT "%3.0" /end MEASUREMENT
/begin MEASUREMENT fmy_stat_n_32_mon_1.ctr_end_diag "counter for end of diagnosis for diagnosis instance N_32_MON_1" UBYTE _CNV_A_R_LINEAR_____1_CM 1 0. 0. 255. DISPLAY_IDENTIFIER CTR_ABC_END_DIAG_N_32_MON_1 ECU_ADDRESS 0x7f9b50 FORMAT "%3.0" /end MEASUREMENT
/begin MEASUREMENT fmy_stat_n_32_mon_1.err_info_stat.reserved "" UWORD _CNV_A_R_LINEAR_____0_CM 1 0. 0. 65535. DISPLAY_IDENTIFIER FMY_STAT_N_32_MON_1_ERR_INFO_STA ECU_ADDRESS 0x7f9b4e BYTE_ORDER MSB_LAST BIT_MASK 0xF800 /end MEASUREMENT
/begin MEASUREMENT fmy_stat_n_32_mon_1.err_info_stat.lv_cdn_diag_stc "Statistical flag for condition of diagnosis of the diagnosis instance N_32_MON_1" UWORD _CNV_S_2_RANGE______380_CM 1 0. 0. 1. DISPLAY_IDENTIFIER LV_CDN_DIAG_STC_N_32_MON_1 ECU_ADDRESS 0x7f9b4e BYTE_ORDER MSB_LAST BIT_MASK 0x400 /end MEASUREMENT
/begin MEASUREMENT fmy_stat_n_32_mon_1.err_info_stat.lv_lock_diag "lock flag (CPU load optimisation) of the diagnosis instance N_32_MON_1" UWORD _CNV_S_2_RANGE______380_CM 1 0. 0. 1. DISPLAY_IDENTIFIER LV_LOCK_DIAG_N_32_MON_1 ECU_ADDRESS 0x7f9b4e BYTE_ORDER MSB_LAST BIT_MASK 0x200 /end MEASUREMENT
/begin MEASUREMENT fmy_stat_n_32_mon_1.err_info_stat.lv_err_mem "storage in dynamic failure memory of the diagnosis instance N_32_MON_1" UWORD _CNV_S_2_RANGE______380_CM 1 0. 0. 1. DISPLAY_IDENTIFIER LV_ERR_MEM_N_32_MON_1 ECU_ADDRESS 0x7f9b4e BYTE_ORDER MSB_LAST BIT_MASK 0x80 /end MEASUREMENT
/begin MEASUREMENT fmy_stat_n_32_mon_1.err_info_stat.lv_ready "readiness status of the diagnosis instance N_32_MON_1" UWORD _CNV_S_2_RANGE______380_CM 1 0. 0. 1. DISPLAY_IDENTIFIER LV_READY_N_32_MON_1 ECU_ADDRESS 0x7f9b4e BYTE_ORDER MSB_LAST BIT_MASK 0x40 /end MEASUREMENT
/begin MEASUREMENT fmy_stat_n_32_mon_1.err_info_stat.lv_end_diag "end of diagnosis of the diagnosis instance N_32_MON_1" UWORD _CNV_S_2_RANGE______380_CM 1 0. 0. 1. DISPLAY_IDENTIFIER LV_END_DIAG_N_32_MON_1 ECU_ADDRESS 0x7f9b4e BYTE_ORDER MSB_LAST BIT_MASK 0x20 /end MEASUREMENT
/begin MEASUREMENT fmy_stat_n_32_mon_1.err_info_stat.lv_cdn_diag "diagnosis condition of the diagnosis instance N_32_MON_1" UWORD _CNV_S_2_RANGE______380_CM 1 0. 0. 1. DISPLAY_IDENTIFIER LV_CDN_DIAG_N_32_MON_1 ECU_ADDRESS 0x7f9b4e BYTE_ORDER MSB_LAST BIT_MASK 0x10 /end MEASUREMENT
/begin MEASUREMENT fmy_stat_n_32_mon_1.err_info_stat.err_sym "symptoms of the diagnosis instance N_32_MON_1" UWORD _CNV_S_6_CONV_ERRM__27_CM 1 0. 0. 15. DISPLAY_IDENTIFIER ERR_SYM_N_32_MON_1 ECU_ADDRESS 0x7f9b4e BYTE_ORDER MSB_LAST BIT_MASK 0xF /end MEASUREMENT
/begin MEASUREMENT lv_err_pvs_mon_1 "Error flag of diagnosis instance PVS_MON_1" UBYTE _CNV_S_2_RANGE______28_CM 1 0. 0. 1. DISPLAY_IDENTIFIER LV_ERR_PVS_MON_1 ECU_ADDRESS 0x7fb559 /end MEASUREMENT
/begin MEASUREMENT fmy_stat_pvs_mon_1.ctr_abc "anti bounce counter for diagnosis instance PVS_MON_1" UBYTE _CNV_A_R_LINEAR_____1_CM 1 0. 0. 255. DISPLAY_IDENTIFIER CTR_ABC_PVS_MON_1 ECU_ADDRESS 0x7f9b55 FORMAT "%3.0" /end MEASUREMENT
/begin MEASUREMENT fmy_stat_pvs_mon_1.ctr_end_diag "counter for end of diagnosis for diagnosis instance PVS_MON_1" UBYTE _CNV_A_R_LINEAR_____1_CM 1 0. 0. 255. DISPLAY_IDENTIFIER CTR_ABC_END_DIAG_PVS_MON_1 ECU_ADDRESS 0x7f9b54 FORMAT "%3.0" /end MEASUREMENT
/begin MEASUREMENT fmy_stat_pvs_mon_1.err_info_stat.reserved "" UWORD _CNV_A_R_LINEAR_____0_CM 1 0. 0. 65535. DISPLAY_IDENTIFIER FMY_STAT_PVS_MON_1_ERR_INFO_STAT ECU_ADDRESS 0x7f9b52 BYTE_ORDER MSB_LAST BIT_MASK 0xF800 /end MEASUREMENT
/begin MEASUREMENT fmy_stat_pvs_mon_1.err_info_stat.lv_cdn_diag_stc "Statistical flag for condition of diagnosis of the diagnosis instance PVS_MON_1" UWORD _CNV_S_2_RANGE______380_CM 1 0. 0. 1. DISPLAY_IDENTIFIER LV_CDN_DIAG_STC_PVS_MON_1 ECU_ADDRESS 0x7f9b52 BYTE_ORDER MSB_LAST BIT_MASK 0x400 /end MEASUREMENT
/begin MEASUREMENT fmy_stat_pvs_mon_1.err_info_stat.lv_lock_diag "lock flag (CPU load optimisation) of the diagnosis instance PVS_MON_1" UWORD _CNV_S_2_RANGE______380_CM 1 0. 0. 1. DISPLAY_IDENTIFIER LV_LOCK_DIAG_PVS_MON_1 ECU_ADDRESS 0x7f9b52 BYTE_ORDER MSB_LAST BIT_MASK 0x200 /end MEASUREMENT
/begin MEASUREMENT fmy_stat_pvs_mon_1.err_info_stat.lv_err_mem "storage in dynamic failure memory of the diagnosis instance PVS_MON_1" UWORD _CNV_S_2_RANGE______380_CM 1 0. 0. 1. DISPLAY_IDENTIFIER LV_ERR_MEM_PVS_MON_1 ECU_ADDRESS 0x7f9b52 BYTE_ORDER MSB_LAST BIT_MASK 0x80 /end MEASUREMENT
/begin MEASUREMENT fmy_stat_pvs_mon_1.err_info_stat.lv_ready "readiness status of the diagnosis instance PVS_MON_1" UWORD _CNV_S_2_RANGE______380_CM 1 0. 0. 1. DISPLAY_IDENTIFIER LV_READY_PVS_MON_1 ECU_ADDRESS 0x7f9b52 BYTE_ORDER MSB_LAST BIT_MASK 0x40 /end MEASUREMENT
/begin MEASUREMENT fmy_stat_pvs_mon_1.err_info_stat.lv_end_diag "end of diagnosis of the diagnosis instance PVS_MON_1" UWORD _CNV_S_2_RANGE______380_CM 1 0. 0. 1. DISPLAY_IDENTIFIER LV_END_DIAG_PVS_MON_1 ECU_ADDRESS 0x7f9b52 BYTE_ORDER MSB_LAST BIT_MASK 0x20 /end MEASUREMENT
/begin MEASUREMENT fmy_stat_pvs_mon_1.err_info_stat.lv_cdn_diag "diagnosis condition of the diagnosis instance PVS_MON_1" UWORD _CNV_S_2_RANGE______380_CM 1 0. 0. 1. DISPLAY_IDENTIFIER LV_CDN_DIAG_PVS_MON_1 ECU_ADDRESS 0x7f9b52 BYTE_ORDER MSB_LAST BIT_MASK 0x10 /end MEASUREMENT
/begin MEASUREMENT fmy_stat_pvs_mon_1.err_info_stat.err_sym "symptoms of the diagnosis instance PVS_MON_1" UWORD _CNV_S_6_CONV_ERRM__27_CM 1 0. 0. 15. DISPLAY_IDENTIFIER ERR_SYM_PVS_MON_1 ECU_ADDRESS 0x7f9b52 BYTE_ORDER MSB_LAST BIT_MASK 0xF /end MEASUREMENT
/begin MEASUREMENT lv_err_fcut_mon_1 "Error flag of diagnosis instance FCUT_MON_1" UBYTE _CNV_S_2_RANGE______28_CM 1 0. 0. 1. DISPLAY_IDENTIFIER LV_ERR_FCUT_MON_1 ECU_ADDRESS 0x7fb55a /end MEASUREMENT
/begin MEASUREMENT fmy_stat_fcut_mon_1.ctr_abc "anti bounce counter for diagnosis instance FCUT_MON_1" UBYTE _CNV_A_R_LINEAR_____1_CM 1 0. 0. 255. DISPLAY_IDENTIFIER CTR_ABC_FCUT_MON_1 ECU_ADDRESS 0x7f9b59 FORMAT "%3.0" /end MEASUREMENT
/begin MEASUREMENT fmy_stat_fcut_mon_1.ctr_end_diag "counter for end of diagnosis for diagnosis instance FCUT_MON_1" UBYTE _CNV_A_R_LINEAR_____1_CM 1 0. 0. 255. DISPLAY_IDENTIFIER CTR_ABC_END_DIAG_FCUT_MON_1 ECU_ADDRESS 0x7f9b58 FORMAT "%3.0" /end MEASUREMENT
/begin MEASUREMENT fmy_stat_fcut_mon_1.err_info_stat.reserved "" UWORD _CNV_A_R_LINEAR_____0_CM 1 0. 0. 65535. DISPLAY_IDENTIFIER FMY_STAT_FCUT_MON_1_ERR_INFO_STA ECU_ADDRESS 0x7f9b56 BYTE_ORDER MSB_LAST BIT_MASK 0xF800 /end MEASUREMENT
/begin MEASUREMENT fmy_stat_fcut_mon_1.err_info_stat.lv_cdn_diag_stc "Statistical flag for condition of diagnosis of the diagnosis instance FCUT_MON_1" UWORD _CNV_S_2_RANGE______380_CM 1 0. 0. 1. DISPLAY_IDENTIFIER LV_CDN_DIAG_STC_FCUT_MON_1 ECU_ADDRESS 0x7f9b56 BYTE_ORDER MSB_LAST BIT_MASK 0x400 /end MEASUREMENT
/begin MEASUREMENT fmy_stat_fcut_mon_1.err_info_stat.lv_lock_diag "lock flag (CPU load optimisation) of the diagnosis instance FCUT_MON_1" UWORD _CNV_S_2_RANGE______380_CM 1 0. 0. 1. DISPLAY_IDENTIFIER LV_LOCK_DIAG_FCUT_MON_1 ECU_ADDRESS 0x7f9b56 BYTE_ORDER MSB_LAST BIT_MASK 0x200 /end MEASUREMENT
/begin MEASUREMENT fmy_stat_fcut_mon_1.err_info_stat.lv_err_mem "storage in dynamic failure memory of the diagnosis instance FCUT_MON_1" UWORD _CNV_S_2_RANGE______380_CM 1 0. 0. 1. DISPLAY_IDENTIFIER LV_ERR_MEM_FCUT_MON_1 ECU_ADDRESS 0x7f9b56 BYTE_ORDER MSB_LAST BIT_MASK 0x80 /end MEASUREMENT
/begin MEASUREMENT fmy_stat_fcut_mon_1.err_info_stat.lv_ready "readiness status of the diagnosis instance FCUT_MON_1" UWORD _CNV_S_2_RANGE______380_CM 1 0. 0. 1. DISPLAY_IDENTIFIER LV_READY_FCUT_MON_1 ECU_ADDRESS 0x7f9b56 BYTE_ORDER MSB_LAST BIT_MASK 0x40 /end MEASUREMENT
/begin MEASUREMENT fmy_stat_fcut_mon_1.err_info_stat.lv_end_diag "end of diagnosis of the diagnosis instance FCUT_MON_1" UWORD _CNV_S_2_RANGE______380_CM 1 0. 0. 1. DISPLAY_IDENTIFIER LV_END_DIAG_FCUT_MON_1 ECU_ADDRESS 0x7f9b56 BYTE_ORDER MSB_LAST BIT_MASK 0x20 /end MEASUREMENT
/begin MEASUREMENT fmy_stat_fcut_mon_1.err_info_stat.lv_cdn_diag "diagnosis condition of the diagnosis instance FCUT_MON_1" UWORD _CNV_S_2_RANGE______380_CM 1 0. 0. 1. DISPLAY_IDENTIFIER LV_CDN_DIAG_FCUT_MON_1 ECU_ADDRESS 0x7f9b56 BYTE_ORDER MSB_LAST BIT_MASK 0x10 /end MEASUREMENT
/begin MEASUREMENT fmy_stat_fcut_mon_1.err_info_stat.err_sym "symptoms of the diagnosis instance FCUT_MON_1" UWORD _CNV_S_6_CONV_ERRM__27_CM 1 0. 0. 15. DISPLAY_IDENTIFIER ERR_SYM_FCUT_MON_1 ECU_ADDRESS 0x7f9b56 BYTE_ORDER MSB_LAST BIT_MASK 0xF /end MEASUREMENT
/begin MEASUREMENT lv_err_tqi_n_max_mon_1 "Error flag of diagnosis instance TQI_N_MAX_MON_1" UBYTE _CNV_S_2_RANGE______28_CM 1 0. 0. 1. DISPLAY_IDENTIFIER LV_ERR_TQI_N_MAX_MON_1 ECU_ADDRESS 0x7fb55b /end MEASUREMENT
/begin MEASUREMENT fmy_stat_tqi_n_max_mon_1.ctr_abc "anti bounce counter for diagnosis instance TQI_N_MAX_MON_1" UBYTE _CNV_A_R_LINEAR_____1_CM 1 0. 0. 255. DISPLAY_IDENTIFIER CTR_ABC_TQI_N_MAX_MON_1 ECU_ADDRESS 0x7f9b5d FORMAT "%3.0" /end MEASUREMENT
/begin MEASUREMENT fmy_stat_tqi_n_max_mon_1.ctr_end_diag "counter for end of diagnosis for diagnosis instance TQI_N_MAX_MON_1" UBYTE _CNV_A_R_LINEAR_____1_CM 1 0. 0. 255. DISPLAY_IDENTIFIER CTR_ABC_END_DIAG_TQI_N_MAX_MON_1 ECU_ADDRESS 0x7f9b5c FORMAT "%3.0" /end MEASUREMENT
/begin MEASUREMENT fmy_stat_tqi_n_max_mon_1.err_info_stat.reserved "" UWORD _CNV_A_R_LINEAR_____0_CM 1 0. 0. 65535. DISPLAY_IDENTIFIER FMY_STAT_TQI_N_MAX_MON_1_ERR_INF ECU_ADDRESS 0x7f9b5a BYTE_ORDER MSB_LAST BIT_MASK 0xF800 /end MEASUREMENT
/begin MEASUREMENT fmy_stat_tqi_n_max_mon_1.err_info_stat.lv_cdn_diag_stc "Statistical flag for condition of diagnosis of the diagnosis instance TQI_N_MAX_MON_1" UWORD _CNV_S_2_RANGE______380_CM 1 0. 0. 1. DISPLAY_IDENTIFIER LV_CDN_DIAG_STC_TQI_N_MAX_MON_1 ECU_ADDRESS 0x7f9b5a BYTE_ORDER MSB_LAST BIT_MASK 0x400 /end MEASUREMENT
/begin MEASUREMENT fmy_stat_tqi_n_max_mon_1.err_info_stat.lv_lock_diag "lock flag (CPU load optimisation) of the diagnosis instance TQI_N_MAX_MON_1" UWORD _CNV_S_2_RANGE______380_CM 1 0. 0. 1. DISPLAY_IDENTIFIER LV_LOCK_DIAG_TQI_N_MAX_MON_1 ECU_ADDRESS 0x7f9b5a BYTE_ORDER MSB_LAST BIT_MASK 0x200 /end MEASUREMENT
/begin MEASUREMENT fmy_stat_tqi_n_max_mon_1.err_info_stat.lv_err_mem "storage in dynamic failure memory of the diagnosis instance TQI_N_MAX_MON_1" UWORD _CNV_S_2_RANGE______380_CM 1 0. 0. 1. DISPLAY_IDENTIFIER LV_ERR_MEM_TQI_N_MAX_MON_1 ECU_ADDRESS 0x7f9b5a BYTE_ORDER MSB_LAST BIT_MASK 0x80 /end MEASUREMENT
/begin MEASUREMENT fmy_stat_tqi_n_max_mon_1.err_info_stat.lv_ready "readiness status of the diagnosis instance TQI_N_MAX_MON_1" UWORD _CNV_S_2_RANGE______380_CM 1 0. 0. 1. DISPLAY_IDENTIFIER LV_READY_TQI_N_MAX_MON_1 ECU_ADDRESS 0x7f9b5a BYTE_ORDER MSB_LAST BIT_MASK 0x40 /end MEASUREMENT
/begin MEASUREMENT fmy_stat_tqi_n_max_mon_1.err_info_stat.lv_end_diag "end of diagnosis of the diagnosis instance TQI_N_MAX_MON_1" UWORD _CNV_S_2_RANGE______380_CM 1 0. 0. 1. DISPLAY_IDENTIFIER LV_END_DIAG_TQI_N_MAX_MON_1 ECU_ADDRESS 0x7f9b5a BYTE_ORDER MSB_LAST BIT_MASK 0x20 /end MEASUREMENT
/begin MEASUREMENT fmy_stat_tqi_n_max_mon_1.err_info_stat.lv_cdn_diag "diagnosis condition of the diagnosis instance TQI_N_MAX_MON_1" UWORD _CNV_S_2_RANGE______380_CM 1 0. 0. 1. DISPLAY_IDENTIFIER LV_CDN_DIAG_TQI_N_MAX_MON_1 ECU_ADDRESS 0x7f9b5a BYTE_ORDER MSB_LAST BIT_MASK 0x10 /end MEASUREMENT
/begin MEASUREMENT fmy_stat_tqi_n_max_mon_1.err_info_stat.err_sym "symptoms of the diagnosis instance TQI_N_MAX_MON_1" UWORD _CNV_S_6_CONV_ERRM__27_CM 1 0. 0. 15. DISPLAY_IDENTIFIER ERR_SYM_TQI_N_MAX_MON_1 ECU_ADDRESS 0x7f9b5a BYTE_ORDER MSB_LAST BIT_MASK 0xF /end MEASUREMENT
/begin MEASUREMENT lv_err_serv_mon_1 "Error flag of diagnosis instance SERV_MON_1" UBYTE _CNV_S_2_RANGE______28_CM 1 0. 0. 1. DISPLAY_IDENTIFIER LV_ERR_SERV_MON_1 ECU_ADDRESS 0x7fb55c /end MEASUREMENT
/begin MEASUREMENT fmy_stat_serv_mon_1.ctr_abc "anti bounce counter for diagnosis instance SERV_MON_1" UBYTE _CNV_A_R_LINEAR_____1_CM 1 0. 0. 255. DISPLAY_IDENTIFIER CTR_ABC_SERV_MON_1 ECU_ADDRESS 0x7f9b61 FORMAT "%3.0" /end MEASUREMENT
/begin MEASUREMENT fmy_stat_serv_mon_1.ctr_end_diag "counter for end of diagnosis for diagnosis instance SERV_MON_1" UBYTE _CNV_A_R_LINEAR_____1_CM 1 0. 0. 255. DISPLAY_IDENTIFIER CTR_ABC_END_DIAG_SERV_MON_1 ECU_ADDRESS 0x7f9b60 FORMAT "%3.0" /end MEASUREMENT
/begin MEASUREMENT fmy_stat_serv_mon_1.err_info_stat.reserved "" UWORD _CNV_A_R_LINEAR_____0_CM 1 0. 0. 65535. DISPLAY_IDENTIFIER FMY_STAT_SERV_MON_1_ERR_INFO_STA ECU_ADDRESS 0x7f9b5e BYTE_ORDER MSB_LAST BIT_MASK 0xF800 /end MEASUREMENT
/begin MEASUREMENT fmy_stat_serv_mon_1.err_info_stat.lv_cdn_diag_stc "Statistical flag for condition of diagnosis of the diagnosis instance SERV_MON_1" UWORD _CNV_S_2_RANGE______380_CM 1 0. 0. 1. DISPLAY_IDENTIFIER LV_CDN_DIAG_STC_SERV_MON_1 ECU_ADDRESS 0x7f9b5e BYTE_ORDER MSB_LAST BIT_MASK 0x400 /end MEASUREMENT
/begin MEASUREMENT fmy_stat_serv_mon_1.err_info_stat.lv_lock_diag "lock flag (CPU load optimisation) of the diagnosis instance SERV_MON_1" UWORD _CNV_S_2_RANGE______380_CM 1 0. 0. 1. DISPLAY_IDENTIFIER LV_LOCK_DIAG_SERV_MON_1 ECU_ADDRESS 0x7f9b5e BYTE_ORDER MSB_LAST BIT_MASK 0x200 /end MEASUREMENT
/begin MEASUREMENT fmy_stat_serv_mon_1.err_info_stat.lv_err_mem "storage in dynamic failure memory of the diagnosis instance SERV_MON_1" UWORD _CNV_S_2_RANGE______380_CM 1 0. 0. 1. DISPLAY_IDENTIFIER LV_ERR_MEM_SERV_MON_1 ECU_ADDRESS 0x7f9b5e BYTE_ORDER MSB_LAST BIT_MASK 0x80 /end MEASUREMENT
/begin MEASUREMENT fmy_stat_serv_mon_1.err_info_stat.lv_ready "readiness status of the diagnosis instance SERV_MON_1" UWORD _CNV_S_2_RANGE______380_CM 1 0. 0. 1. DISPLAY_IDENTIFIER LV_READY_SERV_MON_1 ECU_ADDRESS 0x7f9b5e BYTE_ORDER MSB_LAST BIT_MASK 0x40 /end MEASUREMENT
/begin MEASUREMENT fmy_stat_serv_mon_1.err_info_stat.lv_end_diag "end of diagnosis of the diagnosis instance SERV_MON_1" UWORD _CNV_S_2_RANGE______380_CM 1 0. 0. 1. DISPLAY_IDENTIFIER LV_END_DIAG_SERV_MON_1 ECU_ADDRESS 0x7f9b5e BYTE_ORDER MSB_LAST BIT_MASK 0x20 /end MEASUREMENT
/begin MEASUREMENT fmy_stat_serv_mon_1.err_info_stat.lv_cdn_diag "diagnosis condition of the diagnosis instance SERV_MON_1" UWORD _CNV_S_2_RANGE______380_CM 1 0. 0. 1. DISPLAY_IDENTIFIER LV_CDN_DIAG_SERV_MON_1 ECU_ADDRESS 0x7f9b5e BYTE_ORDER MSB_LAST BIT_MASK 0x10 /end MEASUREMENT
/begin MEASUREMENT fmy_stat_serv_mon_1.err_info_stat.err_sym "symptoms of the diagnosis instance SERV_MON_1" UWORD _CNV_S_6_CONV_ERRM__27_CM 1 0. 0. 15. DISPLAY_IDENTIFIER ERR_SYM_SERV_MON_1 ECU_ADDRESS 0x7f9b5e BYTE_ORDER MSB_LAST BIT_MASK 0xF /end MEASUREMENT
/begin MEASUREMENT lv_err_post_inh_mon "Error flag of diagnosis instance POST_INH_MON" UBYTE _CNV_S_2_RANGE______28_CM 1 0. 0. 1. DISPLAY_IDENTIFIER LV_ERR_POST_INH_MON ECU_ADDRESS 0x7fb55d /end MEASUREMENT
/begin MEASUREMENT fmy_stat_post_inh_mon.ctr_abc "anti bounce counter for diagnosis instance POST_INH_MON" UBYTE _CNV_A_R_LINEAR_____1_CM 1 0. 0. 255. DISPLAY_IDENTIFIER CTR_ABC_POST_INH_MON ECU_ADDRESS 0x7f9b65 FORMAT "%3.0" /end MEASUREMENT
/begin MEASUREMENT fmy_stat_post_inh_mon.ctr_end_diag "counter for end of diagnosis for diagnosis instance POST_INH_MON" UBYTE _CNV_A_R_LINEAR_____1_CM 1 0. 0. 255. DISPLAY_IDENTIFIER CTR_ABC_END_DIAG_POST_INH_MON ECU_ADDRESS 0x7f9b64 FORMAT "%3.0" /end MEASUREMENT
/begin MEASUREMENT fmy_stat_post_inh_mon.err_info_stat.reserved "" UWORD _CNV_A_R_LINEAR_____0_CM 1 0. 0. 65535. DISPLAY_IDENTIFIER FMY_STAT_POST_INH_MON_ERR_INFO_S ECU_ADDRESS 0x7f9b62 BYTE_ORDER MSB_LAST BIT_MASK 0xF800 /end MEASUREMENT
/begin MEASUREMENT fmy_stat_post_inh_mon.err_info_stat.lv_cdn_diag_stc "Statistical flag for condition of diagnosis of the diagnosis instance POST_INH_MON" UWORD _CNV_S_2_RANGE______380_CM 1 0. 0. 1. DISPLAY_IDENTIFIER LV_CDN_DIAG_STC_POST_INH_MON ECU_ADDRESS 0x7f9b62 BYTE_ORDER MSB_LAST BIT_MASK 0x400 /end MEASUREMENT
/begin MEASUREMENT fmy_stat_post_inh_mon.err_info_stat.lv_lock_diag "lock flag (CPU load optimisation) of the diagnosis instance POST_INH_MON" UWORD _CNV_S_2_RANGE______380_CM 1 0. 0. 1. DISPLAY_IDENTIFIER LV_LOCK_DIAG_POST_INH_MON ECU_ADDRESS 0x7f9b62 BYTE_ORDER MSB_LAST BIT_MASK 0x200 /end MEASUREMENT
/begin MEASUREMENT fmy_stat_post_inh_mon.err_info_stat.lv_err_mem "storage in dynamic failure memory of the diagnosis instance POST_INH_MON" UWORD _CNV_S_2_RANGE______380_CM 1 0. 0. 1. DISPLAY_IDENTIFIER LV_ERR_MEM_POST_INH_MON ECU_ADDRESS 0x7f9b62 BYTE_ORDER MSB_LAST BIT_MASK 0x80 /end MEASUREMENT
/begin MEASUREMENT fmy_stat_post_inh_mon.err_info_stat.lv_ready "readiness status of the diagnosis instance POST_INH_MON" UWORD _CNV_S_2_RANGE______380_CM 1 0. 0. 1. DISPLAY_IDENTIFIER LV_READY_POST_INH_MON ECU_ADDRESS 0x7f9b62 BYTE_ORDER MSB_LAST BIT_MASK 0x40 /end MEASUREMENT
/begin MEASUREMENT fmy_stat_post_inh_mon.err_info_stat.lv_end_diag "end of diagnosis of the diagnosis instance POST_INH_MON" UWORD _CNV_S_2_RANGE______380_CM 1 0. 0. 1. DISPLAY_IDENTIFIER LV_END_DIAG_POST_INH_MON ECU_ADDRESS 0x7f9b62 BYTE_ORDER MSB_LAST BIT_MASK 0x20 /end MEASUREMENT
/begin MEASUREMENT fmy_stat_post_inh_mon.err_info_stat.lv_cdn_diag "diagnosis condition of the diagnosis instance POST_INH_MON" UWORD _CNV_S_2_RANGE______380_CM 1 0. 0. 1. DISPLAY_IDENTIFIER LV_CDN_DIAG_POST_INH_MON ECU_ADDRESS 0x7f9b62 BYTE_ORDER MSB_LAST BIT_MASK 0x10 /end MEASUREMENT
/begin MEASUREMENT fmy_stat_post_inh_mon.err_info_stat.err_sym "symptoms of the diagnosis instance POST_INH_MON" UWORD _CNV_S_6_CONV_ERRM__27_CM 1 0. 0. 15. DISPLAY_IDENTIFIER ERR_SYM_POST_INH_MON ECU_ADDRESS 0x7f9b62 BYTE_ORDER MSB_LAST BIT_MASK 0xF /end MEASUREMENT
/begin MEASUREMENT lv_err_cru_inh_mon "Error flag of diagnosis instance CRU_INH_MON" UBYTE _CNV_S_2_RANGE______28_CM 1 0. 0. 1. DISPLAY_IDENTIFIER LV_ERR_CRU_INH_MON ECU_ADDRESS 0x7fb55e /end MEASUREMENT
/begin MEASUREMENT fmy_stat_cru_inh_mon.ctr_abc "anti bounce counter for diagnosis instance CRU_INH_MON" UBYTE _CNV_A_R_LINEAR_____1_CM 1 0. 0. 255. DISPLAY_IDENTIFIER CTR_ABC_CRU_INH_MON ECU_ADDRESS 0x7f9b69 FORMAT "%3.0" /end MEASUREMENT
/begin MEASUREMENT fmy_stat_cru_inh_mon.ctr_end_diag "counter for end of diagnosis for diagnosis instance CRU_INH_MON" UBYTE _CNV_A_R_LINEAR_____1_CM 1 0. 0. 255. DISPLAY_IDENTIFIER CTR_ABC_END_DIAG_CRU_INH_MON ECU_ADDRESS 0x7f9b68 FORMAT "%3.0" /end MEASUREMENT
/begin MEASUREMENT fmy_stat_cru_inh_mon.err_info_stat.reserved "" UWORD _CNV_A_R_LINEAR_____0_CM 1 0. 0. 65535. DISPLAY_IDENTIFIER FMY_STAT_CRU_INH_MON_ERR_INFO_ST ECU_ADDRESS 0x7f9b66 BYTE_ORDER MSB_LAST BIT_MASK 0xF800 /end MEASUREMENT
/begin MEASUREMENT fmy_stat_cru_inh_mon.err_info_stat.lv_cdn_diag_stc "Statistical flag for condition of diagnosis of the diagnosis instance CRU_INH_MON" UWORD _CNV_S_2_RANGE______380_CM 1 0. 0. 1. DISPLAY_IDENTIFIER LV_CDN_DIAG_STC_CRU_INH_MON ECU_ADDRESS 0x7f9b66 BYTE_ORDER MSB_LAST BIT_MASK 0x400 /end MEASUREMENT
/begin MEASUREMENT fmy_stat_cru_inh_mon.err_info_stat.lv_lock_diag "lock flag (CPU load optimisation) of the diagnosis instance CRU_INH_MON" UWORD _CNV_S_2_RANGE______380_CM 1 0. 0. 1. DISPLAY_IDENTIFIER LV_LOCK_DIAG_CRU_INH_MON ECU_ADDRESS 0x7f9b66 BYTE_ORDER MSB_LAST BIT_MASK 0x200 /end MEASUREMENT
/begin MEASUREMENT fmy_stat_cru_inh_mon.err_info_stat.lv_err_mem "storage in dynamic failure memory of the diagnosis instance CRU_INH_MON" UWORD _CNV_S_2_RANGE______380_CM 1 0. 0. 1. DISPLAY_IDENTIFIER LV_ERR_MEM_CRU_INH_MON ECU_ADDRESS 0x7f9b66 BYTE_ORDER MSB_LAST BIT_MASK 0x80 /end MEASUREMENT
/begin MEASUREMENT fmy_stat_cru_inh_mon.err_info_stat.lv_ready "readiness status of the diagnosis instance CRU_INH_MON" UWORD _CNV_S_2_RANGE______380_CM 1 0. 0. 1. DISPLAY_IDENTIFIER LV_READY_CRU_INH_MON ECU_ADDRESS 0x7f9b66 BYTE_ORDER MSB_LAST BIT_MASK 0x40 /end MEASUREMENT
/begin MEASUREMENT fmy_stat_cru_inh_mon.err_info_stat.lv_end_diag "end of diagnosis of the diagnosis instance CRU_INH_MON" UWORD _CNV_S_2_RANGE______380_CM 1 0. 0. 1. DISPLAY_IDENTIFIER LV_END_DIAG_CRU_INH_MON ECU_ADDRESS 0x7f9b66 BYTE_ORDER MSB_LAST BIT_MASK 0x20 /end MEASUREMENT
/begin MEASUREMENT fmy_stat_cru_inh_mon.err_info_stat.lv_cdn_diag "diagnosis condition of the diagnosis instance CRU_INH_MON" UWORD _CNV_S_2_RANGE______380_CM 1 0. 0. 1. DISPLAY_IDENTIFIER LV_CDN_DIAG_CRU_INH_MON ECU_ADDRESS 0x7f9b66 BYTE_ORDER MSB_LAST BIT_MASK 0x10 /end MEASUREMENT
/begin MEASUREMENT fmy_stat_cru_inh_mon.err_info_stat.err_sym "symptoms of the diagnosis instance CRU_INH_MON" UWORD _CNV_S_6_CONV_ERRM__27_CM 1 0. 0. 15. DISPLAY_IDENTIFIER ERR_SYM_CRU_INH_MON ECU_ADDRESS 0x7f9b66 BYTE_ORDER MSB_LAST BIT_MASK 0xF /end MEASUREMENT
/begin MEASUREMENT lv_err_can_inh_mon "Error flag of diagnosis instance CAN_INH_MON" UBYTE _CNV_S_2_RANGE______28_CM 1 0. 0. 1. DISPLAY_IDENTIFIER LV_ERR_CAN_INH_MON ECU_ADDRESS 0x7fb55f /end MEASUREMENT
/begin MEASUREMENT fmy_stat_can_inh_mon.ctr_abc "anti bounce counter for diagnosis instance CAN_INH_MON" UBYTE _CNV_A_R_LINEAR_____1_CM 1 0. 0. 255. DISPLAY_IDENTIFIER CTR_ABC_CAN_INH_MON ECU_ADDRESS 0x7f9b6d FORMAT "%3.0" /end MEASUREMENT
/begin MEASUREMENT fmy_stat_can_inh_mon.ctr_end_diag "counter for end of diagnosis for diagnosis instance CAN_INH_MON" UBYTE _CNV_A_R_LINEAR_____1_CM 1 0. 0. 255. DISPLAY_IDENTIFIER CTR_ABC_END_DIAG_CAN_INH_MON ECU_ADDRESS 0x7f9b6c FORMAT "%3.0" /end MEASUREMENT
/begin MEASUREMENT fmy_stat_can_inh_mon.err_info_stat.reserved "" UWORD _CNV_A_R_LINEAR_____0_CM 1 0. 0. 65535. DISPLAY_IDENTIFIER FMY_STAT_CAN_INH_MON_ERR_INFO_ST ECU_ADDRESS 0x7f9b6a BYTE_ORDER MSB_LAST BIT_MASK 0xF800 /end MEASUREMENT
/begin MEASUREMENT fmy_stat_can_inh_mon.err_info_stat.lv_cdn_diag_stc "Statistical flag for condition of diagnosis of the diagnosis instance CAN_INH_MON" UWORD _CNV_S_2_RANGE______380_CM 1 0. 0. 1. DISPLAY_IDENTIFIER LV_CDN_DIAG_STC_CAN_INH_MON ECU_ADDRESS 0x7f9b6a BYTE_ORDER MSB_LAST BIT_MASK 0x400 /end MEASUREMENT
/begin MEASUREMENT fmy_stat_can_inh_mon.err_info_stat.lv_lock_diag "lock flag (CPU load optimisation) of the diagnosis instance CAN_INH_MON" UWORD _CNV_S_2_RANGE______380_CM 1 0. 0. 1. DISPLAY_IDENTIFIER LV_LOCK_DIAG_CAN_INH_MON ECU_ADDRESS 0x7f9b6a BYTE_ORDER MSB_LAST BIT_MASK 0x200 /end MEASUREMENT
/begin MEASUREMENT fmy_stat_can_inh_mon.err_info_stat.lv_err_mem "storage in dynamic failure memory of the diagnosis instance CAN_INH_MON" UWORD _CNV_S_2_RANGE______380_CM 1 0. 0. 1. DISPLAY_IDENTIFIER LV_ERR_MEM_CAN_INH_MON ECU_ADDRESS 0x7f9b6a BYTE_ORDER MSB_LAST BIT_MASK 0x80 /end MEASUREMENT
/begin MEASUREMENT fmy_stat_can_inh_mon.err_info_stat.lv_ready "readiness status of the diagnosis instance CAN_INH_MON" UWORD _CNV_S_2_RANGE______380_CM 1 0. 0. 1. DISPLAY_IDENTIFIER LV_READY_CAN_INH_MON ECU_ADDRESS 0x7f9b6a BYTE_ORDER MSB_LAST BIT_MASK 0x40 /end MEASUREMENT
/begin MEASUREMENT fmy_stat_can_inh_mon.err_info_stat.lv_end_diag "end of diagnosis of the diagnosis instance CAN_INH_MON" UWORD _CNV_S_2_RANGE______380_CM 1 0. 0. 1. DISPLAY_IDENTIFIER LV_END_DIAG_CAN_INH_MON ECU_ADDRESS 0x7f9b6a BYTE_ORDER MSB_LAST BIT_MASK 0x20 /end MEASUREMENT
/begin MEASUREMENT fmy_stat_can_inh_mon.err_info_stat.lv_cdn_diag "diagnosis condition of the diagnosis instance CAN_INH_MON" UWORD _CNV_S_2_RANGE______380_CM 1 0. 0. 1. DISPLAY_IDENTIFIER LV_CDN_DIAG_CAN_INH_MON ECU_ADDRESS 0x7f9b6a BYTE_ORDER MSB_LAST BIT_MASK 0x10 /end MEASUREMENT
/begin MEASUREMENT fmy_stat_can_inh_mon.err_info_stat.err_sym "symptoms of the diagnosis instance CAN_INH_MON" UWORD _CNV_S_6_CONV_ERRM__27_CM 1 0. 0. 15. DISPLAY_IDENTIFIER ERR_SYM_CAN_INH_MON ECU_ADDRESS 0x7f9b6a BYTE_ORDER MSB_LAST BIT_MASK 0xF /end MEASUREMENT
/begin MEASUREMENT lv_err_mon_3 "Error flag of diagnosis instance MON_3" UBYTE _CNV_S_2_RANGE______28_CM 1 0. 0. 1. DISPLAY_IDENTIFIER LV_ERR_MON_3 ECU_ADDRESS 0x7fb560 /end MEASUREMENT
/begin MEASUREMENT fmy_stat_mon_3.ctr_abc "anti bounce counter for diagnosis instance MON_3" UBYTE _CNV_A_R_LINEAR_____1_CM 1 0. 0. 255. DISPLAY_IDENTIFIER CTR_ABC_MON_3 ECU_ADDRESS 0x7f9b71 FORMAT "%3.0" /end MEASUREMENT
/begin MEASUREMENT fmy_stat_mon_3.ctr_end_diag "counter for end of diagnosis for diagnosis instance MON_3" UBYTE _CNV_A_R_LINEAR_____1_CM 1 0. 0. 255. DISPLAY_IDENTIFIER CTR_ABC_END_DIAG_MON_3 ECU_ADDRESS 0x7f9b70 FORMAT "%3.0" /end MEASUREMENT
/begin MEASUREMENT fmy_stat_mon_3.err_info_stat.reserved "" UWORD _CNV_A_R_LINEAR_____0_CM 1 0. 0. 65535. DISPLAY_IDENTIFIER FMY_STAT_MON_3_ERR_INFO_STAT_RES ECU_ADDRESS 0x7f9b6e BYTE_ORDER MSB_LAST BIT_MASK 0xF800 /end MEASUREMENT
/begin MEASUREMENT fmy_stat_mon_3.err_info_stat.lv_cdn_diag_stc "Statistical flag for condition of diagnosis of the diagnosis instance MON_3" UWORD _CNV_S_2_RANGE______380_CM 1 0. 0. 1. DISPLAY_IDENTIFIER LV_CDN_DIAG_STC_MON_3 ECU_ADDRESS 0x7f9b6e BYTE_ORDER MSB_LAST BIT_MASK 0x400 /end MEASUREMENT
/begin MEASUREMENT fmy_stat_mon_3.err_info_stat.lv_lock_diag "lock flag (CPU load optimisation) of the diagnosis instance MON_3" UWORD _CNV_S_2_RANGE______380_CM 1 0. 0. 1. DISPLAY_IDENTIFIER LV_LOCK_DIAG_MON_3 ECU_ADDRESS 0x7f9b6e BYTE_ORDER MSB_LAST BIT_MASK 0x200 /end MEASUREMENT
/begin MEASUREMENT fmy_stat_mon_3.err_info_stat.lv_err_mem "storage in dynamic failure memory of the diagnosis instance MON_3" UWORD _CNV_S_2_RANGE______380_CM 1 0. 0. 1. DISPLAY_IDENTIFIER LV_ERR_MEM_MON_3 ECU_ADDRESS 0x7f9b6e BYTE_ORDER MSB_LAST BIT_MASK 0x80 /end MEASUREMENT
/begin MEASUREMENT fmy_stat_mon_3.err_info_stat.lv_ready "readiness status of the diagnosis instance MON_3" UWORD _CNV_S_2_RANGE______380_CM 1 0. 0. 1. DISPLAY_IDENTIFIER LV_READY_MON_3 ECU_ADDRESS 0x7f9b6e BYTE_ORDER MSB_LAST BIT_MASK 0x40 /end MEASUREMENT
/begin MEASUREMENT fmy_stat_mon_3.err_info_stat.lv_end_diag "end of diagnosis of the diagnosis instance MON_3" UWORD _CNV_S_2_RANGE______380_CM 1 0. 0. 1. DISPLAY_IDENTIFIER LV_END_DIAG_MON_3 ECU_ADDRESS 0x7f9b6e BYTE_ORDER MSB_LAST BIT_MASK 0x20 /end MEASUREMENT
/begin MEASUREMENT fmy_stat_mon_3.err_info_stat.lv_cdn_diag "diagnosis condition of the diagnosis instance MON_3" UWORD _CNV_S_2_RANGE______380_CM 1 0. 0. 1. DISPLAY_IDENTIFIER LV_CDN_DIAG_MON_3 ECU_ADDRESS 0x7f9b6e BYTE_ORDER MSB_LAST BIT_MASK 0x10 /end MEASUREMENT
/begin MEASUREMENT fmy_stat_mon_3.err_info_stat.err_sym "symptoms of the diagnosis instance MON_3" UWORD _CNV_S_6_CONV_ERRM__27_CM 1 0. 0. 15. DISPLAY_IDENTIFIER ERR_SYM_MON_3 ECU_ADDRESS 0x7f9b6e BYTE_ORDER MSB_LAST BIT_MASK 0xF /end MEASUREMENT
/begin MEASUREMENT fmy_stat_per_cam_in_1.ctr_abc "anti bounce counter for diagnosis instance PER_CAM_IN_1" UBYTE _CNV_A_R_LINEAR_____1_CM 1 0. 0. 255. DISPLAY_IDENTIFIER CTR_ABC_PER_CAM_IN_1 ECU_ADDRESS 0x7f9b75 FORMAT "%3.0" /end MEASUREMENT
/begin MEASUREMENT fmy_stat_per_cam_in_1.ctr_end_diag "counter for end of diagnosis for diagnosis instance PER_CAM_IN_1" UBYTE _CNV_A_R_LINEAR_____1_CM 1 0. 0. 255. DISPLAY_IDENTIFIER CTR_ABC_END_DIAG_PER_CAM_IN_1 ECU_ADDRESS 0x7f9b74 FORMAT "%3.0" /end MEASUREMENT
/begin MEASUREMENT fmy_stat_per_cam_in_1.err_info_stat.reserved "" UWORD _CNV_A_R_LINEAR_____0_CM 1 0. 0. 65535. DISPLAY_IDENTIFIER FMY_STAT_PER_CAM_IN_1_ERR_INFO_S ECU_ADDRESS 0x7f9b72 BYTE_ORDER MSB_LAST BIT_MASK 0xF800 /end MEASUREMENT
/begin MEASUREMENT fmy_stat_per_cam_in_1.err_info_stat.lv_cdn_diag_stc "Statistical flag for condition of diagnosis of the diagnosis instance PER_CAM_IN_1" UWORD _CNV_S_2_RANGE______380_CM 1 0. 0. 1. DISPLAY_IDENTIFIER LV_CDN_DIAG_STC_PER_CAM_IN_1 ECU_ADDRESS 0x7f9b72 BYTE_ORDER MSB_LAST BIT_MASK 0x400 /end MEASUREMENT
/begin MEASUREMENT fmy_stat_per_cam_in_1.err_info_stat.lv_lock_diag "lock flag (CPU load optimisation) of the diagnosis instance PER_CAM_IN_1" UWORD _CNV_S_2_RANGE______380_CM 1 0. 0. 1. DISPLAY_IDENTIFIER LV_LOCK_DIAG_PER_CAM_IN_1 ECU_ADDRESS 0x7f9b72 BYTE_ORDER MSB_LAST BIT_MASK 0x200 /end MEASUREMENT
/begin MEASUREMENT fmy_stat_per_cam_in_1.err_info_stat.lv_err_mem "storage in dynamic failure memory of the diagnosis instance PER_CAM_IN_1" UWORD _CNV_S_2_RANGE______380_CM 1 0. 0. 1. DISPLAY_IDENTIFIER LV_ERR_MEM_PER_CAM_IN_1 ECU_ADDRESS 0x7f9b72 BYTE_ORDER MSB_LAST BIT_MASK 0x80 /end MEASUREMENT
/begin MEASUREMENT fmy_stat_per_cam_in_1.err_info_stat.lv_ready "readiness status of the diagnosis instance PER_CAM_IN_1" UWORD _CNV_S_2_RANGE______380_CM 1 0. 0. 1. DISPLAY_IDENTIFIER LV_READY_PER_CAM_IN_1 ECU_ADDRESS 0x7f9b72 BYTE_ORDER MSB_LAST BIT_MASK 0x40 /end MEASUREMENT
/begin MEASUREMENT fmy_stat_per_cam_in_1.err_info_stat.lv_end_diag "end of diagnosis of the diagnosis instance PER_CAM_IN_1" UWORD _CNV_S_2_RANGE______380_CM 1 0. 0. 1. DISPLAY_IDENTIFIER LV_END_DIAG_PER_CAM_IN_1 ECU_ADDRESS 0x7f9b72 BYTE_ORDER MSB_LAST BIT_MASK 0x20 /end MEASUREMENT
/begin MEASUREMENT fmy_stat_per_cam_in_1.err_info_stat.lv_cdn_diag "diagnosis condition of the diagnosis instance PER_CAM_IN_1" UWORD _CNV_S_2_RANGE______380_CM 1 0. 0. 1. DISPLAY_IDENTIFIER LV_CDN_DIAG_PER_CAM_IN_1 ECU_ADDRESS 0x7f9b72 BYTE_ORDER MSB_LAST BIT_MASK 0x10 /end MEASUREMENT
/begin MEASUREMENT fmy_stat_per_cam_in_1.err_info_stat.err_sym "symptoms of the diagnosis instance PER_CAM_IN_1" UWORD _CNV_S_6_CONV_ERRM__27_CM 1 0. 0. 15. DISPLAY_IDENTIFIER ERR_SYM_PER_CAM_IN_1 ECU_ADDRESS 0x7f9b72 BYTE_ORDER MSB_LAST BIT_MASK 0xF /end MEASUREMENT
/begin MEASUREMENT fmy_stat_syn_cam_in_1.ctr_abc "anti bounce counter for diagnosis instance SYN_CAM_IN_1" UBYTE _CNV_A_R_LINEAR_____1_CM 1 0. 0. 255. DISPLAY_IDENTIFIER CTR_ABC_SYN_CAM_IN_1 ECU_ADDRESS 0x7f9b79 FORMAT "%3.0" /end MEASUREMENT
/begin MEASUREMENT fmy_stat_syn_cam_in_1.ctr_end_diag "counter for end of diagnosis for diagnosis instance SYN_CAM_IN_1" UBYTE _CNV_A_R_LINEAR_____1_CM 1 0. 0. 255. DISPLAY_IDENTIFIER CTR_ABC_END_DIAG_SYN_CAM_IN_1 ECU_ADDRESS 0x7f9b78 FORMAT "%3.0" /end MEASUREMENT
/begin MEASUREMENT fmy_stat_syn_cam_in_1.err_info_stat.reserved "" UWORD _CNV_A_R_LINEAR_____0_CM 1 0. 0. 65535. DISPLAY_IDENTIFIER FMY_STAT_SYN_CAM_IN_1_ERR_INFO_S ECU_ADDRESS 0x7f9b76 BYTE_ORDER MSB_LAST BIT_MASK 0xF800 /end MEASUREMENT
/begin MEASUREMENT fmy_stat_syn_cam_in_1.err_info_stat.lv_cdn_diag_stc "Statistical flag for condition of diagnosis of the diagnosis instance SYN_CAM_IN_1" UWORD _CNV_S_2_RANGE______380_CM 1 0. 0. 1. DISPLAY_IDENTIFIER LV_CDN_DIAG_STC_SYN_CAM_IN_1 ECU_ADDRESS 0x7f9b76 BYTE_ORDER MSB_LAST BIT_MASK 0x400 /end MEASUREMENT
/begin MEASUREMENT fmy_stat_syn_cam_in_1.err_info_stat.lv_lock_diag "lock flag (CPU load optimisation) of the diagnosis instance SYN_CAM_IN_1" UWORD _CNV_S_2_RANGE______380_CM 1 0. 0. 1. DISPLAY_IDENTIFIER LV_LOCK_DIAG_SYN_CAM_IN_1 ECU_ADDRESS 0x7f9b76 BYTE_ORDER MSB_LAST BIT_MASK 0x200 /end MEASUREMENT
/begin MEASUREMENT fmy_stat_syn_cam_in_1.err_info_stat.lv_err_mem "storage in dynamic failure memory of the diagnosis instance SYN_CAM_IN_1" UWORD _CNV_S_2_RANGE______380_CM 1 0. 0. 1. DISPLAY_IDENTIFIER LV_ERR_MEM_SYN_CAM_IN_1 ECU_ADDRESS 0x7f9b76 BYTE_ORDER MSB_LAST BIT_MASK 0x80 /end MEASUREMENT
/begin MEASUREMENT fmy_stat_syn_cam_in_1.err_info_stat.lv_ready "readiness status of the diagnosis instance SYN_CAM_IN_1" UWORD _CNV_S_2_RANGE______380_CM 1 0. 0. 1. DISPLAY_IDENTIFIER LV_READY_SYN_CAM_IN_1 ECU_ADDRESS 0x7f9b76 BYTE_ORDER MSB_LAST BIT_MASK 0x40 /end MEASUREMENT
/begin MEASUREMENT fmy_stat_syn_cam_in_1.err_info_stat.lv_end_diag "end of diagnosis of the diagnosis instance SYN_CAM_IN_1" UWORD _CNV_S_2_RANGE______380_CM 1 0. 0. 1. DISPLAY_IDENTIFIER LV_END_DIAG_SYN_CAM_IN_1 ECU_ADDRESS 0x7f9b76 BYTE_ORDER MSB_LAST BIT_MASK 0x20 /end MEASUREMENT
/begin MEASUREMENT fmy_stat_syn_cam_in_1.err_info_stat.lv_cdn_diag "diagnosis condition of the diagnosis instance SYN_CAM_IN_1" UWORD _CNV_S_2_RANGE______380_CM 1 0. 0. 1. DISPLAY_IDENTIFIER LV_CDN_DIAG_SYN_CAM_IN_1 ECU_ADDRESS 0x7f9b76 BYTE_ORDER MSB_LAST BIT_MASK 0x10 /end MEASUREMENT
/begin MEASUREMENT fmy_stat_syn_cam_in_1.err_info_stat.err_sym "symptoms of the diagnosis instance SYN_CAM_IN_1" UWORD _CNV_S_6_CONV_ERRM__27_CM 1 0. 0. 15. DISPLAY_IDENTIFIER ERR_SYM_SYN_CAM_IN_1 ECU_ADDRESS 0x7f9b76 BYTE_ORDER MSB_LAST BIT_MASK 0xF /end MEASUREMENT
/begin MEASUREMENT fmy_stat_ref_crk_cam_in_1.ctr_abc "anti bounce counter for diagnosis instance REF_CRK_CAM_IN_1" UBYTE _CNV_A_R_LINEAR_____1_CM 1 0. 0. 255. DISPLAY_IDENTIFIER CTR_ABC_REF_CRK_CAM_IN_1 ECU_ADDRESS 0x7f9b7d FORMAT "%3.0" /end MEASUREMENT
/begin MEASUREMENT fmy_stat_ref_crk_cam_in_1.ctr_end_diag "counter for end of diagnosis for diagnosis instance REF_CRK_CAM_IN_1" UBYTE _CNV_A_R_LINEAR_____1_CM 1 0. 0. 255. DISPLAY_IDENTIFIER CTR_ABC_END_DIAG_REF_CRK_CAM_IN_ ECU_ADDRESS 0x7f9b7c FORMAT "%3.0" /end MEASUREMENT
/begin MEASUREMENT fmy_stat_ref_crk_cam_in_1.err_info_stat.reserved "" UWORD _CNV_A_R_LINEAR_____0_CM 1 0. 0. 65535. DISPLAY_IDENTIFIER FMY_STAT_REF_CRK_CAM_IN_1_ERR_IN ECU_ADDRESS 0x7f9b7a BYTE_ORDER MSB_LAST BIT_MASK 0xF800 /end MEASUREMENT
/begin MEASUREMENT fmy_stat_ref_crk_cam_in_1.err_info_stat.lv_cdn_diag_stc "Statistical flag for condition of diagnosis of the diagnosis instance REF_CRK_CAM_IN_1" UWORD _CNV_S_2_RANGE______380_CM 1 0. 0. 1. DISPLAY_IDENTIFIER LV_CDN_DIAG_STC_REF_CRK_CAM_IN_1 ECU_ADDRESS 0x7f9b7a BYTE_ORDER MSB_LAST BIT_MASK 0x400 /end MEASUREMENT
/begin MEASUREMENT fmy_stat_ref_crk_cam_in_1.err_info_stat.lv_lock_diag "lock flag (CPU load optimisation) of the diagnosis instance REF_CRK_CAM_IN_1" UWORD _CNV_S_2_RANGE______380_CM 1 0. 0. 1. DISPLAY_IDENTIFIER LV_LOCK_DIAG_REF_CRK_CAM_IN_1 ECU_ADDRESS 0x7f9b7a BYTE_ORDER MSB_LAST BIT_MASK 0x200 /end MEASUREMENT
/begin MEASUREMENT fmy_stat_ref_crk_cam_in_1.err_info_stat.lv_err_mem "storage in dynamic failure memory of the diagnosis instance REF_CRK_CAM_IN_1" UWORD _CNV_S_2_RANGE______380_CM 1 0. 0. 1. DISPLAY_IDENTIFIER LV_ERR_MEM_REF_CRK_CAM_IN_1 ECU_ADDRESS 0x7f9b7a BYTE_ORDER MSB_LAST BIT_MASK 0x80 /end MEASUREMENT
/begin MEASUREMENT fmy_stat_ref_crk_cam_in_1.err_info_stat.lv_ready "readiness status of the diagnosis instance REF_CRK_CAM_IN_1" UWORD _CNV_S_2_RANGE______380_CM 1 0. 0. 1. DISPLAY_IDENTIFIER LV_READY_REF_CRK_CAM_IN_1 ECU_ADDRESS 0x7f9b7a BYTE_ORDER MSB_LAST BIT_MASK 0x40 /end MEASUREMENT
/begin MEASUREMENT fmy_stat_ref_crk_cam_in_1.err_info_stat.lv_end_diag "end of diagnosis of the diagnosis instance REF_CRK_CAM_IN_1" UWORD _CNV_S_2_RANGE______380_CM 1 0. 0. 1. DISPLAY_IDENTIFIER LV_END_DIAG_REF_CRK_CAM_IN_1 ECU_ADDRESS 0x7f9b7a BYTE_ORDER MSB_LAST BIT_MASK 0x20 /end MEASUREMENT
/begin MEASUREMENT fmy_stat_ref_crk_cam_in_1.err_info_stat.lv_cdn_diag "diagnosis condition of the diagnosis instance REF_CRK_CAM_IN_1" UWORD _CNV_S_2_RANGE______380_CM 1 0. 0. 1. DISPLAY_IDENTIFIER LV_CDN_DIAG_REF_CRK_CAM_IN_1 ECU_ADDRESS 0x7f9b7a BYTE_ORDER MSB_LAST BIT_MASK 0x10 /end MEASUREMENT
/begin MEASUREMENT fmy_stat_ref_crk_cam_in_1.err_info_stat.err_sym "symptoms of the diagnosis instance REF_CRK_CAM_IN_1" UWORD _CNV_S_6_CONV_ERRM__27_CM 1 0. 0. 15. DISPLAY_IDENTIFIER ERR_SYM_REF_CRK_CAM_IN_1 ECU_ADDRESS 0x7f9b7a BYTE_ORDER MSB_LAST BIT_MASK 0xF /end MEASUREMENT
/begin MEASUREMENT fmy_stat_crk_tooth.ctr_abc "anti bounce counter for diagnosis instance CRK_TOOTH" UBYTE _CNV_A_R_LINEAR_____1_CM 1 0. 0. 255. DISPLAY_IDENTIFIER CTR_ABC_CRK_TOOTH ECU_ADDRESS 0x7f9b81 FORMAT "%3.0" /end MEASUREMENT
/begin MEASUREMENT fmy_stat_crk_tooth.ctr_end_diag "counter for end of diagnosis for diagnosis instance CRK_TOOTH" UBYTE _CNV_A_R_LINEAR_____1_CM 1 0. 0. 255. DISPLAY_IDENTIFIER CTR_ABC_END_DIAG_CRK_TOOTH ECU_ADDRESS 0x7f9b80 FORMAT "%3.0" /end MEASUREMENT
/begin MEASUREMENT fmy_stat_crk_tooth.err_info_stat.reserved "" UWORD _CNV_A_R_LINEAR_____0_CM 1 0. 0. 65535. DISPLAY_IDENTIFIER FMY_STAT_CRK_TOOTH_ERR_INFO_STAT ECU_ADDRESS 0x7f9b7e BYTE_ORDER MSB_LAST BIT_MASK 0xF800 /end MEASUREMENT
/begin MEASUREMENT fmy_stat_crk_tooth.err_info_stat.lv_cdn_diag_stc "Statistical flag for condition of diagnosis of the diagnosis instance CRK_TOOTH" UWORD _CNV_S_2_RANGE______380_CM 1 0. 0. 1. DISPLAY_IDENTIFIER LV_CDN_DIAG_STC_CRK_TOOTH ECU_ADDRESS 0x7f9b7e BYTE_ORDER MSB_LAST BIT_MASK 0x400 /end MEASUREMENT
/begin MEASUREMENT fmy_stat_crk_tooth.err_info_stat.lv_lock_diag "lock flag (CPU load optimisation) of the diagnosis instance CRK_TOOTH" UWORD _CNV_S_2_RANGE______380_CM 1 0. 0. 1. DISPLAY_IDENTIFIER LV_LOCK_DIAG_CRK_TOOTH ECU_ADDRESS 0x7f9b7e BYTE_ORDER MSB_LAST BIT_MASK 0x200 /end MEASUREMENT
/begin MEASUREMENT fmy_stat_crk_tooth.err_info_stat.lv_err_mem "storage in dynamic failure memory of the diagnosis instance CRK_TOOTH" UWORD _CNV_S_2_RANGE______380_CM 1 0. 0. 1. DISPLAY_IDENTIFIER LV_ERR_MEM_CRK_TOOTH ECU_ADDRESS 0x7f9b7e BYTE_ORDER MSB_LAST BIT_MASK 0x80 /end MEASUREMENT
/begin MEASUREMENT fmy_stat_crk_tooth.err_info_stat.lv_ready "readiness status of the diagnosis instance CRK_TOOTH" UWORD _CNV_S_2_RANGE______380_CM 1 0. 0. 1. DISPLAY_IDENTIFIER LV_READY_CRK_TOOTH ECU_ADDRESS 0x7f9b7e BYTE_ORDER MSB_LAST BIT_MASK 0x40 /end MEASUREMENT
/begin MEASUREMENT fmy_stat_crk_tooth.err_info_stat.lv_end_diag "end of diagnosis of the diagnosis instance CRK_TOOTH" UWORD _CNV_S_2_RANGE______380_CM 1 0. 0. 1. DISPLAY_IDENTIFIER LV_END_DIAG_CRK_TOOTH ECU_ADDRESS 0x7f9b7e BYTE_ORDER MSB_LAST BIT_MASK 0x20 /end MEASUREMENT
/begin MEASUREMENT fmy_stat_crk_tooth.err_info_stat.lv_cdn_diag "diagnosis condition of the diagnosis instance CRK_TOOTH" UWORD _CNV_S_2_RANGE______380_CM 1 0. 0. 1. DISPLAY_IDENTIFIER LV_CDN_DIAG_CRK_TOOTH ECU_ADDRESS 0x7f9b7e BYTE_ORDER MSB_LAST BIT_MASK 0x10 /end MEASUREMENT
/begin MEASUREMENT fmy_stat_crk_tooth.err_info_stat.err_sym "symptoms of the diagnosis instance CRK_TOOTH" UWORD _CNV_S_6_CONV_ERRM__27_CM 1 0. 0. 15. DISPLAY_IDENTIFIER ERR_SYM_CRK_TOOTH ECU_ADDRESS 0x7f9b7e BYTE_ORDER MSB_LAST BIT_MASK 0xF /end MEASUREMENT
/begin MEASUREMENT fmy_stat_crk_tooth_per.ctr_abc "anti bounce counter for diagnosis instance CRK_TOOTH_PER" UBYTE _CNV_A_R_LINEAR_____1_CM 1 0. 0. 255. DISPLAY_IDENTIFIER CTR_ABC_CRK_TOOTH_PER ECU_ADDRESS 0x7f9b85 FORMAT "%3.0" /end MEASUREMENT
/begin MEASUREMENT fmy_stat_crk_tooth_per.ctr_end_diag "counter for end of diagnosis for diagnosis instance CRK_TOOTH_PER" UBYTE _CNV_A_R_LINEAR_____1_CM 1 0. 0. 255. DISPLAY_IDENTIFIER CTR_ABC_END_DIAG_CRK_TOOTH_PER ECU_ADDRESS 0x7f9b84 FORMAT "%3.0" /end MEASUREMENT
/begin MEASUREMENT fmy_stat_crk_tooth_per.err_info_stat.reserved "" UWORD _CNV_A_R_LINEAR_____0_CM 1 0. 0. 65535. DISPLAY_IDENTIFIER FMY_STAT_CRK_TOOTH_PER_ERR_INFO_ ECU_ADDRESS 0x7f9b82 BYTE_ORDER MSB_LAST BIT_MASK 0xF800 /end MEASUREMENT
/begin MEASUREMENT fmy_stat_crk_tooth_per.err_info_stat.lv_cdn_diag_stc "Statistical flag for condition of diagnosis of the diagnosis instance CRK_TOOTH_PER" UWORD _CNV_S_2_RANGE______380_CM 1 0. 0. 1. DISPLAY_IDENTIFIER LV_CDN_DIAG_STC_CRK_TOOTH_PER ECU_ADDRESS 0x7f9b82 BYTE_ORDER MSB_LAST BIT_MASK 0x400 /end MEASUREMENT
/begin MEASUREMENT fmy_stat_crk_tooth_per.err_info_stat.lv_lock_diag "lock flag (CPU load optimisation) of the diagnosis instance CRK_TOOTH_PER" UWORD _CNV_S_2_RANGE______380_CM 1 0. 0. 1. DISPLAY_IDENTIFIER LV_LOCK_DIAG_CRK_TOOTH_PER ECU_ADDRESS 0x7f9b82 BYTE_ORDER MSB_LAST BIT_MASK 0x200 /end MEASUREMENT
/begin MEASUREMENT fmy_stat_crk_tooth_per.err_info_stat.lv_err_mem "storage in dynamic failure memory of the diagnosis instance CRK_TOOTH_PER" UWORD _CNV_S_2_RANGE______380_CM 1 0. 0. 1. DISPLAY_IDENTIFIER LV_ERR_MEM_CRK_TOOTH_PER ECU_ADDRESS 0x7f9b82 BYTE_ORDER MSB_LAST BIT_MASK 0x80 /end MEASUREMENT
/begin MEASUREMENT fmy_stat_crk_tooth_per.err_info_stat.lv_ready "readiness status of the diagnosis instance CRK_TOOTH_PER" UWORD _CNV_S_2_RANGE______380_CM 1 0. 0. 1. DISPLAY_IDENTIFIER LV_READY_CRK_TOOTH_PER ECU_ADDRESS 0x7f9b82 BYTE_ORDER MSB_LAST BIT_MASK 0x40 /end MEASUREMENT
/begin MEASUREMENT fmy_stat_crk_tooth_per.err_info_stat.lv_end_diag "end of diagnosis of the diagnosis instance CRK_TOOTH_PER" UWORD _CNV_S_2_RANGE______380_CM 1 0. 0. 1. DISPLAY_IDENTIFIER LV_END_DIAG_CRK_TOOTH_PER ECU_ADDRESS 0x7f9b82 BYTE_ORDER MSB_LAST BIT_MASK 0x20 /end MEASUREMENT
/begin MEASUREMENT fmy_stat_crk_tooth_per.err_info_stat.lv_cdn_diag "diagnosis condition of the diagnosis instance CRK_TOOTH_PER" UWORD _CNV_S_2_RANGE______380_CM 1 0. 0. 1. DISPLAY_IDENTIFIER LV_CDN_DIAG_CRK_TOOTH_PER ECU_ADDRESS 0x7f9b82 BYTE_ORDER MSB_LAST BIT_MASK 0x10 /end MEASUREMENT
/begin MEASUREMENT fmy_stat_crk_tooth_per.err_info_stat.err_sym "symptoms of the diagnosis instance CRK_TOOTH_PER" UWORD _CNV_S_6_CONV_ERRM__27_CM 1 0. 0. 15. DISPLAY_IDENTIFIER ERR_SYM_CRK_TOOTH_PER ECU_ADDRESS 0x7f9b82 BYTE_ORDER MSB_LAST BIT_MASK 0xF /end MEASUREMENT
/begin MEASUREMENT fmy_stat_crk_syn.ctr_abc "anti bounce counter for diagnosis instance CRK_SYN" UBYTE _CNV_A_R_LINEAR_____1_CM 1 0. 0. 255. DISPLAY_IDENTIFIER CTR_ABC_CRK_SYN ECU_ADDRESS 0x7f9b89 FORMAT "%3.0" /end MEASUREMENT
/begin MEASUREMENT fmy_stat_crk_syn.ctr_end_diag "counter for end of diagnosis for diagnosis instance CRK_SYN" UBYTE _CNV_A_R_LINEAR_____1_CM 1 0. 0. 255. DISPLAY_IDENTIFIER CTR_ABC_END_DIAG_CRK_SYN ECU_ADDRESS 0x7f9b88 FORMAT "%3.0" /end MEASUREMENT
/begin MEASUREMENT fmy_stat_crk_syn.err_info_stat.reserved "" UWORD _CNV_A_R_LINEAR_____0_CM 1 0. 0. 65535. DISPLAY_IDENTIFIER FMY_STAT_CRK_SYN_ERR_INFO_STAT_R ECU_ADDRESS 0x7f9b86 BYTE_ORDER MSB_LAST BIT_MASK 0xF800 /end MEASUREMENT
/begin MEASUREMENT fmy_stat_crk_syn.err_info_stat.lv_cdn_diag_stc "Statistical flag for condition of diagnosis of the diagnosis instance CRK_SYN" UWORD _CNV_S_2_RANGE______380_CM 1 0. 0. 1. DISPLAY_IDENTIFIER LV_CDN_DIAG_STC_CRK_SYN ECU_ADDRESS 0x7f9b86 BYTE_ORDER MSB_LAST BIT_MASK 0x400 /end MEASUREMENT
/begin MEASUREMENT fmy_stat_crk_syn.err_info_stat.lv_lock_diag "lock flag (CPU load optimisation) of the diagnosis instance CRK_SYN" UWORD _CNV_S_2_RANGE______380_CM 1 0. 0. 1. DISPLAY_IDENTIFIER LV_LOCK_DIAG_CRK_SYN ECU_ADDRESS 0x7f9b86 BYTE_ORDER MSB_LAST BIT_MASK 0x200 /end MEASUREMENT
/begin MEASUREMENT fmy_stat_crk_syn.err_info_stat.lv_err_mem "storage in dynamic failure memory of the diagnosis instance CRK_SYN" UWORD _CNV_S_2_RANGE______380_CM 1 0. 0. 1. DISPLAY_IDENTIFIER LV_ERR_MEM_CRK_SYN ECU_ADDRESS 0x7f9b86 BYTE_ORDER MSB_LAST BIT_MASK 0x80 /end MEASUREMENT
/begin MEASUREMENT fmy_stat_crk_syn.err_info_stat.lv_ready "readiness status of the diagnosis instance CRK_SYN" UWORD _CNV_S_2_RANGE______380_CM 1 0. 0. 1. DISPLAY_IDENTIFIER LV_READY_CRK_SYN ECU_ADDRESS 0x7f9b86 BYTE_ORDER MSB_LAST BIT_MASK 0x40 /end MEASUREMENT
/begin MEASUREMENT fmy_stat_crk_syn.err_info_stat.lv_end_diag "end of diagnosis of the diagnosis instance CRK_SYN" UWORD _CNV_S_2_RANGE______380_CM 1 0. 0. 1. DISPLAY_IDENTIFIER LV_END_DIAG_CRK_SYN ECU_ADDRESS 0x7f9b86 BYTE_ORDER MSB_LAST BIT_MASK 0x20 /end MEASUREMENT
/begin MEASUREMENT fmy_stat_crk_syn.err_info_stat.lv_cdn_diag "diagnosis condition of the diagnosis instance CRK_SYN" UWORD _CNV_S_2_RANGE______380_CM 1 0. 0. 1. DISPLAY_IDENTIFIER LV_CDN_DIAG_CRK_SYN ECU_ADDRESS 0x7f9b86 BYTE_ORDER MSB_LAST BIT_MASK 0x10 /end MEASUREMENT
/begin MEASUREMENT fmy_stat_crk_syn.err_info_stat.err_sym "symptoms of the diagnosis instance CRK_SYN" UWORD _CNV_S_6_CONV_ERRM__27_CM 1 0. 0. 15. DISPLAY_IDENTIFIER ERR_SYM_CRK_SYN ECU_ADDRESS 0x7f9b86 BYTE_ORDER MSB_LAST BIT_MASK 0xF /end MEASUREMENT
/begin MEASUREMENT fmy_stat_crk_plaus.ctr_abc "anti bounce counter for diagnosis instance CRK_PLAUS" UBYTE _CNV_A_R_LINEAR_____1_CM 1 0. 0. 255. DISPLAY_IDENTIFIER CTR_ABC_CRK_PLAUS ECU_ADDRESS 0x7f9b8d FORMAT "%3.0" /end MEASUREMENT
/begin MEASUREMENT fmy_stat_crk_plaus.ctr_end_diag "counter for end of diagnosis for diagnosis instance CRK_PLAUS" UBYTE _CNV_A_R_LINEAR_____1_CM 1 0. 0. 255. DISPLAY_IDENTIFIER CTR_ABC_END_DIAG_CRK_PLAUS ECU_ADDRESS 0x7f9b8c FORMAT "%3.0" /end MEASUREMENT
/begin MEASUREMENT fmy_stat_crk_plaus.err_info_stat.reserved "" UWORD _CNV_A_R_LINEAR_____0_CM 1 0. 0. 65535. DISPLAY_IDENTIFIER FMY_STAT_CRK_PLAUS_ERR_INFO_STAT ECU_ADDRESS 0x7f9b8a BYTE_ORDER MSB_LAST BIT_MASK 0xF800 /end MEASUREMENT
/begin MEASUREMENT fmy_stat_crk_plaus.err_info_stat.lv_cdn_diag_stc "Statistical flag for condition of diagnosis of the diagnosis instance CRK_PLAUS" UWORD _CNV_S_2_RANGE______380_CM 1 0. 0. 1. DISPLAY_IDENTIFIER LV_CDN_DIAG_STC_CRK_PLAUS ECU_ADDRESS 0x7f9b8a BYTE_ORDER MSB_LAST BIT_MASK 0x400 /end MEASUREMENT
/begin MEASUREMENT fmy_stat_crk_plaus.err_info_stat.lv_lock_diag "lock flag (CPU load optimisation) of the diagnosis instance CRK_PLAUS" UWORD _CNV_S_2_RANGE______380_CM 1 0. 0. 1. DISPLAY_IDENTIFIER LV_LOCK_DIAG_CRK_PLAUS ECU_ADDRESS 0x7f9b8a BYTE_ORDER MSB_LAST BIT_MASK 0x200 /end MEASUREMENT
/begin MEASUREMENT fmy_stat_crk_plaus.err_info_stat.lv_err_mem "storage in dynamic failure memory of the diagnosis instance CRK_PLAUS" UWORD _CNV_S_2_RANGE______380_CM 1 0. 0. 1. DISPLAY_IDENTIFIER LV_ERR_MEM_CRK_PLAUS ECU_ADDRESS 0x7f9b8a BYTE_ORDER MSB_LAST BIT_MASK 0x80 /end MEASUREMENT
/begin MEASUREMENT fmy_stat_crk_plaus.err_info_stat.lv_ready "readiness status of the diagnosis instance CRK_PLAUS" UWORD _CNV_S_2_RANGE______380_CM 1 0. 0. 1. DISPLAY_IDENTIFIER LV_READY_CRK_PLAUS ECU_ADDRESS 0x7f9b8a BYTE_ORDER MSB_LAST BIT_MASK 0x40 /end MEASUREMENT
/begin MEASUREMENT fmy_stat_crk_plaus.err_info_stat.lv_end_diag "end of diagnosis of the diagnosis instance CRK_PLAUS" UWORD _CNV_S_2_RANGE______380_CM 1 0. 0. 1. DISPLAY_IDENTIFIER LV_END_DIAG_CRK_PLAUS ECU_ADDRESS 0x7f9b8a BYTE_ORDER MSB_LAST BIT_MASK 0x20 /end MEASUREMENT
/begin MEASUREMENT fmy_stat_crk_plaus.err_info_stat.lv_cdn_diag "diagnosis condition of the diagnosis instance CRK_PLAUS" UWORD _CNV_S_2_RANGE______380_CM 1 0. 0. 1. DISPLAY_IDENTIFIER LV_CDN_DIAG_CRK_PLAUS ECU_ADDRESS 0x7f9b8a BYTE_ORDER MSB_LAST BIT_MASK 0x10 /end MEASUREMENT
/begin MEASUREMENT fmy_stat_crk_plaus.err_info_stat.err_sym "symptoms of the diagnosis instance CRK_PLAUS" UWORD _CNV_S_6_CONV_ERRM__27_CM 1 0. 0. 15. DISPLAY_IDENTIFIER ERR_SYM_CRK_PLAUS ECU_ADDRESS 0x7f9b8a BYTE_ORDER MSB_LAST BIT_MASK 0xF /end MEASUREMENT
/begin MEASUREMENT fmy_stat_plaus_cam_in_1.ctr_abc "anti bounce counter for diagnosis instance PLAUS_CAM_IN_1" UBYTE _CNV_A_R_LINEAR_____1_CM 1 0. 0. 255. DISPLAY_IDENTIFIER CTR_ABC_PLAUS_CAM_IN_1 ECU_ADDRESS 0x7f9b91 FORMAT "%3.0" /end MEASUREMENT
/begin MEASUREMENT fmy_stat_plaus_cam_in_1.ctr_end_diag "counter for end of diagnosis for diagnosis instance PLAUS_CAM_IN_1" UBYTE _CNV_A_R_LINEAR_____1_CM 1 0. 0. 255. DISPLAY_IDENTIFIER CTR_ABC_END_DIAG_PLAUS_CAM_IN_1 ECU_ADDRESS 0x7f9b90 FORMAT "%3.0" /end MEASUREMENT
/begin MEASUREMENT fmy_stat_plaus_cam_in_1.err_info_stat.reserved "" UWORD _CNV_A_R_LINEAR_____0_CM 1 0. 0. 65535. DISPLAY_IDENTIFIER FMY_STAT_PLAUS_CAM_IN_1_ERR_INFO ECU_ADDRESS 0x7f9b8e BYTE_ORDER MSB_LAST BIT_MASK 0xF800 /end MEASUREMENT
/begin MEASUREMENT fmy_stat_plaus_cam_in_1.err_info_stat.lv_cdn_diag_stc "Statistical flag for condition of diagnosis of the diagnosis instance PLAUS_CAM_IN_1" UWORD _CNV_S_2_RANGE______380_CM 1 0. 0. 1. DISPLAY_IDENTIFIER LV_CDN_DIAG_STC_PLAUS_CAM_IN_1 ECU_ADDRESS 0x7f9b8e BYTE_ORDER MSB_LAST BIT_MASK 0x400 /end MEASUREMENT
/begin MEASUREMENT fmy_stat_plaus_cam_in_1.err_info_stat.lv_lock_diag "lock flag (CPU load optimisation) of the diagnosis instance PLAUS_CAM_IN_1" UWORD _CNV_S_2_RANGE______380_CM 1 0. 0. 1. DISPLAY_IDENTIFIER LV_LOCK_DIAG_PLAUS_CAM_IN_1 ECU_ADDRESS 0x7f9b8e BYTE_ORDER MSB_LAST BIT_MASK 0x200 /end MEASUREMENT
/begin MEASUREMENT fmy_stat_plaus_cam_in_1.err_info_stat.lv_err_mem "storage in dynamic failure memory of the diagnosis instance PLAUS_CAM_IN_1" UWORD _CNV_S_2_RANGE______380_CM 1 0. 0. 1. DISPLAY_IDENTIFIER LV_ERR_MEM_PLAUS_CAM_IN_1 ECU_ADDRESS 0x7f9b8e BYTE_ORDER MSB_LAST BIT_MASK 0x80 /end MEASUREMENT
/begin MEASUREMENT fmy_stat_plaus_cam_in_1.err_info_stat.lv_ready "readiness status of the diagnosis instance PLAUS_CAM_IN_1" UWORD _CNV_S_2_RANGE______380_CM 1 0. 0. 1. DISPLAY_IDENTIFIER LV_READY_PLAUS_CAM_IN_1 ECU_ADDRESS 0x7f9b8e BYTE_ORDER MSB_LAST BIT_MASK 0x40 /end MEASUREMENT
/begin MEASUREMENT fmy_stat_plaus_cam_in_1.err_info_stat.lv_end_diag "end of diagnosis of the diagnosis instance PLAUS_CAM_IN_1" UWORD _CNV_S_2_RANGE______380_CM 1 0. 0. 1. DISPLAY_IDENTIFIER LV_END_DIAG_PLAUS_CAM_IN_1 ECU_ADDRESS 0x7f9b8e BYTE_ORDER MSB_LAST BIT_MASK 0x20 /end MEASUREMENT
/begin MEASUREMENT fmy_stat_plaus_cam_in_1.err_info_stat.lv_cdn_diag "diagnosis condition of the diagnosis instance PLAUS_CAM_IN_1" UWORD _CNV_S_2_RANGE______380_CM 1 0. 0. 1. DISPLAY_IDENTIFIER LV_CDN_DIAG_PLAUS_CAM_IN_1 ECU_ADDRESS 0x7f9b8e BYTE_ORDER MSB_LAST BIT_MASK 0x10 /end MEASUREMENT
/begin MEASUREMENT fmy_stat_plaus_cam_in_1.err_info_stat.err_sym "symptoms of the diagnosis instance PLAUS_CAM_IN_1" UWORD _CNV_S_6_CONV_ERRM__27_CM 1 0. 0. 15. DISPLAY_IDENTIFIER ERR_SYM_PLAUS_CAM_IN_1 ECU_ADDRESS 0x7f9b8e BYTE_ORDER MSB_LAST BIT_MASK 0xF /end MEASUREMENT
/begin MEASUREMENT fmy_stat_syn_crk_cam_in_1.ctr_abc "anti bounce counter for diagnosis instance SYN_CRK_CAM_IN_1" UBYTE _CNV_A_R_LINEAR_____1_CM 1 0. 0. 255. DISPLAY_IDENTIFIER CTR_ABC_SYN_CRK_CAM_IN_1 ECU_ADDRESS 0x7f9b95 FORMAT "%3.0" /end MEASUREMENT
/begin MEASUREMENT fmy_stat_syn_crk_cam_in_1.ctr_end_diag "counter for end of diagnosis for diagnosis instance SYN_CRK_CAM_IN_1" UBYTE _CNV_A_R_LINEAR_____1_CM 1 0. 0. 255. DISPLAY_IDENTIFIER CTR_ABC_END_DIAG_SYN_CRK_CAM_IN_ ECU_ADDRESS 0x7f9b94 FORMAT "%3.0" /end MEASUREMENT
/begin MEASUREMENT fmy_stat_syn_crk_cam_in_1.err_info_stat.reserved "" UWORD _CNV_A_R_LINEAR_____0_CM 1 0. 0. 65535. DISPLAY_IDENTIFIER FMY_STAT_SYN_CRK_CAM_IN_1_ERR_IN ECU_ADDRESS 0x7f9b92 BYTE_ORDER MSB_LAST BIT_MASK 0xF800 /end MEASUREMENT
/begin MEASUREMENT fmy_stat_syn_crk_cam_in_1.err_info_stat.lv_cdn_diag_stc "Statistical flag for condition of diagnosis of the diagnosis instance SYN_CRK_CAM_IN_1" UWORD _CNV_S_2_RANGE______380_CM 1 0. 0. 1. DISPLAY_IDENTIFIER LV_CDN_DIAG_STC_SYN_CRK_CAM_IN_1 ECU_ADDRESS 0x7f9b92 BYTE_ORDER MSB_LAST BIT_MASK 0x400 /end MEASUREMENT
/begin MEASUREMENT fmy_stat_syn_crk_cam_in_1.err_info_stat.lv_lock_diag "lock flag (CPU load optimisation) of the diagnosis instance SYN_CRK_CAM_IN_1" UWORD _CNV_S_2_RANGE______380_CM 1 0. 0. 1. DISPLAY_IDENTIFIER LV_LOCK_DIAG_SYN_CRK_CAM_IN_1 ECU_ADDRESS 0x7f9b92 BYTE_ORDER MSB_LAST BIT_MASK 0x200 /end MEASUREMENT
/begin MEASUREMENT fmy_stat_syn_crk_cam_in_1.err_info_stat.lv_err_mem "storage in dynamic failure memory of the diagnosis instance SYN_CRK_CAM_IN_1" UWORD _CNV_S_2_RANGE______380_CM 1 0. 0. 1. DISPLAY_IDENTIFIER LV_ERR_MEM_SYN_CRK_CAM_IN_1 ECU_ADDRESS 0x7f9b92 BYTE_ORDER MSB_LAST BIT_MASK 0x80 /end MEASUREMENT
/begin MEASUREMENT fmy_stat_syn_crk_cam_in_1.err_info_stat.lv_ready "readiness status of the diagnosis instance SYN_CRK_CAM_IN_1" UWORD _CNV_S_2_RANGE______380_CM 1 0. 0. 1. DISPLAY_IDENTIFIER LV_READY_SYN_CRK_CAM_IN_1 ECU_ADDRESS 0x7f9b92 BYTE_ORDER MSB_LAST BIT_MASK 0x40 /end MEASUREMENT
/begin MEASUREMENT fmy_stat_syn_crk_cam_in_1.err_info_stat.lv_end_diag "end of diagnosis of the diagnosis instance SYN_CRK_CAM_IN_1" UWORD _CNV_S_2_RANGE______380_CM 1 0. 0. 1. DISPLAY_IDENTIFIER LV_END_DIAG_SYN_CRK_CAM_IN_1 ECU_ADDRESS 0x7f9b92 BYTE_ORDER MSB_LAST BIT_MASK 0x20 /end MEASUREMENT
/begin MEASUREMENT fmy_stat_syn_crk_cam_in_1.err_info_stat.lv_cdn_diag "diagnosis condition of the diagnosis instance SYN_CRK_CAM_IN_1" UWORD _CNV_S_2_RANGE______380_CM 1 0. 0. 1. DISPLAY_IDENTIFIER LV_CDN_DIAG_SYN_CRK_CAM_IN_1 ECU_ADDRESS 0x7f9b92 BYTE_ORDER MSB_LAST BIT_MASK 0x10 /end MEASUREMENT
/begin MEASUREMENT fmy_stat_syn_crk_cam_in_1.err_info_stat.err_sym "symptoms of the diagnosis instance SYN_CRK_CAM_IN_1" UWORD _CNV_S_6_CONV_ERRM__27_CM 1 0. 0. 15. DISPLAY_IDENTIFIER ERR_SYM_SYN_CRK_CAM_IN_1 ECU_ADDRESS 0x7f9b92 BYTE_ORDER MSB_LAST BIT_MASK 0xF /end MEASUREMENT
/begin MEASUREMENT fmy_stat_lsh_up_1.ctr_abc "anti bounce counter for diagnosis instance LSH_UP_1" UBYTE _CNV_A_R_LINEAR_____1_CM 1 0. 0. 255. DISPLAY_IDENTIFIER CTR_ABC_LSH_UP_1 ECU_ADDRESS 0x7f9b99 FORMAT "%3.0" /end MEASUREMENT
/begin MEASUREMENT fmy_stat_lsh_up_1.ctr_end_diag "counter for end of diagnosis for diagnosis instance LSH_UP_1" UBYTE _CNV_A_R_LINEAR_____1_CM 1 0. 0. 255. DISPLAY_IDENTIFIER CTR_ABC_END_DIAG_LSH_UP_1 ECU_ADDRESS 0x7f9b98 FORMAT "%3.0" /end MEASUREMENT
/begin MEASUREMENT fmy_stat_lsh_up_1.err_info_stat.reserved "" UWORD _CNV_A_R_LINEAR_____0_CM 1 0. 0. 65535. DISPLAY_IDENTIFIER FMY_STAT_LSH_UP_1_ERR_INFO_STAT_ ECU_ADDRESS 0x7f9b96 BYTE_ORDER MSB_LAST BIT_MASK 0xF800 /end MEASUREMENT
/begin MEASUREMENT fmy_stat_lsh_up_1.err_info_stat.lv_cdn_diag_stc "Statistical flag for condition of diagnosis of the diagnosis instance LSH_UP_1" UWORD _CNV_S_2_RANGE______380_CM 1 0. 0. 1. DISPLAY_IDENTIFIER LV_CDN_DIAG_STC_LSH_UP_1 ECU_ADDRESS 0x7f9b96 BYTE_ORDER MSB_LAST BIT_MASK 0x400 /end MEASUREMENT
/begin MEASUREMENT fmy_stat_lsh_up_1.err_info_stat.lv_lock_diag "lock flag (CPU load optimisation) of the diagnosis instance LSH_UP_1" UWORD _CNV_S_2_RANGE______380_CM 1 0. 0. 1. DISPLAY_IDENTIFIER LV_LOCK_DIAG_LSH_UP_1 ECU_ADDRESS 0x7f9b96 BYTE_ORDER MSB_LAST BIT_MASK 0x200 /end MEASUREMENT
/begin MEASUREMENT fmy_stat_lsh_up_1.err_info_stat.lv_err_mem "storage in dynamic failure memory of the diagnosis instance LSH_UP_1" UWORD _CNV_S_2_RANGE______380_CM 1 0. 0. 1. DISPLAY_IDENTIFIER LV_ERR_MEM_LSH_UP_1 ECU_ADDRESS 0x7f9b96 BYTE_ORDER MSB_LAST BIT_MASK 0x80 /end MEASUREMENT
/begin MEASUREMENT fmy_stat_lsh_up_1.err_info_stat.lv_ready "readiness status of the diagnosis instance LSH_UP_1" UWORD _CNV_S_2_RANGE______380_CM 1 0. 0. 1. DISPLAY_IDENTIFIER LV_READY_LSH_UP_1 ECU_ADDRESS 0x7f9b96 BYTE_ORDER MSB_LAST BIT_MASK 0x40 /end MEASUREMENT
/begin MEASUREMENT fmy_stat_lsh_up_1.err_info_stat.lv_end_diag "end of diagnosis of the diagnosis instance LSH_UP_1" UWORD _CNV_S_2_RANGE______380_CM 1 0. 0. 1. DISPLAY_IDENTIFIER LV_END_DIAG_LSH_UP_1 ECU_ADDRESS 0x7f9b96 BYTE_ORDER MSB_LAST BIT_MASK 0x20 /end MEASUREMENT
/begin MEASUREMENT fmy_stat_lsh_up_1.err_info_stat.lv_cdn_diag "diagnosis condition of the diagnosis instance LSH_UP_1" UWORD _CNV_S_2_RANGE______380_CM 1 0. 0. 1. DISPLAY_IDENTIFIER LV_CDN_DIAG_LSH_UP_1 ECU_ADDRESS 0x7f9b96 BYTE_ORDER MSB_LAST BIT_MASK 0x10 /end MEASUREMENT
/begin MEASUREMENT fmy_stat_lsh_up_1.err_info_stat.err_sym "symptoms of the diagnosis instance LSH_UP_1" UWORD _CNV_S_6_CONV_ERRM__27_CM 1 0. 0. 15. DISPLAY_IDENTIFIER ERR_SYM_LSH_UP_1 ECU_ADDRESS 0x7f9b96 BYTE_ORDER MSB_LAST BIT_MASK 0xF /end MEASUREMENT
/begin MEASUREMENT fmy_stat_lsh_down_1.ctr_abc "anti bounce counter for diagnosis instance LSH_DOWN_1" UBYTE _CNV_A_R_LINEAR_____1_CM 1 0. 0. 255. DISPLAY_IDENTIFIER CTR_ABC_LSH_DOWN_1 ECU_ADDRESS 0x7f9b9d FORMAT "%3.0" /end MEASUREMENT
/begin MEASUREMENT fmy_stat_lsh_down_1.ctr_end_diag "counter for end of diagnosis for diagnosis instance LSH_DOWN_1" UBYTE _CNV_A_R_LINEAR_____1_CM 1 0. 0. 255. DISPLAY_IDENTIFIER CTR_ABC_END_DIAG_LSH_DOWN_1 ECU_ADDRESS 0x7f9b9c FORMAT "%3.0" /end MEASUREMENT
/begin MEASUREMENT fmy_stat_lsh_down_1.err_info_stat.reserved "" UWORD _CNV_A_R_LINEAR_____0_CM 1 0. 0. 65535. DISPLAY_IDENTIFIER FMY_STAT_LSH_DOWN_1_ERR_INFO_STA ECU_ADDRESS 0x7f9b9a BYTE_ORDER MSB_LAST BIT_MASK 0xF800 /end MEASUREMENT
/begin MEASUREMENT fmy_stat_lsh_down_1.err_info_stat.lv_cdn_diag_stc "Statistical flag for condition of diagnosis of the diagnosis instance LSH_DOWN_1" UWORD _CNV_S_2_RANGE______380_CM 1 0. 0. 1. DISPLAY_IDENTIFIER LV_CDN_DIAG_STC_LSH_DOWN_1 ECU_ADDRESS 0x7f9b9a BYTE_ORDER MSB_LAST BIT_MASK 0x400 /end MEASUREMENT
/begin MEASUREMENT fmy_stat_lsh_down_1.err_info_stat.lv_lock_diag "lock flag (CPU load optimisation) of the diagnosis instance LSH_DOWN_1" UWORD _CNV_S_2_RANGE______380_CM 1 0. 0. 1. DISPLAY_IDENTIFIER LV_LOCK_DIAG_LSH_DOWN_1 ECU_ADDRESS 0x7f9b9a BYTE_ORDER MSB_LAST BIT_MASK 0x200 /end MEASUREMENT
/begin MEASUREMENT fmy_stat_lsh_down_1.err_info_stat.lv_err_mem "storage in dynamic failure memory of the diagnosis instance LSH_DOWN_1" UWORD _CNV_S_2_RANGE______380_CM 1 0. 0. 1. DISPLAY_IDENTIFIER LV_ERR_MEM_LSH_DOWN_1 ECU_ADDRESS 0x7f9b9a BYTE_ORDER MSB_LAST BIT_MASK 0x80 /end MEASUREMENT
/begin MEASUREMENT fmy_stat_lsh_down_1.err_info_stat.lv_ready "readiness status of the diagnosis instance LSH_DOWN_1" UWORD _CNV_S_2_RANGE______380_CM 1 0. 0. 1. DISPLAY_IDENTIFIER LV_READY_LSH_DOWN_1 ECU_ADDRESS 0x7f9b9a BYTE_ORDER MSB_LAST BIT_MASK 0x40 /end MEASUREMENT
/begin MEASUREMENT fmy_stat_lsh_down_1.err_info_stat.lv_end_diag "end of diagnosis of the diagnosis instance LSH_DOWN_1" UWORD _CNV_S_2_RANGE______380_CM 1 0. 0. 1. DISPLAY_IDENTIFIER LV_END_DIAG_LSH_DOWN_1 ECU_ADDRESS 0x7f9b9a BYTE_ORDER MSB_LAST BIT_MASK 0x20 /end MEASUREMENT
/begin MEASUREMENT fmy_stat_lsh_down_1.err_info_stat.lv_cdn_diag "diagnosis condition of the diagnosis instance LSH_DOWN_1" UWORD _CNV_S_2_RANGE______380_CM 1 0. 0. 1. DISPLAY_IDENTIFIER LV_CDN_DIAG_LSH_DOWN_1 ECU_ADDRESS 0x7f9b9a BYTE_ORDER MSB_LAST BIT_MASK 0x10 /end MEASUREMENT
/begin MEASUREMENT fmy_stat_lsh_down_1.err_info_stat.err_sym "symptoms of the diagnosis instance LSH_DOWN_1" UWORD _CNV_S_6_CONV_ERRM__27_CM 1 0. 0. 15. DISPLAY_IDENTIFIER ERR_SYM_LSH_DOWN_1 ECU_ADDRESS 0x7f9b9a BYTE_ORDER MSB_LAST BIT_MASK 0xF /end MEASUREMENT
/begin MEASUREMENT fmy_stat_scg_ls_down_1.ctr_abc "anti bounce counter for diagnosis instance SCG_LS_DOWN_1" UBYTE _CNV_A_R_LINEAR_____1_CM 1 0. 0. 255. DISPLAY_IDENTIFIER CTR_ABC_SCG_LS_DOWN_1 ECU_ADDRESS 0x7f9ba1 FORMAT "%3.0" /end MEASUREMENT
/begin MEASUREMENT fmy_stat_scg_ls_down_1.ctr_end_diag "counter for end of diagnosis for diagnosis instance SCG_LS_DOWN_1" UBYTE _CNV_A_R_LINEAR_____1_CM 1 0. 0. 255. DISPLAY_IDENTIFIER CTR_ABC_END_DIAG_SCG_LS_DOWN_1 ECU_ADDRESS 0x7f9ba0 FORMAT "%3.0" /end MEASUREMENT
/begin MEASUREMENT fmy_stat_scg_ls_down_1.err_info_stat.reserved "" UWORD _CNV_A_R_LINEAR_____0_CM 1 0. 0. 65535. DISPLAY_IDENTIFIER FMY_STAT_SCG_LS_DOWN_1_ERR_INFO_ ECU_ADDRESS 0x7f9b9e BYTE_ORDER MSB_LAST BIT_MASK 0xF800 /end MEASUREMENT
/begin MEASUREMENT fmy_stat_scg_ls_down_1.err_info_stat.lv_cdn_diag_stc "Statistical flag for condition of diagnosis of the diagnosis instance SCG_LS_DOWN_1" UWORD _CNV_S_2_RANGE______380_CM 1 0. 0. 1. DISPLAY_IDENTIFIER LV_CDN_DIAG_STC_SCG_LS_DOWN_1 ECU_ADDRESS 0x7f9b9e BYTE_ORDER MSB_LAST BIT_MASK 0x400 /end MEASUREMENT
/begin MEASUREMENT fmy_stat_scg_ls_down_1.err_info_stat.lv_lock_diag "lock flag (CPU load optimisation) of the diagnosis instance SCG_LS_DOWN_1" UWORD _CNV_S_2_RANGE______380_CM 1 0. 0. 1. DISPLAY_IDENTIFIER LV_LOCK_DIAG_SCG_LS_DOWN_1 ECU_ADDRESS 0x7f9b9e BYTE_ORDER MSB_LAST BIT_MASK 0x200 /end MEASUREMENT
/begin MEASUREMENT fmy_stat_scg_ls_down_1.err_info_stat.lv_err_mem "storage in dynamic failure memory of the diagnosis instance SCG_LS_DOWN_1" UWORD _CNV_S_2_RANGE______380_CM 1 0. 0. 1. DISPLAY_IDENTIFIER LV_ERR_MEM_SCG_LS_DOWN_1 ECU_ADDRESS 0x7f9b9e BYTE_ORDER MSB_LAST BIT_MASK 0x80 /end MEASUREMENT
/begin MEASUREMENT fmy_stat_scg_ls_down_1.err_info_stat.lv_ready "readiness status of the diagnosis instance SCG_LS_DOWN_1" UWORD _CNV_S_2_RANGE______380_CM 1 0. 0. 1. DISPLAY_IDENTIFIER LV_READY_SCG_LS_DOWN_1 ECU_ADDRESS 0x7f9b9e BYTE_ORDER MSB_LAST BIT_MASK 0x40 /end MEASUREMENT
/begin MEASUREMENT fmy_stat_scg_ls_down_1.err_info_stat.lv_end_diag "end of diagnosis of the diagnosis instance SCG_LS_DOWN_1" UWORD _CNV_S_2_RANGE______380_CM 1 0. 0. 1. DISPLAY_IDENTIFIER LV_END_DIAG_SCG_LS_DOWN_1 ECU_ADDRESS 0x7f9b9e BYTE_ORDER MSB_LAST BIT_MASK 0x20 /end MEASUREMENT
/begin MEASUREMENT fmy_stat_scg_ls_down_1.err_info_stat.lv_cdn_diag "diagnosis condition of the diagnosis instance SCG_LS_DOWN_1" UWORD _CNV_S_2_RANGE______380_CM 1 0. 0. 1. DISPLAY_IDENTIFIER LV_CDN_DIAG_SCG_LS_DOWN_1 ECU_ADDRESS 0x7f9b9e BYTE_ORDER MSB_LAST BIT_MASK 0x10 /end MEASUREMENT
/begin MEASUREMENT fmy_stat_scg_ls_down_1.err_info_stat.err_sym "symptoms of the diagnosis instance SCG_LS_DOWN_1" UWORD _CNV_S_6_CONV_ERRM__27_CM 1 0. 0. 15. DISPLAY_IDENTIFIER ERR_SYM_SCG_LS_DOWN_1 ECU_ADDRESS 0x7f9b9e BYTE_ORDER MSB_LAST BIT_MASK 0xF /end MEASUREMENT
/begin MEASUREMENT fmy_stat_scp_ls_down_1.ctr_abc "anti bounce counter for diagnosis instance SCP_LS_DOWN_1" UBYTE _CNV_A_R_LINEAR_____1_CM 1 0. 0. 255. DISPLAY_IDENTIFIER CTR_ABC_SCP_LS_DOWN_1 ECU_ADDRESS 0x7f9ba5 FORMAT "%3.0" /end MEASUREMENT
/begin MEASUREMENT fmy_stat_scp_ls_down_1.ctr_end_diag "counter for end of diagnosis for diagnosis instance SCP_LS_DOWN_1" UBYTE _CNV_A_R_LINEAR_____1_CM 1 0. 0. 255. DISPLAY_IDENTIFIER CTR_ABC_END_DIAG_SCP_LS_DOWN_1 ECU_ADDRESS 0x7f9ba4 FORMAT "%3.0" /end MEASUREMENT
/begin MEASUREMENT fmy_stat_scp_ls_down_1.err_info_stat.reserved "" UWORD _CNV_A_R_LINEAR_____0_CM 1 0. 0. 65535. DISPLAY_IDENTIFIER FMY_STAT_SCP_LS_DOWN_1_ERR_INFO_ ECU_ADDRESS 0x7f9ba2 BYTE_ORDER MSB_LAST BIT_MASK 0xF800 /end MEASUREMENT
/begin MEASUREMENT fmy_stat_scp_ls_down_1.err_info_stat.lv_cdn_diag_stc "Statistical flag for condition of diagnosis of the diagnosis instance SCP_LS_DOWN_1" UWORD _CNV_S_2_RANGE______380_CM 1 0. 0. 1. DISPLAY_IDENTIFIER LV_CDN_DIAG_STC_SCP_LS_DOWN_1 ECU_ADDRESS 0x7f9ba2 BYTE_ORDER MSB_LAST BIT_MASK 0x400 /end MEASUREMENT
/begin MEASUREMENT fmy_stat_scp_ls_down_1.err_info_stat.lv_lock_diag "lock flag (CPU load optimisation) of the diagnosis instance SCP_LS_DOWN_1" UWORD _CNV_S_2_RANGE______380_CM 1 0. 0. 1. DISPLAY_IDENTIFIER LV_LOCK_DIAG_SCP_LS_DOWN_1 ECU_ADDRESS 0x7f9ba2 BYTE_ORDER MSB_LAST BIT_MASK 0x200 /end MEASUREMENT
/begin MEASUREMENT fmy_stat_scp_ls_down_1.err_info_stat.lv_err_mem "storage in dynamic failure memory of the diagnosis instance SCP_LS_DOWN_1" UWORD _CNV_S_2_RANGE______380_CM 1 0. 0. 1. DISPLAY_IDENTIFIER LV_ERR_MEM_SCP_LS_DOWN_1 ECU_ADDRESS 0x7f9ba2 BYTE_ORDER MSB_LAST BIT_MASK 0x80 /end MEASUREMENT
/begin MEASUREMENT fmy_stat_scp_ls_down_1.err_info_stat.lv_ready "readiness status of the diagnosis instance SCP_LS_DOWN_1" UWORD _CNV_S_2_RANGE______380_CM 1 0. 0. 1. DISPLAY_IDENTIFIER LV_READY_SCP_LS_DOWN_1 ECU_ADDRESS 0x7f9ba2 BYTE_ORDER MSB_LAST BIT_MASK 0x40 /end MEASUREMENT
/begin MEASUREMENT fmy_stat_scp_ls_down_1.err_info_stat.lv_end_diag "end of diagnosis of the diagnosis instance SCP_LS_DOWN_1" UWORD _CNV_S_2_RANGE______380_CM 1 0. 0. 1. DISPLAY_IDENTIFIER LV_END_DIAG_SCP_LS_DOWN_1 ECU_ADDRESS 0x7f9ba2 BYTE_ORDER MSB_LAST BIT_MASK 0x20 /end MEASUREMENT
/begin MEASUREMENT fmy_stat_scp_ls_down_1.err_info_stat.lv_cdn_diag "diagnosis condition of the diagnosis instance SCP_LS_DOWN_1" UWORD _CNV_S_2_RANGE______380_CM 1 0. 0. 1. DISPLAY_IDENTIFIER LV_CDN_DIAG_SCP_LS_DOWN_1 ECU_ADDRESS 0x7f9ba2 BYTE_ORDER MSB_LAST BIT_MASK 0x10 /end MEASUREMENT
/begin MEASUREMENT fmy_stat_scp_ls_down_1.err_info_stat.err_sym "symptoms of the diagnosis instance SCP_LS_DOWN_1" UWORD _CNV_S_6_CONV_ERRM__27_CM 1 0. 0. 15. DISPLAY_IDENTIFIER ERR_SYM_SCP_LS_DOWN_1 ECU_ADDRESS 0x7f9ba2 BYTE_ORDER MSB_LAST BIT_MASK 0xF /end MEASUREMENT
/begin MEASUREMENT fmy_stat_oc_ls_down_1.ctr_abc "anti bounce counter for diagnosis instance OC_LS_DOWN_1" UBYTE _CNV_A_R_LINEAR_____1_CM 1 0. 0. 255. DISPLAY_IDENTIFIER CTR_ABC_OC_LS_DOWN_1 ECU_ADDRESS 0x7f9ba9 FORMAT "%3.0" /end MEASUREMENT
/begin MEASUREMENT fmy_stat_oc_ls_down_1.ctr_end_diag "counter for end of diagnosis for diagnosis instance OC_LS_DOWN_1" UBYTE _CNV_A_R_LINEAR_____1_CM 1 0. 0. 255. DISPLAY_IDENTIFIER CTR_ABC_END_DIAG_OC_LS_DOWN_1 ECU_ADDRESS 0x7f9ba8 FORMAT "%3.0" /end MEASUREMENT
/begin MEASUREMENT fmy_stat_oc_ls_down_1.err_info_stat.reserved "" UWORD _CNV_A_R_LINEAR_____0_CM 1 0. 0. 65535. DISPLAY_IDENTIFIER FMY_STAT_OC_LS_DOWN_1_ERR_INFO_S ECU_ADDRESS 0x7f9ba6 BYTE_ORDER MSB_LAST BIT_MASK 0xF800 /end MEASUREMENT
/begin MEASUREMENT fmy_stat_oc_ls_down_1.err_info_stat.lv_cdn_diag_stc "Statistical flag for condition of diagnosis of the diagnosis instance OC_LS_DOWN_1" UWORD _CNV_S_2_RANGE______380_CM 1 0. 0. 1. DISPLAY_IDENTIFIER LV_CDN_DIAG_STC_OC_LS_DOWN_1 ECU_ADDRESS 0x7f9ba6 BYTE_ORDER MSB_LAST BIT_MASK 0x400 /end MEASUREMENT
/begin MEASUREMENT fmy_stat_oc_ls_down_1.err_info_stat.lv_lock_diag "lock flag (CPU load optimisation) of the diagnosis instance OC_LS_DOWN_1" UWORD _CNV_S_2_RANGE______380_CM 1 0. 0. 1. DISPLAY_IDENTIFIER LV_LOCK_DIAG_OC_LS_DOWN_1 ECU_ADDRESS 0x7f9ba6 BYTE_ORDER MSB_LAST BIT_MASK 0x200 /end MEASUREMENT
/begin MEASUREMENT fmy_stat_oc_ls_down_1.err_info_stat.lv_err_mem "storage in dynamic failure memory of the diagnosis instance OC_LS_DOWN_1" UWORD _CNV_S_2_RANGE______380_CM 1 0. 0. 1. DISPLAY_IDENTIFIER LV_ERR_MEM_OC_LS_DOWN_1 ECU_ADDRESS 0x7f9ba6 BYTE_ORDER MSB_LAST BIT_MASK 0x80 /end MEASUREMENT
/begin MEASUREMENT fmy_stat_oc_ls_down_1.err_info_stat.lv_ready "readiness status of the diagnosis instance OC_LS_DOWN_1" UWORD _CNV_S_2_RANGE______380_CM 1 0. 0. 1. DISPLAY_IDENTIFIER LV_READY_OC_LS_DOWN_1 ECU_ADDRESS 0x7f9ba6 BYTE_ORDER MSB_LAST BIT_MASK 0x40 /end MEASUREMENT
/begin MEASUREMENT fmy_stat_oc_ls_down_1.err_info_stat.lv_end_diag "end of diagnosis of the diagnosis instance OC_LS_DOWN_1" UWORD _CNV_S_2_RANGE______380_CM 1 0. 0. 1. DISPLAY_IDENTIFIER LV_END_DIAG_OC_LS_DOWN_1 ECU_ADDRESS 0x7f9ba6 BYTE_ORDER MSB_LAST BIT_MASK 0x20 /end MEASUREMENT
/begin MEASUREMENT fmy_stat_oc_ls_down_1.err_info_stat.lv_cdn_diag "diagnosis condition of the diagnosis instance OC_LS_DOWN_1" UWORD _CNV_S_2_RANGE______380_CM 1 0. 0. 1. DISPLAY_IDENTIFIER LV_CDN_DIAG_OC_LS_DOWN_1 ECU_ADDRESS 0x7f9ba6 BYTE_ORDER MSB_LAST BIT_MASK 0x10 /end MEASUREMENT
/begin MEASUREMENT fmy_stat_oc_ls_down_1.err_info_stat.err_sym "symptoms of the diagnosis instance OC_LS_DOWN_1" UWORD _CNV_S_6_CONV_ERRM__27_CM 1 0. 0. 15. DISPLAY_IDENTIFIER ERR_SYM_OC_LS_DOWN_1 ECU_ADDRESS 0x7f9ba6 BYTE_ORDER MSB_LAST BIT_MASK 0xF /end MEASUREMENT
/begin MEASUREMENT fmy_stat_obd_lsh_down_1.ctr_abc "anti bounce counter for diagnosis instance OBD_LSH_DOWN_1" UBYTE _CNV_A_R_LINEAR_____1_CM 1 0. 0. 255. DISPLAY_IDENTIFIER CTR_ABC_OBD_LSH_DOWN_1 ECU_ADDRESS 0x7f9bad FORMAT "%3.0" /end MEASUREMENT
/begin MEASUREMENT fmy_stat_obd_lsh_down_1.ctr_end_diag "counter for end of diagnosis for diagnosis instance OBD_LSH_DOWN_1" UBYTE _CNV_A_R_LINEAR_____1_CM 1 0. 0. 255. DISPLAY_IDENTIFIER CTR_ABC_END_DIAG_OBD_LSH_DOWN_1 ECU_ADDRESS 0x7f9bac FORMAT "%3.0" /end MEASUREMENT
/begin MEASUREMENT fmy_stat_obd_lsh_down_1.err_info_stat.reserved "" UWORD _CNV_A_R_LINEAR_____0_CM 1 0. 0. 65535. DISPLAY_IDENTIFIER FMY_STAT_OBD_LSH_DOWN_1_ERR_INFO ECU_ADDRESS 0x7f9baa BYTE_ORDER MSB_LAST BIT_MASK 0xF800 /end MEASUREMENT
/begin MEASUREMENT fmy_stat_obd_lsh_down_1.err_info_stat.lv_cdn_diag_stc "Statistical flag for condition of diagnosis of the diagnosis instance OBD_LSH_DOWN_1" UWORD _CNV_S_2_RANGE______380_CM 1 0. 0. 1. DISPLAY_IDENTIFIER LV_CDN_DIAG_STC_OBD_LSH_DOWN_1 ECU_ADDRESS 0x7f9baa BYTE_ORDER MSB_LAST BIT_MASK 0x400 /end MEASUREMENT
/begin MEASUREMENT fmy_stat_obd_lsh_down_1.err_info_stat.lv_lock_diag "lock flag (CPU load optimisation) of the diagnosis instance OBD_LSH_DOWN_1" UWORD _CNV_S_2_RANGE______380_CM 1 0. 0. 1. DISPLAY_IDENTIFIER LV_LOCK_DIAG_OBD_LSH_DOWN_1 ECU_ADDRESS 0x7f9baa BYTE_ORDER MSB_LAST BIT_MASK 0x200 /end MEASUREMENT
/begin MEASUREMENT fmy_stat_obd_lsh_down_1.err_info_stat.lv_err_mem "storage in dynamic failure memory of the diagnosis instance OBD_LSH_DOWN_1" UWORD _CNV_S_2_RANGE______380_CM 1 0. 0. 1. DISPLAY_IDENTIFIER LV_ERR_MEM_OBD_LSH_DOWN_1 ECU_ADDRESS 0x7f9baa BYTE_ORDER MSB_LAST BIT_MASK 0x80 /end MEASUREMENT
/begin MEASUREMENT fmy_stat_obd_lsh_down_1.err_info_stat.lv_ready "readiness status of the diagnosis instance OBD_LSH_DOWN_1" UWORD _CNV_S_2_RANGE______380_CM 1 0. 0. 1. DISPLAY_IDENTIFIER LV_READY_OBD_LSH_DOWN_1 ECU_ADDRESS 0x7f9baa BYTE_ORDER MSB_LAST BIT_MASK 0x40 /end MEASUREMENT
/begin MEASUREMENT fmy_stat_obd_lsh_down_1.err_info_stat.lv_end_diag "end of diagnosis of the diagnosis instance OBD_LSH_DOWN_1" UWORD _CNV_S_2_RANGE______380_CM 1 0. 0. 1. DISPLAY_IDENTIFIER LV_END_DIAG_OBD_LSH_DOWN_1 ECU_ADDRESS 0x7f9baa BYTE_ORDER MSB_LAST BIT_MASK 0x20 /end MEASUREMENT
/begin MEASUREMENT fmy_stat_obd_lsh_down_1.err_info_stat.lv_cdn_diag "diagnosis condition of the diagnosis instance OBD_LSH_DOWN_1" UWORD _CNV_S_2_RANGE______380_CM 1 0. 0. 1. DISPLAY_IDENTIFIER LV_CDN_DIAG_OBD_LSH_DOWN_1 ECU_ADDRESS 0x7f9baa BYTE_ORDER MSB_LAST BIT_MASK 0x10 /end MEASUREMENT
/begin MEASUREMENT fmy_stat_obd_lsh_down_1.err_info_stat.err_sym "symptoms of the diagnosis instance OBD_LSH_DOWN_1" UWORD _CNV_S_6_CONV_ERRM__27_CM 1 0. 0. 15. DISPLAY_IDENTIFIER ERR_SYM_OBD_LSH_DOWN_1 ECU_ADDRESS 0x7f9baa BYTE_ORDER MSB_LAST BIT_MASK 0xF /end MEASUREMENT
/begin MEASUREMENT fmy_stat_lam_adj_1.ctr_abc "anti bounce counter for diagnosis instance LAM_ADJ_1" UBYTE _CNV_A_R_LINEAR_____1_CM 1 0. 0. 255. DISPLAY_IDENTIFIER CTR_ABC_LAM_ADJ_1 ECU_ADDRESS 0x7f9bb1 FORMAT "%3.0" /end MEASUREMENT
/begin MEASUREMENT fmy_stat_lam_adj_1.ctr_end_diag "counter for end of diagnosis for diagnosis instance LAM_ADJ_1" UBYTE _CNV_A_R_LINEAR_____1_CM 1 0. 0. 255. DISPLAY_IDENTIFIER CTR_ABC_END_DIAG_LAM_ADJ_1 ECU_ADDRESS 0x7f9bb0 FORMAT "%3.0" /end MEASUREMENT
/begin MEASUREMENT fmy_stat_lam_adj_1.err_info_stat.reserved "" UWORD _CNV_A_R_LINEAR_____0_CM 1 0. 0. 65535. DISPLAY_IDENTIFIER FMY_STAT_LAM_ADJ_1_ERR_INFO_STAT ECU_ADDRESS 0x7f9bae BYTE_ORDER MSB_LAST BIT_MASK 0xF800 /end MEASUREMENT
/begin MEASUREMENT fmy_stat_lam_adj_1.err_info_stat.lv_cdn_diag_stc "Statistical flag for condition of diagnosis of the diagnosis instance LAM_ADJ_1" UWORD _CNV_S_2_RANGE______380_CM 1 0. 0. 1. DISPLAY_IDENTIFIER LV_CDN_DIAG_STC_LAM_ADJ_1 ECU_ADDRESS 0x7f9bae BYTE_ORDER MSB_LAST BIT_MASK 0x400 /end MEASUREMENT
/begin MEASUREMENT fmy_stat_lam_adj_1.err_info_stat.lv_lock_diag "lock flag (CPU load optimisation) of the diagnosis instance LAM_ADJ_1" UWORD _CNV_S_2_RANGE______380_CM 1 0. 0. 1. DISPLAY_IDENTIFIER LV_LOCK_DIAG_LAM_ADJ_1 ECU_ADDRESS 0x7f9bae BYTE_ORDER MSB_LAST BIT_MASK 0x200 /end MEASUREMENT
/begin MEASUREMENT fmy_stat_lam_adj_1.err_info_stat.lv_err_mem "storage in dynamic failure memory of the diagnosis instance LAM_ADJ_1" UWORD _CNV_S_2_RANGE______380_CM 1 0. 0. 1. DISPLAY_IDENTIFIER LV_ERR_MEM_LAM_ADJ_1 ECU_ADDRESS 0x7f9bae BYTE_ORDER MSB_LAST BIT_MASK 0x80 /end MEASUREMENT
/begin MEASUREMENT fmy_stat_lam_adj_1.err_info_stat.lv_ready "readiness status of the diagnosis instance LAM_ADJ_1" UWORD _CNV_S_2_RANGE______380_CM 1 0. 0. 1. DISPLAY_IDENTIFIER LV_READY_LAM_ADJ_1 ECU_ADDRESS 0x7f9bae BYTE_ORDER MSB_LAST BIT_MASK 0x40 /end MEASUREMENT
/begin MEASUREMENT fmy_stat_lam_adj_1.err_info_stat.lv_end_diag "end of diagnosis of the diagnosis instance LAM_ADJ_1" UWORD _CNV_S_2_RANGE______380_CM 1 0. 0. 1. DISPLAY_IDENTIFIER LV_END_DIAG_LAM_ADJ_1 ECU_ADDRESS 0x7f9bae BYTE_ORDER MSB_LAST BIT_MASK 0x20 /end MEASUREMENT
/begin MEASUREMENT fmy_stat_lam_adj_1.err_info_stat.lv_cdn_diag "diagnosis condition of the diagnosis instance LAM_ADJ_1" UWORD _CNV_S_2_RANGE______380_CM 1 0. 0. 1. DISPLAY_IDENTIFIER LV_CDN_DIAG_LAM_ADJ_1 ECU_ADDRESS 0x7f9bae BYTE_ORDER MSB_LAST BIT_MASK 0x10 /end MEASUREMENT
/begin MEASUREMENT fmy_stat_lam_adj_1.err_info_stat.err_sym "symptoms of the diagnosis instance LAM_ADJ_1" UWORD _CNV_S_6_CONV_ERRM__27_CM 1 0. 0. 15. DISPLAY_IDENTIFIER ERR_SYM_LAM_ADJ_1 ECU_ADDRESS 0x7f9bae BYTE_ORDER MSB_LAST BIT_MASK 0xF /end MEASUREMENT
/begin MEASUREMENT fmy_stat_chk_ls_down_1.ctr_abc "anti bounce counter for diagnosis instance CHK_LS_DOWN_1" UBYTE _CNV_A_R_LINEAR_____1_CM 1 0. 0. 255. DISPLAY_IDENTIFIER CTR_ABC_CHK_LS_DOWN_1 ECU_ADDRESS 0x7f9bb5 FORMAT "%3.0" /end MEASUREMENT
/begin MEASUREMENT fmy_stat_chk_ls_down_1.ctr_end_diag "counter for end of diagnosis for diagnosis instance CHK_LS_DOWN_1" UBYTE _CNV_A_R_LINEAR_____1_CM 1 0. 0. 255. DISPLAY_IDENTIFIER CTR_ABC_END_DIAG_CHK_LS_DOWN_1 ECU_ADDRESS 0x7f9bb4 FORMAT "%3.0" /end MEASUREMENT
/begin MEASUREMENT fmy_stat_chk_ls_down_1.err_info_stat.reserved "" UWORD _CNV_A_R_LINEAR_____0_CM 1 0. 0. 65535. DISPLAY_IDENTIFIER FMY_STAT_CHK_LS_DOWN_1_ERR_INFO_ ECU_ADDRESS 0x7f9bb2 BYTE_ORDER MSB_LAST BIT_MASK 0xF800 /end MEASUREMENT
/begin MEASUREMENT fmy_stat_chk_ls_down_1.err_info_stat.lv_cdn_diag_stc "Statistical flag for condition of diagnosis of the diagnosis instance CHK_LS_DOWN_1" UWORD _CNV_S_2_RANGE______380_CM 1 0. 0. 1. DISPLAY_IDENTIFIER LV_CDN_DIAG_STC_CHK_LS_DOWN_1 ECU_ADDRESS 0x7f9bb2 BYTE_ORDER MSB_LAST BIT_MASK 0x400 /end MEASUREMENT
/begin MEASUREMENT fmy_stat_chk_ls_down_1.err_info_stat.lv_lock_diag "lock flag (CPU load optimisation) of the diagnosis instance CHK_LS_DOWN_1" UWORD _CNV_S_2_RANGE______380_CM 1 0. 0. 1. DISPLAY_IDENTIFIER LV_LOCK_DIAG_CHK_LS_DOWN_1 ECU_ADDRESS 0x7f9bb2 BYTE_ORDER MSB_LAST BIT_MASK 0x200 /end MEASUREMENT
/begin MEASUREMENT fmy_stat_chk_ls_down_1.err_info_stat.lv_err_mem "storage in dynamic failure memory of the diagnosis instance CHK_LS_DOWN_1" UWORD _CNV_S_2_RANGE______380_CM 1 0. 0. 1. DISPLAY_IDENTIFIER LV_ERR_MEM_CHK_LS_DOWN_1 ECU_ADDRESS 0x7f9bb2 BYTE_ORDER MSB_LAST BIT_MASK 0x80 /end MEASUREMENT
/begin MEASUREMENT fmy_stat_chk_ls_down_1.err_info_stat.lv_ready "readiness status of the diagnosis instance CHK_LS_DOWN_1" UWORD _CNV_S_2_RANGE______380_CM 1 0. 0. 1. DISPLAY_IDENTIFIER LV_READY_CHK_LS_DOWN_1 ECU_ADDRESS 0x7f9bb2 BYTE_ORDER MSB_LAST BIT_MASK 0x40 /end MEASUREMENT
/begin MEASUREMENT fmy_stat_chk_ls_down_1.err_info_stat.lv_end_diag "end of diagnosis of the diagnosis instance CHK_LS_DOWN_1" UWORD _CNV_S_2_RANGE______380_CM 1 0. 0. 1. DISPLAY_IDENTIFIER LV_END_DIAG_CHK_LS_DOWN_1 ECU_ADDRESS 0x7f9bb2 BYTE_ORDER MSB_LAST BIT_MASK 0x20 /end MEASUREMENT
/begin MEASUREMENT fmy_stat_chk_ls_down_1.err_info_stat.lv_cdn_diag "diagnosis condition of the diagnosis instance CHK_LS_DOWN_1" UWORD _CNV_S_2_RANGE______380_CM 1 0. 0. 1. DISPLAY_IDENTIFIER LV_CDN_DIAG_CHK_LS_DOWN_1 ECU_ADDRESS 0x7f9bb2 BYTE_ORDER MSB_LAST BIT_MASK 0x10 /end MEASUREMENT
/begin MEASUREMENT fmy_stat_chk_ls_down_1.err_info_stat.err_sym "symptoms of the diagnosis instance CHK_LS_DOWN_1" UWORD _CNV_S_6_CONV_ERRM__27_CM 1 0. 0. 15. DISPLAY_IDENTIFIER ERR_SYM_CHK_LS_DOWN_1 ECU_ADDRESS 0x7f9bb2 BYTE_ORDER MSB_LAST BIT_MASK 0xF /end MEASUREMENT
/begin MEASUREMENT fmy_stat_puc_ls_down_1.ctr_abc "anti bounce counter for diagnosis instance PUC_LS_DOWN_1" UBYTE _CNV_A_R_LINEAR_____1_CM 1 0. 0. 255. DISPLAY_IDENTIFIER CTR_ABC_PUC_LS_DOWN_1 ECU_ADDRESS 0x7f9bb9 FORMAT "%3.0" /end MEASUREMENT
/begin MEASUREMENT fmy_stat_puc_ls_down_1.ctr_end_diag "counter for end of diagnosis for diagnosis instance PUC_LS_DOWN_1" UBYTE _CNV_A_R_LINEAR_____1_CM 1 0. 0. 255. DISPLAY_IDENTIFIER CTR_ABC_END_DIAG_PUC_LS_DOWN_1 ECU_ADDRESS 0x7f9bb8 FORMAT "%3.0" /end MEASUREMENT
/begin MEASUREMENT fmy_stat_puc_ls_down_1.err_info_stat.reserved "" UWORD _CNV_A_R_LINEAR_____0_CM 1 0. 0. 65535. DISPLAY_IDENTIFIER FMY_STAT_PUC_LS_DOWN_1_ERR_INFO_ ECU_ADDRESS 0x7f9bb6 BYTE_ORDER MSB_LAST BIT_MASK 0xF800 /end MEASUREMENT
/begin MEASUREMENT fmy_stat_puc_ls_down_1.err_info_stat.lv_cdn_diag_stc "Statistical flag for condition of diagnosis of the diagnosis instance PUC_LS_DOWN_1" UWORD _CNV_S_2_RANGE______380_CM 1 0. 0. 1. DISPLAY_IDENTIFIER LV_CDN_DIAG_STC_PUC_LS_DOWN_1 ECU_ADDRESS 0x7f9bb6 BYTE_ORDER MSB_LAST BIT_MASK 0x400 /end MEASUREMENT
/begin MEASUREMENT fmy_stat_puc_ls_down_1.err_info_stat.lv_lock_diag "lock flag (CPU load optimisation) of the diagnosis instance PUC_LS_DOWN_1" UWORD _CNV_S_2_RANGE______380_CM 1 0. 0. 1. DISPLAY_IDENTIFIER LV_LOCK_DIAG_PUC_LS_DOWN_1 ECU_ADDRESS 0x7f9bb6 BYTE_ORDER MSB_LAST BIT_MASK 0x200 /end MEASUREMENT
/begin MEASUREMENT fmy_stat_puc_ls_down_1.err_info_stat.lv_err_mem "storage in dynamic failure memory of the diagnosis instance PUC_LS_DOWN_1" UWORD _CNV_S_2_RANGE______380_CM 1 0. 0. 1. DISPLAY_IDENTIFIER LV_ERR_MEM_PUC_LS_DOWN_1 ECU_ADDRESS 0x7f9bb6 BYTE_ORDER MSB_LAST BIT_MASK 0x80 /end MEASUREMENT
/begin MEASUREMENT fmy_stat_puc_ls_down_1.err_info_stat.lv_ready "readiness status of the diagnosis instance PUC_LS_DOWN_1" UWORD _CNV_S_2_RANGE______380_CM 1 0. 0. 1. DISPLAY_IDENTIFIER LV_READY_PUC_LS_DOWN_1 ECU_ADDRESS 0x7f9bb6 BYTE_ORDER MSB_LAST BIT_MASK 0x40 /end MEASUREMENT
/begin MEASUREMENT fmy_stat_puc_ls_down_1.err_info_stat.lv_end_diag "end of diagnosis of the diagnosis instance PUC_LS_DOWN_1" UWORD _CNV_S_2_RANGE______380_CM 1 0. 0. 1. DISPLAY_IDENTIFIER LV_END_DIAG_PUC_LS_DOWN_1 ECU_ADDRESS 0x7f9bb6 BYTE_ORDER MSB_LAST BIT_MASK 0x20 /end MEASUREMENT
/begin MEASUREMENT fmy_stat_puc_ls_down_1.err_info_stat.lv_cdn_diag "diagnosis condition of the diagnosis instance PUC_LS_DOWN_1" UWORD _CNV_S_2_RANGE______380_CM 1 0. 0. 1. DISPLAY_IDENTIFIER LV_CDN_DIAG_PUC_LS_DOWN_1 ECU_ADDRESS 0x7f9bb6 BYTE_ORDER MSB_LAST BIT_MASK 0x10 /end MEASUREMENT
/begin MEASUREMENT fmy_stat_puc_ls_down_1.err_info_stat.err_sym "symptoms of the diagnosis instance PUC_LS_DOWN_1" UWORD _CNV_S_6_CONV_ERRM__27_CM 1 0. 0. 15. DISPLAY_IDENTIFIER ERR_SYM_PUC_LS_DOWN_1 ECU_ADDRESS 0x7f9bb6 BYTE_ORDER MSB_LAST BIT_MASK 0xF /end MEASUREMENT
/begin MEASUREMENT fmy_stat_fl_ls_down_1.ctr_abc "anti bounce counter for diagnosis instance FL_LS_DOWN_1" UBYTE _CNV_A_R_LINEAR_____1_CM 1 0. 0. 255. DISPLAY_IDENTIFIER CTR_ABC_FL_LS_DOWN_1 ECU_ADDRESS 0x7f9bbd FORMAT "%3.0" /end MEASUREMENT
/begin MEASUREMENT fmy_stat_fl_ls_down_1.ctr_end_diag "counter for end of diagnosis for diagnosis instance FL_LS_DOWN_1" UBYTE _CNV_A_R_LINEAR_____1_CM 1 0. 0. 255. DISPLAY_IDENTIFIER CTR_ABC_END_DIAG_FL_LS_DOWN_1 ECU_ADDRESS 0x7f9bbc FORMAT "%3.0" /end MEASUREMENT
/begin MEASUREMENT fmy_stat_fl_ls_down_1.err_info_stat.reserved "" UWORD _CNV_A_R_LINEAR_____0_CM 1 0. 0. 65535. DISPLAY_IDENTIFIER FMY_STAT_FL_LS_DOWN_1_ERR_INFO_S ECU_ADDRESS 0x7f9bba BYTE_ORDER MSB_LAST BIT_MASK 0xF800 /end MEASUREMENT
/begin MEASUREMENT fmy_stat_fl_ls_down_1.err_info_stat.lv_cdn_diag_stc "Statistical flag for condition of diagnosis of the diagnosis instance FL_LS_DOWN_1" UWORD _CNV_S_2_RANGE______380_CM 1 0. 0. 1. DISPLAY_IDENTIFIER LV_CDN_DIAG_STC_FL_LS_DOWN_1 ECU_ADDRESS 0x7f9bba BYTE_ORDER MSB_LAST BIT_MASK 0x400 /end MEASUREMENT
/begin MEASUREMENT fmy_stat_fl_ls_down_1.err_info_stat.lv_lock_diag "lock flag (CPU load optimisation) of the diagnosis instance FL_LS_DOWN_1" UWORD _CNV_S_2_RANGE______380_CM 1 0. 0. 1. DISPLAY_IDENTIFIER LV_LOCK_DIAG_FL_LS_DOWN_1 ECU_ADDRESS 0x7f9bba BYTE_ORDER MSB_LAST BIT_MASK 0x200 /end MEASUREMENT
/begin MEASUREMENT fmy_stat_fl_ls_down_1.err_info_stat.lv_err_mem "storage in dynamic failure memory of the diagnosis instance FL_LS_DOWN_1" UWORD _CNV_S_2_RANGE______380_CM 1 0. 0. 1. DISPLAY_IDENTIFIER LV_ERR_MEM_FL_LS_DOWN_1 ECU_ADDRESS 0x7f9bba BYTE_ORDER MSB_LAST BIT_MASK 0x80 /end MEASUREMENT
/begin MEASUREMENT fmy_stat_fl_ls_down_1.err_info_stat.lv_ready "readiness status of the diagnosis instance FL_LS_DOWN_1" UWORD _CNV_S_2_RANGE______380_CM 1 0. 0. 1. DISPLAY_IDENTIFIER LV_READY_FL_LS_DOWN_1 ECU_ADDRESS 0x7f9bba BYTE_ORDER MSB_LAST BIT_MASK 0x40 /end MEASUREMENT
/begin MEASUREMENT fmy_stat_fl_ls_down_1.err_info_stat.lv_end_diag "end of diagnosis of the diagnosis instance FL_LS_DOWN_1" UWORD _CNV_S_2_RANGE______380_CM 1 0. 0. 1. DISPLAY_IDENTIFIER LV_END_DIAG_FL_LS_DOWN_1 ECU_ADDRESS 0x7f9bba BYTE_ORDER MSB_LAST BIT_MASK 0x20 /end MEASUREMENT
/begin MEASUREMENT fmy_stat_fl_ls_down_1.err_info_stat.lv_cdn_diag "diagnosis condition of the diagnosis instance FL_LS_DOWN_1" UWORD _CNV_S_2_RANGE______380_CM 1 0. 0. 1. DISPLAY_IDENTIFIER LV_CDN_DIAG_FL_LS_DOWN_1 ECU_ADDRESS 0x7f9bba BYTE_ORDER MSB_LAST BIT_MASK 0x10 /end MEASUREMENT
/begin MEASUREMENT fmy_stat_fl_ls_down_1.err_info_stat.err_sym "symptoms of the diagnosis instance FL_LS_DOWN_1" UWORD _CNV_S_6_CONV_ERRM__27_CM 1 0. 0. 15. DISPLAY_IDENTIFIER ERR_SYM_FL_LS_DOWN_1 ECU_ADDRESS 0x7f9bba BYTE_ORDER MSB_LAST BIT_MASK 0xF /end MEASUREMENT
/begin MEASUREMENT fmy_stat_el_lsl_up_1.ctr_abc "anti bounce counter for diagnosis instance EL_LSL_UP_1" UBYTE _CNV_A_R_LINEAR_____1_CM 1 0. 0. 255. DISPLAY_IDENTIFIER CTR_ABC_EL_LSL_UP_1 ECU_ADDRESS 0x7f9bc1 FORMAT "%3.0" /end MEASUREMENT
/begin MEASUREMENT fmy_stat_el_lsl_up_1.ctr_end_diag "counter for end of diagnosis for diagnosis instance EL_LSL_UP_1" UBYTE _CNV_A_R_LINEAR_____1_CM 1 0. 0. 255. DISPLAY_IDENTIFIER CTR_ABC_END_DIAG_EL_LSL_UP_1 ECU_ADDRESS 0x7f9bc0 FORMAT "%3.0" /end MEASUREMENT
/begin MEASUREMENT fmy_stat_el_lsl_up_1.err_info_stat.reserved "" UWORD _CNV_A_R_LINEAR_____0_CM 1 0. 0. 65535. DISPLAY_IDENTIFIER FMY_STAT_EL_LSL_UP_1_ERR_INFO_ST ECU_ADDRESS 0x7f9bbe BYTE_ORDER MSB_LAST BIT_MASK 0xF800 /end MEASUREMENT
/begin MEASUREMENT fmy_stat_el_lsl_up_1.err_info_stat.lv_cdn_diag_stc "Statistical flag for condition of diagnosis of the diagnosis instance EL_LSL_UP_1" UWORD _CNV_S_2_RANGE______380_CM 1 0. 0. 1. DISPLAY_IDENTIFIER LV_CDN_DIAG_STC_EL_LSL_UP_1 ECU_ADDRESS 0x7f9bbe BYTE_ORDER MSB_LAST BIT_MASK 0x400 /end MEASUREMENT
/begin MEASUREMENT fmy_stat_el_lsl_up_1.err_info_stat.lv_lock_diag "lock flag (CPU load optimisation) of the diagnosis instance EL_LSL_UP_1" UWORD _CNV_S_2_RANGE______380_CM 1 0. 0. 1. DISPLAY_IDENTIFIER LV_LOCK_DIAG_EL_LSL_UP_1 ECU_ADDRESS 0x7f9bbe BYTE_ORDER MSB_LAST BIT_MASK 0x200 /end MEASUREMENT
/begin MEASUREMENT fmy_stat_el_lsl_up_1.err_info_stat.lv_err_mem "storage in dynamic failure memory of the diagnosis instance EL_LSL_UP_1" UWORD _CNV_S_2_RANGE______380_CM 1 0. 0. 1. DISPLAY_IDENTIFIER LV_ERR_MEM_EL_LSL_UP_1 ECU_ADDRESS 0x7f9bbe BYTE_ORDER MSB_LAST BIT_MASK 0x80 /end MEASUREMENT
/begin MEASUREMENT fmy_stat_el_lsl_up_1.err_info_stat.lv_ready "readiness status of the diagnosis instance EL_LSL_UP_1" UWORD _CNV_S_2_RANGE______380_CM 1 0. 0. 1. DISPLAY_IDENTIFIER LV_READY_EL_LSL_UP_1 ECU_ADDRESS 0x7f9bbe BYTE_ORDER MSB_LAST BIT_MASK 0x40 /end MEASUREMENT
/begin MEASUREMENT fmy_stat_el_lsl_up_1.err_info_stat.lv_end_diag "end of diagnosis of the diagnosis instance EL_LSL_UP_1" UWORD _CNV_S_2_RANGE______380_CM 1 0. 0. 1. DISPLAY_IDENTIFIER LV_END_DIAG_EL_LSL_UP_1 ECU_ADDRESS 0x7f9bbe BYTE_ORDER MSB_LAST BIT_MASK 0x20 /end MEASUREMENT
/begin MEASUREMENT fmy_stat_el_lsl_up_1.err_info_stat.lv_cdn_diag "diagnosis condition of the diagnosis instance EL_LSL_UP_1" UWORD _CNV_S_2_RANGE______380_CM 1 0. 0. 1. DISPLAY_IDENTIFIER LV_CDN_DIAG_EL_LSL_UP_1 ECU_ADDRESS 0x7f9bbe BYTE_ORDER MSB_LAST BIT_MASK 0x10 /end MEASUREMENT
/begin MEASUREMENT fmy_stat_el_lsl_up_1.err_info_stat.err_sym "symptoms of the diagnosis instance EL_LSL_UP_1" UWORD _CNV_S_6_CONV_ERRM__27_CM 1 0. 0. 15. DISPLAY_IDENTIFIER ERR_SYM_EL_LSL_UP_1 ECU_ADDRESS 0x7f9bbe BYTE_ORDER MSB_LAST BIT_MASK 0xF /end MEASUREMENT
/begin MEASUREMENT fmy_stat_oc_lsl_up_1.ctr_abc "anti bounce counter for diagnosis instance OC_LSL_UP_1" UBYTE _CNV_A_R_LINEAR_____1_CM 1 0. 0. 255. DISPLAY_IDENTIFIER CTR_ABC_OC_LSL_UP_1 ECU_ADDRESS 0x7f9bc5 FORMAT "%3.0" /end MEASUREMENT
/begin MEASUREMENT fmy_stat_oc_lsl_up_1.ctr_end_diag "counter for end of diagnosis for diagnosis instance OC_LSL_UP_1" UBYTE _CNV_A_R_LINEAR_____1_CM 1 0. 0. 255. DISPLAY_IDENTIFIER CTR_ABC_END_DIAG_OC_LSL_UP_1 ECU_ADDRESS 0x7f9bc4 FORMAT "%3.0" /end MEASUREMENT
/begin MEASUREMENT fmy_stat_oc_lsl_up_1.err_info_stat.reserved "" UWORD _CNV_A_R_LINEAR_____0_CM 1 0. 0. 65535. DISPLAY_IDENTIFIER FMY_STAT_OC_LSL_UP_1_ERR_INFO_ST ECU_ADDRESS 0x7f9bc2 BYTE_ORDER MSB_LAST BIT_MASK 0xF800 /end MEASUREMENT
/begin MEASUREMENT fmy_stat_oc_lsl_up_1.err_info_stat.lv_cdn_diag_stc "Statistical flag for condition of diagnosis of the diagnosis instance OC_LSL_UP_1" UWORD _CNV_S_2_RANGE______380_CM 1 0. 0. 1. DISPLAY_IDENTIFIER LV_CDN_DIAG_STC_OC_LSL_UP_1 ECU_ADDRESS 0x7f9bc2 BYTE_ORDER MSB_LAST BIT_MASK 0x400 /end MEASUREMENT
/begin MEASUREMENT fmy_stat_oc_lsl_up_1.err_info_stat.lv_lock_diag "lock flag (CPU load optimisation) of the diagnosis instance OC_LSL_UP_1" UWORD _CNV_S_2_RANGE______380_CM 1 0. 0. 1. DISPLAY_IDENTIFIER LV_LOCK_DIAG_OC_LSL_UP_1 ECU_ADDRESS 0x7f9bc2 BYTE_ORDER MSB_LAST BIT_MASK 0x200 /end MEASUREMENT
/begin MEASUREMENT fmy_stat_oc_lsl_up_1.err_info_stat.lv_err_mem "storage in dynamic failure memory of the diagnosis instance OC_LSL_UP_1" UWORD _CNV_S_2_RANGE______380_CM 1 0. 0. 1. DISPLAY_IDENTIFIER LV_ERR_MEM_OC_LSL_UP_1 ECU_ADDRESS 0x7f9bc2 BYTE_ORDER MSB_LAST BIT_MASK 0x80 /end MEASUREMENT
/begin MEASUREMENT fmy_stat_oc_lsl_up_1.err_info_stat.lv_ready "readiness status of the diagnosis instance OC_LSL_UP_1" UWORD _CNV_S_2_RANGE______380_CM 1 0. 0. 1. DISPLAY_IDENTIFIER LV_READY_OC_LSL_UP_1 ECU_ADDRESS 0x7f9bc2 BYTE_ORDER MSB_LAST BIT_MASK 0x40 /end MEASUREMENT
/begin MEASUREMENT fmy_stat_oc_lsl_up_1.err_info_stat.lv_end_diag "end of diagnosis of the diagnosis instance OC_LSL_UP_1" UWORD _CNV_S_2_RANGE______380_CM 1 0. 0. 1. DISPLAY_IDENTIFIER LV_END_DIAG_OC_LSL_UP_1 ECU_ADDRESS 0x7f9bc2 BYTE_ORDER MSB_LAST BIT_MASK 0x20 /end MEASUREMENT
/begin MEASUREMENT fmy_stat_oc_lsl_up_1.err_info_stat.lv_cdn_diag "diagnosis condition of the diagnosis instance OC_LSL_UP_1" UWORD _CNV_S_2_RANGE______380_CM 1 0. 0. 1. DISPLAY_IDENTIFIER LV_CDN_DIAG_OC_LSL_UP_1 ECU_ADDRESS 0x7f9bc2 BYTE_ORDER MSB_LAST BIT_MASK 0x10 /end MEASUREMENT
/begin MEASUREMENT fmy_stat_oc_lsl_up_1.err_info_stat.err_sym "symptoms of the diagnosis instance OC_LSL_UP_1" UWORD _CNV_S_6_CONV_ERRM__27_CM 1 0. 0. 15. DISPLAY_IDENTIFIER ERR_SYM_OC_LSL_UP_1 ECU_ADDRESS 0x7f9bc2 BYTE_ORDER MSB_LAST BIT_MASK 0xF /end MEASUREMENT
/begin MEASUREMENT fmy_stat_lsl_up_if_1.ctr_abc "anti bounce counter for diagnosis instance LSL_UP_IF_1" UBYTE _CNV_A_R_LINEAR_____1_CM 1 0. 0. 255. DISPLAY_IDENTIFIER CTR_ABC_LSL_UP_IF_1 ECU_ADDRESS 0x7f9bc9 FORMAT "%3.0" /end MEASUREMENT
/begin MEASUREMENT fmy_stat_lsl_up_if_1.ctr_end_diag "counter for end of diagnosis for diagnosis instance LSL_UP_IF_1" UBYTE _CNV_A_R_LINEAR_____1_CM 1 0. 0. 255. DISPLAY_IDENTIFIER CTR_ABC_END_DIAG_LSL_UP_IF_1 ECU_ADDRESS 0x7f9bc8 FORMAT "%3.0" /end MEASUREMENT
/begin MEASUREMENT fmy_stat_lsl_up_if_1.err_info_stat.reserved "" UWORD _CNV_A_R_LINEAR_____0_CM 1 0. 0. 65535. DISPLAY_IDENTIFIER FMY_STAT_LSL_UP_IF_1_ERR_INFO_ST ECU_ADDRESS 0x7f9bc6 BYTE_ORDER MSB_LAST BIT_MASK 0xF800 /end MEASUREMENT
/begin MEASUREMENT fmy_stat_lsl_up_if_1.err_info_stat.lv_cdn_diag_stc "Statistical flag for condition of diagnosis of the diagnosis instance LSL_UP_IF_1" UWORD _CNV_S_2_RANGE______380_CM 1 0. 0. 1. DISPLAY_IDENTIFIER LV_CDN_DIAG_STC_LSL_UP_IF_1 ECU_ADDRESS 0x7f9bc6 BYTE_ORDER MSB_LAST BIT_MASK 0x400 /end MEASUREMENT
/begin MEASUREMENT fmy_stat_lsl_up_if_1.err_info_stat.lv_lock_diag "lock flag (CPU load optimisation) of the diagnosis instance LSL_UP_IF_1" UWORD _CNV_S_2_RANGE______380_CM 1 0. 0. 1. DISPLAY_IDENTIFIER LV_LOCK_DIAG_LSL_UP_IF_1 ECU_ADDRESS 0x7f9bc6 BYTE_ORDER MSB_LAST BIT_MASK 0x200 /end MEASUREMENT
/begin MEASUREMENT fmy_stat_lsl_up_if_1.err_info_stat.lv_err_mem "storage in dynamic failure memory of the diagnosis instance LSL_UP_IF_1" UWORD _CNV_S_2_RANGE______380_CM 1 0. 0. 1. DISPLAY_IDENTIFIER LV_ERR_MEM_LSL_UP_IF_1 ECU_ADDRESS 0x7f9bc6 BYTE_ORDER MSB_LAST BIT_MASK 0x80 /end MEASUREMENT
/begin MEASUREMENT fmy_stat_lsl_up_if_1.err_info_stat.lv_ready "readiness status of the diagnosis instance LSL_UP_IF_1" UWORD _CNV_S_2_RANGE______380_CM 1 0. 0. 1. DISPLAY_IDENTIFIER LV_READY_LSL_UP_IF_1 ECU_ADDRESS 0x7f9bc6 BYTE_ORDER MSB_LAST BIT_MASK 0x40 /end MEASUREMENT
/begin MEASUREMENT fmy_stat_lsl_up_if_1.err_info_stat.lv_end_diag "end of diagnosis of the diagnosis instance LSL_UP_IF_1" UWORD _CNV_S_2_RANGE______380_CM 1 0. 0. 1. DISPLAY_IDENTIFIER LV_END_DIAG_LSL_UP_IF_1 ECU_ADDRESS 0x7f9bc6 BYTE_ORDER MSB_LAST BIT_MASK 0x20 /end MEASUREMENT
/begin MEASUREMENT fmy_stat_lsl_up_if_1.err_info_stat.lv_cdn_diag "diagnosis condition of the diagnosis instance LSL_UP_IF_1" UWORD _CNV_S_2_RANGE______380_CM 1 0. 0. 1. DISPLAY_IDENTIFIER LV_CDN_DIAG_LSL_UP_IF_1 ECU_ADDRESS 0x7f9bc6 BYTE_ORDER MSB_LAST BIT_MASK 0x10 /end MEASUREMENT
/begin MEASUREMENT fmy_stat_lsl_up_if_1.err_info_stat.err_sym "symptoms of the diagnosis instance LSL_UP_IF_1" UWORD _CNV_S_6_CONV_ERRM__27_CM 1 0. 0. 15. DISPLAY_IDENTIFIER ERR_SYM_LSL_UP_IF_1 ECU_ADDRESS 0x7f9bc6 BYTE_ORDER MSB_LAST BIT_MASK 0xF /end MEASUREMENT
/begin MEASUREMENT fmy_stat_air_lsl_up_1.ctr_abc "anti bounce counter for diagnosis instance AIR_LSL_UP_1" UBYTE _CNV_A_R_LINEAR_____1_CM 1 0. 0. 255. DISPLAY_IDENTIFIER CTR_ABC_AIR_LSL_UP_1 ECU_ADDRESS 0x7f9bcd FORMAT "%3.0" /end MEASUREMENT
/begin MEASUREMENT fmy_stat_air_lsl_up_1.ctr_end_diag "counter for end of diagnosis for diagnosis instance AIR_LSL_UP_1" UBYTE _CNV_A_R_LINEAR_____1_CM 1 0. 0. 255. DISPLAY_IDENTIFIER CTR_ABC_END_DIAG_AIR_LSL_UP_1 ECU_ADDRESS 0x7f9bcc FORMAT "%3.0" /end MEASUREMENT
/begin MEASUREMENT fmy_stat_air_lsl_up_1.err_info_stat.reserved "" UWORD _CNV_A_R_LINEAR_____0_CM 1 0. 0. 65535. DISPLAY_IDENTIFIER FMY_STAT_AIR_LSL_UP_1_ERR_INFO_S ECU_ADDRESS 0x7f9bca BYTE_ORDER MSB_LAST BIT_MASK 0xF800 /end MEASUREMENT
/begin MEASUREMENT fmy_stat_air_lsl_up_1.err_info_stat.lv_cdn_diag_stc "Statistical flag for condition of diagnosis of the diagnosis instance AIR_LSL_UP_1" UWORD _CNV_S_2_RANGE______380_CM 1 0. 0. 1. DISPLAY_IDENTIFIER LV_CDN_DIAG_STC_AIR_LSL_UP_1 ECU_ADDRESS 0x7f9bca BYTE_ORDER MSB_LAST BIT_MASK 0x400 /end MEASUREMENT
/begin MEASUREMENT fmy_stat_air_lsl_up_1.err_info_stat.lv_lock_diag "lock flag (CPU load optimisation) of the diagnosis instance AIR_LSL_UP_1" UWORD _CNV_S_2_RANGE______380_CM 1 0. 0. 1. DISPLAY_IDENTIFIER LV_LOCK_DIAG_AIR_LSL_UP_1 ECU_ADDRESS 0x7f9bca BYTE_ORDER MSB_LAST BIT_MASK 0x200 /end MEASUREMENT
/begin MEASUREMENT fmy_stat_air_lsl_up_1.err_info_stat.lv_err_mem "storage in dynamic failure memory of the diagnosis instance AIR_LSL_UP_1" UWORD _CNV_S_2_RANGE______380_CM 1 0. 0. 1. DISPLAY_IDENTIFIER LV_ERR_MEM_AIR_LSL_UP_1 ECU_ADDRESS 0x7f9bca BYTE_ORDER MSB_LAST BIT_MASK 0x80 /end MEASUREMENT
/begin MEASUREMENT fmy_stat_air_lsl_up_1.err_info_stat.lv_ready "readiness status of the diagnosis instance AIR_LSL_UP_1" UWORD _CNV_S_2_RANGE______380_CM 1 0. 0. 1. DISPLAY_IDENTIFIER LV_READY_AIR_LSL_UP_1 ECU_ADDRESS 0x7f9bca BYTE_ORDER MSB_LAST BIT_MASK 0x40 /end MEASUREMENT
/begin MEASUREMENT fmy_stat_air_lsl_up_1.err_info_stat.lv_end_diag "end of diagnosis of the diagnosis instance AIR_LSL_UP_1" UWORD _CNV_S_2_RANGE______380_CM 1 0. 0. 1. DISPLAY_IDENTIFIER LV_END_DIAG_AIR_LSL_UP_1 ECU_ADDRESS 0x7f9bca BYTE_ORDER MSB_LAST BIT_MASK 0x20 /end MEASUREMENT
/begin MEASUREMENT fmy_stat_air_lsl_up_1.err_info_stat.lv_cdn_diag "diagnosis condition of the diagnosis instance AIR_LSL_UP_1" UWORD _CNV_S_2_RANGE______380_CM 1 0. 0. 1. DISPLAY_IDENTIFIER LV_CDN_DIAG_AIR_LSL_UP_1 ECU_ADDRESS 0x7f9bca BYTE_ORDER MSB_LAST BIT_MASK 0x10 /end MEASUREMENT
/begin MEASUREMENT fmy_stat_air_lsl_up_1.err_info_stat.err_sym "symptoms of the diagnosis instance AIR_LSL_UP_1" UWORD _CNV_S_6_CONV_ERRM__27_CM 1 0. 0. 15. DISPLAY_IDENTIFIER ERR_SYM_AIR_LSL_UP_1 ECU_ADDRESS 0x7f9bca BYTE_ORDER MSB_LAST BIT_MASK 0xF /end MEASUREMENT
/begin MEASUREMENT fmy_stat_ttip_obd_ls_up_1.ctr_abc "anti bounce counter for diagnosis instance TTIP_OBD_LS_UP_1" UBYTE _CNV_A_R_LINEAR_____1_CM 1 0. 0. 255. DISPLAY_IDENTIFIER CTR_ABC_TTIP_OBD_LS_UP_1 ECU_ADDRESS 0x7f9bd1 FORMAT "%3.0" /end MEASUREMENT
/begin MEASUREMENT fmy_stat_ttip_obd_ls_up_1.ctr_end_diag "counter for end of diagnosis for diagnosis instance TTIP_OBD_LS_UP_1" UBYTE _CNV_A_R_LINEAR_____1_CM 1 0. 0. 255. DISPLAY_IDENTIFIER CTR_ABC_END_DIAG_TTIP_OBD_LS_UP_ ECU_ADDRESS 0x7f9bd0 FORMAT "%3.0" /end MEASUREMENT
/begin MEASUREMENT fmy_stat_ttip_obd_ls_up_1.err_info_stat.reserved "" UWORD _CNV_A_R_LINEAR_____0_CM 1 0. 0. 65535. DISPLAY_IDENTIFIER FMY_STAT_TTIP_OBD_LS_UP_1_ERR_IN ECU_ADDRESS 0x7f9bce BYTE_ORDER MSB_LAST BIT_MASK 0xF800 /end MEASUREMENT
/begin MEASUREMENT fmy_stat_ttip_obd_ls_up_1.err_info_stat.lv_cdn_diag_stc "Statistical flag for condition of diagnosis of the diagnosis instance TTIP_OBD_LS_UP_1" UWORD _CNV_S_2_RANGE______380_CM 1 0. 0. 1. DISPLAY_IDENTIFIER LV_CDN_DIAG_STC_TTIP_OBD_LS_UP_1 ECU_ADDRESS 0x7f9bce BYTE_ORDER MSB_LAST BIT_MASK 0x400 /end MEASUREMENT
/begin MEASUREMENT fmy_stat_ttip_obd_ls_up_1.err_info_stat.lv_lock_diag "lock flag (CPU load optimisation) of the diagnosis instance TTIP_OBD_LS_UP_1" UWORD _CNV_S_2_RANGE______380_CM 1 0. 0. 1. DISPLAY_IDENTIFIER LV_LOCK_DIAG_TTIP_OBD_LS_UP_1 ECU_ADDRESS 0x7f9bce BYTE_ORDER MSB_LAST BIT_MASK 0x200 /end MEASUREMENT
/begin MEASUREMENT fmy_stat_ttip_obd_ls_up_1.err_info_stat.lv_err_mem "storage in dynamic failure memory of the diagnosis instance TTIP_OBD_LS_UP_1" UWORD _CNV_S_2_RANGE______380_CM 1 0. 0. 1. DISPLAY_IDENTIFIER LV_ERR_MEM_TTIP_OBD_LS_UP_1 ECU_ADDRESS 0x7f9bce BYTE_ORDER MSB_LAST BIT_MASK 0x80 /end MEASUREMENT
/begin MEASUREMENT fmy_stat_ttip_obd_ls_up_1.err_info_stat.lv_ready "readiness status of the diagnosis instance TTIP_OBD_LS_UP_1" UWORD _CNV_S_2_RANGE______380_CM 1 0. 0. 1. DISPLAY_IDENTIFIER LV_READY_TTIP_OBD_LS_UP_1 ECU_ADDRESS 0x7f9bce BYTE_ORDER MSB_LAST BIT_MASK 0x40 /end MEASUREMENT
/begin MEASUREMENT fmy_stat_ttip_obd_ls_up_1.err_info_stat.lv_end_diag "end of diagnosis of the diagnosis instance TTIP_OBD_LS_UP_1" UWORD _CNV_S_2_RANGE______380_CM 1 0. 0. 1. DISPLAY_IDENTIFIER LV_END_DIAG_TTIP_OBD_LS_UP_1 ECU_ADDRESS 0x7f9bce BYTE_ORDER MSB_LAST BIT_MASK 0x20 /end MEASUREMENT
/begin MEASUREMENT fmy_stat_ttip_obd_ls_up_1.err_info_stat.lv_cdn_diag "diagnosis condition of the diagnosis instance TTIP_OBD_LS_UP_1" UWORD _CNV_S_2_RANGE______380_CM 1 0. 0. 1. DISPLAY_IDENTIFIER LV_CDN_DIAG_TTIP_OBD_LS_UP_1 ECU_ADDRESS 0x7f9bce BYTE_ORDER MSB_LAST BIT_MASK 0x10 /end MEASUREMENT
/begin MEASUREMENT fmy_stat_ttip_obd_ls_up_1.err_info_stat.err_sym "symptoms of the diagnosis instance TTIP_OBD_LS_UP_1" UWORD _CNV_S_6_CONV_ERRM__27_CM 1 0. 0. 15. DISPLAY_IDENTIFIER ERR_SYM_TTIP_OBD_LS_UP_1 ECU_ADDRESS 0x7f9bce BYTE_ORDER MSB_LAST BIT_MASK 0xF /end MEASUREMENT
/begin MEASUREMENT fmy_stat_dyn_vld_ls_up_1.ctr_abc "anti bounce counter for diagnosis instance DYN_VLD_LS_UP_1" UBYTE _CNV_A_R_LINEAR_____1_CM 1 0. 0. 255. DISPLAY_IDENTIFIER CTR_ABC_DYN_VLD_LS_UP_1 ECU_ADDRESS 0x7f9bd5 FORMAT "%3.0" /end MEASUREMENT
/begin MEASUREMENT fmy_stat_dyn_vld_ls_up_1.ctr_end_diag "counter for end of diagnosis for diagnosis instance DYN_VLD_LS_UP_1" UBYTE _CNV_A_R_LINEAR_____1_CM 1 0. 0. 255. DISPLAY_IDENTIFIER CTR_ABC_END_DIAG_DYN_VLD_LS_UP_1 ECU_ADDRESS 0x7f9bd4 FORMAT "%3.0" /end MEASUREMENT
/begin MEASUREMENT fmy_stat_dyn_vld_ls_up_1.err_info_stat.reserved "" UWORD _CNV_A_R_LINEAR_____0_CM 1 0. 0. 65535. DISPLAY_IDENTIFIER FMY_STAT_DYN_VLD_LS_UP_1_ERR_INF ECU_ADDRESS 0x7f9bd2 BYTE_ORDER MSB_LAST BIT_MASK 0xF800 /end MEASUREMENT
/begin MEASUREMENT fmy_stat_dyn_vld_ls_up_1.err_info_stat.lv_cdn_diag_stc "Statistical flag for condition of diagnosis of the diagnosis instance DYN_VLD_LS_UP_1" UWORD _CNV_S_2_RANGE______380_CM 1 0. 0. 1. DISPLAY_IDENTIFIER LV_CDN_DIAG_STC_DYN_VLD_LS_UP_1 ECU_ADDRESS 0x7f9bd2 BYTE_ORDER MSB_LAST BIT_MASK 0x400 /end MEASUREMENT
/begin MEASUREMENT fmy_stat_dyn_vld_ls_up_1.err_info_stat.lv_lock_diag "lock flag (CPU load optimisation) of the diagnosis instance DYN_VLD_LS_UP_1" UWORD _CNV_S_2_RANGE______380_CM 1 0. 0. 1. DISPLAY_IDENTIFIER LV_LOCK_DIAG_DYN_VLD_LS_UP_1 ECU_ADDRESS 0x7f9bd2 BYTE_ORDER MSB_LAST BIT_MASK 0x200 /end MEASUREMENT
/begin MEASUREMENT fmy_stat_dyn_vld_ls_up_1.err_info_stat.lv_err_mem "storage in dynamic failure memory of the diagnosis instance DYN_VLD_LS_UP_1" UWORD _CNV_S_2_RANGE______380_CM 1 0. 0. 1. DISPLAY_IDENTIFIER LV_ERR_MEM_DYN_VLD_LS_UP_1 ECU_ADDRESS 0x7f9bd2 BYTE_ORDER MSB_LAST BIT_MASK 0x80 /end MEASUREMENT
/begin MEASUREMENT fmy_stat_dyn_vld_ls_up_1.err_info_stat.lv_ready "readiness status of the diagnosis instance DYN_VLD_LS_UP_1" UWORD _CNV_S_2_RANGE______380_CM 1 0. 0. 1. DISPLAY_IDENTIFIER LV_READY_DYN_VLD_LS_UP_1 ECU_ADDRESS 0x7f9bd2 BYTE_ORDER MSB_LAST BIT_MASK 0x40 /end MEASUREMENT
/begin MEASUREMENT fmy_stat_dyn_vld_ls_up_1.err_info_stat.lv_end_diag "end of diagnosis of the diagnosis instance DYN_VLD_LS_UP_1" UWORD _CNV_S_2_RANGE______380_CM 1 0. 0. 1. DISPLAY_IDENTIFIER LV_END_DIAG_DYN_VLD_LS_UP_1 ECU_ADDRESS 0x7f9bd2 BYTE_ORDER MSB_LAST BIT_MASK 0x20 /end MEASUREMENT
/begin MEASUREMENT fmy_stat_dyn_vld_ls_up_1.err_info_stat.lv_cdn_diag "diagnosis condition of the diagnosis instance DYN_VLD_LS_UP_1" UWORD _CNV_S_2_RANGE______380_CM 1 0. 0. 1. DISPLAY_IDENTIFIER LV_CDN_DIAG_DYN_VLD_LS_UP_1 ECU_ADDRESS 0x7f9bd2 BYTE_ORDER MSB_LAST BIT_MASK 0x10 /end MEASUREMENT
/begin MEASUREMENT fmy_stat_dyn_vld_ls_up_1.err_info_stat.err_sym "symptoms of the diagnosis instance DYN_VLD_LS_UP_1" UWORD _CNV_S_6_CONV_ERRM__27_CM 1 0. 0. 15. DISPLAY_IDENTIFIER ERR_SYM_DYN_VLD_LS_UP_1 ECU_ADDRESS 0x7f9bd2 BYTE_ORDER MSB_LAST BIT_MASK 0xF /end MEASUREMENT
/begin MEASUREMENT fmy_stat_puc_vld_ls_up_1.ctr_abc "anti bounce counter for diagnosis instance PUC_VLD_LS_UP_1" UBYTE _CNV_A_R_LINEAR_____1_CM 1 0. 0. 255. DISPLAY_IDENTIFIER CTR_ABC_PUC_VLD_LS_UP_1 ECU_ADDRESS 0x7f9bd9 FORMAT "%3.0" /end MEASUREMENT
/begin MEASUREMENT fmy_stat_puc_vld_ls_up_1.ctr_end_diag "counter for end of diagnosis for diagnosis instance PUC_VLD_LS_UP_1" UBYTE _CNV_A_R_LINEAR_____1_CM 1 0. 0. 255. DISPLAY_IDENTIFIER CTR_ABC_END_DIAG_PUC_VLD_LS_UP_1 ECU_ADDRESS 0x7f9bd8 FORMAT "%3.0" /end MEASUREMENT
/begin MEASUREMENT fmy_stat_puc_vld_ls_up_1.err_info_stat.reserved "" UWORD _CNV_A_R_LINEAR_____0_CM 1 0. 0. 65535. DISPLAY_IDENTIFIER FMY_STAT_PUC_VLD_LS_UP_1_ERR_INF ECU_ADDRESS 0x7f9bd6 BYTE_ORDER MSB_LAST BIT_MASK 0xF800 /end MEASUREMENT
/begin MEASUREMENT fmy_stat_puc_vld_ls_up_1.err_info_stat.lv_cdn_diag_stc "Statistical flag for condition of diagnosis of the diagnosis instance PUC_VLD_LS_UP_1" UWORD _CNV_S_2_RANGE______380_CM 1 0. 0. 1. DISPLAY_IDENTIFIER LV_CDN_DIAG_STC_PUC_VLD_LS_UP_1 ECU_ADDRESS 0x7f9bd6 BYTE_ORDER MSB_LAST BIT_MASK 0x400 /end MEASUREMENT
/begin MEASUREMENT fmy_stat_puc_vld_ls_up_1.err_info_stat.lv_lock_diag "lock flag (CPU load optimisation) of the diagnosis instance PUC_VLD_LS_UP_1" UWORD _CNV_S_2_RANGE______380_CM 1 0. 0. 1. DISPLAY_IDENTIFIER LV_LOCK_DIAG_PUC_VLD_LS_UP_1 ECU_ADDRESS 0x7f9bd6 BYTE_ORDER MSB_LAST BIT_MASK 0x200 /end MEASUREMENT
/begin MEASUREMENT fmy_stat_puc_vld_ls_up_1.err_info_stat.lv_err_mem "storage in dynamic failure memory of the diagnosis instance PUC_VLD_LS_UP_1" UWORD _CNV_S_2_RANGE______380_CM 1 0. 0. 1. DISPLAY_IDENTIFIER LV_ERR_MEM_PUC_VLD_LS_UP_1 ECU_ADDRESS 0x7f9bd6 BYTE_ORDER MSB_LAST BIT_MASK 0x80 /end MEASUREMENT
/begin MEASUREMENT fmy_stat_puc_vld_ls_up_1.err_info_stat.lv_ready "readiness status of the diagnosis instance PUC_VLD_LS_UP_1" UWORD _CNV_S_2_RANGE______380_CM 1 0. 0. 1. DISPLAY_IDENTIFIER LV_READY_PUC_VLD_LS_UP_1 ECU_ADDRESS 0x7f9bd6 BYTE_ORDER MSB_LAST BIT_MASK 0x40 /end MEASUREMENT
/begin MEASUREMENT fmy_stat_puc_vld_ls_up_1.err_info_stat.lv_end_diag "end of diagnosis of the diagnosis instance PUC_VLD_LS_UP_1" UWORD _CNV_S_2_RANGE______380_CM 1 0. 0. 1. DISPLAY_IDENTIFIER LV_END_DIAG_PUC_VLD_LS_UP_1 ECU_ADDRESS 0x7f9bd6 BYTE_ORDER MSB_LAST BIT_MASK 0x20 /end MEASUREMENT
/begin MEASUREMENT fmy_stat_puc_vld_ls_up_1.err_info_stat.lv_cdn_diag "diagnosis condition of the diagnosis instance PUC_VLD_LS_UP_1" UWORD _CNV_S_2_RANGE______380_CM 1 0. 0. 1. DISPLAY_IDENTIFIER LV_CDN_DIAG_PUC_VLD_LS_UP_1 ECU_ADDRESS 0x7f9bd6 BYTE_ORDER MSB_LAST BIT_MASK 0x10 /end MEASUREMENT
/begin MEASUREMENT fmy_stat_puc_vld_ls_up_1.err_info_stat.err_sym "symptoms of the diagnosis instance PUC_VLD_LS_UP_1" UWORD _CNV_S_6_CONV_ERRM__27_CM 1 0. 0. 15. DISPLAY_IDENTIFIER ERR_SYM_PUC_VLD_LS_UP_1 ECU_ADDRESS 0x7f9bd6 BYTE_ORDER MSB_LAST BIT_MASK 0xF /end MEASUREMENT
/begin MEASUREMENT fmy_stat_obd_vld_lsh_up_1.ctr_abc "anti bounce counter for diagnosis instance OBD_VLD_LSH_UP_1" UBYTE _CNV_A_R_LINEAR_____1_CM 1 0. 0. 255. DISPLAY_IDENTIFIER CTR_ABC_OBD_VLD_LSH_UP_1 ECU_ADDRESS 0x7f9bdd FORMAT "%3.0" /end MEASUREMENT
/begin MEASUREMENT fmy_stat_obd_vld_lsh_up_1.ctr_end_diag "counter for end of diagnosis for diagnosis instance OBD_VLD_LSH_UP_1" UBYTE _CNV_A_R_LINEAR_____1_CM 1 0. 0. 255. DISPLAY_IDENTIFIER CTR_ABC_END_DIAG_OBD_VLD_LSH_UP_ ECU_ADDRESS 0x7f9bdc FORMAT "%3.0" /end MEASUREMENT
/begin MEASUREMENT fmy_stat_obd_vld_lsh_up_1.err_info_stat.reserved "" UWORD _CNV_A_R_LINEAR_____0_CM 1 0. 0. 65535. DISPLAY_IDENTIFIER FMY_STAT_OBD_VLD_LSH_UP_1_ERR_IN ECU_ADDRESS 0x7f9bda BYTE_ORDER MSB_LAST BIT_MASK 0xF800 /end MEASUREMENT
/begin MEASUREMENT fmy_stat_obd_vld_lsh_up_1.err_info_stat.lv_cdn_diag_stc "Statistical flag for condition of diagnosis of the diagnosis instance OBD_VLD_LSH_UP_1" UWORD _CNV_S_2_RANGE______380_CM 1 0. 0. 1. DISPLAY_IDENTIFIER LV_CDN_DIAG_STC_OBD_VLD_LSH_UP_1 ECU_ADDRESS 0x7f9bda BYTE_ORDER MSB_LAST BIT_MASK 0x400 /end MEASUREMENT
/begin MEASUREMENT fmy_stat_obd_vld_lsh_up_1.err_info_stat.lv_lock_diag "lock flag (CPU load optimisation) of the diagnosis instance OBD_VLD_LSH_UP_1" UWORD _CNV_S_2_RANGE______380_CM 1 0. 0. 1. DISPLAY_IDENTIFIER LV_LOCK_DIAG_OBD_VLD_LSH_UP_1 ECU_ADDRESS 0x7f9bda BYTE_ORDER MSB_LAST BIT_MASK 0x200 /end MEASUREMENT
/begin MEASUREMENT fmy_stat_obd_vld_lsh_up_1.err_info_stat.lv_err_mem "storage in dynamic failure memory of the diagnosis instance OBD_VLD_LSH_UP_1" UWORD _CNV_S_2_RANGE______380_CM 1 0. 0. 1. DISPLAY_IDENTIFIER LV_ERR_MEM_OBD_VLD_LSH_UP_1 ECU_ADDRESS 0x7f9bda BYTE_ORDER MSB_LAST BIT_MASK 0x80 /end MEASUREMENT
/begin MEASUREMENT fmy_stat_obd_vld_lsh_up_1.err_info_stat.lv_ready "readiness status of the diagnosis instance OBD_VLD_LSH_UP_1" UWORD _CNV_S_2_RANGE______380_CM 1 0. 0. 1. DISPLAY_IDENTIFIER LV_READY_OBD_VLD_LSH_UP_1 ECU_ADDRESS 0x7f9bda BYTE_ORDER MSB_LAST BIT_MASK 0x40 /end MEASUREMENT
/begin MEASUREMENT fmy_stat_obd_vld_lsh_up_1.err_info_stat.lv_end_diag "end of diagnosis of the diagnosis instance OBD_VLD_LSH_UP_1" UWORD _CNV_S_2_RANGE______380_CM 1 0. 0. 1. DISPLAY_IDENTIFIER LV_END_DIAG_OBD_VLD_LSH_UP_1 ECU_ADDRESS 0x7f9bda BYTE_ORDER MSB_LAST BIT_MASK 0x20 /end MEASUREMENT
/begin MEASUREMENT fmy_stat_obd_vld_lsh_up_1.err_info_stat.lv_cdn_diag "diagnosis condition of the diagnosis instance OBD_VLD_LSH_UP_1" UWORD _CNV_S_2_RANGE______380_CM 1 0. 0. 1. DISPLAY_IDENTIFIER LV_CDN_DIAG_OBD_VLD_LSH_UP_1 ECU_ADDRESS 0x7f9bda BYTE_ORDER MSB_LAST BIT_MASK 0x10 /end MEASUREMENT
/begin MEASUREMENT fmy_stat_obd_vld_lsh_up_1.err_info_stat.err_sym "symptoms of the diagnosis instance OBD_VLD_LSH_UP_1" UWORD _CNV_S_6_CONV_ERRM__27_CM 1 0. 0. 15. DISPLAY_IDENTIFIER ERR_SYM_OBD_VLD_LSH_UP_1 ECU_ADDRESS 0x7f9bda BYTE_ORDER MSB_LAST BIT_MASK 0xF /end MEASUREMENT
/begin MEASUREMENT fmy_stat_shift_afl_lsl_up_1.ctr_abc "anti bounce counter for diagnosis instance SHIFT_AFL_LSL_UP_1" UBYTE _CNV_A_R_LINEAR_____1_CM 1 0. 0. 255. DISPLAY_IDENTIFIER CTR_ABC_SHIFT_AFL_LSL_UP_1 ECU_ADDRESS 0x7f9be1 FORMAT "%3.0" /end MEASUREMENT
/begin MEASUREMENT fmy_stat_shift_afl_lsl_up_1.ctr_end_diag "counter for end of diagnosis for diagnosis instance SHIFT_AFL_LSL_UP_1" UBYTE _CNV_A_R_LINEAR_____1_CM 1 0. 0. 255. DISPLAY_IDENTIFIER CTR_ABC_END_DIAG_SHIFT_AFL_LSL_U ECU_ADDRESS 0x7f9be0 FORMAT "%3.0" /end MEASUREMENT
/begin MEASUREMENT fmy_stat_shift_afl_lsl_up_1.err_info_stat.reserved "" UWORD _CNV_A_R_LINEAR_____0_CM 1 0. 0. 65535. DISPLAY_IDENTIFIER FMY_STAT_SHIFT_AFL_LSL_UP_1_ERR_ ECU_ADDRESS 0x7f9bde BYTE_ORDER MSB_LAST BIT_MASK 0xF800 /end MEASUREMENT
/begin MEASUREMENT fmy_stat_shift_afl_lsl_up_1.err_info_stat.lv_cdn_diag_stc "Statistical flag for condition of diagnosis of the diagnosis instance SHIFT_AFL_LSL_UP_1" UWORD _CNV_S_2_RANGE______380_CM 1 0. 0. 1. DISPLAY_IDENTIFIER LV_CDN_DIAG_STC_SHIFT_AFL_LSL_UP ECU_ADDRESS 0x7f9bde BYTE_ORDER MSB_LAST BIT_MASK 0x400 /end MEASUREMENT
/begin MEASUREMENT fmy_stat_shift_afl_lsl_up_1.err_info_stat.lv_lock_diag "lock flag (CPU load optimisation) of the diagnosis instance SHIFT_AFL_LSL_UP_1" UWORD _CNV_S_2_RANGE______380_CM 1 0. 0. 1. DISPLAY_IDENTIFIER LV_LOCK_DIAG_SHIFT_AFL_LSL_UP_1 ECU_ADDRESS 0x7f9bde BYTE_ORDER MSB_LAST BIT_MASK 0x200 /end MEASUREMENT
/begin MEASUREMENT fmy_stat_shift_afl_lsl_up_1.err_info_stat.lv_err_mem "storage in dynamic failure memory of the diagnosis instance SHIFT_AFL_LSL_UP_1" UWORD _CNV_S_2_RANGE______380_CM 1 0. 0. 1. DISPLAY_IDENTIFIER LV_ERR_MEM_SHIFT_AFL_LSL_UP_1 ECU_ADDRESS 0x7f9bde BYTE_ORDER MSB_LAST BIT_MASK 0x80 /end MEASUREMENT
/begin MEASUREMENT fmy_stat_shift_afl_lsl_up_1.err_info_stat.lv_ready "readiness status of the diagnosis instance SHIFT_AFL_LSL_UP_1" UWORD _CNV_S_2_RANGE______380_CM 1 0. 0. 1. DISPLAY_IDENTIFIER LV_READY_SHIFT_AFL_LSL_UP_1 ECU_ADDRESS 0x7f9bde BYTE_ORDER MSB_LAST BIT_MASK 0x40 /end MEASUREMENT
/begin MEASUREMENT fmy_stat_shift_afl_lsl_up_1.err_info_stat.lv_end_diag "end of diagnosis of the diagnosis instance SHIFT_AFL_LSL_UP_1" UWORD _CNV_S_2_RANGE______380_CM 1 0. 0. 1. DISPLAY_IDENTIFIER LV_END_DIAG_SHIFT_AFL_LSL_UP_1 ECU_ADDRESS 0x7f9bde BYTE_ORDER MSB_LAST BIT_MASK 0x20 /end MEASUREMENT
/begin MEASUREMENT fmy_stat_shift_afl_lsl_up_1.err_info_stat.lv_cdn_diag "diagnosis condition of the diagnosis instance SHIFT_AFL_LSL_UP_1" UWORD _CNV_S_2_RANGE______380_CM 1 0. 0. 1. DISPLAY_IDENTIFIER LV_CDN_DIAG_SHIFT_AFL_LSL_UP_1 ECU_ADDRESS 0x7f9bde BYTE_ORDER MSB_LAST BIT_MASK 0x10 /end MEASUREMENT
/begin MEASUREMENT fmy_stat_shift_afl_lsl_up_1.err_info_stat.err_sym "symptoms of the diagnosis instance SHIFT_AFL_LSL_UP_1" UWORD _CNV_S_6_CONV_ERRM__27_CM 1 0. 0. 15. DISPLAY_IDENTIFIER ERR_SYM_SHIFT_AFL_LSL_UP_1 ECU_ADDRESS 0x7f9bde BYTE_ORDER MSB_LAST BIT_MASK 0xF /end MEASUREMENT
/begin MEASUREMENT fmy_stat_shift_afr_lsl_up_1.ctr_abc "anti bounce counter for diagnosis instance SHIFT_AFR_LSL_UP_1" UBYTE _CNV_A_R_LINEAR_____1_CM 1 0. 0. 255. DISPLAY_IDENTIFIER CTR_ABC_SHIFT_AFR_LSL_UP_1 ECU_ADDRESS 0x7f9be5 FORMAT "%3.0" /end MEASUREMENT
/begin MEASUREMENT fmy_stat_shift_afr_lsl_up_1.ctr_end_diag "counter for end of diagnosis for diagnosis instance SHIFT_AFR_LSL_UP_1" UBYTE _CNV_A_R_LINEAR_____1_CM 1 0. 0. 255. DISPLAY_IDENTIFIER CTR_ABC_END_DIAG_SHIFT_AFR_LSL_U ECU_ADDRESS 0x7f9be4 FORMAT "%3.0" /end MEASUREMENT
/begin MEASUREMENT fmy_stat_shift_afr_lsl_up_1.err_info_stat.reserved "" UWORD _CNV_A_R_LINEAR_____0_CM 1 0. 0. 65535. DISPLAY_IDENTIFIER FMY_STAT_SHIFT_AFR_LSL_UP_1_ERR_ ECU_ADDRESS 0x7f9be2 BYTE_ORDER MSB_LAST BIT_MASK 0xF800 /end MEASUREMENT
/begin MEASUREMENT fmy_stat_shift_afr_lsl_up_1.err_info_stat.lv_cdn_diag_stc "Statistical flag for condition of diagnosis of the diagnosis instance SHIFT_AFR_LSL_UP_1" UWORD _CNV_S_2_RANGE______380_CM 1 0. 0. 1. DISPLAY_IDENTIFIER LV_CDN_DIAG_STC_SHIFT_AFR_LSL_UP ECU_ADDRESS 0x7f9be2 BYTE_ORDER MSB_LAST BIT_MASK 0x400 /end MEASUREMENT
/begin MEASUREMENT fmy_stat_shift_afr_lsl_up_1.err_info_stat.lv_lock_diag "lock flag (CPU load optimisation) of the diagnosis instance SHIFT_AFR_LSL_UP_1" UWORD _CNV_S_2_RANGE______380_CM 1 0. 0. 1. DISPLAY_IDENTIFIER LV_LOCK_DIAG_SHIFT_AFR_LSL_UP_1 ECU_ADDRESS 0x7f9be2 BYTE_ORDER MSB_LAST BIT_MASK 0x200 /end MEASUREMENT
/begin MEASUREMENT fmy_stat_shift_afr_lsl_up_1.err_info_stat.lv_err_mem "storage in dynamic failure memory of the diagnosis instance SHIFT_AFR_LSL_UP_1" UWORD _CNV_S_2_RANGE______380_CM 1 0. 0. 1. DISPLAY_IDENTIFIER LV_ERR_MEM_SHIFT_AFR_LSL_UP_1 ECU_ADDRESS 0x7f9be2 BYTE_ORDER MSB_LAST BIT_MASK 0x80 /end MEASUREMENT
/begin MEASUREMENT fmy_stat_shift_afr_lsl_up_1.err_info_stat.lv_ready "readiness status of the diagnosis instance SHIFT_AFR_LSL_UP_1" UWORD _CNV_S_2_RANGE______380_CM 1 0. 0. 1. DISPLAY_IDENTIFIER LV_READY_SHIFT_AFR_LSL_UP_1 ECU_ADDRESS 0x7f9be2 BYTE_ORDER MSB_LAST BIT_MASK 0x40 /end MEASUREMENT
/begin MEASUREMENT fmy_stat_shift_afr_lsl_up_1.err_info_stat.lv_end_diag "end of diagnosis of the diagnosis instance SHIFT_AFR_LSL_UP_1" UWORD _CNV_S_2_RANGE______380_CM 1 0. 0. 1. DISPLAY_IDENTIFIER LV_END_DIAG_SHIFT_AFR_LSL_UP_1 ECU_ADDRESS 0x7f9be2 BYTE_ORDER MSB_LAST BIT_MASK 0x20 /end MEASUREMENT
/begin MEASUREMENT fmy_stat_shift_afr_lsl_up_1.err_info_stat.lv_cdn_diag "diagnosis condition of the diagnosis instance SHIFT_AFR_LSL_UP_1" UWORD _CNV_S_2_RANGE______380_CM 1 0. 0. 1. DISPLAY_IDENTIFIER LV_CDN_DIAG_SHIFT_AFR_LSL_UP_1 ECU_ADDRESS 0x7f9be2 BYTE_ORDER MSB_LAST BIT_MASK 0x10 /end MEASUREMENT
/begin MEASUREMENT fmy_stat_shift_afr_lsl_up_1.err_info_stat.err_sym "symptoms of the diagnosis instance SHIFT_AFR_LSL_UP_1" UWORD _CNV_S_6_CONV_ERRM__27_CM 1 0. 0. 15. DISPLAY_IDENTIFIER ERR_SYM_SHIFT_AFR_LSL_UP_1 ECU_ADDRESS 0x7f9be2 BYTE_ORDER MSB_LAST BIT_MASK 0xF /end MEASUREMENT
/begin MEASUREMENT fmy_stat_lsh_lsl_up_1.ctr_abc "anti bounce counter for diagnosis instance LSH_LSL_UP_1" UBYTE _CNV_A_R_LINEAR_____1_CM 1 0. 0. 255. DISPLAY_IDENTIFIER CTR_ABC_LSH_LSL_UP_1 ECU_ADDRESS 0x7f9be9 FORMAT "%3.0" /end MEASUREMENT
/begin MEASUREMENT fmy_stat_lsh_lsl_up_1.ctr_end_diag "counter for end of diagnosis for diagnosis instance LSH_LSL_UP_1" UBYTE _CNV_A_R_LINEAR_____1_CM 1 0. 0. 255. DISPLAY_IDENTIFIER CTR_ABC_END_DIAG_LSH_LSL_UP_1 ECU_ADDRESS 0x7f9be8 FORMAT "%3.0" /end MEASUREMENT
/begin MEASUREMENT fmy_stat_lsh_lsl_up_1.err_info_stat.reserved "" UWORD _CNV_A_R_LINEAR_____0_CM 1 0. 0. 65535. DISPLAY_IDENTIFIER FMY_STAT_LSH_LSL_UP_1_ERR_INFO_S ECU_ADDRESS 0x7f9be6 BYTE_ORDER MSB_LAST BIT_MASK 0xF800 /end MEASUREMENT
/begin MEASUREMENT fmy_stat_lsh_lsl_up_1.err_info_stat.lv_cdn_diag_stc "Statistical flag for condition of diagnosis of the diagnosis instance LSH_LSL_UP_1" UWORD _CNV_S_2_RANGE______380_CM 1 0. 0. 1. DISPLAY_IDENTIFIER LV_CDN_DIAG_STC_LSH_LSL_UP_1 ECU_ADDRESS 0x7f9be6 BYTE_ORDER MSB_LAST BIT_MASK 0x400 /end MEASUREMENT
/begin MEASUREMENT fmy_stat_lsh_lsl_up_1.err_info_stat.lv_lock_diag "lock flag (CPU load optimisation) of the diagnosis instance LSH_LSL_UP_1" UWORD _CNV_S_2_RANGE______380_CM 1 0. 0. 1. DISPLAY_IDENTIFIER LV_LOCK_DIAG_LSH_LSL_UP_1 ECU_ADDRESS 0x7f9be6 BYTE_ORDER MSB_LAST BIT_MASK 0x200 /end MEASUREMENT
/begin MEASUREMENT fmy_stat_lsh_lsl_up_1.err_info_stat.lv_err_mem "storage in dynamic failure memory of the diagnosis instance LSH_LSL_UP_1" UWORD _CNV_S_2_RANGE______380_CM 1 0. 0. 1. DISPLAY_IDENTIFIER LV_ERR_MEM_LSH_LSL_UP_1 ECU_ADDRESS 0x7f9be6 BYTE_ORDER MSB_LAST BIT_MASK 0x80 /end MEASUREMENT
/begin MEASUREMENT fmy_stat_lsh_lsl_up_1.err_info_stat.lv_ready "readiness status of the diagnosis instance LSH_LSL_UP_1" UWORD _CNV_S_2_RANGE______380_CM 1 0. 0. 1. DISPLAY_IDENTIFIER LV_READY_LSH_LSL_UP_1 ECU_ADDRESS 0x7f9be6 BYTE_ORDER MSB_LAST BIT_MASK 0x40 /end MEASUREMENT
/begin MEASUREMENT fmy_stat_lsh_lsl_up_1.err_info_stat.lv_end_diag "end of diagnosis of the diagnosis instance LSH_LSL_UP_1" UWORD _CNV_S_2_RANGE______380_CM 1 0. 0. 1. DISPLAY_IDENTIFIER LV_END_DIAG_LSH_LSL_UP_1 ECU_ADDRESS 0x7f9be6 BYTE_ORDER MSB_LAST BIT_MASK 0x20 /end MEASUREMENT
/begin MEASUREMENT fmy_stat_lsh_lsl_up_1.err_info_stat.lv_cdn_diag "diagnosis condition of the diagnosis instance LSH_LSL_UP_1" UWORD _CNV_S_2_RANGE______380_CM 1 0. 0. 1. DISPLAY_IDENTIFIER LV_CDN_DIAG_LSH_LSL_UP_1 ECU_ADDRESS 0x7f9be6 BYTE_ORDER MSB_LAST BIT_MASK 0x10 /end MEASUREMENT
/begin MEASUREMENT fmy_stat_lsh_lsl_up_1.err_info_stat.err_sym "symptoms of the diagnosis instance LSH_LSL_UP_1" UWORD _CNV_S_6_CONV_ERRM__27_CM 1 0. 0. 15. DISPLAY_IDENTIFIER ERR_SYM_LSH_LSL_UP_1 ECU_ADDRESS 0x7f9be6 BYTE_ORDER MSB_LAST BIT_MASK 0xF /end MEASUREMENT
/begin MEASUREMENT fmy_stat_swt_ls_down_1.ctr_abc "anti bounce counter for diagnosis instance SWT_LS_DOWN_1" UBYTE _CNV_A_R_LINEAR_____1_CM 1 0. 0. 255. DISPLAY_IDENTIFIER CTR_ABC_SWT_LS_DOWN_1 ECU_ADDRESS 0x7f9bed FORMAT "%3.0" /end MEASUREMENT
/begin MEASUREMENT fmy_stat_swt_ls_down_1.ctr_end_diag "counter for end of diagnosis for diagnosis instance SWT_LS_DOWN_1" UBYTE _CNV_A_R_LINEAR_____1_CM 1 0. 0. 255. DISPLAY_IDENTIFIER CTR_ABC_END_DIAG_SWT_LS_DOWN_1 ECU_ADDRESS 0x7f9bec FORMAT "%3.0" /end MEASUREMENT
/begin MEASUREMENT fmy_stat_swt_ls_down_1.err_info_stat.reserved "" UWORD _CNV_A_R_LINEAR_____0_CM 1 0. 0. 65535. DISPLAY_IDENTIFIER FMY_STAT_SWT_LS_DOWN_1_ERR_INFO_ ECU_ADDRESS 0x7f9bea BYTE_ORDER MSB_LAST BIT_MASK 0xF800 /end MEASUREMENT
/begin MEASUREMENT fmy_stat_swt_ls_down_1.err_info_stat.lv_cdn_diag_stc "Statistical flag for condition of diagnosis of the diagnosis instance SWT_LS_DOWN_1" UWORD _CNV_S_2_RANGE______380_CM 1 0. 0. 1. DISPLAY_IDENTIFIER LV_CDN_DIAG_STC_SWT_LS_DOWN_1 ECU_ADDRESS 0x7f9bea BYTE_ORDER MSB_LAST BIT_MASK 0x400 /end MEASUREMENT
/begin MEASUREMENT fmy_stat_swt_ls_down_1.err_info_stat.lv_lock_diag "lock flag (CPU load optimisation) of the diagnosis instance SWT_LS_DOWN_1" UWORD _CNV_S_2_RANGE______380_CM 1 0. 0. 1. DISPLAY_IDENTIFIER LV_LOCK_DIAG_SWT_LS_DOWN_1 ECU_ADDRESS 0x7f9bea BYTE_ORDER MSB_LAST BIT_MASK 0x200 /end MEASUREMENT
/begin MEASUREMENT fmy_stat_swt_ls_down_1.err_info_stat.lv_err_mem "storage in dynamic failure memory of the diagnosis instance SWT_LS_DOWN_1" UWORD _CNV_S_2_RANGE______380_CM 1 0. 0. 1. DISPLAY_IDENTIFIER LV_ERR_MEM_SWT_LS_DOWN_1 ECU_ADDRESS 0x7f9bea BYTE_ORDER MSB_LAST BIT_MASK 0x80 /end MEASUREMENT
/begin MEASUREMENT fmy_stat_swt_ls_down_1.err_info_stat.lv_ready "readiness status of the diagnosis instance SWT_LS_DOWN_1" UWORD _CNV_S_2_RANGE______380_CM 1 0. 0. 1. DISPLAY_IDENTIFIER LV_READY_SWT_LS_DOWN_1 ECU_ADDRESS 0x7f9bea BYTE_ORDER MSB_LAST BIT_MASK 0x40 /end MEASUREMENT
/begin MEASUREMENT fmy_stat_swt_ls_down_1.err_info_stat.lv_end_diag "end of diagnosis of the diagnosis instance SWT_LS_DOWN_1" UWORD _CNV_S_2_RANGE______380_CM 1 0. 0. 1. DISPLAY_IDENTIFIER LV_END_DIAG_SWT_LS_DOWN_1 ECU_ADDRESS 0x7f9bea BYTE_ORDER MSB_LAST BIT_MASK 0x20 /end MEASUREMENT
/begin MEASUREMENT fmy_stat_swt_ls_down_1.err_info_stat.lv_cdn_diag "diagnosis condition of the diagnosis instance SWT_LS_DOWN_1" UWORD _CNV_S_2_RANGE______380_CM 1 0. 0. 1. DISPLAY_IDENTIFIER LV_CDN_DIAG_SWT_LS_DOWN_1 ECU_ADDRESS 0x7f9bea BYTE_ORDER MSB_LAST BIT_MASK 0x10 /end MEASUREMENT
/begin MEASUREMENT fmy_stat_swt_ls_down_1.err_info_stat.err_sym "symptoms of the diagnosis instance SWT_LS_DOWN_1" UWORD _CNV_S_6_CONV_ERRM__27_CM 1 0. 0. 15. DISPLAY_IDENTIFIER ERR_SYM_SWT_LS_DOWN_1 ECU_ADDRESS 0x7f9bea BYTE_ORDER MSB_LAST BIT_MASK 0xF /end MEASUREMENT
/begin MEASUREMENT fmy_stat_pue_ls_down_1.ctr_abc "anti bounce counter for diagnosis instance PUE_LS_DOWN_1" UBYTE _CNV_A_R_LINEAR_____1_CM 1 0. 0. 255. DISPLAY_IDENTIFIER CTR_ABC_PUE_LS_DOWN_1 ECU_ADDRESS 0x7f9bf1 FORMAT "%3.0" /end MEASUREMENT
/begin MEASUREMENT fmy_stat_pue_ls_down_1.ctr_end_diag "counter for end of diagnosis for diagnosis instance PUE_LS_DOWN_1" UBYTE _CNV_A_R_LINEAR_____1_CM 1 0. 0. 255. DISPLAY_IDENTIFIER CTR_ABC_END_DIAG_PUE_LS_DOWN_1 ECU_ADDRESS 0x7f9bf0 FORMAT "%3.0" /end MEASUREMENT
/begin MEASUREMENT fmy_stat_pue_ls_down_1.err_info_stat.reserved "" UWORD _CNV_A_R_LINEAR_____0_CM 1 0. 0. 65535. DISPLAY_IDENTIFIER FMY_STAT_PUE_LS_DOWN_1_ERR_INFO_ ECU_ADDRESS 0x7f9bee BYTE_ORDER MSB_LAST BIT_MASK 0xF800 /end MEASUREMENT
/begin MEASUREMENT fmy_stat_pue_ls_down_1.err_info_stat.lv_cdn_diag_stc "Statistical flag for condition of diagnosis of the diagnosis instance PUE_LS_DOWN_1" UWORD _CNV_S_2_RANGE______380_CM 1 0. 0. 1. DISPLAY_IDENTIFIER LV_CDN_DIAG_STC_PUE_LS_DOWN_1 ECU_ADDRESS 0x7f9bee BYTE_ORDER MSB_LAST BIT_MASK 0x400 /end MEASUREMENT
/begin MEASUREMENT fmy_stat_pue_ls_down_1.err_info_stat.lv_lock_diag "lock flag (CPU load optimisation) of the diagnosis instance PUE_LS_DOWN_1" UWORD _CNV_S_2_RANGE______380_CM 1 0. 0. 1. DISPLAY_IDENTIFIER LV_LOCK_DIAG_PUE_LS_DOWN_1 ECU_ADDRESS 0x7f9bee BYTE_ORDER MSB_LAST BIT_MASK 0x200 /end MEASUREMENT
/begin MEASUREMENT fmy_stat_pue_ls_down_1.err_info_stat.lv_err_mem "storage in dynamic failure memory of the diagnosis instance PUE_LS_DOWN_1" UWORD _CNV_S_2_RANGE______380_CM 1 0. 0. 1. DISPLAY_IDENTIFIER LV_ERR_MEM_PUE_LS_DOWN_1 ECU_ADDRESS 0x7f9bee BYTE_ORDER MSB_LAST BIT_MASK 0x80 /end MEASUREMENT
/begin MEASUREMENT fmy_stat_pue_ls_down_1.err_info_stat.lv_ready "readiness status of the diagnosis instance PUE_LS_DOWN_1" UWORD _CNV_S_2_RANGE______380_CM 1 0. 0. 1. DISPLAY_IDENTIFIER LV_READY_PUE_LS_DOWN_1 ECU_ADDRESS 0x7f9bee BYTE_ORDER MSB_LAST BIT_MASK 0x40 /end MEASUREMENT
/begin MEASUREMENT fmy_stat_pue_ls_down_1.err_info_stat.lv_end_diag "end of diagnosis of the diagnosis instance PUE_LS_DOWN_1" UWORD _CNV_S_2_RANGE______380_CM 1 0. 0. 1. DISPLAY_IDENTIFIER LV_END_DIAG_PUE_LS_DOWN_1 ECU_ADDRESS 0x7f9bee BYTE_ORDER MSB_LAST BIT_MASK 0x20 /end MEASUREMENT
/begin MEASUREMENT fmy_stat_pue_ls_down_1.err_info_stat.lv_cdn_diag "diagnosis condition of the diagnosis instance PUE_LS_DOWN_1" UWORD _CNV_S_2_RANGE______380_CM 1 0. 0. 1. DISPLAY_IDENTIFIER LV_CDN_DIAG_PUE_LS_DOWN_1 ECU_ADDRESS 0x7f9bee BYTE_ORDER MSB_LAST BIT_MASK 0x10 /end MEASUREMENT
/begin MEASUREMENT fmy_stat_pue_ls_down_1.err_info_stat.err_sym "symptoms of the diagnosis instance PUE_LS_DOWN_1" UWORD _CNV_S_6_CONV_ERRM__27_CM 1 0. 0. 15. DISPLAY_IDENTIFIER ERR_SYM_PUE_LS_DOWN_1 ECU_ADDRESS 0x7f9bee BYTE_ORDER MSB_LAST BIT_MASK 0xF /end MEASUREMENT
/begin MEASUREMENT fmy_stat_chg_ls_up.ctr_abc "anti bounce counter for diagnosis instance CHG_LS_UP" UBYTE _CNV_A_R_LINEAR_____1_CM 1 0. 0. 255. DISPLAY_IDENTIFIER CTR_ABC_CHG_LS_UP ECU_ADDRESS 0x7f9bf5 FORMAT "%3.0" /end MEASUREMENT
/begin MEASUREMENT fmy_stat_chg_ls_up.ctr_end_diag "counter for end of diagnosis for diagnosis instance CHG_LS_UP" UBYTE _CNV_A_R_LINEAR_____1_CM 1 0. 0. 255. DISPLAY_IDENTIFIER CTR_ABC_END_DIAG_CHG_LS_UP ECU_ADDRESS 0x7f9bf4 FORMAT "%3.0" /end MEASUREMENT
/begin MEASUREMENT fmy_stat_chg_ls_up.err_info_stat.reserved "" UWORD _CNV_A_R_LINEAR_____0_CM 1 0. 0. 65535. DISPLAY_IDENTIFIER FMY_STAT_CHG_LS_UP_ERR_INFO_STAT ECU_ADDRESS 0x7f9bf2 BYTE_ORDER MSB_LAST BIT_MASK 0xF800 /end MEASUREMENT
/begin MEASUREMENT fmy_stat_chg_ls_up.err_info_stat.lv_cdn_diag_stc "Statistical flag for condition of diagnosis of the diagnosis instance CHG_LS_UP" UWORD _CNV_S_2_RANGE______380_CM 1 0. 0. 1. DISPLAY_IDENTIFIER LV_CDN_DIAG_STC_CHG_LS_UP ECU_ADDRESS 0x7f9bf2 BYTE_ORDER MSB_LAST BIT_MASK 0x400 /end MEASUREMENT
/begin MEASUREMENT fmy_stat_chg_ls_up.err_info_stat.lv_lock_diag "lock flag (CPU load optimisation) of the diagnosis instance CHG_LS_UP" UWORD _CNV_S_2_RANGE______380_CM 1 0. 0. 1. DISPLAY_IDENTIFIER LV_LOCK_DIAG_CHG_LS_UP ECU_ADDRESS 0x7f9bf2 BYTE_ORDER MSB_LAST BIT_MASK 0x200 /end MEASUREMENT
/begin MEASUREMENT fmy_stat_chg_ls_up.err_info_stat.lv_err_mem "storage in dynamic failure memory of the diagnosis instance CHG_LS_UP" UWORD _CNV_S_2_RANGE______380_CM 1 0. 0. 1. DISPLAY_IDENTIFIER LV_ERR_MEM_CHG_LS_UP ECU_ADDRESS 0x7f9bf2 BYTE_ORDER MSB_LAST BIT_MASK 0x80 /end MEASUREMENT
/begin MEASUREMENT fmy_stat_chg_ls_up.err_info_stat.lv_ready "readiness status of the diagnosis instance CHG_LS_UP" UWORD _CNV_S_2_RANGE______380_CM 1 0. 0. 1. DISPLAY_IDENTIFIER LV_READY_CHG_LS_UP ECU_ADDRESS 0x7f9bf2 BYTE_ORDER MSB_LAST BIT_MASK 0x40 /end MEASUREMENT
/begin MEASUREMENT fmy_stat_chg_ls_up.err_info_stat.lv_end_diag "end of diagnosis of the diagnosis instance CHG_LS_UP" UWORD _CNV_S_2_RANGE______380_CM 1 0. 0. 1. DISPLAY_IDENTIFIER LV_END_DIAG_CHG_LS_UP ECU_ADDRESS 0x7f9bf2 BYTE_ORDER MSB_LAST BIT_MASK 0x20 /end MEASUREMENT
/begin MEASUREMENT fmy_stat_chg_ls_up.err_info_stat.lv_cdn_diag "diagnosis condition of the diagnosis instance CHG_LS_UP" UWORD _CNV_S_2_RANGE______380_CM 1 0. 0. 1. DISPLAY_IDENTIFIER LV_CDN_DIAG_CHG_LS_UP ECU_ADDRESS 0x7f9bf2 BYTE_ORDER MSB_LAST BIT_MASK 0x10 /end MEASUREMENT
/begin MEASUREMENT fmy_stat_chg_ls_up.err_info_stat.err_sym "symptoms of the diagnosis instance CHG_LS_UP" UWORD _CNV_S_6_CONV_ERRM__27_CM 1 0. 0. 15. DISPLAY_IDENTIFIER ERR_SYM_CHG_LS_UP ECU_ADDRESS 0x7f9bf2 BYTE_ORDER MSB_LAST BIT_MASK 0xF /end MEASUREMENT
/begin MEASUREMENT fmy_stat_chg_ls_down.ctr_abc "anti bounce counter for diagnosis instance CHG_LS_DOWN" UBYTE _CNV_A_R_LINEAR_____1_CM 1 0. 0. 255. DISPLAY_IDENTIFIER CTR_ABC_CHG_LS_DOWN ECU_ADDRESS 0x7f9bf9 FORMAT "%3.0" /end MEASUREMENT
/begin MEASUREMENT fmy_stat_chg_ls_down.ctr_end_diag "counter for end of diagnosis for diagnosis instance CHG_LS_DOWN" UBYTE _CNV_A_R_LINEAR_____1_CM 1 0. 0. 255. DISPLAY_IDENTIFIER CTR_ABC_END_DIAG_CHG_LS_DOWN ECU_ADDRESS 0x7f9bf8 FORMAT "%3.0" /end MEASUREMENT
/begin MEASUREMENT fmy_stat_chg_ls_down.err_info_stat.reserved "" UWORD _CNV_A_R_LINEAR_____0_CM 1 0. 0. 65535. DISPLAY_IDENTIFIER FMY_STAT_CHG_LS_DOWN_ERR_INFO_ST ECU_ADDRESS 0x7f9bf6 BYTE_ORDER MSB_LAST BIT_MASK 0xF800 /end MEASUREMENT
/begin MEASUREMENT fmy_stat_chg_ls_down.err_info_stat.lv_cdn_diag_stc "Statistical flag for condition of diagnosis of the diagnosis instance CHG_LS_DOWN" UWORD _CNV_S_2_RANGE______380_CM 1 0. 0. 1. DISPLAY_IDENTIFIER LV_CDN_DIAG_STC_CHG_LS_DOWN ECU_ADDRESS 0x7f9bf6 BYTE_ORDER MSB_LAST BIT_MASK 0x400 /end MEASUREMENT
/begin MEASUREMENT fmy_stat_chg_ls_down.err_info_stat.lv_lock_diag "lock flag (CPU load optimisation) of the diagnosis instance CHG_LS_DOWN" UWORD _CNV_S_2_RANGE______380_CM 1 0. 0. 1. DISPLAY_IDENTIFIER LV_LOCK_DIAG_CHG_LS_DOWN ECU_ADDRESS 0x7f9bf6 BYTE_ORDER MSB_LAST BIT_MASK 0x200 /end MEASUREMENT
/begin MEASUREMENT fmy_stat_chg_ls_down.err_info_stat.lv_err_mem "storage in dynamic failure memory of the diagnosis instance CHG_LS_DOWN" UWORD _CNV_S_2_RANGE______380_CM 1 0. 0. 1. DISPLAY_IDENTIFIER LV_ERR_MEM_CHG_LS_DOWN ECU_ADDRESS 0x7f9bf6 BYTE_ORDER MSB_LAST BIT_MASK 0x80 /end MEASUREMENT
/begin MEASUREMENT fmy_stat_chg_ls_down.err_info_stat.lv_ready "readiness status of the diagnosis instance CHG_LS_DOWN" UWORD _CNV_S_2_RANGE______380_CM 1 0. 0. 1. DISPLAY_IDENTIFIER LV_READY_CHG_LS_DOWN ECU_ADDRESS 0x7f9bf6 BYTE_ORDER MSB_LAST BIT_MASK 0x40 /end MEASUREMENT
/begin MEASUREMENT fmy_stat_chg_ls_down.err_info_stat.lv_end_diag "end of diagnosis of the diagnosis instance CHG_LS_DOWN" UWORD _CNV_S_2_RANGE______380_CM 1 0. 0. 1. DISPLAY_IDENTIFIER LV_END_DIAG_CHG_LS_DOWN ECU_ADDRESS 0x7f9bf6 BYTE_ORDER MSB_LAST BIT_MASK 0x20 /end MEASUREMENT
/begin MEASUREMENT fmy_stat_chg_ls_down.err_info_stat.lv_cdn_diag "diagnosis condition of the diagnosis instance CHG_LS_DOWN" UWORD _CNV_S_2_RANGE______380_CM 1 0. 0. 1. DISPLAY_IDENTIFIER LV_CDN_DIAG_CHG_LS_DOWN ECU_ADDRESS 0x7f9bf6 BYTE_ORDER MSB_LAST BIT_MASK 0x10 /end MEASUREMENT
/begin MEASUREMENT fmy_stat_chg_ls_down.err_info_stat.err_sym "symptoms of the diagnosis instance CHG_LS_DOWN" UWORD _CNV_S_6_CONV_ERRM__27_CM 1 0. 0. 15. DISPLAY_IDENTIFIER ERR_SYM_CHG_LS_DOWN ECU_ADDRESS 0x7f9bf6 BYTE_ORDER MSB_LAST BIT_MASK 0xF /end MEASUREMENT
/begin COMPU_METHOD _CNV_A_R_LINEAR_____0_CM "" RAT_FUNC "%6.3" "[-]" COEFFS 0 1. 0. 0 0 1 /end COMPU_METHOD
/begin COMPU_METHOD _CNV_A_R_LINEAR_____1_CM "" RAT_FUNC "%6.3" "-" COEFFS 0 1. 0. 0 0 1 /end COMPU_METHOD
/begin COMPU_METHOD _CNV_S_6_CONV_ERRM__27_CM "" TAB_VERB "%6.3" "[-]" COMPU_TAB_REF _CNV_S_6_CONV_ERRM__27 /end COMPU_METHOD
/begin COMPU_VTAB _CNV_S_6_CONV_ERRM__27 "" TAB_VERB 6 0 "NO_SYM" 1 "SYM_0" 2 "SYM_1" 4 "SYM_2" 8 "SYM_3" 15 "BENCH_MODE" /end COMPU_VTAB
/begin COMPU_METHOD _CNV_S_2_RANGE______28_CM "" TAB_VERB "%6.3" "[-]" COMPU_TAB_REF _CNV_S_2_RANGE______28 /end COMPU_METHOD
/begin COMPU_VTAB _CNV_S_2_RANGE______28 "" TAB_VERB 2 0 "passive" 1 "active" /end COMPU_VTAB
/begin COMPU_METHOD _CNV_S_2_RANGE______380_CM "" TAB_VERB "%6.3" "-" COMPU_TAB_REF _CNV_S_2_RANGE______380 /end COMPU_METHOD
/begin COMPU_VTAB _CNV_S_2_RANGE______380 "" TAB_VERB 2 0 "passive" 1 "active" /end COMPU_VTAB
/begin RECORD_LAYOUT _REC_VAL_20_u1 FNC_VALUES 1 UBYTE COLUMN_DIR DIRECT /end RECORD_LAYOUT
/begin RECORD_LAYOUT _REC_AXS_20_u2 NO_AXIS_PTS_X 1 UWORD AXIS_PTS_X 2 UWORD INDEX_INCR DIRECT /end RECORD_LAYOUT
/begin RECORD_LAYOUT _REC_AXS_20_u1 NO_AXIS_PTS_X 1 UBYTE AXIS_PTS_X 2 UBYTE INDEX_INCR DIRECT /end RECORD_LAYOUT
/begin RECORD_LAYOUT _REC_CUR_20_u2_u2 FNC_VALUES 1 UWORD COLUMN_DIR DIRECT /end RECORD_LAYOUT
/begin RECORD_LAYOUT _REC_CUR_20_u1_u1 FNC_VALUES 1 UBYTE COLUMN_DIR DIRECT /end RECORD_LAYOUT
/begin FUNCTION ERRM_ADGOSPI "Error Management data for diagnosis ADGOSPI"
 /begin OUT_MEASUREMENT lv_err_bpa fmy_stat_bpa.ctr_abc fmy_stat_bpa.ctr_end_diag fmy_stat_bpa.err_info_stat.reserved fmy_stat_bpa.err_info_stat.lv_cdn_diag_stc fmy_stat_bpa.err_info_stat.lv_lock_diag fmy_stat_bpa.err_info_stat.lv_err_mem fmy_stat_bpa.err_info_stat.lv_ready fmy_stat_bpa.err_info_stat.lv_end_diag fmy_stat_bpa.err_info_stat.lv_cdn_diag fmy_stat_bpa.err_info_stat.err_sym lv_err_gl_rly_dps fmy_stat_gl_rly_dps.ctr_abc fmy_stat_gl_rly_dps.ctr_end_diag fmy_stat_gl_rly_dps.err_info_stat.reserved fmy_stat_gl_rly_dps.err_info_stat.lv_cdn_diag_stc fmy_stat_gl_rly_dps.err_info_stat.lv_lock_diag fmy_stat_gl_rly_dps.err_info_stat.lv_err_mem fmy_stat_gl_rly_dps.err_info_stat.lv_ready fmy_stat_gl_rly_dps.err_info_stat.lv_end_diag fmy_stat_gl_rly_dps.err_info_stat.lv_cdn_diag fmy_stat_gl_rly_dps.err_info_stat.err_sym lv_err_pcv_1 fmy_stat_pcv_1.ctr_abc fmy_stat_pcv_1.ctr_end_diag fmy_stat_pcv_1.err_info_stat.reserved fmy_stat_pcv_1.err_info_stat.lv_cdn_diag_stc fmy_stat_pcv_1.err_info_stat.lv_lock_diag fmy_stat_pcv_1.err_info_stat.lv_err_mem fmy_stat_pcv_1.err_info_stat.lv_ready fmy_stat_pcv_1.err_info_stat.lv_end_diag fmy_stat_pcv_1.err_info_stat.lv_cdn_diag fmy_stat_pcv_1.err_info_stat.err_sym lv_err_pcv_3 fmy_stat_pcv_3.ctr_abc fmy_stat_pcv_3.ctr_end_diag fmy_stat_pcv_3.err_info_stat.reserved fmy_stat_pcv_3.err_info_stat.lv_cdn_diag_stc fmy_stat_pcv_3.err_info_stat.lv_lock_diag fmy_stat_pcv_3.err_info_stat.lv_err_mem fmy_stat_pcv_3.err_info_stat.lv_ready fmy_stat_pcv_3.err_info_stat.lv_end_diag fmy_stat_pcv_3.err_info_stat.lv_cdn_diag fmy_stat_pcv_3.err_info_stat.err_sym lv_err_vcv_1 fmy_stat_vcv_1.ctr_abc fmy_stat_vcv_1.ctr_end_diag fmy_stat_vcv_1.err_info_stat.reserved fmy_stat_vcv_1.err_info_stat.lv_cdn_diag_stc fmy_stat_vcv_1.err_info_stat.lv_lock_diag fmy_stat_vcv_1.err_info_stat.lv_err_mem fmy_stat_vcv_1.err_info_stat.lv_ready fmy_stat_vcv_1.err_info_stat.lv_end_diag fmy_stat_vcv_1.err_info_stat.lv_cdn_diag fmy_stat_vcv_1.err_info_stat.err_sym lv_err_vcv_3 fmy_stat_vcv_3.ctr_abc fmy_stat_vcv_3.ctr_end_diag fmy_stat_vcv_3.err_info_stat.reserved fmy_stat_vcv_3.err_info_stat.lv_cdn_diag_stc fmy_stat_vcv_3.err_info_stat.lv_lock_diag fmy_stat_vcv_3.err_info_stat.lv_err_mem fmy_stat_vcv_3.err_info_stat.lv_ready fmy_stat_vcv_3.err_info_stat.lv_end_diag fmy_stat_vcv_3.err_info_stat.lv_cdn_diag fmy_stat_vcv_3.err_info_stat.err_sym /end OUT_MEASUREMENT
/end FUNCTION
/begin FUNCTION ERRM_ARLYDIAG "Error Management data for diagnosis ARLYDIAG"
 /begin OUT_MEASUREMENT lv_err_rly_main fmy_stat_rly_main.ctr_abc fmy_stat_rly_main.ctr_end_diag fmy_stat_rly_main.err_info_stat.reserved fmy_stat_rly_main.err_info_stat.lv_cdn_diag_stc fmy_stat_rly_main.err_info_stat.lv_lock_diag fmy_stat_rly_main.err_info_stat.lv_err_mem fmy_stat_rly_main.err_info_stat.lv_ready fmy_stat_rly_main.err_info_stat.lv_end_diag fmy_stat_rly_main.err_info_stat.lv_cdn_diag fmy_stat_rly_main.err_info_stat.err_sym lv_err_rly_power fmy_stat_rly_power.ctr_abc fmy_stat_rly_power.ctr_end_diag fmy_stat_rly_power.err_info_stat.reserved fmy_stat_rly_power.err_info_stat.lv_cdn_diag_stc fmy_stat_rly_power.err_info_stat.lv_lock_diag fmy_stat_rly_power.err_info_stat.lv_err_mem fmy_stat_rly_power.err_info_stat.lv_ready fmy_stat_rly_power.err_info_stat.lv_end_diag fmy_stat_rly_power.err_info_stat.lv_cdn_diag fmy_stat_rly_power.err_info_stat.err_sym /end OUT_MEASUREMENT
/end FUNCTION
/begin FUNCTION ERRM_AVBDIAG "Error Management data for diagnosis AVBDIAG"
 /begin OUT_MEASUREMENT fmy_stat_vb.ctr_abc fmy_stat_vb.ctr_end_diag fmy_stat_vb.err_info_stat.reserved fmy_stat_vb.err_info_stat.lv_cdn_diag_stc fmy_stat_vb.err_info_stat.lv_lock_diag fmy_stat_vb.err_info_stat.lv_err_mem fmy_stat_vb.err_info_stat.lv_ready fmy_stat_vb.err_info_stat.lv_end_diag fmy_stat_vb.err_info_stat.lv_cdn_diag fmy_stat_vb.err_info_stat.err_sym /end OUT_MEASUREMENT
/end FUNCTION
/begin FUNCTION ERRM_AERRMON "Error Management data for diagnosis AERRMON"
 /begin OUT_MEASUREMENT lv_err_conv_mon_1 fmy_stat_conv_mon_1.ctr_abc fmy_stat_conv_mon_1.ctr_end_diag fmy_stat_conv_mon_1.err_info_stat.reserved fmy_stat_conv_mon_1.err_info_stat.lv_cdn_diag_stc fmy_stat_conv_mon_1.err_info_stat.lv_lock_diag fmy_stat_conv_mon_1.err_info_stat.lv_err_mem fmy_stat_conv_mon_1.err_info_stat.lv_ready fmy_stat_conv_mon_1.err_info_stat.lv_end_diag fmy_stat_conv_mon_1.err_info_stat.lv_cdn_diag fmy_stat_conv_mon_1.err_info_stat.err_sym lv_err_n_32_mon_1 fmy_stat_n_32_mon_1.ctr_abc fmy_stat_n_32_mon_1.ctr_end_diag fmy_stat_n_32_mon_1.err_info_stat.reserved fmy_stat_n_32_mon_1.err_info_stat.lv_cdn_diag_stc fmy_stat_n_32_mon_1.err_info_stat.lv_lock_diag fmy_stat_n_32_mon_1.err_info_stat.lv_err_mem fmy_stat_n_32_mon_1.err_info_stat.lv_ready fmy_stat_n_32_mon_1.err_info_stat.lv_end_diag fmy_stat_n_32_mon_1.err_info_stat.lv_cdn_diag fmy_stat_n_32_mon_1.err_info_stat.err_sym lv_err_pvs_mon_1 fmy_stat_pvs_mon_1.ctr_abc fmy_stat_pvs_mon_1.ctr_end_diag fmy_stat_pvs_mon_1.err_info_stat.reserved fmy_stat_pvs_mon_1.err_info_stat.lv_cdn_diag_stc fmy_stat_pvs_mon_1.err_info_stat.lv_lock_diag fmy_stat_pvs_mon_1.err_info_stat.lv_err_mem fmy_stat_pvs_mon_1.err_info_stat.lv_ready fmy_stat_pvs_mon_1.err_info_stat.lv_end_diag fmy_stat_pvs_mon_1.err_info_stat.lv_cdn_diag fmy_stat_pvs_mon_1.err_info_stat.err_sym lv_err_fcut_mon_1 fmy_stat_fcut_mon_1.ctr_abc fmy_stat_fcut_mon_1.ctr_end_diag fmy_stat_fcut_mon_1.err_info_stat.reserved fmy_stat_fcut_mon_1.err_info_stat.lv_cdn_diag_stc fmy_stat_fcut_mon_1.err_info_stat.lv_lock_diag fmy_stat_fcut_mon_1.err_info_stat.lv_err_mem fmy_stat_fcut_mon_1.err_info_stat.lv_ready fmy_stat_fcut_mon_1.err_info_stat.lv_end_diag fmy_stat_fcut_mon_1.err_info_stat.lv_cdn_diag fmy_stat_fcut_mon_1.err_info_stat.err_sym lv_err_tqi_n_max_mon_1 fmy_stat_tqi_n_max_mon_1.ctr_abc fmy_stat_tqi_n_max_mon_1.ctr_end_diag fmy_stat_tqi_n_max_mon_1.err_info_stat.reserved fmy_stat_tqi_n_max_mon_1.err_info_stat.lv_cdn_diag_stc fmy_stat_tqi_n_max_mon_1.err_info_stat.lv_lock_diag fmy_stat_tqi_n_max_mon_1.err_info_stat.lv_err_mem fmy_stat_tqi_n_max_mon_1.err_info_stat.lv_ready fmy_stat_tqi_n_max_mon_1.err_info_stat.lv_end_diag fmy_stat_tqi_n_max_mon_1.err_info_stat.lv_cdn_diag fmy_stat_tqi_n_max_mon_1.err_info_stat.err_sym lv_err_serv_mon_1 fmy_stat_serv_mon_1.ctr_abc fmy_stat_serv_mon_1.ctr_end_diag fmy_stat_serv_mon_1.err_info_stat.reserved fmy_stat_serv_mon_1.err_info_stat.lv_cdn_diag_stc fmy_stat_serv_mon_1.err_info_stat.lv_lock_diag fmy_stat_serv_mon_1.err_info_stat.lv_err_mem fmy_stat_serv_mon_1.err_info_stat.lv_ready fmy_stat_serv_mon_1.err_info_stat.lv_end_diag fmy_stat_serv_mon_1.err_info_stat.lv_cdn_diag fmy_stat_serv_mon_1.err_info_stat.err_sym lv_err_post_inh_mon fmy_stat_post_inh_mon.ctr_abc fmy_stat_post_inh_mon.ctr_end_diag fmy_stat_post_inh_mon.err_info_stat.reserved fmy_stat_post_inh_mon.err_info_stat.lv_cdn_diag_stc fmy_stat_post_inh_mon.err_info_stat.lv_lock_diag fmy_stat_post_inh_mon.err_info_stat.lv_err_mem fmy_stat_post_inh_mon.err_info_stat.lv_ready fmy_stat_post_inh_mon.err_info_stat.lv_end_diag fmy_stat_post_inh_mon.err_info_stat.lv_cdn_diag fmy_stat_post_inh_mon.err_info_stat.err_sym lv_err_cru_inh_mon fmy_stat_cru_inh_mon.ctr_abc fmy_stat_cru_inh_mon.ctr_end_diag fmy_stat_cru_inh_mon.err_info_stat.reserved fmy_stat_cru_inh_mon.err_info_stat.lv_cdn_diag_stc fmy_stat_cru_inh_mon.err_info_stat.lv_lock_diag fmy_stat_cru_inh_mon.err_info_stat.lv_err_mem fmy_stat_cru_inh_mon.err_info_stat.lv_ready fmy_stat_cru_inh_mon.err_info_stat.lv_end_diag fmy_stat_cru_inh_mon.err_info_stat.lv_cdn_diag fmy_stat_cru_inh_mon.err_info_stat.err_sym lv_err_can_inh_mon fmy_stat_can_inh_mon.ctr_abc fmy_stat_can_inh_mon.ctr_end_diag fmy_stat_can_inh_mon.err_info_stat.reserved fmy_stat_can_inh_mon.err_info_stat.lv_cdn_diag_stc fmy_stat_can_inh_mon.err_info_stat.lv_lock_diag fmy_stat_can_inh_mon.err_info_stat.lv_err_mem fmy_stat_can_inh_mon.err_info_stat.lv_ready fmy_stat_can_inh_mon.err_info_stat.lv_end_diag fmy_stat_can_inh_mon.err_info_stat.lv_cdn_diag fmy_stat_can_inh_mon.err_info_stat.err_sym /end OUT_MEASUREMENT
/end FUNCTION
/begin FUNCTION ERRM_TMO3ERRM "Error Management data for diagnosis TMO3ERRM"
 /begin OUT_MEASUREMENT lv_err_mon_3 fmy_stat_mon_3.ctr_abc fmy_stat_mon_3.ctr_end_diag fmy_stat_mon_3.err_info_stat.reserved fmy_stat_mon_3.err_info_stat.lv_cdn_diag_stc fmy_stat_mon_3.err_info_stat.lv_lock_diag fmy_stat_mon_3.err_info_stat.lv_err_mem fmy_stat_mon_3.err_info_stat.lv_ready fmy_stat_mon_3.err_info_stat.lv_end_diag fmy_stat_mon_3.err_info_stat.lv_cdn_diag fmy_stat_mon_3.err_info_stat.err_sym /end OUT_MEASUREMENT
/end FUNCTION
/begin FUNCTION ERRM_ENSD_DIAG "Error Management data for diagnosis ENSD_DIAG"
 /begin OUT_MEASUREMENT fmy_stat_per_cam_in_1.ctr_abc fmy_stat_per_cam_in_1.ctr_end_diag fmy_stat_per_cam_in_1.err_info_stat.reserved fmy_stat_per_cam_in_1.err_info_stat.lv_cdn_diag_stc fmy_stat_per_cam_in_1.err_info_stat.lv_lock_diag fmy_stat_per_cam_in_1.err_info_stat.lv_err_mem fmy_stat_per_cam_in_1.err_info_stat.lv_ready fmy_stat_per_cam_in_1.err_info_stat.lv_end_diag fmy_stat_per_cam_in_1.err_info_stat.lv_cdn_diag fmy_stat_per_cam_in_1.err_info_stat.err_sym fmy_stat_syn_cam_in_1.ctr_abc fmy_stat_syn_cam_in_1.ctr_end_diag fmy_stat_syn_cam_in_1.err_info_stat.reserved fmy_stat_syn_cam_in_1.err_info_stat.lv_cdn_diag_stc fmy_stat_syn_cam_in_1.err_info_stat.lv_lock_diag fmy_stat_syn_cam_in_1.err_info_stat.lv_err_mem fmy_stat_syn_cam_in_1.err_info_stat.lv_ready fmy_stat_syn_cam_in_1.err_info_stat.lv_end_diag fmy_stat_syn_cam_in_1.err_info_stat.lv_cdn_diag fmy_stat_syn_cam_in_1.err_info_stat.err_sym fmy_stat_ref_crk_cam_in_1.ctr_abc fmy_stat_ref_crk_cam_in_1.ctr_end_diag fmy_stat_ref_crk_cam_in_1.err_info_stat.reserved fmy_stat_ref_crk_cam_in_1.err_info_stat.lv_cdn_diag_stc fmy_stat_ref_crk_cam_in_1.err_info_stat.lv_lock_diag fmy_stat_ref_crk_cam_in_1.err_info_stat.lv_err_mem fmy_stat_ref_crk_cam_in_1.err_info_stat.lv_ready fmy_stat_ref_crk_cam_in_1.err_info_stat.lv_end_diag fmy_stat_ref_crk_cam_in_1.err_info_stat.lv_cdn_diag fmy_stat_ref_crk_cam_in_1.err_info_stat.err_sym fmy_stat_crk_tooth.ctr_abc fmy_stat_crk_tooth.ctr_end_diag fmy_stat_crk_tooth.err_info_stat.reserved fmy_stat_crk_tooth.err_info_stat.lv_cdn_diag_stc fmy_stat_crk_tooth.err_info_stat.lv_lock_diag fmy_stat_crk_tooth.err_info_stat.lv_err_mem fmy_stat_crk_tooth.err_info_stat.lv_ready fmy_stat_crk_tooth.err_info_stat.lv_end_diag fmy_stat_crk_tooth.err_info_stat.lv_cdn_diag fmy_stat_crk_tooth.err_info_stat.err_sym fmy_stat_crk_tooth_per.ctr_abc fmy_stat_crk_tooth_per.ctr_end_diag fmy_stat_crk_tooth_per.err_info_stat.reserved fmy_stat_crk_tooth_per.err_info_stat.lv_cdn_diag_stc fmy_stat_crk_tooth_per.err_info_stat.lv_lock_diag fmy_stat_crk_tooth_per.err_info_stat.lv_err_mem fmy_stat_crk_tooth_per.err_info_stat.lv_ready fmy_stat_crk_tooth_per.err_info_stat.lv_end_diag fmy_stat_crk_tooth_per.err_info_stat.lv_cdn_diag fmy_stat_crk_tooth_per.err_info_stat.err_sym fmy_stat_crk_syn.ctr_abc fmy_stat_crk_syn.ctr_end_diag fmy_stat_crk_syn.err_info_stat.reserved fmy_stat_crk_syn.err_info_stat.lv_cdn_diag_stc fmy_stat_crk_syn.err_info_stat.lv_lock_diag fmy_stat_crk_syn.err_info_stat.lv_err_mem fmy_stat_crk_syn.err_info_stat.lv_ready fmy_stat_crk_syn.err_info_stat.lv_end_diag fmy_stat_crk_syn.err_info_stat.lv_cdn_diag fmy_stat_crk_syn.err_info_stat.err_sym fmy_stat_crk_plaus.ctr_abc fmy_stat_crk_plaus.ctr_end_diag fmy_stat_crk_plaus.err_info_stat.reserved fmy_stat_crk_plaus.err_info_stat.lv_cdn_diag_stc fmy_stat_crk_plaus.err_info_stat.lv_lock_diag fmy_stat_crk_plaus.err_info_stat.lv_err_mem fmy_stat_crk_plaus.err_info_stat.lv_ready fmy_stat_crk_plaus.err_info_stat.lv_end_diag fmy_stat_crk_plaus.err_info_stat.lv_cdn_diag fmy_stat_crk_plaus.err_info_stat.err_sym fmy_stat_plaus_cam_in_1.ctr_abc fmy_stat_plaus_cam_in_1.ctr_end_diag fmy_stat_plaus_cam_in_1.err_info_stat.reserved fmy_stat_plaus_cam_in_1.err_info_stat.lv_cdn_diag_stc fmy_stat_plaus_cam_in_1.err_info_stat.lv_lock_diag fmy_stat_plaus_cam_in_1.err_info_stat.lv_err_mem fmy_stat_plaus_cam_in_1.err_info_stat.lv_ready fmy_stat_plaus_cam_in_1.err_info_stat.lv_end_diag fmy_stat_plaus_cam_in_1.err_info_stat.lv_cdn_diag fmy_stat_plaus_cam_in_1.err_info_stat.err_sym fmy_stat_syn_crk_cam_in_1.ctr_abc fmy_stat_syn_crk_cam_in_1.ctr_end_diag fmy_stat_syn_crk_cam_in_1.err_info_stat.reserved fmy_stat_syn_crk_cam_in_1.err_info_stat.lv_cdn_diag_stc fmy_stat_syn_crk_cam_in_1.err_info_stat.lv_lock_diag fmy_stat_syn_crk_cam_in_1.err_info_stat.lv_err_mem fmy_stat_syn_crk_cam_in_1.err_info_stat.lv_ready fmy_stat_syn_crk_cam_in_1.err_info_stat.lv_end_diag fmy_stat_syn_crk_cam_in_1.err_info_stat.lv_cdn_diag fmy_stat_syn_crk_cam_in_1.err_info_stat.err_sym /end OUT_MEASUREMENT
/end FUNCTION
/begin FUNCTION ERRM_EGCP_DIAG "Error Management data for diagnosis EGCP_DIAG"
 /begin OUT_MEASUREMENT fmy_stat_lsh_up_1.ctr_abc fmy_stat_lsh_up_1.ctr_end_diag fmy_stat_lsh_up_1.err_info_stat.reserved fmy_stat_lsh_up_1.err_info_stat.lv_cdn_diag_stc fmy_stat_lsh_up_1.err_info_stat.lv_lock_diag fmy_stat_lsh_up_1.err_info_stat.lv_err_mem fmy_stat_lsh_up_1.err_info_stat.lv_ready fmy_stat_lsh_up_1.err_info_stat.lv_end_diag fmy_stat_lsh_up_1.err_info_stat.lv_cdn_diag fmy_stat_lsh_up_1.err_info_stat.err_sym fmy_stat_lsh_down_1.ctr_abc fmy_stat_lsh_down_1.ctr_end_diag fmy_stat_lsh_down_1.err_info_stat.reserved fmy_stat_lsh_down_1.err_info_stat.lv_cdn_diag_stc fmy_stat_lsh_down_1.err_info_stat.lv_lock_diag fmy_stat_lsh_down_1.err_info_stat.lv_err_mem fmy_stat_lsh_down_1.err_info_stat.lv_ready fmy_stat_lsh_down_1.err_info_stat.lv_end_diag fmy_stat_lsh_down_1.err_info_stat.lv_cdn_diag fmy_stat_lsh_down_1.err_info_stat.err_sym fmy_stat_scg_ls_down_1.ctr_abc fmy_stat_scg_ls_down_1.ctr_end_diag fmy_stat_scg_ls_down_1.err_info_stat.reserved fmy_stat_scg_ls_down_1.err_info_stat.lv_cdn_diag_stc fmy_stat_scg_ls_down_1.err_info_stat.lv_lock_diag fmy_stat_scg_ls_down_1.err_info_stat.lv_err_mem fmy_stat_scg_ls_down_1.err_info_stat.lv_ready fmy_stat_scg_ls_down_1.err_info_stat.lv_end_diag fmy_stat_scg_ls_down_1.err_info_stat.lv_cdn_diag fmy_stat_scg_ls_down_1.err_info_stat.err_sym fmy_stat_scp_ls_down_1.ctr_abc fmy_stat_scp_ls_down_1.ctr_end_diag fmy_stat_scp_ls_down_1.err_info_stat.reserved fmy_stat_scp_ls_down_1.err_info_stat.lv_cdn_diag_stc fmy_stat_scp_ls_down_1.err_info_stat.lv_lock_diag fmy_stat_scp_ls_down_1.err_info_stat.lv_err_mem fmy_stat_scp_ls_down_1.err_info_stat.lv_ready fmy_stat_scp_ls_down_1.err_info_stat.lv_end_diag fmy_stat_scp_ls_down_1.err_info_stat.lv_cdn_diag fmy_stat_scp_ls_down_1.err_info_stat.err_sym fmy_stat_oc_ls_down_1.ctr_abc fmy_stat_oc_ls_down_1.ctr_end_diag fmy_stat_oc_ls_down_1.err_info_stat.reserved fmy_stat_oc_ls_down_1.err_info_stat.lv_cdn_diag_stc fmy_stat_oc_ls_down_1.err_info_stat.lv_lock_diag fmy_stat_oc_ls_down_1.err_info_stat.lv_err_mem fmy_stat_oc_ls_down_1.err_info_stat.lv_ready fmy_stat_oc_ls_down_1.err_info_stat.lv_end_diag fmy_stat_oc_ls_down_1.err_info_stat.lv_cdn_diag fmy_stat_oc_ls_down_1.err_info_stat.err_sym fmy_stat_obd_lsh_down_1.ctr_abc fmy_stat_obd_lsh_down_1.ctr_end_diag fmy_stat_obd_lsh_down_1.err_info_stat.reserved fmy_stat_obd_lsh_down_1.err_info_stat.lv_cdn_diag_stc fmy_stat_obd_lsh_down_1.err_info_stat.lv_lock_diag fmy_stat_obd_lsh_down_1.err_info_stat.lv_err_mem fmy_stat_obd_lsh_down_1.err_info_stat.lv_ready fmy_stat_obd_lsh_down_1.err_info_stat.lv_end_diag fmy_stat_obd_lsh_down_1.err_info_stat.lv_cdn_diag fmy_stat_obd_lsh_down_1.err_info_stat.err_sym fmy_stat_lam_adj_1.ctr_abc fmy_stat_lam_adj_1.ctr_end_diag fmy_stat_lam_adj_1.err_info_stat.reserved fmy_stat_lam_adj_1.err_info_stat.lv_cdn_diag_stc fmy_stat_lam_adj_1.err_info_stat.lv_lock_diag fmy_stat_lam_adj_1.err_info_stat.lv_err_mem fmy_stat_lam_adj_1.err_info_stat.lv_ready fmy_stat_lam_adj_1.err_info_stat.lv_end_diag fmy_stat_lam_adj_1.err_info_stat.lv_cdn_diag fmy_stat_lam_adj_1.err_info_stat.err_sym fmy_stat_chk_ls_down_1.ctr_abc fmy_stat_chk_ls_down_1.ctr_end_diag fmy_stat_chk_ls_down_1.err_info_stat.reserved fmy_stat_chk_ls_down_1.err_info_stat.lv_cdn_diag_stc fmy_stat_chk_ls_down_1.err_info_stat.lv_lock_diag fmy_stat_chk_ls_down_1.err_info_stat.lv_err_mem fmy_stat_chk_ls_down_1.err_info_stat.lv_ready fmy_stat_chk_ls_down_1.err_info_stat.lv_end_diag fmy_stat_chk_ls_down_1.err_info_stat.lv_cdn_diag fmy_stat_chk_ls_down_1.err_info_stat.err_sym fmy_stat_puc_ls_down_1.ctr_abc fmy_stat_puc_ls_down_1.ctr_end_diag fmy_stat_puc_ls_down_1.err_info_stat.reserved fmy_stat_puc_ls_down_1.err_info_stat.lv_cdn_diag_stc fmy_stat_puc_ls_down_1.err_info_stat.lv_lock_diag fmy_stat_puc_ls_down_1.err_info_stat.lv_err_mem fmy_stat_puc_ls_down_1.err_info_stat.lv_ready fmy_stat_puc_ls_down_1.err_info_stat.lv_end_diag fmy_stat_puc_ls_down_1.err_info_stat.lv_cdn_diag fmy_stat_puc_ls_down_1.err_info_stat.err_sym fmy_stat_fl_ls_down_1.ctr_abc fmy_stat_fl_ls_down_1.ctr_end_diag fmy_stat_fl_ls_down_1.err_info_stat.reserved fmy_stat_fl_ls_down_1.err_info_stat.lv_cdn_diag_stc fmy_stat_fl_ls_down_1.err_info_stat.lv_lock_diag fmy_stat_fl_ls_down_1.err_info_stat.lv_err_mem fmy_stat_fl_ls_down_1.err_info_stat.lv_ready fmy_stat_fl_ls_down_1.err_info_stat.lv_end_diag fmy_stat_fl_ls_down_1.err_info_stat.lv_cdn_diag fmy_stat_fl_ls_down_1.err_info_stat.err_sym fmy_stat_el_lsl_up_1.ctr_abc fmy_stat_el_lsl_up_1.ctr_end_diag fmy_stat_el_lsl_up_1.err_info_stat.reserved fmy_stat_el_lsl_up_1.err_info_stat.lv_cdn_diag_stc fmy_stat_el_lsl_up_1.err_info_stat.lv_lock_diag fmy_stat_el_lsl_up_1.err_info_stat.lv_err_mem fmy_stat_el_lsl_up_1.err_info_stat.lv_ready fmy_stat_el_lsl_up_1.err_info_stat.lv_end_diag fmy_stat_el_lsl_up_1.err_info_stat.lv_cdn_diag fmy_stat_el_lsl_up_1.err_info_stat.err_sym fmy_stat_oc_lsl_up_1.ctr_abc fmy_stat_oc_lsl_up_1.ctr_end_diag fmy_stat_oc_lsl_up_1.err_info_stat.reserved fmy_stat_oc_lsl_up_1.err_info_stat.lv_cdn_diag_stc fmy_stat_oc_lsl_up_1.err_info_stat.lv_lock_diag fmy_stat_oc_lsl_up_1.err_info_stat.lv_err_mem fmy_stat_oc_lsl_up_1.err_info_stat.lv_ready fmy_stat_oc_lsl_up_1.err_info_stat.lv_end_diag fmy_stat_oc_lsl_up_1.err_info_stat.lv_cdn_diag fmy_stat_oc_lsl_up_1.err_info_stat.err_sym fmy_stat_lsl_up_if_1.ctr_abc fmy_stat_lsl_up_if_1.ctr_end_diag fmy_stat_lsl_up_if_1.err_info_stat.reserved fmy_stat_lsl_up_if_1.err_info_stat.lv_cdn_diag_stc fmy_stat_lsl_up_if_1.err_info_stat.lv_lock_diag fmy_stat_lsl_up_if_1.err_info_stat.lv_err_mem fmy_stat_lsl_up_if_1.err_info_stat.lv_ready fmy_stat_lsl_up_if_1.err_info_stat.lv_end_diag fmy_stat_lsl_up_if_1.err_info_stat.lv_cdn_diag fmy_stat_lsl_up_if_1.err_info_stat.err_sym fmy_stat_air_lsl_up_1.ctr_abc fmy_stat_air_lsl_up_1.ctr_end_diag fmy_stat_air_lsl_up_1.err_info_stat.reserved fmy_stat_air_lsl_up_1.err_info_stat.lv_cdn_diag_stc fmy_stat_air_lsl_up_1.err_info_stat.lv_lock_diag fmy_stat_air_lsl_up_1.err_info_stat.lv_err_mem fmy_stat_air_lsl_up_1.err_info_stat.lv_ready fmy_stat_air_lsl_up_1.err_info_stat.lv_end_diag fmy_stat_air_lsl_up_1.err_info_stat.lv_cdn_diag fmy_stat_air_lsl_up_1.err_info_stat.err_sym fmy_stat_ttip_obd_ls_up_1.ctr_abc fmy_stat_ttip_obd_ls_up_1.ctr_end_diag fmy_stat_ttip_obd_ls_up_1.err_info_stat.reserved fmy_stat_ttip_obd_ls_up_1.err_info_stat.lv_cdn_diag_stc fmy_stat_ttip_obd_ls_up_1.err_info_stat.lv_lock_diag fmy_stat_ttip_obd_ls_up_1.err_info_stat.lv_err_mem fmy_stat_ttip_obd_ls_up_1.err_info_stat.lv_ready fmy_stat_ttip_obd_ls_up_1.err_info_stat.lv_end_diag fmy_stat_ttip_obd_ls_up_1.err_info_stat.lv_cdn_diag fmy_stat_ttip_obd_ls_up_1.err_info_stat.err_sym fmy_stat_dyn_vld_ls_up_1.ctr_abc fmy_stat_dyn_vld_ls_up_1.ctr_end_diag fmy_stat_dyn_vld_ls_up_1.err_info_stat.reserved fmy_stat_dyn_vld_ls_up_1.err_info_stat.lv_cdn_diag_stc fmy_stat_dyn_vld_ls_up_1.err_info_stat.lv_lock_diag fmy_stat_dyn_vld_ls_up_1.err_info_stat.lv_err_mem fmy_stat_dyn_vld_ls_up_1.err_info_stat.lv_ready fmy_stat_dyn_vld_ls_up_1.err_info_stat.lv_end_diag fmy_stat_dyn_vld_ls_up_1.err_info_stat.lv_cdn_diag fmy_stat_dyn_vld_ls_up_1.err_info_stat.err_sym fmy_stat_puc_vld_ls_up_1.ctr_abc fmy_stat_puc_vld_ls_up_1.ctr_end_diag fmy_stat_puc_vld_ls_up_1.err_info_stat.reserved fmy_stat_puc_vld_ls_up_1.err_info_stat.lv_cdn_diag_stc fmy_stat_puc_vld_ls_up_1.err_info_stat.lv_lock_diag fmy_stat_puc_vld_ls_up_1.err_info_stat.lv_err_mem fmy_stat_puc_vld_ls_up_1.err_info_stat.lv_ready fmy_stat_puc_vld_ls_up_1.err_info_stat.lv_end_diag fmy_stat_puc_vld_ls_up_1.err_info_stat.lv_cdn_diag fmy_stat_puc_vld_ls_up_1.err_info_stat.err_sym fmy_stat_obd_vld_lsh_up_1.ctr_abc fmy_stat_obd_vld_lsh_up_1.ctr_end_diag fmy_stat_obd_vld_lsh_up_1.err_info_stat.reserved fmy_stat_obd_vld_lsh_up_1.err_info_stat.lv_cdn_diag_stc fmy_stat_obd_vld_lsh_up_1.err_info_stat.lv_lock_diag fmy_stat_obd_vld_lsh_up_1.err_info_stat.lv_err_mem fmy_stat_obd_vld_lsh_up_1.err_info_stat.lv_ready fmy_stat_obd_vld_lsh_up_1.err_info_stat.lv_end_diag fmy_stat_obd_vld_lsh_up_1.err_info_stat.lv_cdn_diag fmy_stat_obd_vld_lsh_up_1.err_info_stat.err_sym fmy_stat_shift_afl_lsl_up_1.ctr_abc fmy_stat_shift_afl_lsl_up_1.ctr_end_diag fmy_stat_shift_afl_lsl_up_1.err_info_stat.reserved fmy_stat_shift_afl_lsl_up_1.err_info_stat.lv_cdn_diag_stc fmy_stat_shift_afl_lsl_up_1.err_info_stat.lv_lock_diag fmy_stat_shift_afl_lsl_up_1.err_info_stat.lv_err_mem fmy_stat_shift_afl_lsl_up_1.err_info_stat.lv_ready fmy_stat_shift_afl_lsl_up_1.err_info_stat.lv_end_diag fmy_stat_shift_afl_lsl_up_1.err_info_stat.lv_cdn_diag fmy_stat_shift_afl_lsl_up_1.err_info_stat.err_sym fmy_stat_shift_afr_lsl_up_1.ctr_abc fmy_stat_shift_afr_lsl_up_1.ctr_end_diag fmy_stat_shift_afr_lsl_up_1.err_info_stat.reserved fmy_stat_shift_afr_lsl_up_1.err_info_stat.lv_cdn_diag_stc fmy_stat_shift_afr_lsl_up_1.err_info_stat.lv_lock_diag fmy_stat_shift_afr_lsl_up_1.err_info_stat.lv_err_mem fmy_stat_shift_afr_lsl_up_1.err_info_stat.lv_ready fmy_stat_shift_afr_lsl_up_1.err_info_stat.lv_end_diag fmy_stat_shift_afr_lsl_up_1.err_info_stat.lv_cdn_diag fmy_stat_shift_afr_lsl_up_1.err_info_stat.err_sym fmy_stat_lsh_lsl_up_1.ctr_abc fmy_stat_lsh_lsl_up_1.ctr_end_diag fmy_stat_lsh_lsl_up_1.err_info_stat.reserved fmy_stat_lsh_lsl_up_1.err_info_stat.lv_cdn_diag_stc fmy_stat_lsh_lsl_up_1.err_info_stat.lv_lock_diag fmy_stat_lsh_lsl_up_1.err_info_stat.lv_err_mem fmy_stat_lsh_lsl_up_1.err_info_stat.lv_ready fmy_stat_lsh_lsl_up_1.err_info_stat.lv_end_diag fmy_stat_lsh_lsl_up_1.err_info_stat.lv_cdn_diag fmy_stat_lsh_lsl_up_1.err_info_stat.err_sym fmy_stat_swt_ls_down_1.ctr_abc fmy_stat_swt_ls_down_1.ctr_end_diag fmy_stat_swt_ls_down_1.err_info_stat.reserved fmy_stat_swt_ls_down_1.err_info_stat.lv_cdn_diag_stc fmy_stat_swt_ls_down_1.err_info_stat.lv_lock_diag fmy_stat_swt_ls_down_1.err_info_stat.lv_err_mem fmy_stat_swt_ls_down_1.err_info_stat.lv_ready fmy_stat_swt_ls_down_1.err_info_stat.lv_end_diag fmy_stat_swt_ls_down_1.err_info_stat.lv_cdn_diag fmy_stat_swt_ls_down_1.err_info_stat.err_sym fmy_stat_pue_ls_down_1.ctr_abc fmy_stat_pue_ls_down_1.ctr_end_diag fmy_stat_pue_ls_down_1.err_info_stat.reserved fmy_stat_pue_ls_down_1.err_info_stat.lv_cdn_diag_stc fmy_stat_pue_ls_down_1.err_info_stat.lv_lock_diag fmy_stat_pue_ls_down_1.err_info_stat.lv_err_mem fmy_stat_pue_ls_down_1.err_info_stat.lv_ready fmy_stat_pue_ls_down_1.err_info_stat.lv_end_diag fmy_stat_pue_ls_down_1.err_info_stat.lv_cdn_diag fmy_stat_pue_ls_down_1.err_info_stat.err_sym fmy_stat_chg_ls_up.ctr_abc fmy_stat_chg_ls_up.ctr_end_diag fmy_stat_chg_ls_up.err_info_stat.reserved fmy_stat_chg_ls_up.err_info_stat.lv_cdn_diag_stc fmy_stat_chg_ls_up.err_info_stat.lv_lock_diag fmy_stat_chg_ls_up.err_info_stat.lv_err_mem fmy_stat_chg_ls_up.err_info_stat.lv_ready fmy_stat_chg_ls_up.err_info_stat.lv_end_diag fmy_stat_chg_ls_up.err_info_stat.lv_cdn_diag fmy_stat_chg_ls_up.err_info_stat.err_sym fmy_stat_chg_ls_down.ctr_abc fmy_stat_chg_ls_down.ctr_end_diag fmy_stat_chg_ls_down.err_info_stat.reserved fmy_stat_chg_ls_down.err_info_stat.lv_cdn_diag_stc fmy_stat_chg_ls_down.err_info_stat.lv_lock_diag fmy_stat_chg_ls_down.err_info_stat.lv_err_mem fmy_stat_chg_ls_down.err_info_stat.lv_ready fmy_stat_chg_ls_down.err_info_stat.lv_end_diag fmy_stat_chg_ls_down.err_info_stat.lv_cdn_diag fmy_stat_chg_ls_down.err_info_stat.err_sym /end OUT_MEASUREMENT
/end FUNCTION
/begin FUNCTION C_B_ERRM ""
 /begin SUB_FUNCTION ERRM_CAL_AIMOB ERRM_CAL_ADCDCDGO ERRM_CAL_APVSDIAG ERRM_CAL_AVCCDIAG ERRM_CAL_ERRM_DIAG ERRM_CAL_ATCODIAG ERRM_CAL_AEGRCTLD ERRM_CAL_AAMPDIAG ERRM_CAL_ATFU ERRM_CAL_AMAPDIAG ERRM_CAL_AMAFPLAD ERRM_CAL_AMAFANAD ERRM_CAL_ATPCDIAG ERRM_CAL_ATACDIAG ERRM_CAL_AOBDFSD ERRM_CAL_ACYBDIAG ERRM_CAL_AEGRVCAD ERRM_CAL_ATHRCAD ERRM_CAL_ABPACAD ERRM_CAL_ABYPCAD ERRM_CAL_AMAPCTLD ERRM_CAL_AOBDEGR ERRM_CAL_AVSDIAG ERRM_CAL_ACSDIAG ERRM_CAL_ABRAKE_D ERRM_CAL_ACANDGO ERRM_CAL_AVARDIAG ERRM_CAL_AAC_DIAG ERRM_CAL_ATBADIAG ERRM_CAL_AALTDIAG ERRM_CAL_AVEGRVDG ERRM_CAL_ACAPDIAG ERRM_CAL_ATCOPLAD ERRM_CAL_AEFPDIAG ERRM_CAL_ASPIDIAG ERRM_CAL_AEGRBYPD ERRM_CAL_AEGRVDHB ERRM_CAL_AINJDIAG ERRM_CAL_ADGOSPI ERRM_CAL_ARLYDIAG ERRM_CAL_AVBDIAG ERRM_CAL_AERRMON ERRM_CAL_TMO3ERRM ERRM_CAL_ENSD_DIAG ERRM_CAL_EGCP_DIAG /end SUB_FUNCTION
/end FUNCTION
/begin FUNCTION ERRM_CAL_AIMOB "Error Management Calibrations for diagnosis AIMOB"
 /begin DEF_CHARACTERISTIC fmy_id_imob.dtc[0] fmy_id_imob.envd fmy_id_imob.c_err_clas fmy_id_ecu_4.dtc[0] fmy_id_ecu_4.envd fmy_id_ecu_4.c_err_clas fmy_id_ecu_2.dtc[0] fmy_id_ecu_2.envd fmy_id_ecu_2.c_err_clas /end DEF_CHARACTERISTIC
/end FUNCTION
/begin FUNCTION ERRM_CAL_ADCDCDGO "Error Management Calibrations for diagnosis ADCDCDGO"
 /begin DEF_CHARACTERISTIC fmy_id_v_dcdc_rng.dtc[0] fmy_id_v_dcdc_rng.envd fmy_id_v_dcdc_rng.c_err_clas /end DEF_CHARACTERISTIC
/end FUNCTION
/end MODULE
/end PROJECT
