ASAP2_VERSION 1 41
/begin PROJECT SN0 "SIMOS PPD"
/begin HEADER "_default_HeaderComment" PROJECT_NO PRJ_NUM /end HEADER
/begin MODULE _default_ModuleName "_default_ModuleLongIdentifier"
/begin MOD_COMMON "_default_ModCommonComment" DEPOSIT ABSOLUTE BYTE_ORDER MSB_FIRST ALIGNMENT_BYTE 1 ALIGNMENT_WORD 2 ALIGNMENT_LONG 4 ALIGNMENT_FLOAT32_IEEE 4 ALIGNMENT_FLOAT64_IEEE 8 /end MOD_COMMON
/begin CHARACTERISTIC ip_t_gl_puc "GLOW: Wartezeit Zwischengluehen (T_Zwischen_1)" CURVE 0x85b098 _REC_CUR_20_u2_u1 6553.5 _CNV_A_R_LINEAR_____19_CM 0. 6553.5 DISPLAY_IDENTIFIER IP_T_GL_PUC FORMAT "%5.1"
 /begin AXIS_DESCR COM_AXIS tam _CNV_A_R_LINEAR_____18_CM 3 -50. 205. FORMAT "%3.0" AXIS_PTS_REF ldp_tam_ip_t_gl_puc /end AXIS_DESCR
/end CHARACTERISTIC
/begin CHARACTERISTIC ip_pwm_gl_ast "GLOW: Tastverhaeltnis Nachgluehen" MAP 0x8581fc _REC_MAP_20_u1_u2_u2 99.99600000000001 _CNV_A_R_LINEAR_____37_CM 0. 99.996 DISPLAY_IDENTIFIER IP_PWM_GL_AST FORMAT "%3.1"
 /begin AXIS_DESCR COM_AXIS mf_tot _CNV_A_R_LINEAR_____38_CM 6 0. 262.14 AXIS_PTS_REF ldp_mf_ip_pwm_gl_ast /end AXIS_DESCR
 /begin AXIS_DESCR COM_AXIS n _CNV_A_R_LINEAR_____5_CM 6 0. 6375. FORMAT "%4.0" AXIS_PTS_REF ldp_n_ip_pwm_gl_ast /end AXIS_DESCR
/end CHARACTERISTIC
/begin MEASUREMENT lv_gll "Gluehlampe" UBYTE _CNV_S_2_RANGE______11_CM 1 0. 0. 1. DISPLAY_IDENTIFIER LV_GLL ECU_ADDRESS 0x7fba18 /end MEASUREMENT
/begin MEASUREMENT pwm_gl "Tastverhaeltnis Gluehsteuergeraet" UBYTE _CNV_A_R_LINEAR_____39_CM 1 0. 0. 100. DISPLAY_IDENTIFIER PWM_GL ECU_ADDRESS 0x7fba19 FORMAT "%3.1" /end MEASUREMENT
/begin MEASUREMENT t_gl_es "Vorgluehzeit" UWORD _CNV_A_R_LINEAR_____19_CM 1 0. 0. 6553.5 DISPLAY_IDENTIFIER T_GL_ES ECU_ADDRESS 0x7f9cd0 BYTE_ORDER MSB_LAST FORMAT "%5.1" /end MEASUREMENT
/begin MEASUREMENT t_gl_ast "Nachgluehzeit" UWORD _CNV_A_R_LINEAR_____19_CM 1 0. 0. 6553.5 DISPLAY_IDENTIFIER T_GL_AST ECU_ADDRESS 0x7fa978 BYTE_ORDER MSB_LAST FORMAT "%5.1" /end MEASUREMENT
/begin MEASUREMENT tco_cor_gl "Abgleichwert Kuehlmitteltemperatur" UBYTE _CNV_A_R_LINEAR_____18_CM 1 0. -50. 205. DISPLAY_IDENTIFIER TCO_COR_GL ECU_ADDRESS 0x7fbe95 FORMAT "%3.0" /end MEASUREMENT
/begin MEASUREMENT lv_gl_boost "Pushen im naechsten Fahrzyklus erlaubt/verboten" UBYTE _CNV_S_2_RANGE______11_CM 1 0. 0. 1. DISPLAY_IDENTIFIER LV_GL_BOOST ECU_ADDRESS 0x7fba1a /end MEASUREMENT
/begin MEASUREMENT sf_gl_state "Status Gluehzeitsteuerung" UBYTE _CNV_S_6_Glow_State_40_CM 1 0. 0. 255. DISPLAY_IDENTIFIER SF_GL_STATE ECU_ADDRESS 0x7fbe91 /end MEASUREMENT
/begin MEASUREMENT lv_gl_es "glowing active at LV_ES" UBYTE _CNV_S_2_RANGE______11_CM 1 0. 0. 1. DISPLAY_IDENTIFIER LV_GL_ES ECU_ADDRESS 0x7fba1b /end MEASUREMENT
/begin MEASUREMENT lv_gl_off "Gluehaktivierung" UBYTE _CNV_S_2_RANGE______11_CM 1 0. 0. 1. DISPLAY_IDENTIFIER LV_GL_OFF ECU_ADDRESS 0x7fbe96 /end MEASUREMENT
/begin MEASUREMENT tco_cor_gl_ofs "Begrenzte Kuehlwassertemperatur" UBYTE _CNV_A_R_LINEAR_____18_CM 1 0. -50. 205. DISPLAY_IDENTIFIER TCO_COR_GL_OFS ECU_ADDRESS 0x7fba1c FORMAT "%3.0" /end MEASUREMENT
/begin MEASUREMENT lv_gl "Gluehkerzenansteuerung an/aus" UBYTE _CNV_S_2_RANGE______11_CM 1 0. 0. 1. DISPLAY_IDENTIFIER LV_GL ECU_ADDRESS 0x7fbe97 /end MEASUREMENT
/begin MEASUREMENT pwm_gl_ast "Drehzahl- und Mengenabhaengiger Vorglueh-PWM-Wert" UBYTE _CNV_A_R_LINEAR_____37_CM 1 0. 0. 99.996 DISPLAY_IDENTIFIER PWM_GL_AST ECU_ADDRESS 0x7fbe92 FORMAT "%3.1" /end MEASUREMENT
/begin MEASUREMENT t_gl_es_act "Zeit seit der Aktivierung der Vorgluehphase" UWORD _CNV_A_R_LINEAR_____19_CM 1 0. 0. 6553.5 DISPLAY_IDENTIFIER T_GL_ES_ACT ECU_ADDRESS 0x7fa97c BYTE_ORDER MSB_LAST FORMAT "%5.1" /end MEASUREMENT
/begin MEASUREMENT pwm_es "Vorglueh-PWM" UBYTE _CNV_A_R_LINEAR_____37_CM 1 0. 0. 99.996 DISPLAY_IDENTIFIER PWM_ES ECU_ADDRESS 0x7fbe93 FORMAT "%3.1" /end MEASUREMENT
/begin MEASUREMENT lv_t_gl_ast_over "Nachgluehzeit abgelaufen?" UBYTE _CNV_S_2_RANGE______11_CM 1 0. 0. 1. DISPLAY_IDENTIFIER LV_T_GL_AST_OVER ECU_ADDRESS 0x7fbe98 /end MEASUREMENT
/begin MEASUREMENT gl_mode "Gluehphasen-Indikator" UBYTE _CNV_S_5_Glow_Mode_41_CM 1 0. 1. 255. DISPLAY_IDENTIFIER GL_MODE ECU_ADDRESS 0x7fbe94 /end MEASUREMENT
/begin MEASUREMENT t_gl_ast_frozen "Eingefrorene Nachgluehzeit" UWORD _CNV_A_R_LINEAR_____19_CM 1 0. 0. 6553.5 DISPLAY_IDENTIFIER T_GL_AST_FROZEN ECU_ADDRESS 0x7fa97e BYTE_ORDER MSB_LAST FORMAT "%5.1" /end MEASUREMENT
/begin MEASUREMENT lv_t_gl_es_end "Vorgluehzeit abgelaufen?" UBYTE _CNV_S_2_RANGE______11_CM 1 0. 0. 1. DISPLAY_IDENTIFIER LV_T_GL_ES_END ECU_ADDRESS 0x7fbe99 /end MEASUREMENT
/begin MEASUREMENT lv_t12_end "Vorglueh-Boost abgelaufen?" UBYTE _CNV_S_2_RANGE______11_CM 1 0. 0. 1. DISPLAY_IDENTIFIER LV_T12_END ECU_ADDRESS 0x7fbe9a /end MEASUREMENT
/begin MEASUREMENT t12_gl_es "Vorglueh-Boost-Zeit" UWORD _CNV_A_R_LINEAR_____19_CM 1 0. 0. 6553.5 DISPLAY_IDENTIFIER T12_GL_ES ECU_ADDRESS 0x7fa980 BYTE_ORDER MSB_LAST FORMAT "%5.1" /end MEASUREMENT
/begin MEASUREMENT lv_t_gl_st_ready_end "Bereitschaftsgluehzeit abgelaufen?" UBYTE _CNV_S_2_RANGE______11_CM 1 0. 0. 1. DISPLAY_IDENTIFIER LV_T_GL_ST_READY_END ECU_ADDRESS 0x7fbe9b /end MEASUREMENT
/begin MEASUREMENT lv_gl_st_ready "Aktivierung Bereitschaftsgluehen" UBYTE _CNV_S_2_RANGE______11_CM 1 0. 0. 1. DISPLAY_IDENTIFIER LV_GL_ST_READY ECU_ADDRESS 0x7fbe9c /end MEASUREMENT
/begin MEASUREMENT lv_tco_st_low "Kuehlwassertemperatur klein genug fuer Startgluehen?" UBYTE _CNV_S_2_RANGE______11_CM 1 0. 0. 1. DISPLAY_IDENTIFIER LV_TCO_ST_LOW ECU_ADDRESS 0x7fbe9d /end MEASUREMENT
/begin MEASUREMENT lv_t_gl_st_end "Startgluehzeit abgelaufen?" UBYTE _CNV_S_2_RANGE______11_CM 1 0. 0. 1. DISPLAY_IDENTIFIER LV_T_GL_ST_END ECU_ADDRESS 0x7fbe9e /end MEASUREMENT
/begin MEASUREMENT lv_gl_st_on "Aktivierungsbedingung Startgluehen vor Abfrage auf 'Drehzahl = 0'" UBYTE _CNV_S_2_RANGE______11_CM 1 0. 0. 1. DISPLAY_IDENTIFIER LV_GL_ST_ON ECU_ADDRESS 0x7fbe9f /end MEASUREMENT
/begin MEASUREMENT lv_t_dly_gl_rly_ast_end "Relay-Schutzzeit beim Nachgluehen abgelaufen?" UBYTE _CNV_S_2_RANGE______11_CM 1 0. 0. 1. DISPLAY_IDENTIFIER LV_T_DLY_GL_RLY_AST_END ECU_ADDRESS 0x7fbea0 /end MEASUREMENT
/begin MEASUREMENT lv_n_hys_gl_ast "Drehzahl-Hysterese Nachgluehen" UBYTE _CNV_S_2_RANGE______11_CM 1 0. 0. 1. DISPLAY_IDENTIFIER LV_N_HYS_GL_AST ECU_ADDRESS 0x7fbea1 /end MEASUREMENT
/begin MEASUREMENT lv_mf_hys_gl_ast "Mengen-Hysterese Nachgluehen" UBYTE _CNV_S_2_RANGE______11_CM 1 0. 0. 1. DISPLAY_IDENTIFIER LV_MF_HYS_GL_AST ECU_ADDRESS 0x7fbea2 /end MEASUREMENT
/begin MEASUREMENT lv_dly_gl_rly_ast_act "Beginn der Relay-Schutzzeit beim Nachgluehen" UBYTE _CNV_S_2_RANGE______11_CM 1 0. 0. 1. DISPLAY_IDENTIFIER LV_DLY_GL_RLY_AST_ACT ECU_ADDRESS 0x7fbea3 /end MEASUREMENT
/begin MEASUREMENT lv_gl_ast_on "Aktivierungsbedingung Nachgluehen vor Abfrage auf 'Drehzahl = 0'" UBYTE _CNV_S_2_RANGE______11_CM 1 0. 0. 1. DISPLAY_IDENTIFIER LV_GL_AST_ON ECU_ADDRESS 0x7fbea4 /end MEASUREMENT
/begin MEASUREMENT lv_t_dly_gl_rly_puc_end "Relay-Schutzzeit beim Zwischengluehen abgelaufen?" UBYTE _CNV_S_2_RANGE______11_CM 1 0. 0. 1. DISPLAY_IDENTIFIER LV_T_DLY_GL_RLY_PUC_END ECU_ADDRESS 0x7fbea5 /end MEASUREMENT
/begin MEASUREMENT lv_dly_gl_rly_puc_act "Beginn der Relay-Schutzzeit beim Zwischengluehen" UBYTE _CNV_S_2_RANGE______11_CM 1 0. 0. 1. DISPLAY_IDENTIFIER LV_DLY_GL_RLY_PUC_ACT ECU_ADDRESS 0x7fbea6 /end MEASUREMENT
/begin MEASUREMENT lv_pull_gl_puc "Zeitlich Entprellte Bedingung 'Menge = 0', Schub-Indikator" UBYTE _CNV_S_2_RANGE______11_CM 1 0. 0. 1. DISPLAY_IDENTIFIER LV_PULL_GL_PUC ECU_ADDRESS 0x7fbea7 /end MEASUREMENT
/begin MEASUREMENT lv_pull_end_gl_puc "Zeitlich Entprellte Bedingung 'Menge > Schwelle', Indikator fuerSchub-Ende" UBYTE _CNV_S_2_RANGE______11_CM 1 0. 0. 1. DISPLAY_IDENTIFIER LV_PULL_END_GL_PUC ECU_ADDRESS 0x7fbea8 /end MEASUREMENT
/begin MEASUREMENT lv_gl_puc_on "Aktivierungsbedingung Zwischengluehen vor Abfrage auf 'Drehzahl = 0'" UBYTE _CNV_S_2_RANGE______11_CM 1 0. 0. 1. DISPLAY_IDENTIFIER LV_GL_PUC_ON ECU_ADDRESS 0x7fbea9 /end MEASUREMENT
/begin MEASUREMENT t_gl_puc "Wartezeit Zwischengluehen (T_Zwischen_1)" UWORD _CNV_A_R_LINEAR_____19_CM 1 0. 0. 6553.5 DISPLAY_IDENTIFIER T_GL_PUC ECU_ADDRESS 0x7fa982 BYTE_ORDER MSB_LAST FORMAT "%5.1" /end MEASUREMENT
/begin MEASUREMENT lv_gl_off_vb "Bateriespannungsabhaengige Gluehaktivierung" UBYTE _CNV_S_2_RANGE______11_CM 1 0. 0. 1. DISPLAY_IDENTIFIER LV_GL_OFF_VB ECU_ADDRESS 0x7fbeaa /end MEASUREMENT
/begin CHARACTERISTIC c_tco_sp_gl "Temperatur-Vorgabewert" VALUE 0x85ccc0 _REC_VAL_20_u1 255. _CNV_A_R_LINEAR_____18_CM -50. 205. DISPLAY_IDENTIFIER C_TCO_SP_GL FORMAT "%3.0" /end CHARACTERISTIC
/begin CHARACTERISTIC lc_gll "Schalter Ansteuerung Gluehanzeige (Schalter 1)" VALUE 0x85ce7c _REC_VAL_20_u1 1. _CNV_A_R_LINEAR_____0_CM 0. 1. DISPLAY_IDENTIFIER LC_GLL FORMAT "%1.0" /end CHARACTERISTIC
/begin CHARACTERISTIC c_tco_cor_gl_max "maximale Begrenzung Abgleichwert" VALUE 0x85cca3 _REC_VAL_20_u1 255. _CNV_A_R_LINEAR_____18_CM -50. 205. DISPLAY_IDENTIFIER C_TCO_COR_GL_MAX FORMAT "%3.0" /end CHARACTERISTIC
/begin CHARACTERISTIC c_tco_cor_gl_min "minimale Begrenzung Abgleichwert" VALUE 0x85cca4 _REC_VAL_20_u1 255. _CNV_A_R_LINEAR_____18_CM -50. 205. DISPLAY_IDENTIFIER C_TCO_COR_GL_MIN FORMAT "%3.0" /end CHARACTERISTIC
/begin CHARACTERISTIC c_t2_gl_es "Vorgluehen Bereich 2" VALUE 0x85cbe8 _REC_VAL_20_u2 6553.5 _CNV_A_R_LINEAR_____19_CM 0. 6553.5 DISPLAY_IDENTIFIER C_T2_GL_ES FORMAT "%5.1" /end CHARACTERISTIC
/begin CHARACTERISTIC lc_t_gl_es_amp_act "Auswahlschalter Vorgluehzeitberechnung aus AMP oder TCO" VALUE 0x85ceac _REC_VAL_20_u1 1. _CNV_A_R_LINEAR_____0_CM 0. 1. DISPLAY_IDENTIFIER LC_T_GL_ES_AMP_ACT FORMAT "%1.0" /end CHARACTERISTIC
/begin CHARACTERISTIC c_pwm_gl_st "Tastverhaeltnis Startgluehen (TV_Start)" VALUE 0x85cb7e _REC_VAL_20_u1 99.99600000000001 _CNV_A_R_LINEAR_____37_CM 0. 99.996 DISPLAY_IDENTIFIER C_PWM_GL_ST FORMAT "%3.1" /end CHARACTERISTIC
/begin CHARACTERISTIC lc_pwm_gl_st "Schalter Auswahl Tastverhaeltnis Startgluehen" VALUE 0x85cea1 _REC_VAL_20_u1 1. _CNV_A_R_LINEAR_____0_CM 0. 1. DISPLAY_IDENTIFIER LC_PWM_GL_ST FORMAT "%1.0" /end CHARACTERISTIC
/begin CHARACTERISTIC c_pwm_gl_es_1 "Tastverhaeltnis Vorgluehen Bereich 1 (TV1)" VALUE 0x85cb7b _REC_VAL_20_u1 99.99600000000001 _CNV_A_R_LINEAR_____37_CM 0. 99.996 DISPLAY_IDENTIFIER C_PWM_GL_ES_1 FORMAT "%3.1" /end CHARACTERISTIC
/begin CHARACTERISTIC c_pwm_gl_es_2 "Tastverhaeltnis Vorgluehen Bereich 2 (TV2)" VALUE 0x85cb7c _REC_VAL_20_u1 99.99600000000001 _CNV_A_R_LINEAR_____37_CM 0. 99.996 DISPLAY_IDENTIFIER C_PWM_GL_ES_2 FORMAT "%3.1" /end CHARACTERISTIC
/begin CHARACTERISTIC c_pwm_gl_es_3 "Tastverhaeltnis Vorgluehen Bereich 3 (TV3)" VALUE 0x85cb7d _REC_VAL_20_u1 99.99600000000001 _CNV_A_R_LINEAR_____37_CM 0. 99.996 DISPLAY_IDENTIFIER C_PWM_GL_ES_3 FORMAT "%3.1" /end CHARACTERISTIC
/begin CHARACTERISTIC c_t_dly_gl_rly "Verzoegerungszeit Relaisansteuerung" VALUE 0x85cc24 _REC_VAL_20_u2 6553.5 _CNV_A_R_LINEAR_____19_CM 0. 6553.5 DISPLAY_IDENTIFIER C_T_DLY_GL_RLY FORMAT "%5.1" /end CHARACTERISTIC
/begin CHARACTERISTIC c_n_max_gl "obere Drehzahlschwelle" VALUE 0x85cb1c _REC_VAL_20_u2 6375. _CNV_A_R_LINEAR_____5_CM 0. 6375. DISPLAY_IDENTIFIER C_N_MAX_GL FORMAT "%4.0" /end CHARACTERISTIC
/begin CHARACTERISTIC c_t_gl_st_ready "Startbereitschaftsgluehen" VALUE 0x85cc4a _REC_VAL_20_u2 6553.5 _CNV_A_R_LINEAR_____19_CM 0. 6553.5 DISPLAY_IDENTIFIER C_T_GL_ST_READY FORMAT "%5.1" /end CHARACTERISTIC
/begin CHARACTERISTIC c_tco_max_gl "Temperaturschwelle" VALUE 0x85ccba _REC_VAL_20_u1 255. _CNV_A_R_LINEAR_____18_CM -50. 205. DISPLAY_IDENTIFIER C_TCO_MAX_GL FORMAT "%3.0" /end CHARACTERISTIC
/begin CHARACTERISTIC c_t_gl_st "Startgluehzeit" VALUE 0x85cc48 _REC_VAL_20_u2 6553.5 _CNV_A_R_LINEAR_____19_CM 0. 6553.5 DISPLAY_IDENTIFIER C_T_GL_ST FORMAT "%5.1" /end CHARACTERISTIC
/begin CHARACTERISTIC c_n_max_gl_ast "Drehzahlschwelle Nachgluehen (Drehzahl_Gluehen)" VALUE 0x85cb1e _REC_VAL_20_u2 6375. _CNV_A_R_LINEAR_____5_CM 0. 6375. DISPLAY_IDENTIFIER C_N_MAX_GL_AST FORMAT "%4.0" /end CHARACTERISTIC
/begin CHARACTERISTIC c_mf_max_gl_ast "Mengenschwelle Nachgluehen (Menge_Gluehen)" VALUE 0x85cadc _REC_VAL_20_u2 262.14 _CNV_A_R_LINEAR_____38_CM 0. 262.14 DISPLAY_IDENTIFIER C_MF_MAX_GL_AST FORMAT "%5.3" /end CHARACTERISTIC
/begin CHARACTERISTIC c_mf_max_gl_ast_ofs "Breite der Mengenhysterese in der Nachphase" VALUE 0x85cade _REC_VAL_20_s2 262.14 _CNV_A_R_LINEAR_____38_CM -131.072 131.068 DISPLAY_IDENTIFIER C_MF_MAX_GL_AST_OFS FORMAT "%5.2" /end CHARACTERISTIC
/begin CHARACTERISTIC c_n_max_gl_ast_ofs "Breite der Drehzahlhysterese in der Nachphase" VALUE 0x85cb20 _REC_VAL_20_s2 1023.98437 _CNV_A_R_LINEAR_____42_CM -512. 511.98437 DISPLAY_IDENTIFIER C_N_MAX_GL_AST_OFS FORMAT "%3.2" /end CHARACTERISTIC
/begin CHARACTERISTIC c_t_gl_puc_3 "Wartezeit Zwischengluehen (T_Zwischen_3)" VALUE 0x85cc46 _REC_VAL_20_u2 6553.5 _CNV_A_R_LINEAR_____19_CM 0. 6553.5 DISPLAY_IDENTIFIER C_T_GL_PUC_3 FORMAT "%5.1" /end CHARACTERISTIC
/begin CHARACTERISTIC c_mf_max_gl_puc "Mengenschwelle kein Gluehen (Menge_Glueh)" VALUE 0x85cae0 _REC_VAL_20_u2 262.14 _CNV_A_R_LINEAR_____38_CM 0. 262.14 DISPLAY_IDENTIFIER C_MF_MAX_GL_PUC FORMAT "%5.3" /end CHARACTERISTIC
/begin CHARACTERISTIC c_t_gl_puc_2 "Wartezeit Zwischengluehen (T_Zwischen_2)" VALUE 0x85cc44 _REC_VAL_20_u2 6553.5 _CNV_A_R_LINEAR_____19_CM 0. 6553.5 DISPLAY_IDENTIFIER C_T_GL_PUC_2 FORMAT "%5.1" /end CHARACTERISTIC
/begin CHARACTERISTIC c_t_gl_boost "Zeit Pushen" VALUE 0x85cc42 _REC_VAL_20_u2 6553.5 _CNV_A_R_LINEAR_____19_CM 0. 6553.5 DISPLAY_IDENTIFIER C_T_GL_BOOST FORMAT "%5.1" /end CHARACTERISTIC
/begin CHARACTERISTIC c_vb_gl_bol_1 "untere Grenze Hysterese Batteriespannung" VALUE 0x85ce06 _REC_VAL_20_u1 28.8 _CNV_A_R_LINEAR_____43_CM 0. 28.8 DISPLAY_IDENTIFIER C_VB_GL_BOL_1 FORMAT "%3.1" /end CHARACTERISTIC
/begin CHARACTERISTIC c_vb_gl_tol_1 "obere Grenze Hysterese Batteriespannung" VALUE 0x85ce08 _REC_VAL_20_u1 28.8 _CNV_A_R_LINEAR_____43_CM 0. 28.8 DISPLAY_IDENTIFIER C_VB_GL_TOL_1 FORMAT "%3.1" /end CHARACTERISTIC
/begin CHARACTERISTIC c_vb_gl_bol_2 "untere Grenze Hysterese Batteriespannung" VALUE 0x85ce07 _REC_VAL_20_u1 28.8 _CNV_A_R_LINEAR_____43_CM 0. 28.8 DISPLAY_IDENTIFIER C_VB_GL_BOL_2 FORMAT "%3.1" /end CHARACTERISTIC
/begin CHARACTERISTIC c_vb_gl_tol_2 "obere Grenze Hysterese Batteriespannung" VALUE 0x85ce09 _REC_VAL_20_u1 28.8 _CNV_A_R_LINEAR_____43_CM 0. 28.8 DISPLAY_IDENTIFIER C_VB_GL_TOL_2 FORMAT "%3.1" /end CHARACTERISTIC
/begin CHARACTERISTIC lc_gl_off "Schalter Ausschalten Gluehfunktion" VALUE 0x85ce7b _REC_VAL_20_u1 1. _CNV_A_R_LINEAR_____0_CM 0. 1. DISPLAY_IDENTIFIER LC_GL_OFF FORMAT "%1.0" /end CHARACTERISTIC
/begin CHARACTERISTIC ip_t_gll "GLOW: Timer Ansteuerung Gluehlampe aus Motortemperatur" CURVE 0x85b09e _REC_CUR_20_u2_u1 6553.5 _CNV_A_R_LINEAR_____19_CM 0. 6553.5 DISPLAY_IDENTIFIER IP_T_GLL FORMAT "%5.1"
 /begin AXIS_DESCR COM_AXIS tco _CNV_A_R_LINEAR_____18_CM 4 -50. 205. FORMAT "%3.0" AXIS_PTS_REF ldp_tco_ip_t_gll /end AXIS_DESCR
/end CHARACTERISTIC
/begin AXIS_PTS ldp_tco_ip_t_gll "" 0x8423da tco _REC_AXS_20_u1 255. _CNV_A_R_LINEAR_____18_CM 4 -50. 205. FORMAT "%3.0" /end AXIS_PTS
/begin CHARACTERISTIC ip_t_gl_ast "GLOW: Nachgluehzeit aus Motortemperatur" CURVE 0x85b068 _REC_CUR_20_u2_u1 6553.5 _CNV_A_R_LINEAR_____19_CM 0. 6553.5 DISPLAY_IDENTIFIER IP_T_GL_AST FORMAT "%5.1"
 /begin AXIS_DESCR COM_AXIS tco _CNV_A_R_LINEAR_____18_CM 4 -50. 205. FORMAT "%3.0" AXIS_PTS_REF ldp_tco_ip_t_gl_ast /end AXIS_DESCR
/end CHARACTERISTIC
/begin AXIS_PTS ldp_tco_ip_t_gl_ast "" 0x8423cf tco _REC_AXS_20_u1 255. _CNV_A_R_LINEAR_____18_CM 4 -50. 205. FORMAT "%3.0" /end AXIS_PTS
/begin CHARACTERISTIC ip_t1_gl_es "GLOW: Vorgluehen Bereich 1 (Kennlinie KL2)" CURVE 0x85b04a _REC_CUR_20_u2_u1 6553.5 _CNV_A_R_LINEAR_____19_CM 0. 6553.5 DISPLAY_IDENTIFIER IP_T1_GL_ES FORMAT "%5.1"
 /begin AXIS_DESCR COM_AXIS tco _CNV_A_R_LINEAR_____18_CM 3 -50. 205. FORMAT "%3.0" AXIS_PTS_REF ldp_tco_ip_t1_gl_es /end AXIS_DESCR
/end CHARACTERISTIC
/begin AXIS_PTS ldp_tco_ip_t1_gl_es "" 0x8423c6 tco _REC_AXS_20_u1 255. _CNV_A_R_LINEAR_____18_CM 3 -50. 205. FORMAT "%3.0" /end AXIS_PTS
/begin AXIS_PTS ldp_tam_ip_t_gl_puc "" 0x842254 tam _REC_AXS_20_u1 255. _CNV_A_R_LINEAR_____18_CM 3 -50. 205. FORMAT "%3.0" /end AXIS_PTS
/begin CHARACTERISTIC ip_t_gl_es_vb "GLOW: Vorgluehen aus Batteriespannung und Wassertemperatur" MAP 0x85b084 _REC_MAP_20_u2_u1_u1 6553.5 _CNV_A_R_LINEAR_____19_CM 0. 6553.5 DISPLAY_IDENTIFIER IP_T_GL_ES_VB FORMAT "%5.1"
 /begin AXIS_DESCR COM_AXIS vb _CNV_A_R_LINEAR_____44_CM 2 0. 28.8 FORMAT "%3.1" AXIS_PTS_REF ldp_vb_ip_t_gl_es /end AXIS_DESCR
 /begin AXIS_DESCR COM_AXIS tco _CNV_A_R_LINEAR_____18_CM 5 -50. 205. FORMAT "%3.0" AXIS_PTS_REF ldp_tco_ip_t_gl_es /end AXIS_DESCR
/end CHARACTERISTIC
/begin AXIS_PTS ldp_vb_ip_t_gl_es "" 0x842a90 vb _REC_AXS_20_u1 28.8 _CNV_A_R_LINEAR_____44_CM 2 0. 28.8 FORMAT "%3.1" /end AXIS_PTS
/begin AXIS_PTS ldp_tco_ip_t_gl_es "" 0x8423d4 tco _REC_AXS_20_u1 255. _CNV_A_R_LINEAR_____18_CM 5 -50. 205. FORMAT "%3.0" /end AXIS_PTS
/begin CHARACTERISTIC ip_t_gl_es_amp "GLOW: Vorgluehen aus Atmosphaerendruck und Wassertemperatur" MAP 0x85b070 _REC_MAP_20_u2_u2_u1 6553.5 _CNV_A_R_LINEAR_____19_CM 0. 6553.5 DISPLAY_IDENTIFIER IP_T_GL_ES_AMP FORMAT "%5.1"
 /begin AXIS_DESCR COM_AXIS amp _CNV_A_R_LINEAR_____45_CM 2 0. 5434. FORMAT "%6.2" AXIS_PTS_REF ldp_amp_ip_t_gl_es /end AXIS_DESCR
 /begin AXIS_DESCR COM_AXIS tco _CNV_A_R_LINEAR_____18_CM 5 -50. 205. FORMAT "%3.0" AXIS_PTS_REF ldp_tco_ip_t_gl_es /end AXIS_DESCR
/end CHARACTERISTIC
/begin AXIS_PTS ldp_amp_ip_t_gl_es "" 0x841328 amp _REC_AXS_20_u2 5434. _CNV_A_R_LINEAR_____45_CM 2 0. 5434. FORMAT "%6.2" /end AXIS_PTS
/begin AXIS_PTS ldp_mf_ip_pwm_gl_ast "" 0x8418a8 mf_tot _REC_AXS_20_u2 262.14 _CNV_A_R_LINEAR_____38_CM 6 0. 262.14 /end AXIS_PTS
/begin AXIS_PTS ldp_n_ip_pwm_gl_ast "" 0x841cea n _REC_AXS_20_u2 6375. _CNV_A_R_LINEAR_____5_CM 6 0. 6375. FORMAT "%4.0" /end AXIS_PTS
/begin MEASUREMENT t1_gl_es "Kuehlwassertemperaturabhaengige Vorglueh-Boost-Zeit (Boost-Bereich 1)" UWORD _CNV_A_R_LINEAR_____19_CM 1 0. 0. 6553.5 DISPLAY_IDENTIFIER T1_GL_ES ECU_ADDRESS 0x7fa97a BYTE_ORDER MSB_LAST FORMAT "%5.1" /end MEASUREMENT
/begin MEASUREMENT t3_gl_es "T3, Dauer des letzten Teils der Startgluehphase" UWORD _CNV_A_R_LINEAR_____19_CM 1 0. 0. 6553.5 DISPLAY_IDENTIFIER T3_GL_ES ECU_ADDRESS 0x7f9cd2 BYTE_ORDER MSB_LAST FORMAT "%5.1" /end MEASUREMENT
/begin MEASUREMENT t2_gl_es "T2, Dauer des zweiten Teils der Startgluehphase" UWORD _CNV_A_R_LINEAR_____19_CM 1 0. 0. 6553.5 DISPLAY_IDENTIFIER T2_GL_ES ECU_ADDRESS 0x7f9cd4 BYTE_ORDER MSB_LAST FORMAT "%5.1" /end MEASUREMENT
/begin MEASUREMENT v_tfu "fuel temperature (voltage)" UWORD _CNV_A_R_LINEAR_____28_CM 1 0. 0. 4.9951171875 DISPLAY_IDENTIFIER V_TFU ECU_ADDRESS 0x7fa160 BYTE_ORDER MSB_LAST FORMAT "%3.2" /end MEASUREMENT
/begin MEASUREMENT tfu_mes "measured fuel temperature" UBYTE _CNV_A_R_LINEAR_____18_CM 1 0. -50. 205. DISPLAY_IDENTIFIER TFU_MES ECU_ADDRESS 0x7fbb64 FORMAT "%3.0" /end MEASUREMENT
/begin MEASUREMENT tfu "fuel temperature" UBYTE _CNV_A_R_LINEAR_____18_CM 1 0. -50. 205. DISPLAY_IDENTIFIER TFU ECU_ADDRESS 0x7fbb65 FORMAT "%3.0" /end MEASUREMENT
/begin CHARACTERISTIC c_tfu_sub_diag "fuel temperature substitude value" VALUE 0x85ccfb _REC_VAL_20_u1 255. _CNV_A_R_LINEAR_____18_CM -50. 205. DISPLAY_IDENTIFIER C_TFU_SUB_DIAG FORMAT "%3.0" /end CHARACTERISTIC
/begin CHARACTERISTIC ip_tfu_mes__v_tfu "TFU sensor map" CURVE 0x85b1c4 _REC_CUR_20_u1_u2 255. _CNV_A_R_LINEAR_____18_CM -50. 205. DISPLAY_IDENTIFIER IP_TFU_MES__V_TFU FORMAT "%3.0"
 /begin AXIS_DESCR COM_AXIS v_tfu _CNV_A_R_LINEAR_____28_CM 16 0. 4.9951171875 FORMAT "%3.2" AXIS_PTS_REF ldp_v_tfu_ip_tfu_mes /end AXIS_DESCR
/end CHARACTERISTIC
/begin AXIS_PTS ldp_v_tfu_ip_tfu_mes "" 0x842a62 v_tfu _REC_AXS_20_u2 4.9951171875 _CNV_A_R_LINEAR_____28_CM 16 0. 4.9951171875 FORMAT "%3.2" /end AXIS_PTS
/begin MEASUREMENT n_pred "predicted engine speed" UWORD _CNV_A_R_LINEAR_____5_CM 1 0. 0. 8160. DISPLAY_IDENTIFIER N_PRED ECU_ADDRESS 0x7fa11a BYTE_ORDER MSB_LAST FORMAT "%4.0" /end MEASUREMENT
/begin MEASUREMENT t_mmv "segment time moving average over 720°CRK" UWORD _CNV_A_R_LINEAR_____61_CM 1 0. 0. 2.09712 DISPLAY_IDENTIFIER T_MMV ECU_ADDRESS 0x7fa116 BYTE_ORDER MSB_LAST FORMAT "%7.6" /end MEASUREMENT
/begin MEASUREMENT t_seg_mis "Shifted segment time for misfire detection and engine roughness calculation" UWORD _CNV_A_R_LINEAR_____62_CM 1 0. 0. 6.5536e-002 DISPLAY_IDENTIFIER T_SEG_MIS ECU_ADDRESS 0x7fa114 BYTE_ORDER MSB_LAST FORMAT "%7.6" /end MEASUREMENT
/begin MEASUREMENT tab_t_seg[0] "segment time for each cylinder" UWORD _CNV_A_R_LINEAR_____63_CM 1 0. 0. 0.26214 DISPLAY_IDENTIFIER TAB_T_SEG_0_ ECU_ADDRESS 0x7fa124 BYTE_ORDER MSB_LAST FORMAT "%7.6" /end MEASUREMENT
/begin MEASUREMENT tab_t_seg[1] "segment time for each cylinder" UWORD _CNV_A_R_LINEAR_____63_CM 1 0. 0. 0.26214 DISPLAY_IDENTIFIER TAB_T_SEG_1_ ECU_ADDRESS 0x7fa126 BYTE_ORDER MSB_LAST FORMAT "%7.6" /end MEASUREMENT
/begin MEASUREMENT tab_t_seg[2] "segment time for each cylinder" UWORD _CNV_A_R_LINEAR_____63_CM 1 0. 0. 0.26214 DISPLAY_IDENTIFIER TAB_T_SEG_2_ ECU_ADDRESS 0x7fa128 BYTE_ORDER MSB_LAST FORMAT "%7.6" /end MEASUREMENT
/begin MEASUREMENT tab_t_seg[3] "segment time for each cylinder" UWORD _CNV_A_R_LINEAR_____63_CM 1 0. 0. 0.26214 DISPLAY_IDENTIFIER TAB_T_SEG_3_ ECU_ADDRESS 0x7fa12a BYTE_ORDER MSB_LAST FORMAT "%7.6" /end MEASUREMENT
/begin MEASUREMENT t_seg_clc_red_tab[0] "array of segment times for segment tasks groups 0,1,2,3 and 4" UWORD _CNV_A_R_LINEAR_____64_CM 1 0. 0. 4.19424 DISPLAY_IDENTIFIER T_SEG_CLC_RED_TAB_0_ ECU_ADDRESS 0x7fa12c BYTE_ORDER MSB_LAST FORMAT "%7.6" /end MEASUREMENT
/begin MEASUREMENT t_seg_clc_red_tab[1] "array of segment times for segment tasks groups 0,1,2,3 and 4" UWORD _CNV_A_R_LINEAR_____64_CM 1 0. 0. 4.19424 DISPLAY_IDENTIFIER T_SEG_CLC_RED_TAB_1_ ECU_ADDRESS 0x7fa12e BYTE_ORDER MSB_LAST FORMAT "%7.6" /end MEASUREMENT
/begin MEASUREMENT t_seg_clc_red_tab[2] "array of segment times for segment tasks groups 0,1,2,3 and 4" UWORD _CNV_A_R_LINEAR_____64_CM 1 0. 0. 4.19424 DISPLAY_IDENTIFIER T_SEG_CLC_RED_TAB_2_ ECU_ADDRESS 0x7fa130 BYTE_ORDER MSB_LAST FORMAT "%7.6" /end MEASUREMENT
/begin MEASUREMENT t_seg_clc_red_tab[3] "array of segment times for segment tasks groups 0,1,2,3 and 4" UWORD _CNV_A_R_LINEAR_____64_CM 1 0. 0. 4.19424 DISPLAY_IDENTIFIER T_SEG_CLC_RED_TAB_3_ ECU_ADDRESS 0x7fa132 BYTE_ORDER MSB_LAST FORMAT "%7.6" /end MEASUREMENT
/begin MEASUREMENT t_seg_clc_red_tab[4] "array of segment times for segment tasks groups 0,1,2,3 and 4" UWORD _CNV_A_R_LINEAR_____64_CM 1 0. 0. 4.19424 DISPLAY_IDENTIFIER T_SEG_CLC_RED_TAB_4_ ECU_ADDRESS 0x7fa134 BYTE_ORDER MSB_LAST FORMAT "%7.6" /end MEASUREMENT
/begin MEASUREMENT t_seg_4 "segment time with special resolution" UWORD _CNV_A_R_LINEAR_____64_CM 1 0. 0. 4.19424 DISPLAY_IDENTIFIER T_SEG_4 ECU_ADDRESS 0x7fa118 BYTE_ORDER MSB_LAST FORMAT "%7.6" /end MEASUREMENT
/begin MEASUREMENT t_seg_clc_red "segment time for segment tasks groups 0,1,2,3 and 4" UWORD _CNV_A_R_LINEAR_____64_CM 1 0. 0. 4.19424 DISPLAY_IDENTIFIER T_SEG_CLC_RED ECU_ADDRESS 0x7fa136 BYTE_ORDER MSB_LAST FORMAT "%7.6" /end MEASUREMENT
/begin MEASUREMENT cyl_nr "Actual segment number (from 0 to NC_CYL_NR - 1)" UBYTE _CNV_A_R_LINEAR_____0_CM 1 0. 0. 7. DISPLAY_IDENTIFIER CYL_NR ECU_ADDRESS 0x7fbb59 FORMAT "%3.0" /end MEASUREMENT
/begin MEASUREMENT ptr_seg_clc "next element of segment time array to compute" UBYTE _CNV_A_R_LINEAR_____0_CM 1 0. 1. 4. DISPLAY_IDENTIFIER PTR_SEG_CLC ECU_ADDRESS 0x7fbb5a FORMAT "%3.0" /end MEASUREMENT
/begin MEASUREMENT n_sp_is_cor_max "Corrected engine speed setpoint before limitation to maximum allowed engine speed" UWORD _CNV_A_R_LINEAR_____5_CM 1 0. 0. 8160. DISPLAY_IDENTIFIER N_SP_IS_COR_MAX ECU_ADDRESS 0x7f9cd6 BYTE_ORDER MSB_LAST FORMAT "%4.0" /end MEASUREMENT
/begin MEASUREMENT n_sp_is "Final engine speed setpoint" UWORD _CNV_A_R_LINEAR_____5_CM 1 0. 0. 8160. DISPLAY_IDENTIFIER N_SP_IS ECU_ADDRESS 0x7f9cd8 BYTE_ORDER MSB_LAST FORMAT "%4.0" /end MEASUREMENT
/begin MEASUREMENT lv_n_sp_is_max_1 "Report setpoint increase step 1 to CAN" UBYTE _CNV_S_2_RANGE______11_CM 1 0. 0. 1. DISPLAY_IDENTIFIER LV_N_SP_IS_MAX_1 ECU_ADDRESS 0x7fba1e /end MEASUREMENT
/begin MEASUREMENT lv_n_sp_is_max_2 "Report setpoint increase step 2 to CAN" UBYTE _CNV_S_2_RANGE______11_CM 1 0. 0. 1. DISPLAY_IDENTIFIER LV_N_SP_IS_MAX_2 ECU_ADDRESS 0x7fba1f /end MEASUREMENT
/begin MEASUREMENT n_sp_is_cor "Corrected engine speed setpoint" UWORD _CNV_A_R_LINEAR_____5_CM 1 0. 0. 8160. DISPLAY_IDENTIFIER N_SP_IS_COR ECU_ADDRESS 0x7f9cda BYTE_ORDER MSB_LAST FORMAT "%4.0" /end MEASUREMENT
/begin MEASUREMENT n_sp_is_cvt "Engine speed setpoint for CVT transmission" UWORD _CNV_A_R_LINEAR_____5_CM 1 0. 0. 8160. DISPLAY_IDENTIFIER N_SP_IS_CVT ECU_ADDRESS 0x7f9cdc BYTE_ORDER MSB_LAST FORMAT "%4.0" /end MEASUREMENT
/begin MEASUREMENT n_sp_is_lim "Engine speed setpoint after limitation to maximum allowed value" UWORD _CNV_A_R_LINEAR_____5_CM 1 0. 0. 8160. DISPLAY_IDENTIFIER N_SP_IS_LIM ECU_ADDRESS 0x7f9cde BYTE_ORDER MSB_LAST FORMAT "%4.0" /end MEASUREMENT
/begin MEASUREMENT n_sp_is_pf_rgn "Increased idle speed setpoint for pf regeneration" UWORD _CNV_A_R_LINEAR_____5_CM 1 0. 0. 8160. DISPLAY_IDENTIFIER N_SP_IS_PF_RGN ECU_ADDRESS 0x7f9ce0 BYTE_ORDER MSB_LAST FORMAT "%4.0" /end MEASUREMENT
/begin MEASUREMENT lv_tpc_thd_is_sp_pf "Temperature pre catalyst is above threshold for after treatment" UBYTE _CNV_S_2_RANGE______11_CM 1 0. 0. 1. DISPLAY_IDENTIFIER LV_TPC_THD_IS_SP_PF ECU_ADDRESS 0x7fba20 /end MEASUREMENT
/begin MEASUREMENT lv_pf_rgn_is_act "PF regenration is active" UBYTE _CNV_S_2_RANGE______11_CM 1 0. 0. 1. DISPLAY_IDENTIFIER LV_PF_RGN_IS_ACT ECU_ADDRESS 0x7fba21 /end MEASUREMENT
/begin MEASUREMENT lv_n_sp_is_inc_pf_set "Increased idle speed setpoint for pf regeneration is set" UBYTE _CNV_S_2_RANGE______11_CM 1 0. 0. 1. DISPLAY_IDENTIFIER LV_N_SP_IS_INC_PF_SET ECU_ADDRESS 0x7fba22 /end MEASUREMENT
/begin MEASUREMENT lv_n_sp_is_inc_pf_rst "Increased idle speed setpoint for pf regeneration not active" UBYTE _CNV_S_2_RANGE______11_CM 1 0. 0. 1. DISPLAY_IDENTIFIER LV_N_SP_IS_INC_PF_RST ECU_ADDRESS 0x7fba23 /end MEASUREMENT
/begin MEASUREMENT lv_is_ac "Engine speed setpoint requested by air conditioning system" UBYTE _CNV_S_2_RANGE______11_CM 1 0. 0. 1. DISPLAY_IDENTIFIER LV_IS_AC ECU_ADDRESS 0x7fbeab /end MEASUREMENT
/begin MEASUREMENT lv_n_sp_is_driv "Bit indicating driver intervention" UBYTE _CNV_S_2_RANGE______11_CM 1 0. 0. 1. DISPLAY_IDENTIFIER LV_N_SP_IS_DRIV ECU_ADDRESS 0x7fbeac /end MEASUREMENT
/begin MEASUREMENT lv_n_sp_is_eng "indicates engine speed request by hot idle conditions" UBYTE _CNV_S_2_RANGE______11_CM 1 0. 0. 1. DISPLAY_IDENTIFIER LV_N_SP_IS_ENG ECU_ADDRESS 0x7fbead /end MEASUREMENT
/begin MEASUREMENT lv_n_sp_is_ext "Engine speed setpoint request step 1" UBYTE _CNV_S_2_RANGE______11_CM 1 0. 0. 1. DISPLAY_IDENTIFIER LV_N_SP_IS_EXT ECU_ADDRESS 0x7fbeae /end MEASUREMENT
/begin MEASUREMENT lv_n_sp_is_ext_2 "Engine speed setpoint request step 2" UBYTE _CNV_S_2_RANGE______11_CM 1 0. 0. 1. DISPLAY_IDENTIFIER LV_N_SP_IS_EXT_2 ECU_ADDRESS 0x7fbeaf /end MEASUREMENT
/begin MEASUREMENT n_sp_is_ac "Engine speed setpoint for air conditioning system" UWORD _CNV_A_R_LINEAR_____5_CM 1 0. 0. 8160. DISPLAY_IDENTIFIER N_SP_IS_AC ECU_ADDRESS 0x7fa984 BYTE_ORDER MSB_LAST FORMAT "%4.0" /end MEASUREMENT
/begin MEASUREMENT lv_is_bsg "Request by energy management control unit" UBYTE _CNV_S_2_RANGE______11_CM 1 0. 0. 1. DISPLAY_IDENTIFIER LV_IS_BSG ECU_ADDRESS 0x7fbeb0 /end MEASUREMENT
/begin MEASUREMENT n_sp_is_bsg "Engine speed setpoint step 1" UWORD _CNV_A_R_LINEAR_____5_CM 1 0. 0. 8160. DISPLAY_IDENTIFIER N_SP_IS_BSG ECU_ADDRESS 0x7fa986 BYTE_ORDER MSB_LAST FORMAT "%4.0" /end MEASUREMENT
/begin MEASUREMENT n_sp_is_cor_driv "Engine speed setpoint after driver intervention" UWORD _CNV_A_R_LINEAR_____5_CM 1 0. 0. 8160. DISPLAY_IDENTIFIER N_SP_IS_COR_DRIV ECU_ADDRESS 0x7fa988 BYTE_ORDER MSB_LAST FORMAT "%4.0" /end MEASUREMENT
/begin MEASUREMENT n_sp_is_eng "Engine speed setpoint by internal request" UWORD _CNV_A_R_LINEAR_____5_CM 1 0. 0. 8160. DISPLAY_IDENTIFIER N_SP_IS_ENG ECU_ADDRESS 0x7fa98a BYTE_ORDER MSB_LAST FORMAT "%4.0" /end MEASUREMENT
/begin MEASUREMENT lv_is_ramp "Engine speed setpoint ramp-up" UBYTE _CNV_S_2_RANGE______11_CM 1 0. 0. 1. DISPLAY_IDENTIFIER LV_IS_RAMP ECU_ADDRESS 0x7fbeb1 /end MEASUREMENT
/begin MEASUREMENT n_sp_is_ext "Engine speed setpoint including air conditioning, low voltage and engery management needs" UWORD _CNV_A_R_LINEAR_____5_CM 1 0. 0. 8160. DISPLAY_IDENTIFIER N_SP_IS_EXT ECU_ADDRESS 0x7fa98c BYTE_ORDER MSB_LAST FORMAT "%4.0" /end MEASUREMENT
/begin MEASUREMENT n_sp_is_ext_2 "Engine speed setpoint for energy management system step 2" UWORD _CNV_A_R_LINEAR_____5_CM 1 0. 0. 8160. DISPLAY_IDENTIFIER N_SP_IS_EXT_2 ECU_ADDRESS 0x7fa98e BYTE_ORDER MSB_LAST FORMAT "%4.0" /end MEASUREMENT
/begin MEASUREMENT n_sp_is_ext_2_ramp "Engine speed setpoint step 2 for ramp-up" UWORD _CNV_A_R_LINEAR_____5_CM 1 0. 0. 8160. DISPLAY_IDENTIFIER N_SP_IS_EXT_2_RAMP ECU_ADDRESS 0x7fa990 BYTE_ORDER MSB_LAST FORMAT "%4.0" /end MEASUREMENT
/begin MEASUREMENT n_sp_is_ext_req "Engine speed setpoint requested by air conditioning system, low voltage or energy management system" UWORD _CNV_A_R_LINEAR_____5_CM 1 0. 0. 8160. DISPLAY_IDENTIFIER N_SP_IS_EXT_REQ ECU_ADDRESS 0x7fa992 BYTE_ORDER MSB_LAST FORMAT "%4.0" /end MEASUREMENT
/begin MEASUREMENT n_sp_is_ramp "Engine speed put out of gradient limiter" UWORD _CNV_A_R_LINEAR_____5_CM 1 0. 0. 8160. DISPLAY_IDENTIFIER N_SP_IS_RAMP ECU_ADDRESS 0x7fa994 BYTE_ORDER MSB_LAST FORMAT "%4.0" /end MEASUREMENT
/begin MEASUREMENT n_sp_is_ramp_tar "Engine speed setpoint target for ramp-up" UWORD _CNV_A_R_LINEAR_____5_CM 1 0. 0. 8160. DISPLAY_IDENTIFIER N_SP_IS_RAMP_TAR ECU_ADDRESS 0x7fa996 BYTE_ORDER MSB_LAST FORMAT "%4.0" /end MEASUREMENT
/begin MEASUREMENT n_sp_is_vb "Engine speed setpoint requested by low voltage" UWORD _CNV_A_R_LINEAR_____5_CM 1 0. 0. 8160. DISPLAY_IDENTIFIER N_SP_IS_VB ECU_ADDRESS 0x7fa998 BYTE_ORDER MSB_LAST FORMAT "%4.0" /end MEASUREMENT
/begin MEASUREMENT lv_is_ramp_act "Engine speed setpoint ramp-up active" UBYTE _CNV_S_2_RANGE______11_CM 1 0. 0. 1. DISPLAY_IDENTIFIER LV_IS_RAMP_ACT ECU_ADDRESS 0x7fbeb2 /end MEASUREMENT
/begin MEASUREMENT n_sp_is_vecu_2 "Internal engine speed setpoint variable" UWORD _CNV_A_R_LINEAR_____5_CM 1 0. 0. 8160. DISPLAY_IDENTIFIER N_SP_IS_VECU_2 ECU_ADDRESS 0x7fa99a BYTE_ORDER MSB_LAST FORMAT "%4.0" /end MEASUREMENT
/begin MEASUREMENT lv_is_ramp_ena "Engine speed setpoint ramp-up enabled" UBYTE _CNV_S_2_RANGE______11_CM 1 0. 0. 1. DISPLAY_IDENTIFIER LV_IS_RAMP_ENA ECU_ADDRESS 0x7fbeb3 /end MEASUREMENT
/begin MEASUREMENT lv_is_ramp_req "Engine speed setpoint ramp-up requested" UBYTE _CNV_S_2_RANGE______11_CM 1 0. 0. 1. DISPLAY_IDENTIFIER LV_IS_RAMP_REQ ECU_ADDRESS 0x7fbeb4 /end MEASUREMENT
/begin MEASUREMENT lv_is_ub "Engine speed setpoint request by low voltage" UBYTE _CNV_S_2_RANGE______11_CM 1 0. 0. 1. DISPLAY_IDENTIFIER LV_IS_UB ECU_ADDRESS 0x7fbeb5 /end MEASUREMENT
/begin MEASUREMENT lv_n_sp_is_ramp_max "Engine speed setpoint ramp reached maximum" UBYTE _CNV_S_2_RANGE______11_CM 1 0. 0. 1. DISPLAY_IDENTIFIER LV_N_SP_IS_RAMP_MAX ECU_ADDRESS 0x7fbeb6 /end MEASUREMENT
/begin CHARACTERISTIC lc_n_sp_is_tcu_ena "Engine speed setpoint request by transmission control unit enabled" VALUE 0x85015e _REC_VAL_20_u1 1. _CNV_A_R_LINEAR_____0_CM 0. 1. DISPLAY_IDENTIFIER LC_N_SP_IS_TCU_ENA FORMAT "%1.0" /end CHARACTERISTIC
/begin CHARACTERISTIC c_n_sp_is_dn_cvt "Engine speed setpoint change for CVT transmission" VALUE 0x84fe1a _REC_VAL_20_u2 8160. _CNV_A_R_LINEAR_____5_CM 0. 8160. DISPLAY_IDENTIFIER C_N_SP_IS_DN_CVT FORMAT "%4.0" /end CHARACTERISTIC
/begin CHARACTERISTIC c_lih_n_sp_is "Engine speed setpoint requested by limp-home manager" VALUE 0x84fd9a _REC_VAL_20_u2 8160. _CNV_A_R_LINEAR_____5_CM 0. 8160. DISPLAY_IDENTIFIER C_LIH_N_SP_IS FORMAT "%4.0" /end CHARACTERISTIC
/begin CHARACTERISTIC c_n_sp_is_max "Maximum allowed engine speed setpoint" VALUE 0x84fe1c _REC_VAL_20_u2 8160. _CNV_A_R_LINEAR_____5_CM 0. 8160. DISPLAY_IDENTIFIER C_N_SP_IS_MAX FORMAT "%4.0" /end CHARACTERISTIC
/begin CHARACTERISTIC c_n_sp_is_ofs "Hysteresis for engine speed setpoint increase" VALUE 0x84fe1e _REC_VAL_20_u2 8160. _CNV_A_R_LINEAR_____5_CM 0. 8160. DISPLAY_IDENTIFIER C_N_SP_IS_OFS FORMAT "%4.0" /end CHARACTERISTIC
/begin CHARACTERISTIC c_t_dly_n_sp "Delayed time for activation of some functions of engine speed setpoint calculation after engine start" VALUE 0x84ff6a _REC_VAL_20_u2 6553.5 _CNV_A_R_LINEAR_____19_CM 0. 6553.5 DISPLAY_IDENTIFIER C_T_DLY_N_SP FORMAT "%5.1" /end CHARACTERISTIC
/begin CHARACTERISTIC lc_is_ub_ena "Enables increase of engine speed setpoint in case of low voltage" VALUE 0x850149 _REC_VAL_20_u1 1. _CNV_A_R_LINEAR_____0_CM 0. 1. DISPLAY_IDENTIFIER LC_IS_UB_ENA FORMAT "%1.0" /end CHARACTERISTIC
/begin CHARACTERISTIC lc_is_ac_ena "Enables increase of engine speed setpoint for air conditioning" VALUE 0x850135 _REC_VAL_20_u1 1. _CNV_A_R_LINEAR_____0_CM 0. 1. DISPLAY_IDENTIFIER LC_IS_AC_ENA FORMAT "%1.0" /end CHARACTERISTIC
/begin CHARACTERISTIC lc_is_ramp_ub_req "Enables engine speed setpoint ramp-up for low voltage" VALUE 0x850145 _REC_VAL_20_u1 1. _CNV_A_R_LINEAR_____0_CM 0. 1. DISPLAY_IDENTIFIER LC_IS_RAMP_UB_REQ FORMAT "%1.0" /end CHARACTERISTIC
/begin CHARACTERISTIC lc_is_ramp_vecu_1_req "Enables engine speed setpoint ramp-up step 1 without driver intervention" VALUE 0x850146 _REC_VAL_20_u1 1. _CNV_A_R_LINEAR_____0_CM 0. 1. DISPLAY_IDENTIFIER LC_IS_RAMP_VECU_1_REQ FORMAT "%1.0" /end CHARACTERISTIC
/begin CHARACTERISTIC lc_is_bem_1_ena "Enables engine speed setpoint request step 1" VALUE 0x850139 _REC_VAL_20_u1 1. _CNV_A_R_LINEAR_____0_CM 0. 1. DISPLAY_IDENTIFIER LC_IS_BEM_1_ENA FORMAT "%1.0" /end CHARACTERISTIC
/begin CHARACTERISTIC lc_is_bem_2_ena "Enables engine speed setpoint request step 2" VALUE 0x85013a _REC_VAL_20_u1 1. _CNV_A_R_LINEAR_____0_CM 0. 1. DISPLAY_IDENTIFIER LC_IS_BEM_2_ENA FORMAT "%1.0" /end CHARACTERISTIC
/begin CHARACTERISTIC lc_is_ramp_vecu_2_req "Enables engine speed setpoint ramp-up step 2 without driver intervention" VALUE 0x850147 _REC_VAL_20_u1 1. _CNV_A_R_LINEAR_____0_CM 0. 1. DISPLAY_IDENTIFIER LC_IS_RAMP_VECU_2_REQ FORMAT "%1.0" /end CHARACTERISTIC
/begin CHARACTERISTIC lc_is_ramp_ac_req "Enables engine speed setpoint request by air conditioning system" VALUE 0x85013f _REC_VAL_20_u1 1. _CNV_A_R_LINEAR_____0_CM 0. 1. DISPLAY_IDENTIFIER LC_IS_RAMP_AC_REQ FORMAT "%1.0" /end CHARACTERISTIC
/begin CHARACTERISTIC lc_is_vecu_1_ena "Enable engine speed setpoint request step 1 by energy management control unit" VALUE 0x85014a _REC_VAL_20_u1 1. _CNV_A_R_LINEAR_____0_CM 0. 1. DISPLAY_IDENTIFIER LC_IS_VECU_1_ENA FORMAT "%1.0" /end CHARACTERISTIC
/begin CHARACTERISTIC lc_is_vecu_2_ena "Enable engine speed setpoint request step 2 by energy management control unit" VALUE 0x85014b _REC_VAL_20_u1 1. _CNV_A_R_LINEAR_____0_CM 0. 1. DISPLAY_IDENTIFIER LC_IS_VECU_2_ENA FORMAT "%1.0" /end CHARACTERISTIC
/begin CHARACTERISTIC c_n_ofs_set_is_sp_pf "engine speed offset for activating idle speed setpoint increase for PF" VALUE 0x84fdfe _REC_VAL_20_u2 8160. _CNV_A_R_LINEAR_____5_CM 0. 8160. DISPLAY_IDENTIFIER C_N_OFS_SET_IS_SP_PF FORMAT "%4.0" /end CHARACTERISTIC
/begin CHARACTERISTIC c_state_rgn_pf "filter mask for activation of idle speed setpoint increase for PF" VALUE 0x84fefe _REC_VAL_20_u2 65535. _CNV_A_R_LINEAR_____0_CM 0. 65535. DISPLAY_IDENTIFIER C_STATE_RGN_PF FORMAT "%5.0" /end CHARACTERISTIC
/begin CHARACTERISTIC c_temp_thd_is_sp_pf "Temperature pre catalyst threshold" VALUE 0x850030 _REC_VAL_20_u2 1024. _CNV_A_R_LINEAR_____51_CM 0. 1024. DISPLAY_IDENTIFIER C_TEMP_THD_IS_SP_PF FORMAT "%6.2" /end CHARACTERISTIC
/begin CHARACTERISTIC c_n_ofs_rst_is_sp_pf "engine speed offset for deactivating idle speed setpoint increase for PF" VALUE 0x84fdfc _REC_VAL_20_u2 8160. _CNV_A_R_LINEAR_____5_CM 0. 8160. DISPLAY_IDENTIFIER C_N_OFS_RST_IS_SP_PF FORMAT "%4.0" /end CHARACTERISTIC
/begin CHARACTERISTIC lc_is_acin "Enables engine speed setpoint request by air conditioning system" VALUE 0x850138 _REC_VAL_20_u1 1. _CNV_A_R_LINEAR_____0_CM 0. 1. DISPLAY_IDENTIFIER LC_IS_ACIN FORMAT "%1.0" /end CHARACTERISTIC
/begin CHARACTERISTIC lc_is_accin_on "Enables engine speed setpoint request by air condition compressor" VALUE 0x850137 _REC_VAL_20_u1 1. _CNV_A_R_LINEAR_____0_CM 0. 1. DISPLAY_IDENTIFIER LC_IS_ACCIN_ON FORMAT "%1.0" /end CHARACTERISTIC
/begin CHARACTERISTIC lc_is_ac_sw "Enable engine speed setpoint request by air condition switch" VALUE 0x850136 _REC_VAL_20_u1 1. _CNV_A_R_LINEAR_____0_CM 0. 1. DISPLAY_IDENTIFIER LC_IS_AC_SW FORMAT "%1.0" /end CHARACTERISTIC
/begin CHARACTERISTIC c_hi_tco_thd "Threshold on temperature of cooleant for hot idle state detection" VALUE 0x84fd66 _REC_VAL_20_u1 255. _CNV_A_R_LINEAR_____18_CM -50. 205. DISPLAY_IDENTIFIER C_HI_TCO_THD FORMAT "%3.0" /end CHARACTERISTIC
/begin CHARACTERISTIC c_hi_tia_thd "Threshold on intake air temperature for hot idle detection" VALUE 0x84fd67 _REC_VAL_20_u1 255. _CNV_A_R_LINEAR_____18_CM -50. 205. DISPLAY_IDENTIFIER C_HI_TIA_THD FORMAT "%3.0" /end CHARACTERISTIC
/begin CHARACTERISTIC c_hi_toil_thd "Threshold on oil temperature for hot idle state detection" VALUE 0x84fd68 _REC_VAL_20_u1 200. _CNV_A_R_LINEAR_____65_CM -40. 160. DISPLAY_IDENTIFIER C_HI_TOIL_THD FORMAT "%3.0" /end CHARACTERISTIC
/begin CHARACTERISTIC lc_is_hi_ena "Enables engine speed request in hot idle state" VALUE 0x85013b _REC_VAL_20_u1 1. _CNV_A_R_LINEAR_____0_CM 0. 1. DISPLAY_IDENTIFIER LC_IS_HI_ENA FORMAT "%1.0" /end CHARACTERISTIC
/begin CHARACTERISTIC c_tco_max_vb_n_sp "Maximum temperature of cooleant to allow engine speed setpoint request by low voltage" VALUE 0x85001f _REC_VAL_20_u1 255. _CNV_A_R_LINEAR_____18_CM -50. 205. DISPLAY_IDENTIFIER C_TCO_MAX_VB_N_SP FORMAT "%3.0" /end CHARACTERISTIC
/begin CHARACTERISTIC c_n_sp_lgrd_is "Positive slope of engine speed setpoint ramp-up" VALUE 0x84fe24 _REC_VAL_20_u2 127.998 _CNV_A_R_LINEAR_____66_CM 2.e-003 128. DISPLAY_IDENTIFIER C_N_SP_LGRD_IS FORMAT "%5.2" /end CHARACTERISTIC
/begin CHARACTERISTIC lc_is_ramp_brake "Enable engine speed setpoint ramp if brake is actuated" VALUE 0x850140 _REC_VAL_20_u1 1. _CNV_A_R_LINEAR_____0_CM 0. 1. DISPLAY_IDENTIFIER LC_IS_RAMP_BRAKE FORMAT "%1.0" /end CHARACTERISTIC
/begin CHARACTERISTIC lc_is_ramp_dri "Enable ramp if \"Neutral\" or \"Park\" is selected in automatic transmission vehicles" VALUE 0x850143 _REC_VAL_20_u1 1. _CNV_A_R_LINEAR_____0_CM 0. 1. DISPLAY_IDENTIFIER LC_IS_RAMP_DRI FORMAT "%1.0" /end CHARACTERISTIC
/begin CHARACTERISTIC lc_is_ramp_dct "Enable engine speed setpoint ramp if DCT-clutch is open" VALUE 0x850142 _REC_VAL_20_u1 1. _CNV_A_R_LINEAR_____0_CM 0. 1. DISPLAY_IDENTIFIER LC_IS_RAMP_DCT FORMAT "%1.0" /end CHARACTERISTIC
/begin CHARACTERISTIC lc_is_ramp_cs_2 "Enable engine speed setpoint ramp by interlock switch" VALUE 0x850141 _REC_VAL_20_u1 1. _CNV_A_R_LINEAR_____0_CM 0. 1. DISPLAY_IDENTIFIER LC_IS_RAMP_CS_2 FORMAT "%1.0" /end CHARACTERISTIC
/begin CHARACTERISTIC lc_is_ramp_vs_n "Enable engine speed setpoint ramp if vehicle-speed-to-engine-speed-ratio-condition is fulfilled" VALUE 0x850148 _REC_VAL_20_u1 1. _CNV_A_R_LINEAR_____0_CM 0. 1. DISPLAY_IDENTIFIER LC_IS_RAMP_VS_N FORMAT "%1.0" /end CHARACTERISTIC
/begin CHARACTERISTIC lc_is_ramp_man "Enable engine speed setpoint ramp manually" VALUE 0x850144 _REC_VAL_20_u1 1. _CNV_A_R_LINEAR_____0_CM 0. 1. DISPLAY_IDENTIFIER LC_IS_RAMP_MAN FORMAT "%1.0" /end CHARACTERISTIC
/begin CHARACTERISTIC c_is_vs_n_thd "Threshold for vehicle-speed-to-engine-speed-ratio-condition" VALUE 0x84fd6c _REC_VAL_20_u2 0.9999874 _CNV_A_R_LINEAR_____67_CM 0. 0.9999874 DISPLAY_IDENTIFIER C_IS_VS_N_THD FORMAT "%4.3" /end CHARACTERISTIC
/begin CHARACTERISTIC lc_is_2st "Switch for single step energy management control system" VALUE 0x850134 _REC_VAL_20_u1 1. _CNV_A_R_LINEAR_____0_CM 0. 1. DISPLAY_IDENTIFIER LC_IS_2ST FORMAT "%1.0" /end CHARACTERISTIC
/begin CHARACTERISTIC id_n_sp_min_is__vb_fil "N_IS: Minimum engine speed setpoint depending on battery voltage" CURVE 0x844d78 _REC_CUR_20_u2_u1 8160. _CNV_A_R_LINEAR_____5_CM 0. 8160. DISPLAY_IDENTIFIER ID_N_SP_MIN_IS__VB_FIL FORMAT "%4.0"
 /begin AXIS_DESCR COM_AXIS vb _CNV_A_R_LINEAR_____43_CM 6 0. 28.8 FORMAT "%4.2" AXIS_PTS_REF ldp_vb_fil_n_sp_min_is /end AXIS_DESCR
/end CHARACTERISTIC
/begin AXIS_PTS ldp_vb_fil_n_sp_min_is "" 0x842a84 vb _REC_AXS_20_u1 28.8 _CNV_A_R_LINEAR_____43_CM 6 0. 28.8 FORMAT "%4.2" /end AXIS_PTS
/begin CHARACTERISTIC ip_n_sp_is_cvt_vs "N_IS: Engine speed setpoint for CVT transmission depending on vehicle speed" CURVE 0x84d3e4 _REC_CUR_20_u2_u1 8160. _CNV_A_R_LINEAR_____5_CM 0. 8160. DISPLAY_IDENTIFIER IP_N_SP_IS_CVT_VS FORMAT "%4.0"
 /begin AXIS_DESCR COM_AXIS vs _CNV_A_R_LINEAR_____34_CM 6 0. 255. FORMAT "%3.0" AXIS_PTS_REF ldp_vs_n_sp_is_cvt_vs /end AXIS_DESCR
/end CHARACTERISTIC
/begin AXIS_PTS ldp_vs_n_sp_is_cvt_vs "" 0x842af0 vs _REC_AXS_20_u1 255. _CNV_A_R_LINEAR_____34_CM 6 0. 255. FORMAT "%3.0" /end AXIS_PTS
/begin CHARACTERISTIC ip_n_inc_is_sp_pf "N_IS: Increased idle speed setpoint for PF regeneration" CURVE 0x84d2ec _REC_CUR_20_u2_u1 8160. _CNV_A_R_LINEAR_____5_CM 0. 8160. DISPLAY_IDENTIFIER IP_N_INC_IS_SP_PF FORMAT "%4.0"
 /begin AXIS_DESCR COM_AXIS tco _CNV_A_R_LINEAR_____18_CM 6 -50. 205. FORMAT "%3.0" AXIS_PTS_REF ldp_tco_ip_n_inc_is_sp_pf /end AXIS_DESCR
/end CHARACTERISTIC
/begin AXIS_PTS ldp_tco_ip_n_inc_is_sp_pf "" 0x8423ad tco _REC_AXS_20_u1 255. _CNV_A_R_LINEAR_____18_CM 6 -50. 205. FORMAT "%3.0" /end AXIS_PTS
/begin CHARACTERISTIC ip_n_sp_acin_dri_is__tco "N_IS: Engine speed setpoint with requested air condioning for automatic transmission vehicles in drive position" CURVE 0x84d35c _REC_CUR_20_u2_u1 8160. _CNV_A_R_LINEAR_____5_CM 0. 8160. DISPLAY_IDENTIFIER IP_N_SP_ACIN_DRI_IS__TCO FORMAT "%4.0"
 /begin AXIS_DESCR COM_AXIS tco _CNV_A_R_LINEAR_____18_CM 8 -50. 205. FORMAT "%3.0" AXIS_PTS_REF ldpm_tco_ip_n_sp_is /end AXIS_DESCR
/end CHARACTERISTIC
/begin AXIS_PTS ldpm_tco_ip_n_sp_is "" 0x8437b6 tco _REC_AXS_20_u1 255. _CNV_A_R_LINEAR_____18_CM 8 -50. 205. FORMAT "%3.0" /end AXIS_PTS
/begin CHARACTERISTIC ip_n_sp_acin_is_at__tco "N_IS: Engine speed setpoint with requested air condioning for automatic transmission vehicles" CURVE 0x84d36c _REC_CUR_20_u2_u1 8160. _CNV_A_R_LINEAR_____5_CM 0. 8160. DISPLAY_IDENTIFIER IP_N_SP_ACIN_IS_AT__TCO FORMAT "%4.0"
 /begin AXIS_DESCR COM_AXIS tco _CNV_A_R_LINEAR_____18_CM 8 -50. 205. FORMAT "%3.0" AXIS_PTS_REF ldpm_tco_ip_n_sp_is /end AXIS_DESCR
/end CHARACTERISTIC
/begin CHARACTERISTIC ip_n_sp_acin_is_mt__tco "N_IS: Engine speed setpoint with requested air condioning for manual transmission vehicles" CURVE 0x84d37c _REC_CUR_20_u2_u1 8160. _CNV_A_R_LINEAR_____5_CM 0. 8160. DISPLAY_IDENTIFIER IP_N_SP_ACIN_IS_MT__TCO FORMAT "%4.0"
 /begin AXIS_DESCR COM_AXIS tco _CNV_A_R_LINEAR_____18_CM 8 -50. 205. FORMAT "%3.0" AXIS_PTS_REF ldpm_tco_ip_n_sp_is /end AXIS_DESCR
/end CHARACTERISTIC
/begin CHARACTERISTIC ip_n_sp_is_max_vecu_1_tco "N_IS: Engine speed setpoint requested by engery managment control system step 1" CURVE 0x84d3fc _REC_CUR_20_u2_u1 8160. _CNV_A_R_LINEAR_____5_CM 0. 8160. DISPLAY_IDENTIFIER IP_N_SP_IS_MAX_VECU_1_TCO FORMAT "%4.0"
 /begin AXIS_DESCR COM_AXIS tco _CNV_A_R_LINEAR_____18_CM 8 -50. 205. FORMAT "%3.0" AXIS_PTS_REF ldpm_tco_ip_n_sp_is /end AXIS_DESCR
/end CHARACTERISTIC
/begin CHARACTERISTIC ip_n_sp_is_max_vecu_2_tco "N_IS: Engine speed setpoint requested by engery managment control system step 2" CURVE 0x84d40c _REC_CUR_20_u2_u1 8160. _CNV_A_R_LINEAR_____5_CM 0. 8160. DISPLAY_IDENTIFIER IP_N_SP_IS_MAX_VECU_2_TCO FORMAT "%4.0"
 /begin AXIS_DESCR COM_AXIS tco _CNV_A_R_LINEAR_____18_CM 8 -50. 205. FORMAT "%3.0" AXIS_PTS_REF ldpm_tco_ip_n_sp_is /end AXIS_DESCR
/end CHARACTERISTIC
/begin CHARACTERISTIC ip_n_sp_is_hi "N_IS: Engine speed setpoint for hot idle state" CURVE 0x84d3f0 _REC_CUR_20_u2_u1 8160. _CNV_A_R_LINEAR_____5_CM 0. 8160. DISPLAY_IDENTIFIER IP_N_SP_IS_HI FORMAT "%4.0"
 /begin AXIS_DESCR COM_AXIS toil _CNV_A_R_LINEAR_____65_CM 6 -40. 160. FORMAT "%3.0" AXIS_PTS_REF ldp_toil_n_sp_is_hi /end AXIS_DESCR
/end CHARACTERISTIC
/begin AXIS_PTS ldp_toil_n_sp_is_hi "" 0x84259e toil _REC_AXS_20_u1 200. _CNV_A_R_LINEAR_____65_CM 6 -40. 160. FORMAT "%3.0" /end AXIS_PTS
/begin MEASUREMENT n_sp_is_bas "basic idle speed setpoint" UWORD _CNV_A_R_LINEAR_____5_CM 1 0. 0. 8160. DISPLAY_IDENTIFIER N_SP_IS_BAS ECU_ADDRESS 0x7f9ce2 BYTE_ORDER MSB_LAST FORMAT "%4.0" /end MEASUREMENT
/begin CHARACTERISTIC id_n_sp_is_mt_dri "N_IS_SP_I: gear dependent engine speed setpoint for manual transmission vehicles" CURVE 0x844d6a _REC_CUR_20_u2_u1 8160. _CNV_A_R_LINEAR_____5_CM 0. 8160. DISPLAY_IDENTIFIER ID_N_SP_IS_MT_DRI FORMAT "%4.0"
 /begin AXIS_DESCR COM_AXIS dri _CNV_A_R_LINEAR_____0_CM 7 0. 6. FORMAT "%1.0" AXIS_PTS_REF ldpm_dri_n_sp_is /end AXIS_DESCR
/end CHARACTERISTIC
/begin AXIS_PTS ldpm_dri_n_sp_is "" 0x842b66 dri _REC_AXS_20_u1 6. _CNV_A_R_LINEAR_____0_CM 7 0. 6. FORMAT "%1.0" /end AXIS_PTS
/begin CHARACTERISTIC id_n_sp_is_at_dri "N_IS_SP_I: gear dependent engine speed setpoint for automatic transmission vehicles" CURVE 0x844d5c _REC_CUR_20_u2_u1 8160. _CNV_A_R_LINEAR_____5_CM 0. 8160. DISPLAY_IDENTIFIER ID_N_SP_IS_AT_DRI FORMAT "%4.0"
 /begin AXIS_DESCR COM_AXIS dri _CNV_A_R_LINEAR_____0_CM 7 0. 6. FORMAT "%1.0" AXIS_PTS_REF ldpm_dri_n_sp_is /end AXIS_DESCR
/end CHARACTERISTIC
/begin CHARACTERISTIC ip_n_sp_is_at "N_IS_SP_I: normal idle speed setpoint for automatic transmission vehicles" CURVE 0x84d3d4 _REC_CUR_20_u2_u1 8160. _CNV_A_R_LINEAR_____5_CM 0. 8160. DISPLAY_IDENTIFIER IP_N_SP_IS_AT FORMAT "%4.0"
 /begin AXIS_DESCR COM_AXIS tco _CNV_A_R_LINEAR_____18_CM 8 -50. 205. FORMAT "%3.0" AXIS_PTS_REF ldpm_tco_ip_n_sp_is /end AXIS_DESCR
/end CHARACTERISTIC
/begin CHARACTERISTIC ip_n_sp_is_mt "N_IS_SP_I: normal idle speed setpoint for manual transmission vehicles" CURVE 0x84d41c _REC_CUR_20_u2_u1 8160. _CNV_A_R_LINEAR_____5_CM 0. 8160. DISPLAY_IDENTIFIER IP_N_SP_IS_MT FORMAT "%4.0"
 /begin AXIS_DESCR COM_AXIS tco _CNV_A_R_LINEAR_____18_CM 8 -50. 205. FORMAT "%3.0" AXIS_PTS_REF ldpm_tco_ip_n_sp_is /end AXIS_DESCR
/end CHARACTERISTIC
/begin MEASUREMENT v_dip_pf "Voltage from differential pressure sensor on particulate filter" UWORD _CNV_A_R_LINEAR_____28_CM 1 0. 0. 4.9951171875 DISPLAY_IDENTIFIER V_DIP_PF ECU_ADDRESS 0x7fa10c BYTE_ORDER MSB_LAST FORMAT "%4.3" /end MEASUREMENT
/begin MEASUREMENT dip_pf_mes "Measured differential pressure on particulate filter" UWORD _CNV_A_R_LINEAR_____45_CM 1 0. 0. 5434. DISPLAY_IDENTIFIER DIP_PF_MES ECU_ADDRESS 0x7fa10e BYTE_ORDER MSB_LAST FORMAT "%6.2" /end MEASUREMENT
/begin MEASUREMENT v_dip_pf_ad "Calibrated offset minus sensor voltage messured with zero differential pressure" SWORD _CNV_A_R_LINEAR_____107_CM 1 0. -5.00000000000182 4.99511718999747 DISPLAY_IDENTIFIER V_DIP_PF_AD ECU_ADDRESS 0x7fa10a BYTE_ORDER MSB_LAST FORMAT "%4.3" /end MEASUREMENT
/begin MEASUREMENT dip_pf "Differential Pressure on Particulate Filter" UWORD _CNV_A_R_LINEAR_____45_CM 1 0. 0. 5434. DISPLAY_IDENTIFIER DIP_PF ECU_ADDRESS 0x7fa110 BYTE_ORDER MSB_LAST FORMAT "%6.2" /end MEASUREMENT
/begin MEASUREMENT dip_pf_mmv "Filtered Differential Pressure on Particulate Filter" UWORD _CNV_A_R_LINEAR_____45_CM 1 0. 0. 5434. DISPLAY_IDENTIFIER DIP_PF_MMV ECU_ADDRESS 0x7fa112 BYTE_ORDER MSB_LAST FORMAT "%6.2" /end MEASUREMENT
/begin MEASUREMENT dip_pf_temp "Differential Pressure on Particulate Filter without filtering" UWORD _CNV_A_R_LINEAR_____45_CM 1 0. 0. 5434. DISPLAY_IDENTIFIER DIP_PF_TEMP ECU_ADDRESS 0x7fb3ea BYTE_ORDER MSB_LAST FORMAT "%6.2" /end MEASUREMENT
/begin CHARACTERISTIC c_dip_pf_sub_diag "Differential Pressure on Particulate Filter substitute value" VALUE 0x84fc0e _REC_VAL_20_u2 5434. _CNV_A_R_LINEAR_____45_CM 0. 5434. DISPLAY_IDENTIFIER C_DIP_PF_SUB_DIAG FORMAT "%6.2" /end CHARACTERISTIC
/begin CHARACTERISTIC c_fac_dip_pf_fil "Filter factor for DIP_PV" VALUE 0x84fcfc _REC_VAL_20_u2 0.9999847412109381 _CNV_A_R_LINEAR_____14_CM 0. 0.9999847412109381 DISPLAY_IDENTIFIER C_FAC_DIP_PF_FIL FORMAT "%6.5" /end CHARACTERISTIC
/begin CHARACTERISTIC c_v_dip_pf_ofs "Voltage offset for DIP_PF calculation" VALUE 0x8500aa _REC_VAL_20_u2 4.9951171875 _CNV_A_R_LINEAR_____28_CM 0. 4.9951171875 DISPLAY_IDENTIFIER C_V_DIP_PF_OFS FORMAT "%4.3" /end CHARACTERISTIC
/begin CHARACTERISTIC c_fac_v_dip_pf "Scaling factor for DIP_PF calculation" VALUE 0x84fd56 _REC_VAL_20_u2 8681.460985 _CNV_A_R_LINEAR_____116_CM 0. 8681.460985 DISPLAY_IDENTIFIER C_FAC_V_DIP_PF FORMAT "%5.1" /end CHARACTERISTIC
/begin CHARACTERISTIC c_tco_max_dip_pf_ad "Upper TCO limit for DIP_PF adaptation" VALUE 0x85001a _REC_VAL_20_u1 255. _CNV_A_R_LINEAR_____18_CM -50. 205. DISPLAY_IDENTIFIER C_TCO_MAX_DIP_PF_AD FORMAT "%3.0" /end CHARACTERISTIC
/begin CHARACTERISTIC c_tia_min_dip_pf_ad "Lower TIA limit for DIP_PF adaptation" VALUE 0x850041 _REC_VAL_20_u1 255. _CNV_A_R_LINEAR_____18_CM -50. 205. DISPLAY_IDENTIFIER C_TIA_MIN_DIP_PF_AD FORMAT "%3.0" /end CHARACTERISTIC
/begin CHARACTERISTIC c_tia_max_dip_pf_ad "Upper TIA limit for DIP_PF adaptation" VALUE 0x850040 _REC_VAL_20_u1 255. _CNV_A_R_LINEAR_____18_CM -50. 205. DISPLAY_IDENTIFIER C_TIA_MAX_DIP_PF_AD FORMAT "%3.0" /end CHARACTERISTIC
/begin CHARACTERISTIC c_v_dip_pf_ad_max "Maximum limitation of learning offset to correct V_DIP_PF" VALUE 0x8500a2 _REC_VAL_20_s2 9.99511718999929 _CNV_A_R_LINEAR_____107_CM -5.00000000000182 4.99511718999747 DISPLAY_IDENTIFIER C_V_DIP_PF_AD_MAX FORMAT "%4.3" /end CHARACTERISTIC
/begin CHARACTERISTIC c_v_dip_pf_ad_min "Minimum limitation of learning offset to correct V_DIP_PF" VALUE 0x8500a4 _REC_VAL_20_s2 9.99511718999929 _CNV_A_R_LINEAR_____107_CM -5.00000000000182 4.99511718999747 DISPLAY_IDENTIFIER C_V_DIP_PF_AD_MIN FORMAT "%4.3" /end CHARACTERISTIC
/begin MEASUREMENT lv_heat_1 "o v" UBYTE _CNV_S_2_RANGE______11_CM 1 0. 0. 1. DISPLAY_IDENTIFIER LV_HEAT_1 ECU_ADDRESS 0x7fbb18 /end MEASUREMENT
/begin MEASUREMENT lv_heat_2 "o v" UBYTE _CNV_S_2_RANGE______11_CM 1 0. 0. 1. DISPLAY_IDENTIFIER LV_HEAT_2 ECU_ADDRESS 0x7fbb19 /end MEASUREMENT
/begin MEASUREMENT lv_heat_3 "o v" UBYTE _CNV_S_2_RANGE______11_CM 1 0. 0. 1. DISPLAY_IDENTIFIER LV_HEAT_3 ECU_ADDRESS 0x7fbb1a /end MEASUREMENT
/begin MEASUREMENT sf_heat "o v" UWORD _CNV_A_R_LINEAR_____0_CM 1 0. 0. 32768. DISPLAY_IDENTIFIER SF_HEAT ECU_ADDRESS 0x7fa0c6 BYTE_ORDER MSB_LAST FORMAT "%5.0" /end MEASUREMENT
/begin MEASUREMENT lv_heat_var_temp "o v" UBYTE _CNV_S_2_RANGE______11_CM 1 0. 0. 1. DISPLAY_IDENTIFIER LV_HEAT_VAR_TEMP ECU_ADDRESS 0x7fbb1b /end MEASUREMENT
/begin MEASUREMENT lv_req_n_sp_is_min_heat "o v" UBYTE _CNV_S_2_RANGE______11_CM 1 0. 0. 1. DISPLAY_IDENTIFIER LV_REQ_N_SP_IS_MIN_HEAT ECU_ADDRESS 0x7fbb1c /end MEASUREMENT
/begin MEASUREMENT temp_tco_heat_tol_act "v" UBYTE _CNV_A_R_LINEAR_____18_CM 1 0. -50. 205. DISPLAY_IDENTIFIER TEMP_TCO_HEAT_TOL_ACT ECU_ADDRESS 0x7fbf5a FORMAT "%3.0" /end MEASUREMENT
/begin MEASUREMENT count_act_heat_elems "v" UBYTE _CNV_A_R_LINEAR_____0_CM 1 0. 0. 3. DISPLAY_IDENTIFIER COUNT_ACT_HEAT_ELEMS ECU_ADDRESS 0x7fbf5b FORMAT "%1.0" /end MEASUREMENT
/begin CHARACTERISTIC lc_heat_var_temp "" VALUE 0x85ce80 _REC_VAL_20_u1 1. _CNV_A_R_LINEAR_____0_CM 0. 1. DISPLAY_IDENTIFIER LC_HEAT_VAR_TEMP FORMAT "%1.0" /end CHARACTERISTIC
/begin CHARACTERISTIC c_tco_heat_bol "" VALUE 0x85ccad _REC_VAL_20_u1 255. _CNV_A_R_LINEAR_____18_CM -50. 205. DISPLAY_IDENTIFIER C_TCO_HEAT_BOL FORMAT "%3.0" /end CHARACTERISTIC
/begin CHARACTERISTIC c_t_dly_heat_st "" VALUE 0x85cc28 _REC_VAL_20_u2 6553.5 _CNV_A_R_LINEAR_____19_CM 0. 6553.5 DISPLAY_IDENTIFIER C_T_DLY_HEAT_ST FORMAT "%5.1" /end CHARACTERISTIC
/begin CHARACTERISTIC lc_heat_var_swi "" VALUE 0x85ce7f _REC_VAL_20_u1 2. _CNV_A_R_LINEAR_____0_CM 0. 2. DISPLAY_IDENTIFIER LC_HEAT_VAR_SWI FORMAT "%1.0" /end CHARACTERISTIC
/begin CHARACTERISTIC lc_heat_off_ac "" VALUE 0x85ce7e _REC_VAL_20_u1 1. _CNV_A_R_LINEAR_____0_CM 0. 1. DISPLAY_IDENTIFIER LC_HEAT_OFF_AC FORMAT "%1.0" /end CHARACTERISTIC
/begin CHARACTERISTIC c_vb_heat_bol "" VALUE 0x85ce0a _REC_VAL_20_u1 28.8 _CNV_A_R_LINEAR_____43_CM 0. 28.8 DISPLAY_IDENTIFIER C_VB_HEAT_BOL FORMAT "%3.1" /end CHARACTERISTIC
/begin CHARACTERISTIC c_vb_heat_tol "" VALUE 0x85ce0b _REC_VAL_20_u1 28.8 _CNV_A_R_LINEAR_____43_CM 0. 28.8 DISPLAY_IDENTIFIER C_VB_HEAT_TOL FORMAT "%3.1" /end CHARACTERISTIC
/begin CHARACTERISTIC c_n_heat_bol "" VALUE 0x85cb0c _REC_VAL_20_u2 6375. _CNV_A_R_LINEAR_____5_CM 0. 6375. DISPLAY_IDENTIFIER C_N_HEAT_BOL FORMAT "%4.0" /end CHARACTERISTIC
/begin CHARACTERISTIC c_n_heat_tol "" VALUE 0x85cb0e _REC_VAL_20_u2 6375. _CNV_A_R_LINEAR_____5_CM 0. 6375. DISPLAY_IDENTIFIER C_N_HEAT_TOL FORMAT "%4.0" /end CHARACTERISTIC
/begin CHARACTERISTIC c_tia_heat_bol "" VALUE 0x85cd1f _REC_VAL_20_u1 255. _CNV_A_R_LINEAR_____18_CM -50. 205. DISPLAY_IDENTIFIER C_TIA_HEAT_BOL FORMAT "%3.0" /end CHARACTERISTIC
/begin CHARACTERISTIC c_tia_heat_tol "" VALUE 0x85cd20 _REC_VAL_20_u1 255. _CNV_A_R_LINEAR_____18_CM -50. 205. DISPLAY_IDENTIFIER C_TIA_HEAT_TOL FORMAT "%3.0" /end CHARACTERISTIC
/begin CHARACTERISTIC lc_heat_3_off_ac "" VALUE 0x85ce7d _REC_VAL_20_u1 1. _CNV_A_R_LINEAR_____0_CM 0. 1. DISPLAY_IDENTIFIER LC_HEAT_3_OFF_AC FORMAT "%1.0" /end CHARACTERISTIC
/begin CHARACTERISTIC c_altpwm_heat_tol_dec "" VALUE 0x85c870 _REC_VAL_20_u2 100. _CNV_A_R_LINEAR_____134_CM 0. 100. DISPLAY_IDENTIFIER C_ALTPWM_HEAT_TOL_DEC FORMAT "%5.3" /end CHARACTERISTIC
/begin CHARACTERISTIC c_t_dly_heat "" VALUE 0x85cc26 _REC_VAL_20_u2 6553.5 _CNV_A_R_LINEAR_____19_CM 0. 6553.5 DISPLAY_IDENTIFIER C_T_DLY_HEAT FORMAT "%5.1" /end CHARACTERISTIC
/begin CHARACTERISTIC c_fac_fil_altpwm_heat "" VALUE 0x85c9da _REC_VAL_20_u2 0.9999874 _CNV_A_R_LINEAR_____87_CM 0. 0.9999874 DISPLAY_IDENTIFIER C_FAC_FIL_ALTPWM_HEAT FORMAT "%6.5" /end CHARACTERISTIC
/begin CHARACTERISTIC c_t_dly_n_dec "" VALUE 0x85cc30 _REC_VAL_20_u2 6553.5 _CNV_A_R_LINEAR_____19_CM 0. 6553.5 DISPLAY_IDENTIFIER C_T_DLY_N_DEC FORMAT "%5.1" /end CHARACTERISTIC
/begin CHARACTERISTIC ip_tco_heat_tol__temp "Higher Threshold for Water Temperature Hysteresis" CURVE 0x85b140 _REC_CUR_20_u1_u1 255. _CNV_A_R_LINEAR_____18_CM -50. 205. DISPLAY_IDENTIFIER IP_TCO_HEAT_TOL__TEMP FORMAT "%3.0"
 /begin AXIS_DESCR COM_AXIS tco _CNV_A_R_LINEAR_____18_CM 10 -50. 205. FORMAT "%3.0" AXIS_PTS_REF ldp_tco_ip_tco_heat_tol /end AXIS_DESCR
/end CHARACTERISTIC
/begin AXIS_PTS ldp_tco_ip_tco_heat_tol "" 0x8423e5 tco _REC_AXS_20_u1 255. _CNV_A_R_LINEAR_____18_CM 10 -50. 205. FORMAT "%3.0" /end AXIS_PTS
/begin CHARACTERISTIC ip_altpwm_heat_bol__n "Lower Deactivation Threshold of the Generator Load Hysteresis" CURVE 0x85095c _REC_CUR_20_u2_u2 99.99847412109381 _CNV_A_R_LINEAR_____8_CM 0. 99.99847412109381 DISPLAY_IDENTIFIER IP_ALTPWM_HEAT_BOL__N FORMAT "%5.4"
 /begin AXIS_DESCR COM_AXIS n _CNV_A_R_LINEAR_____5_CM 6 0. 6375. FORMAT "%4.0" AXIS_PTS_REF ldp_n_ip_altpwm_heat_bol /end AXIS_DESCR
/end CHARACTERISTIC
/begin AXIS_PTS ldp_n_ip_altpwm_heat_bol "" 0x841952 n _REC_AXS_20_u2 6375. _CNV_A_R_LINEAR_____5_CM 6 0. 6375. FORMAT "%4.0" /end AXIS_PTS
/begin CHARACTERISTIC ip_altpwm_heat_tol__n "Higher Deactivation Threshold of Generator Load Hysteresis" CURVE 0x850968 _REC_CUR_20_u2_u2 99.99847412109381 _CNV_A_R_LINEAR_____8_CM 0. 99.99847412109381 DISPLAY_IDENTIFIER IP_ALTPWM_HEAT_TOL__N FORMAT "%5.4"
 /begin AXIS_DESCR COM_AXIS n _CNV_A_R_LINEAR_____5_CM 6 0. 6375. FORMAT "%4.0" AXIS_PTS_REF ldp_n_ip_altpwm_heat_tol /end AXIS_DESCR
/end CHARACTERISTIC
/begin AXIS_PTS ldp_n_ip_altpwm_heat_tol "" 0x841960 n _REC_AXS_20_u2 6375. _CNV_A_R_LINEAR_____5_CM 6 0. 6375. FORMAT "%4.0" /end AXIS_PTS
/begin MEASUREMENT lv_es_act "Flag indicating that the engine stop function is active" UBYTE _CNV_S_2_RANGE______11_CM 1 0. 0. 1. DISPLAY_IDENTIFIER LV_ES_ACT ECU_ADDRESS 0x7fb88a /end MEASUREMENT
/begin MEASUREMENT lv_es_prep "Flag indicating that the preparation phase for engine stop is active" UBYTE _CNV_S_2_RANGE______11_CM 1 0. 0. 1. DISPLAY_IDENTIFIER LV_ES_PREP ECU_ADDRESS 0x7fb88b /end MEASUREMENT
/begin MEASUREMENT lv_inh_es_diag "Flag to inhibit the engine stop function diagnosis" UBYTE _CNV_S_2_RANGE______11_CM 1 0. 0. 1. DISPLAY_IDENTIFIER LV_INH_ES_DIAG ECU_ADDRESS 0x7fb88c /end MEASUREMENT
/begin MEASUREMENT lv_pwl_lock_es "Flag indicating that the engine stop function is locking the power latch phase of the ECU" UBYTE _CNV_S_2_RANGE______11_CM 1 0. 0. 1. DISPLAY_IDENTIFIER LV_PWL_LOCK_ES ECU_ADDRESS 0x7fb88d /end MEASUREMENT
/begin MEASUREMENT lv_req_es_inj "request for engine stop by electrical cut-off path" UBYTE _CNV_S_2_RANGE______11_CM 1 0. 0. 1. DISPLAY_IDENTIFIER LV_REQ_ES_INJ ECU_ADDRESS 0x7fb88e /end MEASUREMENT
/begin MEASUREMENT lv_req_es_fup "request for engine stop by hydraulic cut-off path " UBYTE _CNV_S_2_RANGE______11_CM 1 0. 0. 1. DISPLAY_IDENTIFIER LV_REQ_ES_FUP ECU_ADDRESS 0x7fb88f /end MEASUREMENT
/begin MEASUREMENT lv_req_es_thr "request for engine stop for throttel control" UBYTE _CNV_S_2_RANGE______11_CM 1 0. 0. 1. DISPLAY_IDENTIFIER LV_REQ_ES_THR ECU_ADDRESS 0x7fb890 /end MEASUREMENT
/begin MEASUREMENT ctr_req_es_fup "counter requests engine stop by hydraulic cut-off path" UWORD _CNV_A_R_LINEAR_____0_CM 1 0. 0. 65535. DISPLAY_IDENTIFIER CTR_REQ_ES_FUP ECU_ADDRESS 0x7f99ce BYTE_ORDER MSB_LAST FORMAT "%5.0" /end MEASUREMENT
/begin MEASUREMENT lv_req_es_fup_act "request for engine stop by hydraulic cut-off path activated" UBYTE _CNV_S_2_RANGE______11_CM 1 0. 0. 1. DISPLAY_IDENTIFIER LV_REQ_ES_FUP_ACT ECU_ADDRESS 0x7fbe7c /end MEASUREMENT
/begin MEASUREMENT ctr_req_es_inj "counter requests engine stop by electrical cut-off path" UWORD _CNV_A_R_LINEAR_____0_CM 1 0. 0. 65535. DISPLAY_IDENTIFIER CTR_REQ_ES_INJ ECU_ADDRESS 0x7f99d0 BYTE_ORDER MSB_LAST FORMAT "%5.0" /end MEASUREMENT
/begin MEASUREMENT lv_req_es_inj_act "request for engine stop by electrical cut-off path activated" UBYTE _CNV_S_2_RANGE______11_CM 1 0. 0. 1. DISPLAY_IDENTIFIER LV_REQ_ES_INJ_ACT ECU_ADDRESS 0x7fbe7d /end MEASUREMENT
/begin CHARACTERISTIC c_t_req_es_fup "time for request engine cut-off by hydraulic path" VALUE 0x85cc7c _REC_VAL_20_u4 4294963695. _CNV_A_R_LINEAR_____16_CM 3600. 4294967295. DISPLAY_IDENTIFIER C_T_REQ_ES_FUP FORMAT "%10.0" /end CHARACTERISTIC
/begin CHARACTERISTIC c_t_req_es_inj "time for request engine cut-off by electrical path" VALUE 0x85cc80 _REC_VAL_20_u4 4294963695. _CNV_A_R_LINEAR_____16_CM 3600. 4294967295. DISPLAY_IDENTIFIER C_T_REQ_ES_INJ FORMAT "%10.0" /end CHARACTERISTIC
/begin CHARACTERISTIC c_t_es_prep "Duration of the engine stop preparation (typical value: 50ms)" VALUE 0x85cc3d _REC_VAL_20_u1 2550. _CNV_A_R_LINEAR_____93_CM 0. 2550. DISPLAY_IDENTIFIER C_T_ES_PREP FORMAT "%4.0" /end CHARACTERISTIC
/begin MEASUREMENT lv_req_es_supp_fct "request for engine stop from supplementary functions " UBYTE _CNV_S_2_RANGE______11_CM 1 0. 0. 1. DISPLAY_IDENTIFIER LV_REQ_ES_SUPP_FCT ECU_ADDRESS 0x7fb891 /end MEASUREMENT
/begin MEASUREMENT pwl_lock_cdn "power latch extension by project specific configuration:" UWORD _CNV_A_R_LINEAR_____1_CM 1 0. 0. 65535. DISPLAY_IDENTIFIER PWL_LOCK_CDN ECU_ADDRESS 0x7fa31e BYTE_ORDER MSB_LAST /end MEASUREMENT
/begin MEASUREMENT t_pwl "incrementing timer during PWL phase active" UWORD _CNV_A_R_LINEAR_____240_CM 1 0. 0. 6553.5 DISPLAY_IDENTIFIER T_PWL ECU_ADDRESS 0x7fa31c BYTE_ORDER MSB_LAST FORMAT "%6.1" /end MEASUREMENT
/begin MEASUREMENT lv_pwl_act "power latch phase active" UBYTE _CNV_S_2_RANGE__0___85_CM 1 0. 0. 1. DISPLAY_IDENTIFIER LV_PWL_ACT ECU_ADDRESS 0x7fbc14 BIT_MASK 0x1 /end MEASUREMENT
/begin MEASUREMENT lv_inh_pwl_tran_es_el "flag active in shut down phase: IGK on is not accepted without reset" UBYTE _CNV_S_2_RANGE__0___85_CM 1 0. 0. 1. DISPLAY_IDENTIFIER LV_INH_PWL_TRAN_ES_EL ECU_ADDRESS 0x7fbc15 BIT_MASK 0x1 /end MEASUREMENT
/begin CHARACTERISTIC c_t_min_pwl "minimum power latch time for ECU switch off" VALUE 0x84ffd4 _REC_VAL_20_u2 6533.5 _CNV_A_R_LINEAR_____240_CM 20. 6553.5 DISPLAY_IDENTIFIER C_T_MIN_PWL FORMAT "%6.1" /end CHARACTERISTIC
/begin CHARACTERISTIC c_t_max_pwl "maximum power latch time for ECU switch off" VALUE 0x84ffc2 _REC_VAL_20_u2 6553.5 _CNV_A_R_LINEAR_____240_CM 0. 6553.5 DISPLAY_IDENTIFIER C_T_MAX_PWL FORMAT "%6.1" /end CHARACTERISTIC
/begin MEASUREMENT lv_cwp_act "bit for active electrical coolant water pump" UBYTE _CNV_S_2_RANGE__0___85_CM 1 0. 0. 1. DISPLAY_IDENTIFIER LV_CWP_ACT ECU_ADDRESS 0x7fbc08 BIT_MASK 0x1 /end MEASUREMENT
/begin MEASUREMENT lv_cwp_act_eru "bit for active electrical coolant water pump while engine running" UBYTE _CNV_S_2_RANGE__0___85_CM 1 0. 0. 1. DISPLAY_IDENTIFIER LV_CWP_ACT_ERU ECU_ADDRESS 0x7fbfee BIT_MASK 0x1 /end MEASUREMENT
/begin CHARACTERISTIC c_t_ast_min_cwp "minimum time after start to activate CWP while engine running" VALUE 0x84ff22 _REC_VAL_20_u2 6553.5 _CNV_A_R_LINEAR_____240_CM 0. 6553.5 DISPLAY_IDENTIFIER C_T_AST_MIN_CWP FORMAT "%6.1" /end CHARACTERISTIC
/begin CHARACTERISTIC c_tam_max_cwp_act_eru "maximum TAM to activate CWP while engine running" VALUE 0x850009 _REC_VAL_20_u1 190.5 _CNV_A_R_LINEAR_____241_CM -48. 142.5 DISPLAY_IDENTIFIER C_TAM_MAX_CWP_ACT_ERU FORMAT "%5.1" /end CHARACTERISTIC
/begin MEASUREMENT lv_equip_cwp "Vehicle has a electrical coolant water pump" UBYTE _CNV_S_2_RANGE__0___85_CM 1 0. 0. 1. DISPLAY_IDENTIFIER LV_EQUIP_CWP ECU_ADDRESS 0x7fbfef BIT_MASK 0x1 /end MEASUREMENT
/begin CHARACTERISTIC c_tco_max_cwp_act_eru "maximum TCO to activate CWP while engine running" VALUE 0x850019 _REC_VAL_20_u1 190.5 _CNV_A_R_LINEAR_____241_CM -48. 142.5 DISPLAY_IDENTIFIER C_TCO_MAX_CWP_ACT_ERU FORMAT "%5.1" /end CHARACTERISTIC
/begin CHARACTERISTIC c_t_ast_max_cwp "maximum time after start to activate CWP while engine running" VALUE 0x84ff20 _REC_VAL_20_u2 6553.5 _CNV_A_R_LINEAR_____240_CM 0. 6553.5 DISPLAY_IDENTIFIER C_T_AST_MAX_CWP FORMAT "%6.1" /end CHARACTERISTIC
/begin CHARACTERISTIC c_equip_cwp "0 - CWP never used" VALUE 0x84fcf2 _REC_VAL_20_u1 255. _CNV_A_R_LINEAR_____1_CM 0. 255. DISPLAY_IDENTIFIER C_EQUIP_CWP FORMAT "%3.0" /end CHARACTERISTIC
/begin MEASUREMENT ectpwm "PWM signal to control the electrical heated coolant thermostat" UWORD _CNV_A_R_LINEAR_____258_CM 1 0. 0. 99.99847412109381 DISPLAY_IDENTIFIER ECTPWM ECU_ADDRESS 0x7fa026 BYTE_ORDER MSB_LAST /end MEASUREMENT
/begin MEASUREMENT ectpwm_bas "pre control value for ECTPWM" UWORD _CNV_A_R_LINEAR_____258_CM 1 0. 0. 99.99847412109381 DISPLAY_IDENTIFIER ECTPWM_BAS ECU_ADDRESS 0x7fb390 BYTE_ORDER MSB_LAST /end MEASUREMENT
/begin MEASUREMENT ectpwm_i "integral part for ECTPWM control" SWORD _CNV_A_R_LINEAR_____259_CM 1 0. -100. 99.9969482421875 DISPLAY_IDENTIFIER ECTPWM_I ECU_ADDRESS 0x7fb398 BYTE_ORDER MSB_LAST FORMAT "%8.3" /end MEASUREMENT
/begin MEASUREMENT ectpwm_raw "raw value for ECTPWM before limitation and external requests" UWORD _CNV_A_R_LINEAR_____258_CM 1 0. 0. 99.99847412109381 DISPLAY_IDENTIFIER ECTPWM_RAW ECU_ADDRESS 0x7fb392 BYTE_ORDER MSB_LAST /end MEASUREMENT
/begin MEASUREMENT ectpwm_inter_1 "ECTPWM Intermediate value" UWORD _CNV_A_R_LINEAR_____258_CM 1 0. 0. 99.99847412109381 DISPLAY_IDENTIFIER ECTPWM_INTER_1 ECU_ADDRESS 0x7fb394 BYTE_ORDER MSB_LAST /end MEASUREMENT
/begin MEASUREMENT ectpwm_inter_2 "ECTPWM Intermediate value" UWORD _CNV_A_R_LINEAR_____258_CM 1 0. 0. 99.99847412109381 DISPLAY_IDENTIFIER ECTPWM_INTER_2 ECU_ADDRESS 0x7fb396 BYTE_ORDER MSB_LAST /end MEASUREMENT
/begin CHARACTERISTIC c_tco_dif_min_ectpwm_i "minimum TCO_DIF threshold to activate I-controller" VALUE 0x850017 _REC_VAL_20_s1 191.25 _CNV_A_R_LINEAR_____260_CM -96. 95.25 DISPLAY_IDENTIFIER C_TCO_DIF_MIN_ECTPWM_I FORMAT "%4.1" /end CHARACTERISTIC
/begin CHARACTERISTIC c_tco_dif_max_ectpwm_i "maximum TCO_DIF threshold to activate I-controller" VALUE 0x850016 _REC_VAL_20_s1 191.25 _CNV_A_R_LINEAR_____260_CM -96. 95.25 DISPLAY_IDENTIFIER C_TCO_DIF_MAX_ECTPWM_I FORMAT "%4.1" /end CHARACTERISTIC
/begin CHARACTERISTIC c_ectpwm_i_min "minimum value for integral part of ECTPWM control" VALUE 0x84fcc0 _REC_VAL_20_s2 199.9969482421875 _CNV_A_R_LINEAR_____259_CM -100. 99.9969482421875 DISPLAY_IDENTIFIER C_ECTPWM_I_MIN FORMAT "%8.3" /end CHARACTERISTIC
/begin CHARACTERISTIC c_ectpwm_i_max "maximum value for integral part of ECTPWM control" VALUE 0x84fcbe _REC_VAL_20_s2 199.9969482421875 _CNV_A_R_LINEAR_____259_CM -100. 99.9969482421875 DISPLAY_IDENTIFIER C_ECTPWM_I_MAX FORMAT "%8.3" /end CHARACTERISTIC
/begin CHARACTERISTIC c_tco_2_max_ectpwm_tol "Maximum TCO_2 threshold to activate ECTPWM_SUB (upper limit)" VALUE 0x85000f _REC_VAL_20_u1 190.5 _CNV_A_R_LINEAR_____241_CM -48. 142.5 DISPLAY_IDENTIFIER C_TCO_2_MAX_ECTPWM_TOL FORMAT "%5.1" /end CHARACTERISTIC
/begin CHARACTERISTIC c_ectpwm_sub "substitute value for ECTPWM while power latch phase or while TCO_2 > C_TCO_2_MAX_ECTPWM" VALUE 0x84fcc6 _REC_VAL_20_u2 99.99847412109381 _CNV_A_R_LINEAR_____258_CM 0. 99.99847412109381 DISPLAY_IDENTIFIER C_ECTPWM_SUB /end CHARACTERISTIC
/begin CHARACTERISTIC c_ectpwm_max "maximum value for ECTPWM" VALUE 0x84fcc2 _REC_VAL_20_u2 99.99847412109381 _CNV_A_R_LINEAR_____258_CM 0. 99.99847412109381 DISPLAY_IDENTIFIER C_ECTPWM_MAX /end CHARACTERISTIC
/begin CHARACTERISTIC c_ectpwm_min "minimum value for ECTPWM" VALUE 0x84fcc4 _REC_VAL_20_u2 99.99847412109381 _CNV_A_R_LINEAR_____258_CM 0. 99.99847412109381 DISPLAY_IDENTIFIER C_ECTPWM_MIN /end CHARACTERISTIC
/begin CHARACTERISTIC c_tco_2_max_ectpwm_bol "Maximum TCO_2 threshold to activate ECTPWM_SUB(lower limit)" VALUE 0x85000e _REC_VAL_20_u1 190.5 _CNV_A_R_LINEAR_____241_CM -48. 142.5 DISPLAY_IDENTIFIER C_TCO_2_MAX_ECTPWM_BOL FORMAT "%5.1" /end CHARACTERISTIC
/begin CHARACTERISTIC c_ectpwm_sub_st "ECTPWM while Start phase" VALUE 0x84fcca _REC_VAL_20_u2 99.99847412109381 _CNV_A_R_LINEAR_____258_CM 0. 99.99847412109381 DISPLAY_IDENTIFIER C_ECTPWM_SUB_ST /end CHARACTERISTIC
/begin CHARACTERISTIC c_ectpwm_sub_pwl "ECTPWM while non cooling management power latch phase" VALUE 0x84fcc8 _REC_VAL_20_u2 99.99847412109381 _CNV_A_R_LINEAR_____258_CM 0. 99.99847412109381 DISPLAY_IDENTIFIER C_ECTPWM_SUB_PWL /end CHARACTERISTIC
/begin CHARACTERISTIC c_t_ast_min_ectpwm "Time after Start for setting ECTPWM to substitute value C_ECTPWM_SUB_ST" VALUE 0x84ff24 _REC_VAL_20_u2 6553.5 _CNV_A_R_LINEAR_____240_CM 0. 6553.5 DISPLAY_IDENTIFIER C_T_AST_MIN_ECTPWM FORMAT "%6.1" /end CHARACTERISTIC
/begin AXIS_PTS ldp_tco_dif__ectpwm_i "" 0x844270 tco_dif _REC_AXS_20_u1 191.25 _CNV_A_R_LINEAR_____261_CM 12 -96. 95.25 FORMAT "%4.1" /end AXIS_PTS
/begin CHARACTERISTIC ip_ectpwm_i "integral part of ECTPWM controller" CURVE 0x846392 _REC_CUR_20_u2_u1 199.9969482 _CNV_A_R_LINEAR_____161_CM -100. 99.99694820000001 DISPLAY_IDENTIFIER IP_ECTPWM_I FORMAT "%8.3"
 /begin AXIS_DESCR COM_AXIS tco_dif _CNV_A_R_LINEAR_____261_CM 12 -96. 95.25 FORMAT "%4.1" AXIS_PTS_REF ldp_tco_dif__ectpwm_i /end AXIS_DESCR
/end CHARACTERISTIC
/begin AXIS_PTS ldp_tco_dif__ectpwm_bas "" 0x844267 tco_dif _REC_AXS_20_u1 191.25 _CNV_A_R_LINEAR_____261_CM 8 -96. 95.25 FORMAT "%4.1" /end AXIS_PTS
/begin AXIS_PTS ldp_tco_sp__ectpwm_bas "" 0x8442ab tco_sp _REC_AXS_20_u1 190.5 _CNV_A_R_LINEAR_____241_CM 8 -48. 142.5 FORMAT "%5.1" /end AXIS_PTS
/begin CHARACTERISTIC ip_ectpwm_bas "basic map for ECTPWM (pre control)" MAP 0x846312 _REC_MAP_20_u2_u1_u1 99.99847412109381 _CNV_A_R_LINEAR_____258_CM 0. 99.99847412109381 DISPLAY_IDENTIFIER IP_ECTPWM_BAS
 /begin AXIS_DESCR COM_AXIS tco_dif _CNV_A_R_LINEAR_____261_CM 8 -96. 95.25 FORMAT "%4.1" AXIS_PTS_REF ldp_tco_dif__ectpwm_bas /end AXIS_DESCR
 /begin AXIS_DESCR COM_AXIS tco_sp _CNV_A_R_LINEAR_____241_CM 8 -48. 142.5 FORMAT "%5.1" AXIS_PTS_REF ldp_tco_sp__ectpwm_bas /end AXIS_DESCR
/end CHARACTERISTIC
/begin CHARACTERISTIC c_t_accin_dly_st "" VALUE 0x84ff1d _REC_VAL_20_u1 25.5 _CNV_A_R_LINEAR_____19_CM 0. 25.5 DISPLAY_IDENTIFIER C_T_ACCIN_DLY_ST FORMAT "%2.1" /end CHARACTERISTIC
/begin CHARACTERISTIC c_pv_accin_fl_thd "Volllastschwelle fuer Klimakompressorabwurf" VALUE 0x84fec0 _REC_VAL_20_u2 99.90000000000001 _CNV_A_R_LINEAR_____266_CM 0. 99.90000000000001 DISPLAY_IDENTIFIER C_PV_ACCIN_FL_THD FORMAT "%2.1" /end CHARACTERISTIC
/begin CHARACTERISTIC c_n_accin_fl_thd "Drehzahlschwelle fuer Klimakompressorabwurf bei Vollast" VALUE 0x84fdde _REC_VAL_20_u2 6375. _CNV_A_R_LINEAR_____267_CM 0. 6375. DISPLAY_IDENTIFIER C_N_ACCIN_FL_THD FORMAT "%4.0" /end CHARACTERISTIC
/begin CHARACTERISTIC c_t_max_accin_fl "Maximale Abschaltzeit des Kompressors bei Vollast" VALUE 0x84ffb8 _REC_VAL_20_u1 25.5 _CNV_A_R_LINEAR_____19_CM 0. 25.5 DISPLAY_IDENTIFIER C_T_MAX_ACCIN_FL FORMAT "%3.1" /end CHARACTERISTIC
/begin CHARACTERISTIC c_t_min_accin_fl "Minimale Abschaltzeit des Kompressors bei Vollast" VALUE 0x84ffd0 _REC_VAL_20_u1 25.5 _CNV_A_R_LINEAR_____19_CM 0. 25.5 DISPLAY_IDENTIFIER C_T_MIN_ACCIN_FL FORMAT "%3.1" /end CHARACTERISTIC
/begin CHARACTERISTIC c_tco_accin_tol "Kuehlwassertemperaturschwelle fuer Klimakompressorabwurf" VALUE 0x850013 _REC_VAL_20_u1 255. _CNV_A_R_LINEAR_____18_CM -50. 205. DISPLAY_IDENTIFIER C_TCO_ACCIN_TOL FORMAT "%3.0" /end CHARACTERISTIC
/begin CHARACTERISTIC c_tco_accin_bol "Kuehlwassertemperaturschwelle fuer Wiedereinschalten des Klimakompressors" VALUE 0x850012 _REC_VAL_20_u1 255. _CNV_A_R_LINEAR_____18_CM -50. 205. DISPLAY_IDENTIFIER C_TCO_ACCIN_BOL FORMAT "%3.0" /end CHARACTERISTIC
/begin CHARACTERISTIC c_acp_high_bol "Einschaltung Klimakompressor wegen Kaeltemitteldruck nicht mehr zu hoch" VALUE 0x84fb8a _REC_VAL_20_u1 3100. _CNV_A_R_LINEAR_____209_CM 0. 3100. DISPLAY_IDENTIFIER C_ACP_HIGH_BOL FORMAT "%4.0" /end CHARACTERISTIC
/begin CHARACTERISTIC c_acp_high_tol "Abschaltung Klimakompressor wegen Kaeltemittel zu hoch" VALUE 0x84fb8b _REC_VAL_20_u1 3100. _CNV_A_R_LINEAR_____209_CM 0. 3100. DISPLAY_IDENTIFIER C_ACP_HIGH_TOL FORMAT "%4.0" /end CHARACTERISTIC
/begin CHARACTERISTIC c_acp_low_bol "Abschaltung Klimakompressor wegen Kaeltemitteldruck zu niedrig" VALUE 0x84fb8c _REC_VAL_20_u1 3100. _CNV_A_R_LINEAR_____209_CM 0. 3100. DISPLAY_IDENTIFIER C_ACP_LOW_BOL FORMAT "%4.0" /end CHARACTERISTIC
/begin CHARACTERISTIC c_acp_low_tol "Einschaltung Klimakomporessor wegen Kaeltemitteldruck nicht mehr zu niedrig" VALUE 0x84fb8d _REC_VAL_20_u1 3100. _CNV_A_R_LINEAR_____209_CM 0. 3100. DISPLAY_IDENTIFIER C_ACP_LOW_TOL FORMAT "%4.0" /end CHARACTERISTIC
/begin CHARACTERISTIC c_t_dly_accin "Einschaltverzoegerung Klimakompressor" VALUE 0x84ff62 _REC_VAL_20_u1 25.5 _CNV_A_R_LINEAR_____19_CM 0. 25.5 DISPLAY_IDENTIFIER C_T_DLY_ACCIN FORMAT "%3.1" /end CHARACTERISTIC
/begin CHARACTERISTIC c_t_min_accout_rly "Minimale Abschaltzeit des Kompressors" VALUE 0x84ffd1 _REC_VAL_20_u1 25.5 _CNV_A_R_LINEAR_____19_CM 0. 25.5 DISPLAY_IDENTIFIER C_T_MIN_ACCOUT_RLY FORMAT "%3.1" /end CHARACTERISTIC
/begin MEASUREMENT lv_acc_ena_fl "" UBYTE _CNV_S_2_RANGE__0___85_CM 1 0. 0. 1. DISPLAY_IDENTIFIER LV_ACC_ENA_FL ECU_ADDRESS 0x7fccb4 /end MEASUREMENT
/begin MEASUREMENT lv_acc_ena_st "" UBYTE _CNV_S_2_RANGE__0___85_CM 1 0. 0. 1. DISPLAY_IDENTIFIER LV_ACC_ENA_ST ECU_ADDRESS 0x7fccb5 /end MEASUREMENT
/begin MEASUREMENT lv_acc_ena_sys_err "" UBYTE _CNV_S_2_RANGE__0___85_CM 1 0. 0. 1. DISPLAY_IDENTIFIER LV_ACC_ENA_SYS_ERR ECU_ADDRESS 0x7fccb9 /end MEASUREMENT
/begin MEASUREMENT lv_acc_ena_acp "" UBYTE _CNV_S_2_RANGE__0___85_CM 1 0. 0. 1. DISPLAY_IDENTIFIER LV_ACC_ENA_ACP ECU_ADDRESS 0x7fccba /end MEASUREMENT
/begin MEASUREMENT lv_accin "" UBYTE _CNV_S_2_RANGE__0___85_CM 1 0. 0. 1. DISPLAY_IDENTIFIER LV_ACCIN ECU_ADDRESS 0x7fbbff /end MEASUREMENT
/begin MEASUREMENT lv_acc_ena_tco "" UBYTE _CNV_S_2_RANGE__0___85_CM 1 0. 0. 1. DISPLAY_IDENTIFIER LV_ACC_ENA_TCO ECU_ADDRESS 0x7fccb6 /end MEASUREMENT
/begin MEASUREMENT lv_acc_off_cmd "" UBYTE _CNV_S_2_RANGE__0___85_CM 1 0. 0. 1. DISPLAY_IDENTIFIER LV_ACC_OFF_CMD ECU_ADDRESS 0x7fbbfe /end MEASUREMENT
/begin MEASUREMENT lv_acc_driv_req "" UBYTE _CNV_S_2_RANGE__0___85_CM 1 0. 0. 1. DISPLAY_IDENTIFIER LV_ACC_DRIV_REQ ECU_ADDRESS 0x7fbc00 /end MEASUREMENT
/begin MEASUREMENT lv_acin_man "" UBYTE _CNV_A_R_LINEAR_____1_CM 1 0. 0. 1. DISPLAY_IDENTIFIER LV_ACIN_MAN ECU_ADDRESS 0x7fccbc FORMAT "%1.0" /end MEASUREMENT
/begin MEASUREMENT lv_old_acc_di "" UBYTE _CNV_A_R_LINEAR_____1_CM 1 0. 0. 1. DISPLAY_IDENTIFIER LV_OLD_ACC_DI ECU_ADDRESS 0x7fccbb FORMAT "%1.0" /end MEASUREMENT
/begin MEASUREMENT lv_acin_can_ecu "" UBYTE _CNV_A_R_LINEAR_____1_CM 1 0. 0. 1. DISPLAY_IDENTIFIER LV_ACIN_CAN_ECU ECU_ADDRESS 0x7fccbd FORMAT "%1.0" /end MEASUREMENT
/begin MEASUREMENT accpwm_b "" UWORD _CNV_A_R_LINEAR_____8_CM 1 0. 0. 99.99847412109381 DISPLAY_IDENTIFIER ACCPWM_B ECU_ADDRESS 0x7fbc02 BYTE_ORDER MSB_LAST FORMAT "%5.2" /end MEASUREMENT
/begin MEASUREMENT lv_acc_ena "" UBYTE _CNV_S_2_RANGE__0___85_CM 1 0. 0. 1. DISPLAY_IDENTIFIER LV_ACC_ENA ECU_ADDRESS 0x7fccb3 /end MEASUREMENT
/begin MEASUREMENT t_accin_dly_st "" UBYTE _CNV_A_R_LINEAR_____16_CM 1 0. 0. 255. DISPLAY_IDENTIFIER T_ACCIN_DLY_ST ECU_ADDRESS 0x7fccb2 FORMAT "%3.0" /end MEASUREMENT
/begin MEASUREMENT t_accin_fl "" UBYTE _CNV_A_R_LINEAR_____16_CM 1 0. 0. 255. DISPLAY_IDENTIFIER T_ACCIN_FL ECU_ADDRESS 0x7fccae FORMAT "%3.0" /end MEASUREMENT
/begin MEASUREMENT t_dly_accin "" UBYTE _CNV_A_R_LINEAR_____16_CM 1 0. 0. 255. DISPLAY_IDENTIFIER T_DLY_ACCIN ECU_ADDRESS 0x7fccb1 FORMAT "%3.0" /end MEASUREMENT
/begin MEASUREMENT t_dly_accin_st "" UBYTE _CNV_A_R_LINEAR_____16_CM 1 0. 0. 255. DISPLAY_IDENTIFIER T_DLY_ACCIN_ST ECU_ADDRESS 0x7fccaf FORMAT "%3.0" /end MEASUREMENT
/begin MEASUREMENT t_min_accout_rly "" UBYTE _CNV_A_R_LINEAR_____16_CM 1 0. 0. 255. DISPLAY_IDENTIFIER T_MIN_ACCOUT_RLY ECU_ADDRESS 0x7fccb0 FORMAT "%3.0" /end MEASUREMENT
/begin MEASUREMENT lv_acc_ena_tcu1 "" UBYTE _CNV_S_2_RANGE__0___85_CM 1 0. 0. 1. DISPLAY_IDENTIFIER LV_ACC_ENA_TCU1 ECU_ADDRESS 0x7fccb7 /end MEASUREMENT
/begin MEASUREMENT lv_acc_ena_vecu1 "" UBYTE _CNV_S_2_RANGE__0___85_CM 1 0. 0. 1. DISPLAY_IDENTIFIER LV_ACC_ENA_VECU1 ECU_ADDRESS 0x7fccb8 /end MEASUREMENT
/begin MEASUREMENT lv_acin "" UBYTE _CNV_S_2_RANGE______23_CM 1 0. 0. 1. DISPLAY_IDENTIFIER LV_ACIN ECU_ADDRESS 0x7fbbfc /end MEASUREMENT
/begin MEASUREMENT lv_accout_rly "" UBYTE _CNV_S_2_RANGE______23_CM 1 0. 0. 1. DISPLAY_IDENTIFIER LV_ACCOUT_RLY ECU_ADDRESS 0x7fbbfd /end MEASUREMENT
/begin MEASUREMENT sf_eng_state "engine states" UBYTE _CNV_S_4_Engine_Sta_342_CM 1 0. 1. 8. DISPLAY_IDENTIFIER SF_ENG_STATE ECU_ADDRESS 0x7fb880 /end MEASUREMENT
/begin MEASUREMENT lv_es "engine state : engine stop" UBYTE _CNV_S_2_RANGE______11_CM 1 0. 0. 1. DISPLAY_IDENTIFIER LV_ES ECU_ADDRESS 0x7fb882 /end MEASUREMENT
/begin MEASUREMENT lv_st "engine state : start" UBYTE _CNV_S_2_RANGE______11_CM 1 0. 0. 1. DISPLAY_IDENTIFIER LV_ST ECU_ADDRESS 0x7fb883 /end MEASUREMENT
/begin MEASUREMENT lv_is "engine state : idle" UBYTE _CNV_S_2_RANGE______11_CM 1 0. 0. 1. DISPLAY_IDENTIFIER LV_IS ECU_ADDRESS 0x7fb884 /end MEASUREMENT
/begin MEASUREMENT lv_pl "engine state : part load" UBYTE _CNV_S_2_RANGE______11_CM 1 0. 0. 1. DISPLAY_IDENTIFIER LV_PL ECU_ADDRESS 0x7fb885 /end MEASUREMENT
/begin MEASUREMENT lv_puc "pull fuel cutoff" UBYTE _CNV_S_2_RANGE______11_CM 1 0. 0. 1. DISPLAY_IDENTIFIER LV_PUC ECU_ADDRESS 0x7fb881 /end MEASUREMENT
/begin MEASUREMENT lv_st_end "engine operating state start not active" UBYTE _CNV_S_2_RANGE______11_CM 1 0. 0. 1. DISPLAY_IDENTIFIER LV_ST_END ECU_ADDRESS 0x7fb886 /end MEASUREMENT
/begin MEASUREMENT t_ast "timer after start" UWORD _CNV_A_R_LINEAR_____19_CM 1 0. 0. 6553.5 DISPLAY_IDENTIFIER T_AST ECU_ADDRESS 0x7f99ca BYTE_ORDER MSB_LAST FORMAT "%2.1" /end MEASUREMENT
/begin MEASUREMENT t_apl "timer after part load" UWORD _CNV_A_R_LINEAR_____19_CM 1 0. 0. 6553.5 DISPLAY_IDENTIFIER T_APL ECU_ADDRESS 0x7f99cc BYTE_ORDER MSB_LAST FORMAT "%2.1" /end MEASUREMENT
/begin CHARACTERISTIC ip_n_max_tol_st__tco "AENGSTAT: Threshold engine speed for ST" CURVE 0x857e26 _REC_CUR_20_u2_u1 6375. _CNV_A_R_LINEAR_____5_CM 0. 6375. DISPLAY_IDENTIFIER IP_N_MAX_TOL_ST__TCO FORMAT "%4.0"
 /begin AXIS_DESCR COM_AXIS tco _CNV_A_R_LINEAR_____18_CM 8 -50. 205. FORMAT "%3.0" AXIS_PTS_REF ldp_tco_ip_n_max_tol_st /end AXIS_DESCR
/end CHARACTERISTIC
/begin AXIS_PTS ldp_tco_ip_n_max_tol_st "" 0x8423bd tco _REC_AXS_20_u1 255. _CNV_A_R_LINEAR_____18_CM 8 -50. 205. FORMAT "%3.0" /end AXIS_PTS
/begin CHARACTERISTIC c_n_max_bol_st "Lower engine speed level" VALUE 0x85cb16 _REC_VAL_20_u2 6375. _CNV_A_R_LINEAR_____5_CM 0. 6375. DISPLAY_IDENTIFIER C_N_MAX_BOL_ST FORMAT "%4.0" /end CHARACTERISTIC
/begin CHARACTERISTIC c_n_min_bol "Upper engine speed level" VALUE 0x85cb34 _REC_VAL_20_u2 6375. _CNV_A_R_LINEAR_____5_CM 0. 6375. DISPLAY_IDENTIFIER C_N_MIN_BOL FORMAT "%4.0" /end CHARACTERISTIC
/begin CHARACTERISTIC c_pv_av_min "Pedal value minimum for IS" VALUE 0x85cb6a _REC_VAL_20_u2 99.90000000000001 _CNV_A_R_LINEAR_____266_CM 0. 99.90000000000001 DISPLAY_IDENTIFIER C_PV_AV_MIN FORMAT "%4.2" /end CHARACTERISTIC
/begin CHARACTERISTIC c_ctr_max_ti_min "maximum countervalue for minimal injection-time mode" VALUE 0x85c971 _REC_VAL_20_u1 255. _CNV_A_R_LINEAR_____0_CM 0. 255. DISPLAY_IDENTIFIER C_CTR_MAX_TI_MIN FORMAT "%3.0" /end CHARACTERISTIC
/begin MEASUREMENT lv_rest "auxiliary function re-start" UBYTE _CNV_S_2_RANGE______11_CM 1 0. 0. 1. DISPLAY_IDENTIFIER LV_REST ECU_ADDRESS 0x7fb888 /end MEASUREMENT
/begin MEASUREMENT tco_rest "coolant temperature stored to detect  a re-start" UBYTE _CNV_A_R_LINEAR_____18_CM 1 0. -50. 205. DISPLAY_IDENTIFIER TCO_REST ECU_ADDRESS 0x7fb887 FORMAT "%3.0" /end MEASUREMENT
/begin MEASUREMENT lv_rest_auth "authorisation for restart" UBYTE _CNV_S_2_RANGE______11_CM 1 0. 0. 1. DISPLAY_IDENTIFIER LV_REST_AUTH ECU_ADDRESS 0x7fb889 /end MEASUREMENT
/begin CHARACTERISTIC c_t_max_rest "time delay after switching on from LV_ST to detect LV_REST" VALUE 0x85cc5e _REC_VAL_20_u2 6553.5 _CNV_A_R_LINEAR_____19_CM 0. 6553.5 DISPLAY_IDENTIFIER C_T_MAX_REST FORMAT "%5.1" /end CHARACTERISTIC
/begin CHARACTERISTIC c_tco_dif_max_rest "coolant temperature threshold to detect LV_REST" VALUE 0x85cca5 _REC_VAL_20_u1 255. _CNV_A_R_LINEAR_____20_CM 0. 255. DISPLAY_IDENTIFIER C_TCO_DIF_MAX_REST FORMAT "%3.0" /end CHARACTERISTIC
/begin MEASUREMENT lv_str_1_2_on "Einschaltanforderung fuer beide Starterrelais" UBYTE _CNV_S_2_RANGE__0___85_CM 1 0. 0. 1. DISPLAY_IDENTIFIER LV_STR_1_2_ON ECU_ADDRESS 0x7fb894 BIT_MASK 0x1 /end MEASUREMENT
/begin MEASUREMENT lv_err_str_2 "Starterrelais 2 defekt" UBYTE _CNV_S_2_RANGE__0___85_CM 1 0. 0. 1. DISPLAY_IDENTIFIER LV_ERR_STR_2 ECU_ADDRESS 0x7fb898 BIT_MASK 0x1 /end MEASUREMENT
/begin MEASUREMENT lv_str_1_2_off "Angeforderte Abschaltreihenfolge:Starterrelais 1- Starterrelais 2" UBYTE _CNV_S_2_RANGE__0___85_CM 1 0. 0. 1. DISPLAY_IDENTIFIER LV_STR_1_2_OFF ECU_ADDRESS 0x7fb896 BIT_MASK 0x1 /end MEASUREMENT
/begin MEASUREMENT ctr_str "Zaehler Startversuche" UBYTE _CNV_A_R_LINEAR_____1_CM 1 0. 0. 255. DISPLAY_IDENTIFIER CTR_STR ECU_ADDRESS 0x7fbe80 FORMAT "%3.0" /end MEASUREMENT
/begin MEASUREMENT lv_err_str_1 "Starterrelais 1 defekt" UBYTE _CNV_S_2_RANGE__0___85_CM 1 0. 0. 1. DISPLAY_IDENTIFIER LV_ERR_STR_1 ECU_ADDRESS 0x7fb897 BIT_MASK 0x1 /end MEASUREMENT
/begin MEASUREMENT lv_err_str_1_2 "Diagnoseflag Starterrelais" UBYTE _CNV_S_2_RANGE__0___85_CM 1 0. 0. 1. DISPLAY_IDENTIFIER LV_ERR_STR_1_2 ECU_ADDRESS 0x7fb895 BIT_MASK 0x1 /end MEASUREMENT
/begin MEASUREMENT t_str_rng "Regenerierungszeit Starter" UWORD _CNV_A_R_LINEAR_____226_CM 1 0. 0. 655.35 DISPLAY_IDENTIFIER T_STR_RNG ECU_ADDRESS 0x7fa950 BYTE_ORDER MSB_LAST FORMAT "%6.2" /end MEASUREMENT
/begin MEASUREMENT t_str_n_min "Zeit fuer N unter Einspurdrehzahl" UWORD _CNV_A_R_LINEAR_____226_CM 1 0. 0. 655.35 DISPLAY_IDENTIFIER T_STR_N_MIN ECU_ADDRESS 0x7fa954 BYTE_ORDER MSB_LAST FORMAT "%6.2" /end MEASUREMENT
/begin MEASUREMENT lv_str_1 "Starterrelais 1 (STC_HOLD)" UBYTE _CNV_S_2_RANGE__0___85_CM 1 0. 0. 1. DISPLAY_IDENTIFIER LV_STR_1 ECU_ADDRESS 0x7fb899 BIT_MASK 0x1 /end MEASUREMENT
/begin MEASUREMENT lv_kl15_lock "Bit fuer Klemme 15 Sperre" UBYTE _CNV_S_2_RANGE__0___85_CM 1 0. 0. 1. DISPLAY_IDENTIFIER LV_KL15_LOCK ECU_ADDRESS 0x7fbe81 BIT_MASK 0x1 /end MEASUREMENT
/begin MEASUREMENT t_str_sum "Zeit Anlasser aktiv bei mehreren Startversuchen" UWORD _CNV_A_R_LINEAR_____226_CM 1 0. 0. 655.35 DISPLAY_IDENTIFIER T_STR_SUM ECU_ADDRESS 0x7fa952 BYTE_ORDER MSB_LAST FORMAT "%6.2" /end MEASUREMENT
/begin MEASUREMENT t_str_act "Zeit nach Einspurdrehzahl ueberschritten" UWORD _CNV_A_R_LINEAR_____226_CM 1 0. 0. 655.35 DISPLAY_IDENTIFIER T_STR_ACT ECU_ADDRESS 0x7fa94a BYTE_ORDER MSB_LAST FORMAT "%6.2" /end MEASUREMENT
/begin MEASUREMENT t_vs_str_off "Zeit fuer die das FZ vom Anlasser bewegt wird" UWORD _CNV_A_R_LINEAR_____226_CM 1 0. 0. 655.35 DISPLAY_IDENTIFIER T_VS_STR_OFF ECU_ADDRESS 0x7fa94c BYTE_ORDER MSB_LAST FORMAT "%6.2" /end MEASUREMENT
/begin MEASUREMENT t_chk_eng_stop "Zeitzaehler fuer Pruefung \\'Motor steht\\'" UWORD _CNV_A_R_LINEAR_____226_CM 1 0. 0. 655.35 DISPLAY_IDENTIFIER T_CHK_ENG_STOP ECU_ADDRESS 0x7fa946 BYTE_ORDER MSB_LAST FORMAT "%6.2" /end MEASUREMENT
/begin MEASUREMENT lv_str_2 "Starterrelais 2 (STC_OFF)" UBYTE _CNV_S_2_RANGE__0___85_CM 1 0. 0. 1. DISPLAY_IDENTIFIER LV_STR_2 ECU_ADDRESS 0x7fb89a BIT_MASK 0x1 /end MEASUREMENT
/begin MEASUREMENT lv_n_sub "Flag fuer Aktivierung der Startverlaengerung bei KW-Fehler" UBYTE _CNV_S_2_RANGE__0___85_CM 1 0. 0. 1. DISPLAY_IDENTIFIER LV_N_SUB ECU_ADDRESS 0x7fbe82 BIT_MASK 0x1 /end MEASUREMENT
/begin MEASUREMENT t_str_off "Abschaltzeit Starterrelais" UWORD _CNV_A_R_LINEAR_____226_CM 1 0. 0. 655.35 DISPLAY_IDENTIFIER T_STR_OFF ECU_ADDRESS 0x7fa94e BYTE_ORDER MSB_LAST FORMAT "%6.2" /end MEASUREMENT
/begin MEASUREMENT t_n_sub "Zeitzaehler fuer Pruefung KW-Fehler vorhanden" UWORD _CNV_A_R_LINEAR_____226_CM 1 0. 0. 655.35 DISPLAY_IDENTIFIER T_N_SUB ECU_ADDRESS 0x7fa948 BYTE_ORDER MSB_LAST FORMAT "%6.2" /end MEASUREMENT
/begin MEASUREMENT lv_sta_rls "Anlasserfreigabebit ueber CAN (Motor5 Byte7 Bit0)" UBYTE _CNV_S_2_RANGE__0___85_CM 1 0. 0. 1. DISPLAY_IDENTIFIER LV_STA_RLS ECU_ADDRESS 0x7fb892 BIT_MASK 0x1 /end MEASUREMENT
/begin MEASUREMENT lv_sta_stop "Anlasser-Stop-Bit ueber CAN (Motor5 Byte7 Bit1)" UBYTE _CNV_S_2_RANGE__0___85_CM 1 0. 0. 1. DISPLAY_IDENTIFIER LV_STA_STOP ECU_ADDRESS 0x7fb893 BIT_MASK 0x1 /end MEASUREMENT
/begin CHARACTERISTIC c_t_str_n_min "Max. Zeit fuer N unter Einspurdrehzahl (MSG)" VALUE 0x84fff0 _REC_VAL_20_u2 655.35 _CNV_A_R_LINEAR_____226_CM 0. 655.35 DISPLAY_IDENTIFIER C_T_STR_N_MIN FORMAT "%6.2" /end CHARACTERISTIC
/begin CHARACTERISTIC c_t_max_n_sub "UEberpruefungszeit bis Startverlaengerung bei KW-Fehler aktiv (MSG)" VALUE 0x84ffc0 _REC_VAL_20_u2 655.35 _CNV_A_R_LINEAR_____226_CM 0. 655.35 DISPLAY_IDENTIFIER C_T_MAX_N_SUB FORMAT "%6.2" /end CHARACTERISTIC
/begin CHARACTERISTIC c_cam_1_ctr_max "Max. Anzahl NW-Flanken bis Startverlaengerung bei KW-Fehler aktiv (MSG)" VALUE 0x84fbdf _REC_VAL_20_u1 255. _CNV_A_R_LINEAR_____1_CM 0. 255. DISPLAY_IDENTIFIER C_CAM_1_CTR_MAX FORMAT "%3.0" /end CHARACTERISTIC
/begin CHARACTERISTIC c_t_str_rng "Regenerierungszeit Starter (MSG)" VALUE 0x84fff4 _REC_VAL_20_u2 655.35 _CNV_A_R_LINEAR_____226_CM 0. 655.35 DISPLAY_IDENTIFIER C_T_STR_RNG FORMAT "%6.2" /end CHARACTERISTIC
/begin CHARACTERISTIC c_n_str_min "Einspurdrehzahl (MSG + BSG)" VALUE 0x84fe28 _REC_VAL_20_u2 8160. _CNV_A_R_LINEAR_____154_CM 0. 8160. DISPLAY_IDENTIFIER C_N_STR_MIN FORMAT "%4.0" /end CHARACTERISTIC
/begin CHARACTERISTIC c_t_str_off_max "Max. Abschaltzeit der Starterrelais (MSG)" VALUE 0x84fff2 _REC_VAL_20_u2 655.35 _CNV_A_R_LINEAR_____226_CM 0. 655.35 DISPLAY_IDENTIFIER C_T_STR_OFF_MAX FORMAT "%6.2" /end CHARACTERISTIC
/begin CHARACTERISTIC c_n_chk_eng_stop "Drehzahlschwelle fuer Erkennung \\'Motor-steht \\' (BSG)" VALUE 0x84fde0 _REC_VAL_20_u2 8160. _CNV_A_R_LINEAR_____154_CM 0. 8160. DISPLAY_IDENTIFIER C_N_CHK_ENG_STOP FORMAT "%4.0" /end CHARACTERISTIC
/begin CHARACTERISTIC c_vs_str_off "Geschwindigkeitsschwelle fuer Abschalten d. Anlassers (BSG)" VALUE 0x850104 _REC_VAL_20_u1 255. _CNV_A_R_LINEAR_____245_CM 0. 255. DISPLAY_IDENTIFIER C_VS_STR_OFF FORMAT "%3.0" /end CHARACTERISTIC
/begin AXIS_PTS ldp_ctr_str_id_t_str_sum_max "" 0x843faf ctr_str _REC_AXS_20_u1 255. _CNV_A_R_LINEAR_____1_CM 6 0. 255. FORMAT "%3.0" /end AXIS_PTS
/begin CHARACTERISTIC ip_n_str_off "Drehzahlabschaltschwelle Starterrelais (MSG + BSG)" CURVE 0x84d42c _REC_CUR_20_u2_u1 8160. _CNV_A_R_LINEAR_____154_CM 0. 8160. DISPLAY_IDENTIFIER IP_N_STR_OFF FORMAT "%4.0"
 /begin AXIS_DESCR COM_AXIS tco _CNV_A_R_LINEAR_____241_CM 6 -48. 142.5 FORMAT "%5.1" AXIS_PTS_REF ldp_tco_ip_n_str_off /end AXIS_DESCR
/end CHARACTERISTIC
/begin AXIS_PTS ldp_tco_ip_t_str_act_max "" 0x84429d tco _REC_AXS_20_u1 190.5 _CNV_A_R_LINEAR_____241_CM 6 -48. 142.5 FORMAT "%5.1" /end AXIS_PTS
/begin CHARACTERISTIC id_fac_n_str "Ausspur-Drehzahlanhebung nach Fehlstart (MSG)" CURVE 0x84452c _REC_CUR_20_u1_u1 7.96875 _CNV_A_R_LINEAR_____304_CM 0. 7.96875 DISPLAY_IDENTIFIER ID_FAC_N_STR FORMAT "%4.2"
 /begin AXIS_DESCR COM_AXIS ctr_str _CNV_A_R_LINEAR_____1_CM 6 0. 255. FORMAT "%3.0" AXIS_PTS_REF ldp_ctr_str_id_fac_n_str /end AXIS_DESCR
/end CHARACTERISTIC
/begin CHARACTERISTIC ip_t_str_act_max "Maximale Startzeit nach UEberschreiten der Einspurdrehzahl (BSG)" CURVE 0x84f0f2 _REC_CUR_20_u2_u1 655.35 _CNV_A_R_LINEAR_____226_CM 0. 655.35 DISPLAY_IDENTIFIER IP_T_STR_ACT_MAX FORMAT "%6.2"
 /begin AXIS_DESCR COM_AXIS tco _CNV_A_R_LINEAR_____241_CM 6 -48. 142.5 FORMAT "%5.1" AXIS_PTS_REF ldp_tco_ip_t_str_act_max /end AXIS_DESCR
/end CHARACTERISTIC
/begin CHARACTERISTIC c_t_chk_eng_stop "UEberpruefungszeit fuer Erkennung \\'Motor -steht\\' (BSG)" VALUE 0x84ff44 _REC_VAL_20_u2 655.35 _CNV_A_R_LINEAR_____226_CM 0. 655.35 DISPLAY_IDENTIFIER C_T_CHK_ENG_STOP FORMAT "%6.2" /end CHARACTERISTIC
/begin CHARACTERISTIC c_t_max_vs_str_off "Maximale Zeit die das FZ mit dem Anlasser bewegt werden darf" VALUE 0x84ffce _REC_VAL_20_u2 655.35 _CNV_A_R_LINEAR_____226_CM 0. 655.35 DISPLAY_IDENTIFIER C_T_MAX_VS_STR_OFF FORMAT "%6.2" /end CHARACTERISTIC
/begin CHARACTERISTIC lc_kl15_lock "Schalter fuer Konfiguration Klemme 15 Sperre (BSG)" VALUE 0x85014e _REC_VAL_20_u1 1. _CNV_A_R_LINEAR_____0_CM 0. 1. DISPLAY_IDENTIFIER LC_KL15_LOCK FORMAT "%2.0" /end CHARACTERISTIC
/begin AXIS_PTS ldp_tco_ip_n_str_off "" 0x844296 tco _REC_AXS_20_u1 190.5 _CNV_A_R_LINEAR_____241_CM 6 -48. 142.5 FORMAT "%5.1" /end AXIS_PTS
/begin AXIS_PTS ldp_tco_ip_dur_str_nom_str_act "" 0x84428f tco _REC_AXS_20_u1 190.5 _CNV_A_R_LINEAR_____241_CM 6 -48. 142.5 FORMAT "%5.1" /end AXIS_PTS
/begin AXIS_PTS ldp_ctr_str_id_fac_n_str "" 0x843fa8 ctr_str _REC_AXS_20_u1 255. _CNV_A_R_LINEAR_____1_CM 6 0. 255. FORMAT "%3.0" /end AXIS_PTS
/begin AXIS_PTS ldp_t_ip_dur_str_nom_str_act "" 0x844184 t_gl_es _REC_AXS_20_u2 655.35 _CNV_A_R_LINEAR_____226_CM 6 0. 655.35 FORMAT "%6.2" /end AXIS_PTS
/begin CHARACTERISTIC id_t_str_sum_max "Max. Anlasserbetriebszeit abh.von Anzahl Startversuche (MSG)" CURVE 0x844de6 _REC_CUR_20_u2_u1 655.35 _CNV_A_R_LINEAR_____226_CM 0. 655.35 DISPLAY_IDENTIFIER ID_T_STR_SUM_MAX FORMAT "%6.2"
 /begin AXIS_DESCR COM_AXIS ctr_str _CNV_A_R_LINEAR_____1_CM 6 0. 255. FORMAT "%3.0" AXIS_PTS_REF ldp_ctr_str_id_t_str_sum_max /end AXIS_DESCR
/end CHARACTERISTIC
/begin CHARACTERISTIC ip_dur_str_nom_str_act "Gluehzeit" MAP 0x846262 _REC_MAP_20_u2_u1_u2 655.35 _CNV_A_R_LINEAR_____226_CM 0. 655.35 DISPLAY_IDENTIFIER IP_DUR_STR_NOM_STR_ACT FORMAT "%6.2"
 /begin AXIS_DESCR COM_AXIS tco _CNV_A_R_LINEAR_____241_CM 6 -48. 142.5 FORMAT "%5.1" AXIS_PTS_REF ldp_tco_ip_dur_str_nom_str_act /end AXIS_DESCR
 /begin AXIS_DESCR COM_AXIS t_gl_es _CNV_A_R_LINEAR_____226_CM 6 0. 655.35 FORMAT "%6.2" AXIS_PTS_REF ldp_t_ip_dur_str_nom_str_act /end AXIS_DESCR
/end CHARACTERISTIC
/begin CHARACTERISTIC lc_n_sub "Bei LC_N_SUB = 1 wird Startverlaengerung bei defektem Drehzahlgeber ermoeglicht" VALUE 0x85015f _REC_VAL_20_u1 1. _CNV_A_R_LINEAR_____0_CM 0. 1. DISPLAY_IDENTIFIER LC_N_SUB FORMAT "%2.0" /end CHARACTERISTIC
/begin CHARACTERISTIC lc_str_conf "Schalter fuer Konfiguration der Startersteuerung 0 = BSG / 1 = MSG" VALUE 0x850164 _REC_VAL_20_u1 1. _CNV_A_R_LINEAR_____0_CM 0. 1. DISPLAY_IDENTIFIER LC_STR_CONF FORMAT "%2.0" /end CHARACTERISTIC
/begin MEASUREMENT kl50r "Start Anforderungs Rueckkopplung" UBYTE _CNV_A_R_LINEAR_____0_CM 1 0. 0. 1. DISPLAY_IDENTIFIER KL50R ECU_ADDRESS 0x7fb89b FORMAT "%1.0" /end MEASUREMENT
/begin MEASUREMENT kl50 "Start Anforderung" UBYTE _CNV_A_R_LINEAR_____0_CM 1 0. 0. 1. DISPLAY_IDENTIFIER KL50 ECU_ADDRESS 0x7fb89c FORMAT "%1.0" /end MEASUREMENT
/begin MEASUREMENT cam_1_ctr "Anzahl der NW-Flanken bis Startverlaengerung bei KW_Fehler aktiv (MSG)" UBYTE _CNV_A_R_LINEAR_____0_CM 1 0. 0. 1. DISPLAY_IDENTIFIER CAM_1_CTR ECU_ADDRESS 0x7fb89d FORMAT "%1.0" /end MEASUREMENT
/begin MEASUREMENT lv_st_es "Start Abbruch Erkennung (MSG)" UBYTE _CNV_S_2_RANGE______11_CM 1 0. 0. 1. DISPLAY_IDENTIFIER LV_ST_ES ECU_ADDRESS 0x7fb89e /end MEASUREMENT
/begin MEASUREMENT lv_str_on "Starterrelais 1" UBYTE _CNV_S_2_RANGE______11_CM 1 0. 0. 1. DISPLAY_IDENTIFIER LV_STR_ON ECU_ADDRESS 0x7fb89f /end MEASUREMENT
/begin MEASUREMENT lv_str_off "Starterrelais 2" UBYTE _CNV_S_2_RANGE______11_CM 1 0. 0. 1. DISPLAY_IDENTIFIER LV_STR_OFF ECU_ADDRESS 0x7fb8a0 /end MEASUREMENT
/begin MEASUREMENT lv_auth_eng_rest "Authorisation f&uuml;r den Re-Start" UBYTE _CNV_S_2_RANGE______11_CM 1 0. 0. 1. DISPLAY_IDENTIFIER LV_AUTH_ENG_REST ECU_ADDRESS 0x7fb8a1 /end MEASUREMENT
/begin MEASUREMENT lv_req_es_driv "Fahrer fordert Motor Stop" UBYTE _CNV_S_2_RANGE______11_CM 1 0. 0. 1. DISPLAY_IDENTIFIER LV_REQ_ES_DRIV ECU_ADDRESS 0x7fb8a2 /end MEASUREMENT
/begin CHARACTERISTIC c_lih_cru_a_wr_1 "sets inputs selective to 1" VALUE 0x85ca55 _REC_VAL_20_u1 255. _CNV_A_R_LINEAR_____0_CM 0. 255. DISPLAY_IDENTIFIER C_LIH_CRU_A_WR_1 FORMAT "%3.0" /end CHARACTERISTIC
/begin CHARACTERISTIC c_lih_cyl_bal_a_wr_0 "sets inputs selective to 0" VALUE 0x85ca56 _REC_VAL_20_u1 255. _CNV_A_R_LINEAR_____0_CM 0. 255. DISPLAY_IDENTIFIER C_LIH_CYL_BAL_A_WR_0 FORMAT "%3.0" /end CHARACTERISTIC
/begin CHARACTERISTIC c_lih_cyl_bal_a_wr_1 "sets inputs selective to 0" VALUE 0x85ca57 _REC_VAL_20_u1 255. _CNV_A_R_LINEAR_____0_CM 0. 255. DISPLAY_IDENTIFIER C_LIH_CYL_BAL_A_WR_1 FORMAT "%3.0" /end CHARACTERISTIC
/begin CHARACTERISTIC c_lih_egr_a_wr_0 "sets inputs selective to 0" VALUE 0x85ca58 _REC_VAL_20_u2 65535. _CNV_A_R_LINEAR_____0_CM 0. 65535. DISPLAY_IDENTIFIER C_LIH_EGR_A_WR_0 FORMAT "%5.0" /end CHARACTERISTIC
/begin CHARACTERISTIC c_lih_egr_a_wr_1 "sets inputs selective to 1" VALUE 0x85ca5a _REC_VAL_20_u2 65535. _CNV_A_R_LINEAR_____0_CM 0. 65535. DISPLAY_IDENTIFIER C_LIH_EGR_A_WR_1 FORMAT "%5.0" /end CHARACTERISTIC
/begin CHARACTERISTIC c_lih_egy_a_wr_0 "sets inputs selective to 0" VALUE 0x85ca5c _REC_VAL_20_u1 255. _CNV_A_R_LINEAR_____0_CM 0. 255. DISPLAY_IDENTIFIER C_LIH_EGY_A_WR_0 FORMAT "%3.0" /end CHARACTERISTIC
/begin CHARACTERISTIC c_lih_egy_a_wr_1 "sets inputs selective to 1" VALUE 0x85ca5d _REC_VAL_20_u1 255. _CNV_A_R_LINEAR_____0_CM 0. 255. DISPLAY_IDENTIFIER C_LIH_EGY_A_WR_1 FORMAT "%3.0" /end CHARACTERISTIC
/begin CHARACTERISTIC c_lih_esp_a_wr_0 "sets inputs selective to 0" VALUE 0x85ca5e _REC_VAL_20_u2 65535. _CNV_A_R_LINEAR_____0_CM 0. 65535. DISPLAY_IDENTIFIER C_LIH_ESP_A_WR_0 FORMAT "%5.0" /end CHARACTERISTIC
/begin CHARACTERISTIC c_lih_esp_a_wr_1 "sets inputs selective to 1" VALUE 0x85ca60 _REC_VAL_20_u2 65535. _CNV_A_R_LINEAR_____0_CM 0. 65535. DISPLAY_IDENTIFIER C_LIH_ESP_A_WR_1 FORMAT "%5.0" /end CHARACTERISTIC
/begin CHARACTERISTIC c_lih_etcu_a_wr_0 "sets inputs selective to 0" VALUE 0x85ca62 _REC_VAL_20_u2 65535. _CNV_A_R_LINEAR_____0_CM 0. 65535. DISPLAY_IDENTIFIER C_LIH_ETCU_A_WR_0 FORMAT "%5.0" /end CHARACTERISTIC
/begin CHARACTERISTIC c_lih_etcu_a_wr_1 "sets inputs selective to 1" VALUE 0x85ca64 _REC_VAL_20_u2 65535. _CNV_A_R_LINEAR_____0_CM 0. 65535. DISPLAY_IDENTIFIER C_LIH_ETCU_A_WR_1 FORMAT "%5.0" /end CHARACTERISTIC
/begin CHARACTERISTIC c_lih_gear_a_wr_0 "sets inputs selective to 0" VALUE 0x85ca66 _REC_VAL_20_u1 255. _CNV_A_R_LINEAR_____0_CM 0. 255. DISPLAY_IDENTIFIER C_LIH_GEAR_A_WR_0 FORMAT "%3.0" /end CHARACTERISTIC
/begin CHARACTERISTIC c_lih_gear_a_wr_1 "sets inputs selective to 1" VALUE 0x85ca67 _REC_VAL_20_u1 255. _CNV_A_R_LINEAR_____0_CM 0. 255. DISPLAY_IDENTIFIER C_LIH_GEAR_A_WR_1 FORMAT "%3.0" /end CHARACTERISTIC
/begin CHARACTERISTIC c_lih_inj_a_wr_0 "sets inputs selective to 0" VALUE 0x85ca68 _REC_VAL_20_u1 255. _CNV_A_R_LINEAR_____0_CM 0. 255. DISPLAY_IDENTIFIER C_LIH_INJ_A_WR_0 FORMAT "%3.0" /end CHARACTERISTIC
/begin CHARACTERISTIC c_lih_inj_a_wr_1 "sets inputs selective to 1" VALUE 0x85ca69 _REC_VAL_20_u1 255. _CNV_A_R_LINEAR_____0_CM 0. 255. DISPLAY_IDENTIFIER C_LIH_INJ_A_WR_1 FORMAT "%3.0" /end CHARACTERISTIC
/begin CHARACTERISTIC c_lih_is_sp_a_wr_0 "sets inputs selective to 0" VALUE 0x85ca6a _REC_VAL_20_u2 65535. _CNV_A_R_LINEAR_____0_CM 0. 65535. DISPLAY_IDENTIFIER C_LIH_IS_SP_A_WR_0 FORMAT "%5.0" /end CHARACTERISTIC
/begin CHARACTERISTIC c_lih_is_sp_a_wr_1 "sets inputs selective to 1" VALUE 0x85ca6c _REC_VAL_20_u2 65535. _CNV_A_R_LINEAR_____0_CM 0. 65535. DISPLAY_IDENTIFIER C_LIH_IS_SP_A_WR_1 FORMAT "%5.0" /end CHARACTERISTIC
/begin CHARACTERISTIC c_lih_n_lim_a_wr_0 "sets inputs selective to 0" VALUE 0x85ca6e _REC_VAL_20_u2 65535. _CNV_A_R_LINEAR_____0_CM 0. 65535. DISPLAY_IDENTIFIER C_LIH_N_LIM_A_WR_0 FORMAT "%5.0" /end CHARACTERISTIC
/begin CHARACTERISTIC c_lih_n_lim_a_wr_1 "sets inputs selective to 1" VALUE 0x85ca70 _REC_VAL_20_u2 65535. _CNV_A_R_LINEAR_____0_CM 0. 65535. DISPLAY_IDENTIFIER C_LIH_N_LIM_A_WR_1 FORMAT "%5.0" /end CHARACTERISTIC
/begin CHARACTERISTIC c_lih_post_inj_a_wr_0 "sets inputs selective to 0" VALUE 0x85ca72 _REC_VAL_20_u1 255. _CNV_A_R_LINEAR_____0_CM 0. 255. DISPLAY_IDENTIFIER C_LIH_POST_INJ_A_WR_0 FORMAT "%3.0" /end CHARACTERISTIC
/begin CHARACTERISTIC c_lih_post_inj_a_wr_1 "sets inputs selective to 1" VALUE 0x85ca73 _REC_VAL_20_u1 255. _CNV_A_R_LINEAR_____0_CM 0. 255. DISPLAY_IDENTIFIER C_LIH_POST_INJ_A_WR_1 FORMAT "%3.0" /end CHARACTERISTIC
/begin CHARACTERISTIC c_lih_prev_inj_a_wr_0 "sets inputs selective to 0" VALUE 0x85ca74 _REC_VAL_20_u1 255. _CNV_A_R_LINEAR_____0_CM 0. 255. DISPLAY_IDENTIFIER C_LIH_PREV_INJ_A_WR_0 FORMAT "%3.0" /end CHARACTERISTIC
/begin CHARACTERISTIC c_lih_prev_inj_a_wr_1 "sets inputs selective to 1" VALUE 0x85ca75 _REC_VAL_20_u1 255. _CNV_A_R_LINEAR_____0_CM 0. 255. DISPLAY_IDENTIFIER C_LIH_PREV_INJ_A_WR_1 FORMAT "%3.0" /end CHARACTERISTIC
/begin CHARACTERISTIC c_lih_tq_clc_a_wr_0 "sets inputs selective to 0" VALUE 0x85ca78 _REC_VAL_20_u2 65535. _CNV_A_R_LINEAR_____0_CM 0. 65535. DISPLAY_IDENTIFIER C_LIH_TQ_CLC_A_WR_0 FORMAT "%5.0" /end CHARACTERISTIC
/begin CHARACTERISTIC c_lih_tq_clc_a_wr_1 "sets inputs selective to 1" VALUE 0x85ca7a _REC_VAL_20_u2 65535. _CNV_A_R_LINEAR_____0_CM 0. 65535. DISPLAY_IDENTIFIER C_LIH_TQ_CLC_A_WR_1 FORMAT "%5.0" /end CHARACTERISTIC
/begin CHARACTERISTIC c_lih_tq_clc_b_wr_0 "sets inputs selective to 0" VALUE 0x85ca7c _REC_VAL_20_u2 65535. _CNV_A_R_LINEAR_____0_CM 0. 65535. DISPLAY_IDENTIFIER C_LIH_TQ_CLC_B_WR_0 FORMAT "%5.0" /end CHARACTERISTIC
/begin CHARACTERISTIC c_lih_tq_clc_b_wr_1 "sets inputs selective to 1" VALUE 0x85ca7e _REC_VAL_20_u2 65535. _CNV_A_R_LINEAR_____0_CM 0. 65535. DISPLAY_IDENTIFIER C_LIH_TQ_CLC_B_WR_1 FORMAT "%5.0" /end CHARACTERISTIC
/begin CHARACTERISTIC c_lih_tqi_a_wr_0 "sets inputs selective to 0" VALUE 0x85ca80 _REC_VAL_20_u2 65535. _CNV_A_R_LINEAR_____0_CM 0. 65535. DISPLAY_IDENTIFIER C_LIH_TQI_A_WR_0 FORMAT "%5.0" /end CHARACTERISTIC
/begin CHARACTERISTIC c_lih_tqi_a_wr_1 "sets inputs selective to 1" VALUE 0x85ca82 _REC_VAL_20_u2 65535. _CNV_A_R_LINEAR_____0_CM 0. 65535. DISPLAY_IDENTIFIER C_LIH_TQI_A_WR_1 FORMAT "%5.0" /end CHARACTERISTIC
/begin CHARACTERISTIC c_lih_tqi_b_wr_0 "sets inputs selective to 0" VALUE 0x85ca84 _REC_VAL_20_u2 65535. _CNV_A_R_LINEAR_____0_CM 0. 65535. DISPLAY_IDENTIFIER C_LIH_TQI_B_WR_0 FORMAT "%5.0" /end CHARACTERISTIC
/begin CHARACTERISTIC c_lih_tqi_b_wr_1 "sets inputs selective to 1" VALUE 0x85ca86 _REC_VAL_20_u2 65535. _CNV_A_R_LINEAR_____0_CM 0. 65535. DISPLAY_IDENTIFIER C_LIH_TQI_B_WR_1 FORMAT "%5.0" /end CHARACTERISTIC
/begin CHARACTERISTIC c_lih_tqi_rst "provides reversibility of torque limitation reaction" VALUE 0x85ca88 _REC_VAL_20_u1 1. _CNV_A_R_LINEAR_____0_CM 0. 1. DISPLAY_IDENTIFIER C_LIH_TQI_RST FORMAT "%1.0" /end CHARACTERISTIC
/begin MEASUREMENT lv_lih_act "Bit showing that at least one limp home request is set" UBYTE _CNV_S_2_RANGE______11_CM 1 0. 0. 1. DISPLAY_IDENTIFIER LV_LIH_ACT ECU_ADDRESS 0x7fbee1 /end MEASUREMENT
/begin MEASUREMENT lv_lih_aj "AJ: Anti Jerk deactivation" UBYTE _CNV_S_2_RANGE______11_CM 1 0. 0. 1. DISPLAY_IDENTIFIER LV_LIH_AJ ECU_ADDRESS 0x7fbecc /end MEASUREMENT
/begin MEASUREMENT lv_lih_asr_ramp_up "ESP: ramp up ASR intervention" UBYTE _CNV_S_2_RANGE______11_CM 1 0. 0. 1. DISPLAY_IDENTIFIER LV_LIH_ASR_RAMP_UP ECU_ADDRESS 0x7fbed6 /end MEASUREMENT
/begin MEASUREMENT lv_lih_cru_off "CRU: Cruise Control limp home" UBYTE _CNV_S_2_RANGE______11_CM 1 0. 0. 1. DISPLAY_IDENTIFIER LV_LIH_CRU_OFF ECU_ADDRESS 0x7fbecd /end MEASUREMENT
/begin MEASUREMENT lv_lih_cru_stb "CRU: Cruise Control standby" UBYTE _CNV_S_2_RANGE______11_CM 1 0. 0. 1. DISPLAY_IDENTIFIER LV_LIH_CRU_STB ECU_ADDRESS 0x7fbece /end MEASUREMENT
/begin MEASUREMENT lv_lih_cyl_bal_off "CYLBAL: deactivation of cylinderbalancing" UBYTE _CNV_S_2_RANGE______11_CM 1 0. 0. 1. DISPLAY_IDENTIFIER LV_LIH_CYL_BAL_OFF ECU_ADDRESS 0x7fbed2 /end MEASUREMENT
/begin MEASUREMENT lv_lih_egr_ctl "EGR: shutdown EGR" UBYTE _CNV_S_2_RANGE______11_CM 1 0. 0. 1. DISPLAY_IDENTIFIER LV_LIH_EGR_CTL ECU_ADDRESS 0x7fbec4 /end MEASUREMENT
/begin MEASUREMENT lv_lih_egy "EGY: Energy closed-loop control shut off" UBYTE _CNV_S_2_RANGE______11_CM 1 0. 0. 1. DISPLAY_IDENTIFIER LV_LIH_EGY ECU_ADDRESS 0x7fbecf /end MEASUREMENT
/begin MEASUREMENT lv_lih_err_tq_clc_1 "TQ: torque accuracy degraded" UBYTE _CNV_S_2_RANGE______11_CM 1 0. 0. 1. DISPLAY_IDENTIFIER LV_LIH_ERR_TQ_CLC_1 ECU_ADDRESS 0x7fbedd /end MEASUREMENT
/begin MEASUREMENT lv_lih_err_tq_clc_2 "TQ: torque accuracy strongly degraded" UBYTE _CNV_S_2_RANGE______11_CM 1 0. 0. 1. DISPLAY_IDENTIFIER LV_LIH_ERR_TQ_CLC_2 ECU_ADDRESS 0x7fbede /end MEASUREMENT
/begin MEASUREMENT lv_lih_etcu_clu_ad "ETCU: disable ETCU adaptation of torque at clutch" UBYTE _CNV_S_2_RANGE______11_CM 1 0. 0. 1. DISPLAY_IDENTIFIER LV_LIH_ETCU_CLU_AD ECU_ADDRESS 0x7fbedb /end MEASUREMENT
/begin MEASUREMENT lv_lih_etcu_inh "ETCU: inhibit ETCU" UBYTE _CNV_S_2_RANGE______11_CM 1 0. 0. 1. DISPLAY_IDENTIFIER LV_LIH_ETCU_INH ECU_ADDRESS 0x7fbed9 /end MEASUREMENT
/begin MEASUREMENT lv_lih_etcu_ramp_up "ETCU: ramp up ETCU intervention" UBYTE _CNV_S_2_RANGE______11_CM 1 0. 0. 1. DISPLAY_IDENTIFIER LV_LIH_ETCU_RAMP_UP ECU_ADDRESS 0x7fbeda /end MEASUREMENT
/begin MEASUREMENT lv_lih_gear_det "GEAR: Gear Detection inputs faulty" UBYTE _CNV_S_2_RANGE______11_CM 1 0. 0. 1. DISPLAY_IDENTIFIER LV_LIH_GEAR_DET ECU_ADDRESS 0x7fbed4 /end MEASUREMENT
/begin MEASUREMENT lv_lih_inj_1_off "Cylinder selective cut off" UBYTE _CNV_S_2_RANGE______11_CM 1 0. 0. 1. DISPLAY_IDENTIFIER LV_LIH_INJ_1_OFF ECU_ADDRESS 0x7fbec6 /end MEASUREMENT
/begin MEASUREMENT lv_lih_inj_2_off "Cylinder selective cut off" UBYTE _CNV_S_2_RANGE______11_CM 1 0. 0. 1. DISPLAY_IDENTIFIER LV_LIH_INJ_2_OFF ECU_ADDRESS 0x7fbec7 /end MEASUREMENT
/begin MEASUREMENT lv_lih_inj_3_off "Cylinder selective cut off" UBYTE _CNV_S_2_RANGE______11_CM 1 0. 0. 1. DISPLAY_IDENTIFIER LV_LIH_INJ_3_OFF ECU_ADDRESS 0x7fbec8 /end MEASUREMENT
/begin MEASUREMENT lv_lih_inj_4_off "Cylinder selective cut off" UBYTE _CNV_S_2_RANGE______11_CM 1 0. 0. 1. DISPLAY_IDENTIFIER LV_LIH_INJ_4_OFF ECU_ADDRESS 0x7fbec9 /end MEASUREMENT
/begin MEASUREMENT lv_lih_inj_5_off "Cylinder selective cut off" UBYTE _CNV_S_2_RANGE______11_CM 1 0. 0. 1. DISPLAY_IDENTIFIER LV_LIH_INJ_5_OFF ECU_ADDRESS 0x7fbeca /end MEASUREMENT
/begin MEASUREMENT lv_lih_inj_6_off "Cylinder selective cut off" UBYTE _CNV_S_2_RANGE______11_CM 1 0. 0. 1. DISPLAY_IDENTIFIER LV_LIH_INJ_6_OFF ECU_ADDRESS 0x7fbecb /end MEASUREMENT
/begin MEASUREMENT lv_lih_msr_inh "ESP: inhibit MSR intervention" UBYTE _CNV_S_2_RANGE______11_CM 1 0. 0. 1. DISPLAY_IDENTIFIER LV_LIH_MSR_INH ECU_ADDRESS 0x7fbed7 /end MEASUREMENT
/begin MEASUREMENT lv_lih_msr_ramp_down "ESP: ramp down MSR intervention" UBYTE _CNV_S_2_RANGE______11_CM 1 0. 0. 1. DISPLAY_IDENTIFIER LV_LIH_MSR_RAMP_DOWN ECU_ADDRESS 0x7fbed8 /end MEASUREMENT
/begin MEASUREMENT lv_lih_n_is_sp "IS: Increased Idlespeedsetpoint" UBYTE _CNV_S_2_RANGE______11_CM 1 0. 0. 1. DISPLAY_IDENTIFIER LV_LIH_N_IS_SP ECU_ADDRESS 0x7fbec5 /end MEASUREMENT
/begin MEASUREMENT lv_lih_n_lim "Limp home enginespeed limitation" UBYTE _CNV_S_2_RANGE______11_CM 1 0. 0. 1. DISPLAY_IDENTIFIER LV_LIH_N_LIM ECU_ADDRESS 0x7fbed3 /end MEASUREMENT
/begin MEASUREMENT lv_lih_post_inj_inh "Post-injection cutoff" UBYTE _CNV_S_2_RANGE______11_CM 1 0. 0. 1. DISPLAY_IDENTIFIER LV_LIH_POST_INJ_INH ECU_ADDRESS 0x7fbed0 /end MEASUREMENT
/begin MEASUREMENT lv_lih_prev_inj_inh "Pre-Injection deactivation" UBYTE _CNV_S_2_RANGE______11_CM 1 0. 0. 1. DISPLAY_IDENTIFIER LV_LIH_PREV_INJ_INH ECU_ADDRESS 0x7fbed1 /end MEASUREMENT
/begin MEASUREMENT lv_lih_tcs_inh "ESP: inhibit TCS" UBYTE _CNV_S_2_RANGE______11_CM 1 0. 0. 1. DISPLAY_IDENTIFIER LV_LIH_TCS_INH ECU_ADDRESS 0x7fbed5 /end MEASUREMENT
/begin MEASUREMENT lv_lih_tqi "TQI: Torque Limp Home limitation" UBYTE _CNV_S_2_RANGE______11_CM 1 0. 0. 1. DISPLAY_IDENTIFIER LV_LIH_TQI ECU_ADDRESS 0x7fbedc /end MEASUREMENT
/begin MEASUREMENT sf_lih_1 "Status flag showing the active limp home requests 1..16" UWORD _CNV_A_R_LINEAR_____0_CM 1 0. 0. 65535. DISPLAY_IDENTIFIER SF_LIH_1 ECU_ADDRESS 0x7f9d02 BYTE_ORDER MSB_LAST FORMAT "%5.0" /end MEASUREMENT
/begin MEASUREMENT sf_lih_2 "Status flag showing the active limp home requests 17..32" UWORD _CNV_A_R_LINEAR_____0_CM 1 0. 0. 65535. DISPLAY_IDENTIFIER SF_LIH_2 ECU_ADDRESS 0x7f9d04 BYTE_ORDER MSB_LAST FORMAT "%5.0" /end MEASUREMENT
/begin MEASUREMENT sf_lih_3 "Status flag showing the active limp home requests 33..48" UWORD _CNV_A_R_LINEAR_____0_CM 1 0. 0. 65535. DISPLAY_IDENTIFIER SF_LIH_3 ECU_ADDRESS 0x7f9d06 BYTE_ORDER MSB_LAST FORMAT "%5.0" /end MEASUREMENT
/begin MEASUREMENT lv_lih_off_refu "AAS: deactivate function" UBYTE _CNV_S_2_RANGE______11_CM 1 0. 0. 1. DISPLAY_IDENTIFIER LV_LIH_OFF_REFU ECU_ADDRESS 0x7fbedf /end MEASUREMENT
/begin MEASUREMENT lv_lih_vs_refu "AAS: vehiclespeed influence not used" UBYTE _CNV_S_2_RANGE______11_CM 1 0. 0. 1. DISPLAY_IDENTIFIER LV_LIH_VS_REFU ECU_ADDRESS 0x7fbee0 /end MEASUREMENT
/begin CHARACTERISTIC c_lih_cru_a_wr_0 "sets inputs selective to 0" VALUE 0x85ca54 _REC_VAL_20_u1 255. _CNV_A_R_LINEAR_____0_CM 0. 255. DISPLAY_IDENTIFIER C_LIH_CRU_A_WR_0 FORMAT "%3.0" /end CHARACTERISTIC
/begin CHARACTERISTIC c_lih_aj_a_wr_1 "sets inputs selective to 1" VALUE 0x85ca53 _REC_VAL_20_u1 255. _CNV_A_R_LINEAR_____0_CM 0. 255. DISPLAY_IDENTIFIER C_LIH_AJ_A_WR_1 FORMAT "%3.0" /end CHARACTERISTIC
/begin CHARACTERISTIC c_lih_refu_a_wr_0 "sets inputs selective to 0" VALUE 0x85ca76 _REC_VAL_20_u1 255. _CNV_A_R_LINEAR_____0_CM 0. 255. DISPLAY_IDENTIFIER C_LIH_REFU_A_WR_0 FORMAT "%3.0" /end CHARACTERISTIC
/begin CHARACTERISTIC c_lih_aj_a_wr_0 "sets inputs selective to 0" VALUE 0x85ca52 _REC_VAL_20_u1 255. _CNV_A_R_LINEAR_____0_CM 0. 255. DISPLAY_IDENTIFIER C_LIH_AJ_A_WR_0 FORMAT "%3.0" /end CHARACTERISTIC
/begin CHARACTERISTIC c_lih_refu_a_wr_1 "sets inputs selective to 1" VALUE 0x85ca77 _REC_VAL_20_u1 255. _CNV_A_R_LINEAR_____0_CM 0. 255. DISPLAY_IDENTIFIER C_LIH_REFU_A_WR_1 FORMAT "%3.0" /end CHARACTERISTIC
/begin CHARACTERISTIC c_add_n_max_fcut "Additive threshold to maximum engine speed for activation fuel cut-off all cylinders" VALUE 0x85c86c _REC_VAL_20_u2 8160. _CNV_A_R_LINEAR_____386_CM 0. 8160. DISPLAY_IDENTIFIER C_ADD_N_MAX_FCUT FORMAT "%4.0" /end CHARACTERISTIC
/begin CHARACTERISTIC c_crlc_n_grd_fil_1 "N_GRD_FIL low pass filter constant if LV_N_MAX = 0" VALUE 0x85c900 _REC_VAL_20_u2 0.9999847412109381 _CNV_A_R_LINEAR_____14_CM 0. 0.9999847412109381 DISPLAY_IDENTIFIER C_CRLC_N_GRD_FIL_1 FORMAT "%6.5" /end CHARACTERISTIC
/begin CHARACTERISTIC c_crlc_n_grd_fil_2 "N_GRD_FIL low pass filter constant if LV_N_MAX = 1" VALUE 0x85c902 _REC_VAL_20_u2 0.9999847412109381 _CNV_A_R_LINEAR_____14_CM 0. 0.9999847412109381 DISPLAY_IDENTIFIER C_CRLC_N_GRD_FIL_2 FORMAT "%6.5" /end CHARACTERISTIC
/begin CHARACTERISTIC c_n_grd_hys "Hysteresis for N_GRD Filtering" VALUE 0x85cb0a _REC_VAL_20_s1 8160. _CNV_A_R_LINEAR_____387_CM -4096. 4064. DISPLAY_IDENTIFIER C_N_GRD_HYS FORMAT "%5.0" /end CHARACTERISTIC
/begin CHARACTERISTIC c_tqi_max_pas "Passive value for TQI_N_MAX if engine-speed limitation is passive" VALUE 0x85cd42 _REC_VAL_20_s2 1023.96875 _CNV_A_R_LINEAR_____52_CM 0. 1023.96875 DISPLAY_IDENTIFIER C_TQI_MAX_PAS FORMAT "%8.3" /end CHARACTERISTIC
/begin MEASUREMENT lv_n_max "Logical variable engine speed limitation active" UBYTE _CNV_S_2_RANGE______3_CM 1 0. 0. 1. DISPLAY_IDENTIFIER LV_N_MAX ECU_ADDRESS 0x7fbb15 /end MEASUREMENT
/begin MEASUREMENT lv_n_max_req_fcut "Logical variable fuel cut-off of all cylinder requested for engine speed limitation" UBYTE _CNV_S_2_RANGE______3_CM 1 0. 0. 1. DISPLAY_IDENTIFIER LV_N_MAX_REQ_FCUT ECU_ADDRESS 0x7fbb16 /end MEASUREMENT
/begin MEASUREMENT n_dif_max_lim "Engine speed difference as an input for PI-controller" SWORD _CNV_A_R_LINEAR_____386_CM 1 0. -8160. 8160. DISPLAY_IDENTIFIER N_DIF_MAX_LIM ECU_ADDRESS 0x7fb3b2 BYTE_ORDER MSB_LAST FORMAT "%5.0" /end MEASUREMENT
/begin MEASUREMENT n_grd_fil "engine speed gradient  pre-selection for low pass filter" SBYTE _CNV_A_R_LINEAR_____387_CM 1 0. -4096. 4064. DISPLAY_IDENTIFIER N_GRD_FIL ECU_ADDRESS 0x7fbf51 FORMAT "%5.0" /end MEASUREMENT
/begin MEASUREMENT n_grd_fil_fil "Low pass filtered engine speed gradient for predicted engine speed" SBYTE _CNV_A_R_LINEAR_____387_CM 1 0. -4096. 4064. DISPLAY_IDENTIFIER N_GRD_FIL_FIL ECU_ADDRESS 0x7fbf52 FORMAT "%5.0" /end MEASUREMENT
/begin MEASUREMENT n_pred_max_lim "Predicted engine speed" UWORD _CNV_A_R_LINEAR_____386_CM 1 0. 0. 8160. DISPLAY_IDENTIFIER N_PRED_MAX_LIM ECU_ADDRESS 0x7fb3b0 BYTE_ORDER MSB_LAST FORMAT "%4.0" /end MEASUREMENT
/begin MEASUREMENT tq_n_max_dif "Torque output of N_MAX-PI-Controller" SWORD _CNV_A_R_LINEAR_____52_CM 1 0. -1024. 1023.96875 DISPLAY_IDENTIFIER TQ_N_MAX_DIF ECU_ADDRESS 0x7fb3b8 BYTE_ORDER MSB_LAST FORMAT "%8.3" /end MEASUREMENT
/begin MEASUREMENT tq_n_max_dif_p "Torque output of N_MAX-P-Controller" SWORD _CNV_A_R_LINEAR_____52_CM 1 0. -1024. 1023.96875 DISPLAY_IDENTIFIER TQ_N_MAX_DIF_P ECU_ADDRESS 0x7fb3ba BYTE_ORDER MSB_LAST FORMAT "%8.3" /end MEASUREMENT
/begin MEASUREMENT tq_n_max_inp_i "Torque input for N_MAX I-controller" SWORD _CNV_A_R_LINEAR_____388_CM 1 0. -4. 3.99987793 DISPLAY_IDENTIFIER TQ_N_MAX_INP_I ECU_ADDRESS 0x7fb3b4 BYTE_ORDER MSB_LAST FORMAT "%6.4" /end MEASUREMENT
/begin MEASUREMENT tqi_n_max_1 "Intermitted indicated engine torque after considering PI-controller output" SWORD _CNV_A_R_LINEAR_____52_CM 1 0. -1024. 1023.96875 DISPLAY_IDENTIFIER TQI_N_MAX_1 ECU_ADDRESS 0x7fb3bc BYTE_ORDER MSB_LAST FORMAT "%8.3" /end MEASUREMENT
/begin MEASUREMENT tqi_n_max_ref "Reference indicated engine  torque on which controller output is applied" SWORD _CNV_A_R_LINEAR_____52_CM 1 0. 0. 1023.96875 DISPLAY_IDENTIFIER TQI_N_MAX_REF ECU_ADDRESS 0x7fb3b6 BYTE_ORDER MSB_LAST FORMAT "%8.3" /end MEASUREMENT
/begin AXIS_PTS ldp_n_32_n_grd_thd "Engine speed gradient threshold for filtering of basic engine speed gradient" 0x84191d n_32 _REC_AXS_20_u1 8160. _CNV_A_R_LINEAR_____30_CM 6 0. 8160. FORMAT "%4.0" /end AXIS_PTS
/begin AXIS_PTS ldpm_gear "P-control parameter for N_MAX-controller automatic transmission" 0x842ba4 dri _REC_AXS_20_u1 255. _CNV_A_R_LINEAR_____0_CM 9 0. 255. FORMAT "%3.0" /end AXIS_PTS
/begin CHARACTERISTIC id_fac_n_max_i_at__gear "ES: I-control parameter AT" CURVE 0x8502e4 _REC_CUR_20_u2_u1 7.9998779296875 _CNV_A_R_LINEAR_____389_CM 0. 7.9998779296875 DISPLAY_IDENTIFIER ID_FAC_N_MAX_I_AT__GEAR FORMAT "%8.7"
 /begin AXIS_DESCR COM_AXIS dri _CNV_A_R_LINEAR_____0_CM 9 0. 255. FORMAT "%3.0" AXIS_PTS_REF ldpm_gear /end AXIS_DESCR
/end CHARACTERISTIC
/begin CHARACTERISTIC id_fac_n_max_i_mt__gear "ES: I-control parameter MT" CURVE 0x8502f6 _REC_CUR_20_u2_u1 7.9998779296875 _CNV_A_R_LINEAR_____389_CM 0. 7.9998779296875 DISPLAY_IDENTIFIER ID_FAC_N_MAX_I_MT__GEAR FORMAT "%7.6"
 /begin AXIS_DESCR COM_AXIS dri _CNV_A_R_LINEAR_____0_CM 9 0. 255. FORMAT "%3.0" AXIS_PTS_REF ldpm_gear /end AXIS_DESCR
/end CHARACTERISTIC
/begin CHARACTERISTIC id_fac_n_max_p_at__gear "ES: P-control parameter AT" CURVE 0x850308 _REC_CUR_20_u1_u1 7.968 _CNV_A_R_LINEAR_____390_CM 0. 7.968 DISPLAY_IDENTIFIER ID_FAC_N_MAX_P_AT__GEAR FORMAT "%4.3"
 /begin AXIS_DESCR COM_AXIS dri _CNV_A_R_LINEAR_____0_CM 9 0. 255. FORMAT "%3.0" AXIS_PTS_REF ldpm_gear /end AXIS_DESCR
/end CHARACTERISTIC
/begin CHARACTERISTIC id_fac_n_max_p_mt__gear "ES: P-control parameter MT" CURVE 0x850311 _REC_CUR_20_u1_u1 7.968 _CNV_A_R_LINEAR_____390_CM 0. 7.968 DISPLAY_IDENTIFIER ID_FAC_N_MAX_P_MT__GEAR FORMAT "%4.3"
 /begin AXIS_DESCR COM_AXIS dri _CNV_A_R_LINEAR_____0_CM 9 0. 255. FORMAT "%3.0" AXIS_PTS_REF ldpm_gear /end AXIS_DESCR
/end CHARACTERISTIC
/begin CHARACTERISTIC id_t_n_max_pred_at__gear "ES: prediction time for AT" CURVE 0x850848 _REC_CUR_20_u1_u1 7.968 _CNV_A_R_LINEAR_____391_CM 0. 7.968 DISPLAY_IDENTIFIER ID_T_N_MAX_PRED_AT__GEAR FORMAT "%6.5"
 /begin AXIS_DESCR COM_AXIS dri _CNV_A_R_LINEAR_____0_CM 9 0. 255. FORMAT "%3.0" AXIS_PTS_REF ldpm_gear /end AXIS_DESCR
/end CHARACTERISTIC
/begin CHARACTERISTIC id_t_n_max_pred_mt__gear "ES: prediction time for MT" CURVE 0x850851 _REC_CUR_20_u1_u1 7.968 _CNV_A_R_LINEAR_____392_CM 0. 7.968 DISPLAY_IDENTIFIER ID_T_N_MAX_PRED_MT__GEAR FORMAT "%6.5"
 /begin AXIS_DESCR COM_AXIS dri _CNV_A_R_LINEAR_____0_CM 9 0. 255. FORMAT "%3.0" AXIS_PTS_REF ldpm_gear /end AXIS_DESCR
/end CHARACTERISTIC
/begin CHARACTERISTIC ip_n_grd_thd__n_32 "ES: gradient threshold for filter" CURVE 0x857dfc _REC_CUR_20_u1_u1 8160. _CNV_A_R_LINEAR_____393_CM -4096. 4064. DISPLAY_IDENTIFIER IP_N_GRD_THD__N_32 FORMAT "%5.0"
 /begin AXIS_DESCR COM_AXIS n_32 _CNV_A_R_LINEAR_____30_CM 6 0. 8160. FORMAT "%4.0" AXIS_PTS_REF ldp_n_32_n_grd_thd /end AXIS_DESCR
/end CHARACTERISTIC
/begin MEASUREMENT tq_n_max_dif_i.sbyte[0] "" SBYTE _CNV_A_R_LINEAR_____0_CM 1 0. -128. 127. DISPLAY_IDENTIFIER TQ_N_MAX_DIF_I_SBYTE_0_ ECU_ADDRESS 0x7fb3c0 /end MEASUREMENT
/begin MEASUREMENT tq_n_max_dif_i.sbyte[1] "" SBYTE _CNV_A_R_LINEAR_____0_CM 1 0. -128. 127. DISPLAY_IDENTIFIER TQ_N_MAX_DIF_I_SBYTE_1_ ECU_ADDRESS 0x7fb3c1 /end MEASUREMENT
/begin MEASUREMENT tq_n_max_dif_i.sbyte[2] "" SBYTE _CNV_A_R_LINEAR_____0_CM 1 0. -128. 127. DISPLAY_IDENTIFIER TQ_N_MAX_DIF_I_SBYTE_2_ ECU_ADDRESS 0x7fb3c2 /end MEASUREMENT
/begin MEASUREMENT tq_n_max_dif_i.sbyte[3] "" SBYTE _CNV_A_R_LINEAR_____0_CM 1 0. -128. 127. DISPLAY_IDENTIFIER TQ_N_MAX_DIF_I_SBYTE_3_ ECU_ADDRESS 0x7fb3c3 /end MEASUREMENT
/begin MEASUREMENT tq_n_max_dif_i.sword[0] "" SWORD _CNV_A_R_LINEAR_____0_CM 1 0. -32768. 32767. DISPLAY_IDENTIFIER TQ_N_MAX_DIF_I_SWORD_0_ ECU_ADDRESS 0x7fb3c0 BYTE_ORDER MSB_LAST /end MEASUREMENT
/begin MEASUREMENT tq_n_max_dif_i.sword[1] "" SWORD _CNV_A_R_LINEAR_____0_CM 1 0. -32768. 32767. DISPLAY_IDENTIFIER TQ_N_MAX_DIF_I_SWORD_1_ ECU_ADDRESS 0x7fb3c2 BYTE_ORDER MSB_LAST /end MEASUREMENT
/begin MEASUREMENT tq_n_max_dif_i.slongword "" SLONG _CNV_A_R_LINEAR_____394_CM 1 0. -1024. 1023.96875 DISPLAY_IDENTIFIER TQ_N_MAX_DIF_I_SLONGWORD ECU_ADDRESS 0x7fb3c0 BYTE_ORDER MSB_LAST FORMAT "%12.7" /end MEASUREMENT
/begin MEASUREMENT teg_tur_up "Exhaust gas temperature before turbine regulation" UWORD _CNV_A_R_LINEAR_____157_CM 1 0. 0. 1023.984375 DISPLAY_IDENTIFIER TEG_TUR_UP ECU_ADDRESS 0x7fa15a BYTE_ORDER MSB_LAST FORMAT "%6.2" /end MEASUREMENT
/begin CHARACTERISTIC c_teg_tur_up_sub_diag "Exhaust gas temperature before turbine substitute value" VALUE 0x85ccc8 _REC_VAL_20_u2 1024. _CNV_A_R_LINEAR_____51_CM 0. 1024. DISPLAY_IDENTIFIER C_TEG_TUR_UP_SUB_DIAG FORMAT "%6.2" /end CHARACTERISTIC
/begin MEASUREMENT teg_tur_up_mes "measured exhaust gas temperature before turbine" UWORD _CNV_A_R_LINEAR_____51_CM 1 0. 0. 1024. DISPLAY_IDENTIFIER TEG_TUR_UP_MES ECU_ADDRESS 0x7fa15c BYTE_ORDER MSB_LAST FORMAT "%6.2" /end MEASUREMENT
/begin MEASUREMENT v_teg_tur_up "v_teg_tur_up" UWORD _CNV_A_R_LINEAR_____361_CM 1 0. 0. 5. DISPLAY_IDENTIFIER V_TEG_TUR_UP ECU_ADDRESS 0x7fa15e BYTE_ORDER MSB_LAST FORMAT "%4.3" /end MEASUREMENT
/begin CHARACTERISTIC ip_teg_tur_up_mes "TEGPC: TEG_TUR_UP sensor map" CURVE 0x85b14a _REC_CUR_20_u2_u2 1024. _CNV_A_R_LINEAR_____51_CM 0. 1024. DISPLAY_IDENTIFIER IP_TEG_TUR_UP_MES FORMAT "%6.2"
 /begin AXIS_DESCR COM_AXIS v_teg_tur_up _CNV_A_R_LINEAR_____361_CM 16 0. 5. FORMAT "%4.3" AXIS_PTS_REF ldp_v_teg_tur_up_ip_teg_tur_up /end AXIS_DESCR
/end CHARACTERISTIC
/begin AXIS_PTS ldp_v_teg_tur_up_ip_teg_tur_up "" 0x842a40 v_teg_tur_up _REC_AXS_20_u2 5. _CNV_A_R_LINEAR_____361_CM 16 0. 5. FORMAT "%4.3" /end AXIS_PTS
/begin MEASUREMENT sf_conf_inj "Injection configuration region" UBYTE _CNV_A_R_LINEAR_____0_CM 1 0. 0. 4. DISPLAY_IDENTIFIER SF_CONF_INJ ECU_ADDRESS 0x7fb8a3 FORMAT "%1.0" /end MEASUREMENT
/begin MEASUREMENT sf_conf_inj_rgn_1 "Injection configuration region during regeneration 1" UBYTE _CNV_A_R_LINEAR_____0_CM 1 0. 0. 4. DISPLAY_IDENTIFIER SF_CONF_INJ_RGN_1 ECU_ADDRESS 0x7fb8a4 FORMAT "%1.0" /end MEASUREMENT
/begin MEASUREMENT sf_conf_inj_rgn_2 "Injection configuration region during regeneration 2" UBYTE _CNV_A_R_LINEAR_____0_CM 1 0. 0. 4. DISPLAY_IDENTIFIER SF_CONF_INJ_RGN_2 ECU_ADDRESS 0x7fb8a5 FORMAT "%1.0" /end MEASUREMENT
/begin CHARACTERISTIC id_conf_inj "ACMB_MNG: Injection Region" CURVE 0x850296 _REC_CUR_20_u1_u1 4. _CNV_A_R_LINEAR_____0_CM 0. 4. DISPLAY_IDENTIFIER ID_CONF_INJ FORMAT "%1.0"
 /begin AXIS_DESCR COM_AXIS act_inj_coded _CNV_A_R_LINEAR_____0_CM 16 0. 15. FORMAT "%2.0" AXIS_PTS_REF ldpm_sf_conf_inj /end AXIS_DESCR
/end CHARACTERISTIC
/begin CHARACTERISTIC id_conf_inj_rgn_1 "ACMB_MNG: Injection Region for Regeneration 1" CURVE 0x8502b6 _REC_CUR_20_u1_u1 4. _CNV_A_R_LINEAR_____0_CM 0. 4. DISPLAY_IDENTIFIER ID_CONF_INJ_RGN_1 FORMAT "%1.0"
 /begin AXIS_DESCR COM_AXIS act_inj_coded _CNV_A_R_LINEAR_____0_CM 16 0. 15. FORMAT "%2.0" AXIS_PTS_REF ldpm_sf_conf_inj /end AXIS_DESCR
/end CHARACTERISTIC
/begin CHARACTERISTIC id_conf_inj_rgn_2 "ACMB_MNG: Injection Region for Regeneration 2" CURVE 0x8502c6 _REC_CUR_20_u1_u1 4. _CNV_A_R_LINEAR_____0_CM 0. 4. DISPLAY_IDENTIFIER ID_CONF_INJ_RGN_2 FORMAT "%1.0"
 /begin AXIS_DESCR COM_AXIS act_inj_coded _CNV_A_R_LINEAR_____0_CM 16 0. 15. FORMAT "%2.0" AXIS_PTS_REF ldpm_sf_conf_inj /end AXIS_DESCR
/end CHARACTERISTIC
/begin AXIS_PTS ldpm_sf_conf_inj "Injection Region" 0x843764 act_inj_coded _REC_AXS_20_u1 15. _CNV_A_R_LINEAR_____0_CM 16 0. 15. FORMAT "%2.0" /end AXIS_PTS
/begin MEASUREMENT act_inj_coded "Injection Region" UBYTE _CNV_A_R_LINEAR_____0_CM 1 0. 0. 15. DISPLAY_IDENTIFIER ACT_INJ_CODED ECU_ADDRESS 0x7fbe85 FORMAT "%3.0" /end MEASUREMENT
/begin MEASUREMENT tgas "Air Temperature (ambiant or intake manifold)" UBYTE _CNV_A_R_LINEAR_____18_CM 1 0. -50. 205. DISPLAY_IDENTIFIER TGAS ECU_ADDRESS 0x7fb8a6 FORMAT "%3.0" /end MEASUREMENT
/begin CHARACTERISTIC lc_ena_tia "LC_ENA_TIA : switch between TIA and TBA enable flag" VALUE 0x85ce79 _REC_VAL_20_u1 1. _CNV_A_R_LINEAR_____0_CM 0. 1. DISPLAY_IDENTIFIER LC_ENA_TIA FORMAT "%1.0" /end CHARACTERISTIC
/begin MEASUREMENT lv_ena_clc_mf_main1 "Flag to enable the calculation of MF_MAIN1" UBYTE _CNV_S_2_RANGE______11_CM 1 0. 0. 1. DISPLAY_IDENTIFIER LV_ENA_CLC_MF_MAIN1 ECU_ADDRESS 0x7fb8a7 /end MEASUREMENT
/begin CHARACTERISTIC lc_ena_clc_mf_main1 "Enable flag to calculate MF_MAIN1" VALUE 0x85ce78 _REC_VAL_20_u1 1. _CNV_A_R_LINEAR_____0_CM 0. 1. DISPLAY_IDENTIFIER LC_ENA_CLC_MF_MAIN1 FORMAT "%1.0" /end CHARACTERISTIC
/begin MEASUREMENT ang_thr[0] "actual position of the throttle (j = 0..NC_EGRV_NR-1)" SWORD _CNV_A_R_LINEAR_____136_CM 1 0. -100. 99.9969482421875 DISPLAY_IDENTIFIER ANG_THR_0_ ECU_ADDRESS 0x7fa14c BYTE_ORDER MSB_LAST FORMAT "%5.3" /end MEASUREMENT
/begin MEASUREMENT v_thr[0] "throttle position j ( j=0..NC_THR_NR-1 )" UWORD _CNV_A_R_LINEAR_____28_CM 1 0. 0. 4.9951171875 DISPLAY_IDENTIFIER V_THR_0_ ECU_ADDRESS 0x7fa14e BYTE_ORDER MSB_LAST FORMAT "%4.3" /end MEASUREMENT
/begin MEASUREMENT v_thr_mes[0] "measured throttle position j ( j=0..NC_THR_NR-1 )" UWORD _CNV_A_R_LINEAR_____28_CM 1 0. 0. 4.9951171875 DISPLAY_IDENTIFIER V_THR_MES_0_ ECU_ADDRESS 0x7fa150 BYTE_ORDER MSB_LAST FORMAT "%4.3" /end MEASUREMENT
/begin MEASUREMENT ang_grd_thr_fil[0] "gradient of the actual position of the throttle (j = 0..NC_EGRV_NR-1)" SWORD _CNV_A_R_LINEAR_____428_CM 1 0. -32768. 32767. DISPLAY_IDENTIFIER ANG_GRD_THR_FIL_0_ ECU_ADDRESS 0x7fa152 BYTE_ORDER MSB_LAST FORMAT "%5.0" /end MEASUREMENT
/begin MEASUREMENT ang_thr_fil[0] "actual position of the throttle, PT1 filtered (j = 0..NC_THR_NR-1)" SWORD _CNV_A_R_LINEAR_____136_CM 1 0. -100. 99.9969482421875 DISPLAY_IDENTIFIER ANG_THR_FIL_0_ ECU_ADDRESS 0x7fa154 BYTE_ORDER MSB_LAST FORMAT "%5.3" /end MEASUREMENT
/begin MEASUREMENT ang_thr_fil_dif[0] "difference between the unfiltered and filtered actual position" SWORD _CNV_A_R_LINEAR_____136_CM 1 0. -100. 99.9969482421875 DISPLAY_IDENTIFIER ANG_THR_FIL_DIF_0_ ECU_ADDRESS 0x7fa156 BYTE_ORDER MSB_LAST FORMAT "%5.3" /end MEASUREMENT
/begin CHARACTERISTIC c_v_thr_bol_man[0] "" VALUE 0x8500c4 _REC_VAL_20_u2 319.995172 _CNV_A_R_LINEAR_____415_CM 0. 319.995172 DISPLAY_IDENTIFIER C_V_THR_BOL_MAN_0_ /end CHARACTERISTIC
/begin CHARACTERISTIC lc_v_thr_dif_bol_tol_man[0] "" VALUE 0x850183 _REC_VAL_20_u1 1. _CNV_A_R_LINEAR_____0_CM 0. 1. DISPLAY_IDENTIFIER LC_V_THR_DIF_BOL_TOL_MAN_0_ FORMAT "%1.0" /end CHARACTERISTIC
/begin CHARACTERISTIC lc_v_thr_bol_man[0] "" VALUE 0x850182 _REC_VAL_20_u1 1. _CNV_A_R_LINEAR_____0_CM 0. 1. DISPLAY_IDENTIFIER LC_V_THR_BOL_MAN_0_ FORMAT "%1.0" /end CHARACTERISTIC
/begin CHARACTERISTIC c_ang_thr_bol[0] "" VALUE 0x84fb9a _REC_VAL_20_s2 399.99389 _CNV_A_R_LINEAR_____402_CM -200. 199.99389 DISPLAY_IDENTIFIER C_ANG_THR_BOL_0_ /end CHARACTERISTIC
/begin CHARACTERISTIC c_ang_thr_tol[0] "" VALUE 0x84fb9c _REC_VAL_20_s2 399.99389 _CNV_A_R_LINEAR_____402_CM -200. 199.99389 DISPLAY_IDENTIFIER C_ANG_THR_TOL_0_ /end CHARACTERISTIC
/begin CHARACTERISTIC c_v_thr_dif_bol_tol_man[0] "" VALUE 0x8500c6 _REC_VAL_20_u2 319.995172 _CNV_A_R_LINEAR_____415_CM 0. 319.995172 DISPLAY_IDENTIFIER C_V_THR_DIF_BOL_TOL_MAN_0_ /end CHARACTERISTIC
/begin CHARACTERISTIC c_v_thr_sub_diag "THR position substitute value" VALUE 0x8500c8 _REC_VAL_20_u2 4.9951171875 _CNV_A_R_LINEAR_____28_CM 0. 4.9951171875 DISPLAY_IDENTIFIER C_V_THR_SUB_DIAG FORMAT "%4.3" /end CHARACTERISTIC
/begin CHARACTERISTIC ip_t_lpf_ang_thr_fil "THRAQ: Time constant of the low-pass filter for ANG_THR_FIL_j" CURVE 0x84eff0 _REC_CUR_20_u2_u2 65.535 _CNV_A_R_LINEAR_____73_CM 0. 65.535 DISPLAY_IDENTIFIER IP_T_LPF_ANG_THR_FIL FORMAT "%5.3"
 /begin AXIS_DESCR COM_AXIS ang_thr_fil_dif[0] _CNV_A_R_LINEAR_____161_CM 9 -100. 99.99694820000001 FORMAT "%5.3" AXIS_PTS_REF ldp_ang_thr_fil_dif_ip_t_lpf /end AXIS_DESCR
/end CHARACTERISTIC
/begin AXIS_PTS ldp_ang_thr_fil_dif_ip_t_lpf "" 0x8413be ang_thr_fil_dif[0] _REC_AXS_20_u2 199.9969482 _CNV_A_R_LINEAR_____161_CM 9 -100. 99.99694820000001 FORMAT "%5.3" /end AXIS_PTS
/begin MEASUREMENT tqi_lim_dmf "Torque limitation for DMF protection" SWORD _CNV_A_R_LINEAR_____52_CM 1 0. -1024. 1023.96875 DISPLAY_IDENTIFIER TQI_LIM_DMF ECU_ADDRESS 0x7fa0c8 BYTE_ORDER MSB_LAST FORMAT "%6.2" /end MEASUREMENT
/begin MEASUREMENT lv_dly_ctr_ena_dmf "Delay counter enabled" UBYTE _CNV_S_2_RANGE______11_CM 1 0. 0. 1. DISPLAY_IDENTIFIER LV_DLY_CTR_ENA_DMF ECU_ADDRESS 0x7fbf64 /end MEASUREMENT
/begin MEASUREMENT lv_dly_n_thd_dmf_act "2nd engine speed theshold for DMF protection during start active" UBYTE _CNV_S_2_RANGE______11_CM 1 0. 0. 1. DISPLAY_IDENTIFIER LV_DLY_N_THD_DMF_ACT ECU_ADDRESS 0x7fbf65 /end MEASUREMENT
/begin MEASUREMENT lv_trig_chk_n_thd_dmf "1st engine speed theshold for DMF protection during start active" UBYTE _CNV_S_2_RANGE______11_CM 1 0. 0. 1. DISPLAY_IDENTIFIER LV_TRIG_CHK_N_THD_DMF ECU_ADDRESS 0x7fbf66 /end MEASUREMENT
/begin MEASUREMENT lv_dmf_fcut "Fuel cut off in progress" UBYTE _CNV_S_2_RANGE______11_CM 1 0. 0. 1. DISPLAY_IDENTIFIER LV_DMF_FCUT ECU_ADDRESS 0x7fbf67 /end MEASUREMENT
/begin MEASUREMENT lv_dmf_fcut_byp "Fuel cut off conditions present" UBYTE _CNV_S_2_RANGE______11_CM 1 0. 0. 1. DISPLAY_IDENTIFIER LV_DMF_FCUT_BYP ECU_ADDRESS 0x7fbf68 /end MEASUREMENT
/begin MEASUREMENT t_fcut_dmf_prot "Fuel cut-off time for DMF protection" UWORD _CNV_A_R_LINEAR_____56_CM 1 0. 0. 10.23 DISPLAY_IDENTIFIER T_FCUT_DMF_PROT ECU_ADDRESS 0x7fb3d4 BYTE_ORDER MSB_LAST FORMAT "%4.2" /end MEASUREMENT
/begin CHARACTERISTIC c_t_off_dmf "Time for fuel cut off during normal engine state" VALUE 0x84ffd6 _REC_VAL_20_u2 10.23 _CNV_A_R_LINEAR_____56_CM 0. 10.23 DISPLAY_IDENTIFIER C_T_OFF_DMF FORMAT "%4.2" /end CHARACTERISTIC
/begin CHARACTERISTIC c_t_off_dmf_st "Time for fuel cut off during start" VALUE 0x84ffd8 _REC_VAL_20_u2 10.23 _CNV_A_R_LINEAR_____56_CM 0. 10.23 DISPLAY_IDENTIFIER C_T_OFF_DMF_ST FORMAT "%4.2" /end CHARACTERISTIC
/begin CHARACTERISTIC c_n_thd_dmf_syn "Engine speed theshold for DMF protection with synchronised engine" VALUE 0x84fe30 _REC_VAL_20_u2 8160. _CNV_A_R_LINEAR_____5_CM 0. 8160. DISPLAY_IDENTIFIER C_N_THD_DMF_SYN FORMAT "%4.0" /end CHARACTERISTIC
/begin CHARACTERISTIC c_n_thd_dmf_not_syn "Engine speed threshold for DMF protection with not synchonised engine" VALUE 0x84fe2c _REC_VAL_20_u2 8160. _CNV_A_R_LINEAR_____5_CM 0. 8160. DISPLAY_IDENTIFIER C_N_THD_DMF_NOT_SYN FORMAT "%4.0" /end CHARACTERISTIC
/begin CHARACTERISTIC c_vb_fil_min_gra_dmf "Minimum positive gradient of battery voltage for detection of disconnected starter" VALUE 0x8500ee _REC_VAL_20_u2 28.8 _CNV_A_R_LINEAR_____43_CM 0. 28.8 DISPLAY_IDENTIFIER C_VB_FIL_MIN_GRA_DMF FORMAT "%4.2" /end CHARACTERISTIC
/begin CHARACTERISTIC c_vb_fil_min_dmf "Minimum battery voltage for detection of disconnected starter" VALUE 0x8500ec _REC_VAL_20_u2 28.8 _CNV_A_R_LINEAR_____43_CM 0. 28.8 DISPLAY_IDENTIFIER C_VB_FIL_MIN_DMF FORMAT "%4.2" /end CHARACTERISTIC
/begin CHARACTERISTIC c_n_thd_dmf_prot_act "Engine speed threshold for activation of DMF protection" VALUE 0x84fe2e _REC_VAL_20_u2 8160. _CNV_A_R_LINEAR_____5_CM 0. 8160. DISPLAY_IDENTIFIER C_N_THD_DMF_PROT_ACT FORMAT "%4.0" /end CHARACTERISTIC
/begin CHARACTERISTIC c_t_dly_st_dmf "Delay-time for activation of 2nd engine speed threshold for DMF-protection during start" VALUE 0x84ff6c _REC_VAL_20_u2 10.23 _CNV_A_R_LINEAR_____56_CM 0. 10.23 DISPLAY_IDENTIFIER C_T_DLY_ST_DMF FORMAT "%4.2" /end CHARACTERISTIC
/begin CHARACTERISTIC ip_n_thd_st_dmf "DMFPROT: Engine speed threshold for DMF protection during start" CURVE 0x84d438 _REC_CUR_20_u2_u1 8160. _CNV_A_R_LINEAR_____5_CM 0. 8160. DISPLAY_IDENTIFIER IP_N_THD_ST_DMF FORMAT "%4.0"
 /begin AXIS_DESCR COM_AXIS tco _CNV_A_R_LINEAR_____18_CM 6 -50. 205. FORMAT "%3.0" AXIS_PTS_REF ldpm_tco_1_dmf_prot /end AXIS_DESCR
/end CHARACTERISTIC
/begin AXIS_PTS ldpm_tco_1_dmf_prot "" 0x843788 tco _REC_AXS_20_u1 255. _CNV_A_R_LINEAR_____18_CM 6 -50. 205. FORMAT "%3.0" /end AXIS_PTS
/begin CHARACTERISTIC ip_n_thd_st_post_dly_dmf "DMFPROT: Engine speed theshold for DMF protection during start (after delay)" CURVE 0x84d444 _REC_CUR_20_u2_u1 8160. _CNV_A_R_LINEAR_____5_CM 0. 8160. DISPLAY_IDENTIFIER IP_N_THD_ST_POST_DLY_DMF FORMAT "%4.0"
 /begin AXIS_DESCR COM_AXIS tco _CNV_A_R_LINEAR_____18_CM 6 -50. 205. FORMAT "%3.0" AXIS_PTS_REF ldpm_tco_1_dmf_prot /end AXIS_DESCR
/end CHARACTERISTIC
/begin MEASUREMENT lv_aeb "active engine bracket hard/soft" UBYTE _CNV_S_2_RANGE______11_CM 1 0. 0. 1. DISPLAY_IDENTIFIER LV_AEB ECU_ADDRESS 0x7fbb1d /end MEASUREMENT
/begin MEASUREMENT aeb_act "Control of Active Engine Brackets" UBYTE _CNV_A_R_LINEAR_____29_CM 1 0. 0. 0.99609375 DISPLAY_IDENTIFIER AEB_ACT ECU_ADDRESS 0x7fbf6c FORMAT "%4.3" /end MEASUREMENT
/begin CHARACTERISTIC c_aeb_hys_up "upper value for hysteresis" VALUE 0x84fb93 _REC_VAL_20_u1 0.99609375 _CNV_A_R_LINEAR_____29_CM 0. 0.99609375 DISPLAY_IDENTIFIER C_AEB_HYS_UP FORMAT "%4.3" /end CHARACTERISTIC
/begin CHARACTERISTIC c_aeb_hys_down "under value for hysteresis" VALUE 0x84fb92 _REC_VAL_20_u1 0.99609375 _CNV_A_R_LINEAR_____29_CM 0. 0.99609375 DISPLAY_IDENTIFIER C_AEB_HYS_DOWN FORMAT "%4.3" /end CHARACTERISTIC
/begin CHARACTERISTIC ip_aeb_act__n__tqi_sp "SUPP_AEB: map for control of Active Engine Brackets" MAP 0x844f80 _REC_MAP_20_u1_u2_u2 0.99609375 _CNV_A_R_LINEAR_____29_CM 0. 0.99609375 DISPLAY_IDENTIFIER IP_AEB_ACT__N__TQI_SP FORMAT "%4.3"
 /begin AXIS_DESCR COM_AXIS n _CNV_A_R_LINEAR_____5_CM 5 0. 8160. FORMAT "%4.0" AXIS_PTS_REF ldpm_n_ip_aeb_act /end AXIS_DESCR
 /begin AXIS_DESCR COM_AXIS tqi_sp _CNV_A_R_LINEAR_____343_CM 5 -1024. 1023.97 FORMAT "%6.2" AXIS_PTS_REF ldpm_tqi_sp_ip_aeb_act /end AXIS_DESCR
/end CHARACTERISTIC
/begin AXIS_PTS ldpm_n_ip_aeb_act "" 0x842ef2 n _REC_AXS_20_u2 8160. _CNV_A_R_LINEAR_____5_CM 5 0. 8160. FORMAT "%4.0" /end AXIS_PTS
/begin AXIS_PTS ldpm_tqi_sp_ip_aeb_act "" 0x843cb0 tqi_sp _REC_AXS_20_u2 2047.97 _CNV_A_R_LINEAR_____343_CM 5 -1024. 1023.97 FORMAT "%6.2" /end AXIS_PTS
/begin COMPU_METHOD _CNV_A_R_LINEAR_____0_CM "" RAT_FUNC "%6.3" "[-]" COEFFS 0 1. 0. 0 0 1 /end COMPU_METHOD
/begin COMPU_METHOD _CNV_A_R_LINEAR_____1_CM "" RAT_FUNC "%6.3" "-" COEFFS 0 1. 0. 0 0 1 /end COMPU_METHOD
/begin COMPU_METHOD _CNV_S_2_RANGE______3_CM "" TAB_VERB "%6.3" "[-]" COMPU_TAB_REF _CNV_S_2_RANGE______3 /end COMPU_METHOD
/begin COMPU_VTAB _CNV_S_2_RANGE______3 "" TAB_VERB 2 0 "" 1 "1" /end COMPU_VTAB
/begin COMPU_METHOD _CNV_A_R_LINEAR_____5_CM "" RAT_FUNC "%6.3" "[rpm]" COEFFS 0 1. 0. 0 0 1 /end COMPU_METHOD
/begin COMPU_METHOD _CNV_A_R_LINEAR_____8_CM "" RAT_FUNC "%6.3" "[%]" COEFFS 0 655.3599999999997 0. 0 0 1 /end COMPU_METHOD
/begin COMPU_METHOD _CNV_S_2_RANGE______11_CM "" TAB_VERB "%6.3" "[-]" COMPU_TAB_REF _CNV_S_2_RANGE______11 /end COMPU_METHOD
/begin COMPU_VTAB _CNV_S_2_RANGE______11 "" TAB_VERB 2 0 "0" 1 "1" /end COMPU_VTAB
/begin COMPU_METHOD _CNV_A_R_LINEAR_____14_CM "" RAT_FUNC "%6.3" "[-]" COEFFS 0 65535.99999999996 0. 0 0 1 /end COMPU_METHOD
/begin COMPU_METHOD _CNV_A_R_LINEAR_____16_CM "" RAT_FUNC "%6.3" "[s]" COEFFS 0 1. 0. 0 0 1 /end COMPU_METHOD
/begin COMPU_METHOD _CNV_A_R_LINEAR_____18_CM "" RAT_FUNC "%6.3" "[°C]" COEFFS 0 1. 50. 0 0 1 /end COMPU_METHOD
/begin COMPU_METHOD _CNV_A_R_LINEAR_____19_CM "" RAT_FUNC "%6.3" "[s]" COEFFS 0 10. 0. 0 0 1 /end COMPU_METHOD
/begin COMPU_METHOD _CNV_A_R_LINEAR_____20_CM "" RAT_FUNC "%6.3" "[°C]" COEFFS 0 1. 0. 0 0 1 /end COMPU_METHOD
/begin COMPU_METHOD _CNV_S_2_RANGE______23_CM "" TAB_VERB "%6.3" "[-]" COMPU_TAB_REF _CNV_S_2_RANGE______23 /end COMPU_METHOD
/begin COMPU_VTAB _CNV_S_2_RANGE______23 "" TAB_VERB 2 0 "passive" 1 "active" /end COMPU_VTAB
/begin COMPU_METHOD _CNV_A_R_LINEAR_____28_CM "" RAT_FUNC "%6.3" "[V]" COEFFS 0 204.8 0. 0 0 1 /end COMPU_METHOD
/begin COMPU_METHOD _CNV_A_R_LINEAR_____29_CM "" RAT_FUNC "%6.3" "[-]" COEFFS 0 256. 0. 0 0 1 /end COMPU_METHOD
/begin COMPU_METHOD _CNV_A_R_LINEAR_____30_CM "" RAT_FUNC "%6.3" "[1/min]" COEFFS 0 3.125e-002 0. 0 0 1 /end COMPU_METHOD
/begin COMPU_METHOD _CNV_A_R_LINEAR_____34_CM "" RAT_FUNC "%6.3" "[km/h]" COEFFS 0 1. 0. 0 0 1 /end COMPU_METHOD
/begin COMPU_METHOD _CNV_A_R_LINEAR_____37_CM "" RAT_FUNC "%6.3" "[%]" COEFFS 0 2.550102004080163 0. 0 0 1 /end COMPU_METHOD
/begin COMPU_METHOD _CNV_A_R_LINEAR_____38_CM "" RAT_FUNC "%6.3" "[mg/stk]" COEFFS 0 250. 0. 0 0 1 /end COMPU_METHOD
/begin COMPU_METHOD _CNV_A_R_LINEAR_____39_CM "" RAT_FUNC "%6.3" "[%]" COEFFS 0 2.55 0. 0 0 1 /end COMPU_METHOD
/begin COMPU_METHOD _CNV_S_6_Glow_State_40_CM "" TAB_VERB "%6.3" "[-]" COMPU_TAB_REF _CNV_S_6_Glow_State_40 /end COMPU_METHOD
/begin COMPU_VTAB _CNV_S_6_Glow_State_40 "" TAB_VERB 6 0 "SF_GL_ES" 1 "SF_GL_ST_REDY" 2 "SF_GL_ST" 3 "SF_GL_AST" 4 "SF_GL_PUC" 255 "DONT GLOW" /end COMPU_VTAB
/begin COMPU_METHOD _CNV_S_5_Glow_Mode_41_CM "" TAB_VERB "%6.3" "[-]" COMPU_TAB_REF _CNV_S_5_Glow_Mode_41 /end COMPU_METHOD
/begin COMPU_VTAB _CNV_S_5_Glow_Mode_41 "" TAB_VERB 5 1 "PRE START MODE ON" 2 "START MODE ON" 3 "POST START MODE ON" 4 "INTERMEDIATE MODE ON" 255 "DONT GLOW" /end COMPU_VTAB
/begin COMPU_METHOD _CNV_A_R_LINEAR_____42_CM "" RAT_FUNC "%6.3" "[rpm]" COEFFS 0 0.9990386864987011 -0.4921925126650422 0 0 1 /end COMPU_METHOD
/begin COMPU_METHOD _CNV_A_R_LINEAR_____43_CM "" RAT_FUNC "%6.3" "[V]" COEFFS 0 8.854166666666666 0. 0 0 1 /end COMPU_METHOD
/begin COMPU_METHOD _CNV_A_R_LINEAR_____44_CM "" RAT_FUNC "%6.3" "[s]" COEFFS 0 8.854166666666666 0. 0 0 1 /end COMPU_METHOD
/begin COMPU_METHOD _CNV_A_R_LINEAR_____45_CM "" RAT_FUNC "%6.3" "[hPa]" COEFFS 0 12.06017666543982 0. 0 0 1 /end COMPU_METHOD
/begin COMPU_METHOD _CNV_A_R_LINEAR_____51_CM "" RAT_FUNC "%6.3" "[°C]" COEFFS 0 63.9990234375 0. 0 0 1 /end COMPU_METHOD
/begin COMPU_METHOD _CNV_A_R_LINEAR_____52_CM "" RAT_FUNC "%6.3" "[Nm]" COEFFS 0 32. 0. 0 0 1 /end COMPU_METHOD
/begin COMPU_METHOD _CNV_A_R_LINEAR_____56_CM "" RAT_FUNC "%6.3" "[s]" COEFFS 0 100. 0. 0 0 1 /end COMPU_METHOD
/begin COMPU_METHOD _CNV_A_R_LINEAR_____61_CM "" RAT_FUNC "%6.3" "[s]" COEFFS 0 31250. 0. 0 0 1 /end COMPU_METHOD
/begin COMPU_METHOD _CNV_A_R_LINEAR_____62_CM "" RAT_FUNC "%6.3" "[s]" COEFFS 0 999984.7412109375 0. 0 0 1 /end COMPU_METHOD
/begin COMPU_METHOD _CNV_A_R_LINEAR_____63_CM "" RAT_FUNC "%6.3" "[s]" COEFFS 0 250000. 0. 0 0 1 /end COMPU_METHOD
/begin COMPU_METHOD _CNV_A_R_LINEAR_____64_CM "" RAT_FUNC "%6.3" "[s]" COEFFS 0 15625. 0. 0 0 1 /end COMPU_METHOD
/begin COMPU_METHOD _CNV_A_R_LINEAR_____65_CM "" RAT_FUNC "%6.3" "°C" COEFFS 0 1. 40. 0 0 1 /end COMPU_METHOD
/begin COMPU_METHOD _CNV_A_R_LINEAR_____66_CM "" RAT_FUNC "%6.3" "[rpm/10ms]" COEFFS 0 511.9921875 0. 0 0 1 /end COMPU_METHOD
/begin COMPU_METHOD _CNV_A_R_LINEAR_____67_CM "" RAT_FUNC "%6.3" "[km/h/rpm]" COEFFS 0 65535.82575140447 0. 0 0 1 /end COMPU_METHOD
/begin COMPU_METHOD _CNV_A_R_LINEAR_____73_CM "" RAT_FUNC "%6.3" "[s]" COEFFS 0 1000. 0. 0 0 1 /end COMPU_METHOD
/begin COMPU_METHOD _CNV_S_2_RANGE__0___85_CM "" TAB_VERB "%6.3" "-" COMPU_TAB_REF _CNV_S_2_RANGE__0___85 /end COMPU_METHOD
/begin COMPU_VTAB _CNV_S_2_RANGE__0___85 "" TAB_VERB 2 0 "0" 1 "1" /end COMPU_VTAB
/begin COMPU_METHOD _CNV_A_R_LINEAR_____87_CM "" RAT_FUNC "%6.3" "[-]" COEFFS 0 65535.82575140447 0. 0 0 1 /end COMPU_METHOD
/begin COMPU_METHOD _CNV_A_R_LINEAR_____93_CM "" RAT_FUNC "%6.3" "[ms]" COEFFS 0 0.1 0. 0 0 1 /end COMPU_METHOD
/begin COMPU_METHOD _CNV_A_R_LINEAR_____107_CM "" RAT_FUNC "%6.3" "[V]" COEFFS 0 204.7999999487896 -2.556795379859977e-007 0 0 1 /end COMPU_METHOD
/begin COMPU_METHOD _CNV_A_R_LINEAR_____116_CM "" RAT_FUNC "%6.3" "[hPa/V]" COEFFS 0 7.548844614199462 0. 0 0 1 /end COMPU_METHOD
/begin COMPU_METHOD _CNV_A_R_LINEAR_____134_CM "" RAT_FUNC "%6.3" "[%]" COEFFS 0 655.35 0. 0 0 1 /end COMPU_METHOD
/begin COMPU_METHOD _CNV_A_R_LINEAR_____136_CM "" RAT_FUNC "%6.3" "[%]" COEFFS 0 327.68 0. 0 0 1 /end COMPU_METHOD
/begin COMPU_METHOD _CNV_A_R_LINEAR_____154_CM "" RAT_FUNC "%6.3" "rpm" COEFFS 0 1. 0. 0 0 1 /end COMPU_METHOD
/begin COMPU_METHOD _CNV_A_R_LINEAR_____157_CM "" RAT_FUNC "%6.3" "[°C]" COEFFS 0 64. 0. 0 0 1 /end COMPU_METHOD
/begin COMPU_METHOD _CNV_A_R_LINEAR_____161_CM "" RAT_FUNC "%6.3" "[%]" COEFFS 0 327.680000069121 32768.0000069121 0 0 1 /end COMPU_METHOD
/begin COMPU_METHOD _CNV_A_R_LINEAR_____209_CM "" RAT_FUNC "%6.3" "[kPa]" COEFFS 0 8.225806451612903e-002 0. 0 0 1 /end COMPU_METHOD
/begin COMPU_METHOD _CNV_A_R_LINEAR_____226_CM "" RAT_FUNC "%6.3" "s" COEFFS 0 100. 0. 0 0 1 /end COMPU_METHOD
/begin COMPU_METHOD _CNV_A_R_LINEAR_____240_CM "" RAT_FUNC "%6.3" "s" COEFFS 0 10. 0. 0 0 1 /end COMPU_METHOD
/begin COMPU_METHOD _CNV_A_R_LINEAR_____241_CM "" RAT_FUNC "%6.3" "[\260C]" COEFFS 0 1.333333333333333 64. 0 0 1 /end COMPU_METHOD
/begin COMPU_METHOD _CNV_A_R_LINEAR_____245_CM "" RAT_FUNC "%6.3" "km/h" COEFFS 0 1. 0. 0 0 1 /end COMPU_METHOD
/begin COMPU_METHOD _CNV_A_R_LINEAR_____258_CM "" RAT_FUNC "%6.3" "%" COEFFS 0 655.3599999999997 0. 0 0 1 /end COMPU_METHOD
/begin COMPU_METHOD _CNV_A_R_LINEAR_____259_CM "" RAT_FUNC "%6.3" "%" COEFFS 0 327.68 0. 0 0 1 /end COMPU_METHOD
/begin COMPU_METHOD _CNV_A_R_LINEAR_____260_CM "" RAT_FUNC "%6.3" "[C]" COEFFS 0 1.333333333333333 0. 0 0 1 /end COMPU_METHOD
/begin COMPU_METHOD _CNV_A_R_LINEAR_____261_CM "" RAT_FUNC "%6.3" "[C]" COEFFS 0 1.333333333333333 128. 0 0 1 /end COMPU_METHOD
/begin COMPU_METHOD _CNV_A_R_LINEAR_____266_CM "" RAT_FUNC "%6.3" "[%]" COEFFS 0 10.24024024024024 0. 0 0 1 /end COMPU_METHOD
/begin COMPU_METHOD _CNV_A_R_LINEAR_____267_CM "" RAT_FUNC "%6.3" "[%]" COEFFS 0 1. 0. 0 0 1 /end COMPU_METHOD
/begin COMPU_METHOD _CNV_A_R_LINEAR_____304_CM "" RAT_FUNC "%6.3" "-" COEFFS 0 32. 0. 0 0 1 /end COMPU_METHOD
/begin COMPU_METHOD _CNV_S_4_Engine_Sta_342_CM "" TAB_VERB "%6.3" "[-]" COMPU_TAB_REF _CNV_S_4_Engine_Sta_342 /end COMPU_METHOD
/begin COMPU_VTAB _CNV_S_4_Engine_Sta_342 "" TAB_VERB 4 1 "ES" 2 "ST" 4 "IS" 8 "PL" /end COMPU_VTAB
/begin COMPU_METHOD _CNV_A_R_LINEAR_____343_CM "" RAT_FUNC "%6.3" "[Nm]" COEFFS 0 31.99998046846389 32767.97999970703 0 0 1 /end COMPU_METHOD
/begin COMPU_METHOD _CNV_A_R_LINEAR_____361_CM "" RAT_FUNC "%6.3" "[V]" COEFFS 0 204.6 0. 0 0 1 /end COMPU_METHOD
/begin COMPU_METHOD _CNV_A_R_LINEAR_____386_CM "" RAT_FUNC "%6.3" "[1/min]" COEFFS 0 1. 0. 0 0 1 /end COMPU_METHOD
/begin COMPU_METHOD _CNV_A_R_LINEAR_____387_CM "" RAT_FUNC "%6.3" "[(1/min)/s]" COEFFS 0 3.125e-002 0. 0 0 1 /end COMPU_METHOD
/begin COMPU_METHOD _CNV_A_R_LINEAR_____388_CM "" RAT_FUNC "%6.3" "[Nm]" COEFFS 0 8191.999999679995 -1.280019205296412e-006 0 0 1 /end COMPU_METHOD
/begin COMPU_METHOD _CNV_A_R_LINEAR_____389_CM "" RAT_FUNC "%6.3" "[Nm(1/min)]" COEFFS 0 8192. 0. 0 0 1 /end COMPU_METHOD
/begin COMPU_METHOD _CNV_A_R_LINEAR_____390_CM "" RAT_FUNC "%6.3" "[Nm(1/min)]" COEFFS 0 32.00301204819277 0. 0 0 1 /end COMPU_METHOD
/begin COMPU_METHOD _CNV_A_R_LINEAR_____391_CM "" RAT_FUNC "%6.3" "[rpm]" COEFFS 0 32.00301204819277 0. 0 0 1 /end COMPU_METHOD
/begin COMPU_METHOD _CNV_A_R_LINEAR_____392_CM "" RAT_FUNC "%6.3" "[s]" COEFFS 0 32.00301204819277 0. 0 0 1 /end COMPU_METHOD
/begin COMPU_METHOD _CNV_A_R_LINEAR_____393_CM "" RAT_FUNC "%6.3" "[(1/min)/s]" COEFFS 0 3.125e-002 128. 0 0 1 /end COMPU_METHOD
/begin COMPU_METHOD _CNV_A_R_LINEAR_____394_CM "" RAT_FUNC "%6.3" "[Nm]" COEFFS 0 2097184. 32768. 0 0 1 /end COMPU_METHOD
/begin COMPU_METHOD _CNV_A_R_LINEAR_____402_CM "" RAT_FUNC "%6.3" "[%]" COEFFS 0 163.8400026560406 5.312081193551421e-004 0 0 1 /end COMPU_METHOD
/begin COMPU_METHOD _CNV_A_R_LINEAR_____415_CM "" RAT_FUNC "%6.3" "[V]" COEFFS 0 204.7999649194707 0. 0 0 1 /end COMPU_METHOD
/begin COMPU_METHOD _CNV_A_R_LINEAR_____428_CM "" RAT_FUNC "%6.3" "[%/s]" COEFFS 0 1. 0. 0 0 1 /end COMPU_METHOD
/begin RECORD_LAYOUT _REC_VAL_20_u1 FNC_VALUES 1 UBYTE COLUMN_DIR DIRECT /end RECORD_LAYOUT
/begin RECORD_LAYOUT _REC_AXS_20_u2 NO_AXIS_PTS_X 1 UWORD AXIS_PTS_X 2 UWORD INDEX_INCR DIRECT /end RECORD_LAYOUT
/begin RECORD_LAYOUT _REC_VAL_20_u2 FNC_VALUES 1 UWORD COLUMN_DIR DIRECT /end RECORD_LAYOUT
/begin RECORD_LAYOUT _REC_VAL_20_s2 FNC_VALUES 1 SWORD COLUMN_DIR DIRECT /end RECORD_LAYOUT
/begin RECORD_LAYOUT _REC_AXS_20_u1 NO_AXIS_PTS_X 1 UBYTE AXIS_PTS_X 2 UBYTE INDEX_INCR DIRECT /end RECORD_LAYOUT
/begin RECORD_LAYOUT _REC_CUR_20_u2_u2 FNC_VALUES 1 UWORD COLUMN_DIR DIRECT /end RECORD_LAYOUT
/begin RECORD_LAYOUT _REC_CUR_20_u2_u1 FNC_VALUES 1 UWORD COLUMN_DIR DIRECT /end RECORD_LAYOUT
/begin RECORD_LAYOUT _REC_MAP_20_u1_u2_u2 FNC_VALUES 1 UBYTE COLUMN_DIR DIRECT /end RECORD_LAYOUT
/begin RECORD_LAYOUT _REC_MAP_20_u2_u1_u1 FNC_VALUES 1 UWORD COLUMN_DIR DIRECT /end RECORD_LAYOUT
/begin RECORD_LAYOUT _REC_MAP_20_u2_u2_u1 FNC_VALUES 1 UWORD COLUMN_DIR DIRECT /end RECORD_LAYOUT
/begin RECORD_LAYOUT _REC_CUR_20_u1_u2 FNC_VALUES 1 UBYTE COLUMN_DIR DIRECT /end RECORD_LAYOUT
/begin RECORD_LAYOUT _REC_CUR_20_u1_u1 FNC_VALUES 1 UBYTE COLUMN_DIR DIRECT /end RECORD_LAYOUT
/begin RECORD_LAYOUT _REC_MAP_20_u2_u1_u2 FNC_VALUES 1 UWORD COLUMN_DIR DIRECT /end RECORD_LAYOUT
/begin RECORD_LAYOUT _REC_VAL_20_u4 FNC_VALUES 1 ULONG COLUMN_DIR DIRECT /end RECORD_LAYOUT
/begin RECORD_LAYOUT _REC_VAL_20_s1 FNC_VALUES 1 SBYTE COLUMN_DIR DIRECT /end RECORD_LAYOUT
/begin FUNCTION SYS_VAR_THRAQ "Acquisition of the THR- position"
 /begin DEF_CHARACTERISTIC c_v_thr_bol_man[0] lc_v_thr_dif_bol_tol_man[0] lc_v_thr_bol_man[0] c_ang_thr_bol[0] c_ang_thr_tol[0] c_v_thr_dif_bol_tol_man[0] c_v_thr_sub_diag ip_t_lpf_ang_thr_fil ldp_ang_thr_fil_dif_ip_t_lpf /end DEF_CHARACTERISTIC
 /begin OUT_MEASUREMENT ang_thr[0] v_thr[0] v_thr_mes[0] ang_grd_thr_fil[0] ang_thr_fil[0] ang_thr_fil_dif[0] /end OUT_MEASUREMENT
/end FUNCTION
/begin FUNCTION SYS_VAR_AN ""
 /begin OUT_MEASUREMENT n_pred t_mmv t_seg_mis tab_t_seg[0] tab_t_seg[1] tab_t_seg[2] tab_t_seg[3] t_seg_clc_red_tab[0] t_seg_clc_red_tab[1] t_seg_clc_red_tab[2] t_seg_clc_red_tab[3] t_seg_clc_red_tab[4] t_seg_4 t_seg_clc_red cyl_nr ptr_seg_clc /end OUT_MEASUREMENT
/end FUNCTION
/begin FUNCTION SYS_VAR_AN_IS_SP "IS SP Calculation"
 /begin DEF_CHARACTERISTIC lc_n_sp_is_tcu_ena c_n_sp_is_dn_cvt c_lih_n_sp_is c_n_sp_is_max c_n_sp_is_ofs c_t_dly_n_sp lc_is_ub_ena lc_is_ac_ena lc_is_ramp_ub_req lc_is_ramp_vecu_1_req lc_is_bem_1_ena lc_is_bem_2_ena lc_is_ramp_vecu_2_req lc_is_ramp_ac_req lc_is_vecu_1_ena lc_is_vecu_2_ena c_n_ofs_set_is_sp_pf c_state_rgn_pf c_temp_thd_is_sp_pf c_n_ofs_rst_is_sp_pf lc_is_acin lc_is_accin_on lc_is_ac_sw c_hi_tco_thd c_hi_tia_thd c_hi_toil_thd lc_is_hi_ena c_tco_max_vb_n_sp c_n_sp_lgrd_is lc_is_ramp_brake lc_is_ramp_dri lc_is_ramp_dct lc_is_ramp_cs_2 lc_is_ramp_vs_n lc_is_ramp_man c_is_vs_n_thd lc_is_2st id_n_sp_min_is__vb_fil ldp_vb_fil_n_sp_min_is ip_n_sp_is_cvt_vs ldp_vs_n_sp_is_cvt_vs ip_n_inc_is_sp_pf ldp_tco_ip_n_inc_is_sp_pf ip_n_sp_acin_dri_is__tco ldpm_tco_ip_n_sp_is ip_n_sp_acin_is_at__tco ip_n_sp_acin_is_mt__tco ip_n_sp_is_max_vecu_1_tco ip_n_sp_is_max_vecu_2_tco ip_n_sp_is_hi ldp_toil_n_sp_is_hi /end DEF_CHARACTERISTIC
 /begin OUT_MEASUREMENT n_sp_is_cor_max n_sp_is lv_n_sp_is_max_1 lv_n_sp_is_max_2 n_sp_is_cor n_sp_is_cvt n_sp_is_lim n_sp_is_pf_rgn lv_tpc_thd_is_sp_pf lv_pf_rgn_is_act lv_n_sp_is_inc_pf_set lv_n_sp_is_inc_pf_rst lv_is_ac lv_n_sp_is_driv lv_n_sp_is_eng lv_n_sp_is_ext lv_n_sp_is_ext_2 n_sp_is_ac lv_is_bsg n_sp_is_bsg n_sp_is_cor_driv n_sp_is_eng lv_is_ramp n_sp_is_ext n_sp_is_ext_2 n_sp_is_ext_2_ramp n_sp_is_ext_req n_sp_is_ramp n_sp_is_ramp_tar n_sp_is_vb lv_is_ramp_act n_sp_is_vecu_2 lv_is_ramp_ena lv_is_ramp_req lv_is_ub lv_n_sp_is_ramp_max /end OUT_MEASUREMENT
/end FUNCTION
/begin FUNCTION SYS_VAR_AN_IS_SP_I "IS SP Calculation (Appl.Inc.)"
 /begin DEF_CHARACTERISTIC id_n_sp_is_mt_dri ldpm_dri_n_sp_is id_n_sp_is_at_dri ip_n_sp_is_at ip_n_sp_is_mt /end DEF_CHARACTERISTIC
 /begin OUT_MEASUREMENT n_sp_is_bas /end OUT_MEASUREMENT
/end FUNCTION
/begin FUNCTION SYS_VAR_ATEGPC ""
 /begin DEF_CHARACTERISTIC c_teg_tur_up_sub_diag ip_teg_tur_up_mes ldp_v_teg_tur_up_ip_teg_tur_up /end DEF_CHARACTERISTIC
 /begin OUT_MEASUREMENT teg_tur_up teg_tur_up_mes v_teg_tur_up /end OUT_MEASUREMENT
/end FUNCTION
/begin FUNCTION VAR_ADIP_PF ""
 /begin DEF_CHARACTERISTIC c_dip_pf_sub_diag c_fac_dip_pf_fil c_v_dip_pf_ofs c_fac_v_dip_pf c_tco_max_dip_pf_ad c_tia_min_dip_pf_ad c_tia_max_dip_pf_ad c_v_dip_pf_ad_max c_v_dip_pf_ad_min /end DEF_CHARACTERISTIC
 /begin OUT_MEASUREMENT v_dip_pf dip_pf_mes v_dip_pf_ad dip_pf dip_pf_mmv dip_pf_temp /end OUT_MEASUREMENT
/end FUNCTION
/begin FUNCTION SYS_VAR_ATFU "Fuel Temperature Acquisition" /begin DEF_CHARACTERISTIC c_tfu_sub_diag ip_tfu_mes__v_tfu ldp_v_tfu_ip_tfu_mes /end DEF_CHARACTERISTIC /begin OUT_MEASUREMENT v_tfu tfu_mes tfu /end OUT_MEASUREMENT /end FUNCTION
/begin FUNCTION C_5_EOS "" /begin SUB_FUNCTION EOS_AENGSTAT EOS_ASPL_MOD EOS_AREST /end SUB_FUNCTION /end FUNCTION
/begin FUNCTION EOS_AENGSTAT "Engine States"
 /begin DEF_CHARACTERISTIC ip_n_max_tol_st__tco ldp_tco_ip_n_max_tol_st c_n_max_bol_st c_n_min_bol c_pv_av_min /end DEF_CHARACTERISTIC
 /begin OUT_MEASUREMENT sf_eng_state lv_es lv_st lv_is lv_pl lv_puc lv_st_end t_ast t_apl /end OUT_MEASUREMENT
/end FUNCTION
/begin FUNCTION EOS_ASPL_MOD "Special engine states" /begin DEF_CHARACTERISTIC c_ctr_max_ti_min /end DEF_CHARACTERISTIC /end FUNCTION
/begin FUNCTION EOS_AREST "Auxiliary Start Functions" /begin DEF_CHARACTERISTIC c_t_max_rest c_tco_dif_max_rest /end DEF_CHARACTERISTIC /begin OUT_MEASUREMENT lv_rest tco_rest lv_rest_auth /end OUT_MEASUREMENT /end FUNCTION
/begin FUNCTION C_5_STAT "" /begin SUB_FUNCTION STAT_STST STAT_STSTAI STAT_AENGSSFI STAT_ACMB_MNG /end SUB_FUNCTION /end FUNCTION
/begin FUNCTION STAT_STST ""
 /begin DEF_CHARACTERISTIC c_t_str_n_min c_t_max_n_sub c_cam_1_ctr_max c_t_str_rng c_n_str_min c_t_str_off_max c_n_chk_eng_stop c_vs_str_off ldp_ctr_str_id_t_str_sum_max ip_n_str_off ldp_tco_ip_t_str_act_max id_fac_n_str ip_t_str_act_max c_t_chk_eng_stop c_t_max_vs_str_off lc_kl15_lock ldp_tco_ip_n_str_off ldp_tco_ip_dur_str_nom_str_act ldp_ctr_str_id_fac_n_str ldp_t_ip_dur_str_nom_str_act id_t_str_sum_max ip_dur_str_nom_str_act lc_n_sub lc_str_conf /end DEF_CHARACTERISTIC
 /begin OUT_MEASUREMENT lv_str_1_2_on lv_err_str_2 lv_str_1_2_off ctr_str lv_err_str_1 lv_err_str_1_2 t_str_rng t_str_n_min lv_str_1 lv_kl15_lock t_str_sum t_str_act t_vs_str_off t_chk_eng_stop lv_str_2 lv_n_sub t_str_off t_n_sub lv_sta_rls lv_sta_stop /end OUT_MEASUREMENT
/end FUNCTION
/begin FUNCTION STAT_STSTAI ""
 /begin OUT_MEASUREMENT kl50r kl50 cam_1_ctr lv_st_es lv_str_on lv_str_off lv_auth_eng_rest lv_req_es_driv /end OUT_MEASUREMENT
/end FUNCTION
/begin FUNCTION STAT_AENGSSFI "" /end FUNCTION
/begin FUNCTION STAT_ACMB_MNG ""
 /begin DEF_CHARACTERISTIC id_conf_inj id_conf_inj_rgn_1 id_conf_inj_rgn_2 ldpm_sf_conf_inj lc_ena_tia lc_ena_clc_mf_main1 /end DEF_CHARACTERISTIC
 /begin OUT_MEASUREMENT sf_conf_inj sf_conf_inj_rgn_1 sf_conf_inj_rgn_2 act_inj_coded tgas lv_ena_clc_mf_main1 /end OUT_MEASUREMENT
/end FUNCTION
/begin FUNCTION C_9_SUPP ""
 /begin DEF_CHARACTERISTIC c_t_accin_dly_st c_pv_accin_fl_thd c_n_accin_fl_thd c_t_max_accin_fl c_t_min_accin_fl c_tco_accin_tol c_tco_accin_bol c_acp_high_bol c_acp_high_tol c_acp_low_bol c_acp_low_tol c_t_dly_accin c_t_min_accout_rly /end DEF_CHARACTERISTIC
 /begin OUT_MEASUREMENT lv_acc_ena_fl lv_acc_ena_st lv_acc_ena_sys_err lv_acc_ena_acp lv_accin lv_acc_ena_tco lv_acc_off_cmd lv_acc_driv_req lv_acin_man lv_old_acc_di lv_acin_can_ecu accpwm_b lv_acc_ena t_accin_dly_st t_accin_fl t_dly_accin t_dly_accin_st t_min_accout_rly lv_acc_ena_tcu1 lv_acc_ena_vecu1 lv_acin lv_accout_rly /end OUT_MEASUREMENT
 /begin SUB_FUNCTION AHEAT SUPP_STOP SUPP_AGLOW SUPP_ASTOP SUPP_ALIHCORD SUPP_AN_LIM SUPP_ADMFPROT SUPP_AEB /end SUB_FUNCTION
/end FUNCTION
/begin FUNCTION AHEAT ""
 /begin DEF_CHARACTERISTIC lc_heat_var_temp c_tco_heat_bol c_t_dly_heat_st lc_heat_var_swi lc_heat_off_ac c_vb_heat_bol c_vb_heat_tol c_n_heat_bol c_n_heat_tol c_tia_heat_bol c_tia_heat_tol lc_heat_3_off_ac c_altpwm_heat_tol_dec c_t_dly_heat c_fac_fil_altpwm_heat c_t_dly_n_dec ip_tco_heat_tol__temp ldp_tco_ip_tco_heat_tol ip_altpwm_heat_bol__n ldp_n_ip_altpwm_heat_bol ip_altpwm_heat_tol__n ldp_n_ip_altpwm_heat_tol /end DEF_CHARACTERISTIC
 /begin OUT_MEASUREMENT lv_heat_1 lv_heat_2 lv_heat_3 sf_heat lv_heat_var_temp lv_req_n_sp_is_min_heat temp_tco_heat_tol_act count_act_heat_elems /end OUT_MEASUREMENT
/end FUNCTION
/begin FUNCTION SUPP_STOP "" /end FUNCTION
/begin FUNCTION SUPP_AGLOW ""
 /begin DEF_CHARACTERISTIC ip_t_gl_puc ip_pwm_gl_ast c_tco_sp_gl lc_gll c_tco_cor_gl_max c_tco_cor_gl_min c_t2_gl_es lc_t_gl_es_amp_act c_pwm_gl_st lc_pwm_gl_st c_pwm_gl_es_1 c_pwm_gl_es_2 c_pwm_gl_es_3 c_t_dly_gl_rly c_n_max_gl c_t_gl_st_ready c_tco_max_gl c_t_gl_st c_n_max_gl_ast c_mf_max_gl_ast c_mf_max_gl_ast_ofs c_n_max_gl_ast_ofs c_t_gl_puc_3 c_mf_max_gl_puc c_t_gl_puc_2 c_t_gl_boost c_vb_gl_bol_1 c_vb_gl_tol_1 c_vb_gl_bol_2 c_vb_gl_tol_2 lc_gl_off ip_t_gll ldp_tco_ip_t_gll ip_t_gl_ast ldp_tco_ip_t_gl_ast ip_t1_gl_es ldp_tco_ip_t1_gl_es ldp_tam_ip_t_gl_puc ip_t_gl_es_vb ldp_vb_ip_t_gl_es ldp_tco_ip_t_gl_es ip_t_gl_es_amp ldp_amp_ip_t_gl_es ldp_mf_ip_pwm_gl_ast ldp_n_ip_pwm_gl_ast /end DEF_CHARACTERISTIC
 /begin OUT_MEASUREMENT lv_gll pwm_gl t_gl_es t_gl_ast tco_cor_gl lv_gl_boost sf_gl_state lv_gl_es lv_gl_off tco_cor_gl_ofs lv_gl pwm_gl_ast t_gl_es_act pwm_es lv_t_gl_ast_over gl_mode t_gl_ast_frozen lv_t_gl_es_end lv_t12_end t12_gl_es lv_t_gl_st_ready_end lv_gl_st_ready lv_tco_st_low lv_t_gl_st_end lv_gl_st_on lv_t_dly_gl_rly_ast_end lv_n_hys_gl_ast lv_mf_hys_gl_ast lv_dly_gl_rly_ast_act lv_gl_ast_on lv_t_dly_gl_rly_puc_end lv_dly_gl_rly_puc_act lv_pull_gl_puc lv_pull_end_gl_puc lv_gl_puc_on t_gl_puc lv_gl_off_vb t1_gl_es t3_gl_es t2_gl_es /end OUT_MEASUREMENT
/end FUNCTION
/begin FUNCTION SUPP_ASTOP "Engine Stop Function" /begin DEF_CHARACTERISTIC c_t_req_es_fup c_t_req_es_inj c_t_es_prep /end DEF_CHARACTERISTIC
 /begin OUT_MEASUREMENT lv_es_act lv_es_prep lv_inh_es_diag lv_pwl_lock_es lv_req_es_inj lv_req_es_fup lv_req_es_thr ctr_req_es_fup lv_req_es_fup_act ctr_req_es_inj lv_req_es_inj_act lv_req_es_supp_fct /end OUT_MEASUREMENT
/end FUNCTION
/begin FUNCTION SUPP_ALIHCORD "Limp home coordination"
 /begin DEF_CHARACTERISTIC c_lih_cru_a_wr_1 c_lih_cyl_bal_a_wr_0 c_lih_cyl_bal_a_wr_1 c_lih_egr_a_wr_0 c_lih_egr_a_wr_1 c_lih_egy_a_wr_0 c_lih_egy_a_wr_1 c_lih_esp_a_wr_0 c_lih_esp_a_wr_1 c_lih_etcu_a_wr_0 c_lih_etcu_a_wr_1 c_lih_gear_a_wr_0 c_lih_gear_a_wr_1 c_lih_inj_a_wr_0 c_lih_inj_a_wr_1 c_lih_is_sp_a_wr_0 c_lih_is_sp_a_wr_1 c_lih_n_lim_a_wr_0 c_lih_n_lim_a_wr_1 c_lih_post_inj_a_wr_0 c_lih_post_inj_a_wr_1 c_lih_prev_inj_a_wr_0 c_lih_prev_inj_a_wr_1 c_lih_tq_clc_a_wr_0 c_lih_tq_clc_a_wr_1 c_lih_tq_clc_b_wr_0 c_lih_tq_clc_b_wr_1 c_lih_tqi_a_wr_0 c_lih_tqi_a_wr_1 c_lih_tqi_b_wr_0 c_lih_tqi_b_wr_1 c_lih_tqi_rst c_lih_cru_a_wr_0 c_lih_aj_a_wr_1 c_lih_refu_a_wr_0 c_lih_aj_a_wr_0 c_lih_refu_a_wr_1 /end DEF_CHARACTERISTIC
 /begin OUT_MEASUREMENT lv_lih_act lv_lih_aj lv_lih_asr_ramp_up lv_lih_cru_off lv_lih_cru_stb lv_lih_cyl_bal_off lv_lih_egr_ctl lv_lih_egy lv_lih_err_tq_clc_1 lv_lih_err_tq_clc_2 lv_lih_etcu_clu_ad lv_lih_etcu_inh lv_lih_etcu_ramp_up lv_lih_gear_det lv_lih_inj_1_off lv_lih_inj_2_off lv_lih_inj_3_off lv_lih_inj_4_off lv_lih_inj_5_off lv_lih_inj_6_off lv_lih_msr_inh lv_lih_msr_ramp_down lv_lih_n_is_sp lv_lih_n_lim lv_lih_post_inj_inh lv_lih_prev_inj_inh lv_lih_tcs_inh lv_lih_tqi sf_lih_1 sf_lih_2 sf_lih_3 lv_lih_off_refu lv_lih_vs_refu /end OUT_MEASUREMENT
/end FUNCTION
/begin FUNCTION SUPP_AN_LIM "Engine speed limitation"
 /begin DEF_CHARACTERISTIC c_add_n_max_fcut c_crlc_n_grd_fil_1 c_crlc_n_grd_fil_2 c_n_grd_hys c_tqi_max_pas id_fac_n_max_i_at__gear id_fac_n_max_i_mt__gear id_fac_n_max_p_at__gear id_fac_n_max_p_mt__gear id_t_n_max_pred_at__gear id_t_n_max_pred_mt__gear ip_n_grd_thd__n_32 /end DEF_CHARACTERISTIC
 /begin OUT_MEASUREMENT lv_n_max lv_n_max_req_fcut n_dif_max_lim n_grd_fil n_grd_fil_fil n_pred_max_lim tq_n_max_dif tq_n_max_dif_p tq_n_max_inp_i tqi_n_max_1 tqi_n_max_ref tq_n_max_dif_i.sbyte[0] tq_n_max_dif_i.sbyte[1] tq_n_max_dif_i.sbyte[2] tq_n_max_dif_i.sbyte[3] tq_n_max_dif_i.sword[0] tq_n_max_dif_i.sword[1] tq_n_max_dif_i.slongword /end OUT_MEASUREMENT
/end FUNCTION
/begin FUNCTION SUPP_ADMFPROT "Protection of Dual Mass Flywheel"
 /begin DEF_CHARACTERISTIC c_t_off_dmf c_t_off_dmf_st c_n_thd_dmf_syn c_n_thd_dmf_not_syn c_vb_fil_min_gra_dmf c_vb_fil_min_dmf c_n_thd_dmf_prot_act c_t_dly_st_dmf ip_n_thd_st_dmf ldpm_tco_1_dmf_prot ip_n_thd_st_post_dly_dmf /end DEF_CHARACTERISTIC
 /begin OUT_MEASUREMENT tqi_lim_dmf lv_dly_ctr_ena_dmf lv_dly_n_thd_dmf_act lv_trig_chk_n_thd_dmf lv_dmf_fcut lv_dmf_fcut_byp t_fcut_dmf_prot /end OUT_MEASUREMENT
/end FUNCTION
/begin FUNCTION SUPP_AEB "Active Engine Brackets"
 /begin DEF_CHARACTERISTIC c_aeb_hys_up c_aeb_hys_down ip_aeb_act__n__tqi_sp ldpm_n_ip_aeb_act ldpm_tqi_sp_ip_aeb_act /end DEF_CHARACTERISTIC
 /begin OUT_MEASUREMENT lv_aeb aeb_act /end OUT_MEASUREMENT
/end FUNCTION
/begin FUNCTION C_9_AUX ""
 /begin SUB_FUNCTION AUX_ECU_Power_Latch_Manag AUX_Electr_Contr_Water_Pump AUX_Electr_Contr_Thermostat AUX_Electr_Cool_Fans AUX_Eng_Cool_Control AUX_Calc_Lubric_Maint_Interv AUX_Calc_Lubric_Maint_Interv__AI AUX_ECU_Power_Latch_Manag__AI AUX_Fuel_Consumption_Calc AUX_IMOB_INC /end SUB_FUNCTION
/end FUNCTION
/begin FUNCTION AUX_ECU_Power_Latch_Manag "" /begin DEF_CHARACTERISTIC c_t_min_pwl c_t_max_pwl /end DEF_CHARACTERISTIC /begin OUT_MEASUREMENT pwl_lock_cdn t_pwl lv_pwl_act lv_inh_pwl_tran_es_el /end OUT_MEASUREMENT /end FUNCTION
/begin FUNCTION AUX_Electr_Contr_Water_Pump ""
 /begin DEF_CHARACTERISTIC c_t_ast_min_cwp c_tam_max_cwp_act_eru c_tco_max_cwp_act_eru c_t_ast_max_cwp c_equip_cwp /end DEF_CHARACTERISTIC
 /begin OUT_MEASUREMENT lv_cwp_act lv_cwp_act_eru lv_equip_cwp /end OUT_MEASUREMENT
/end FUNCTION
/begin FUNCTION AUX_Electr_Contr_Thermostat ""
 /begin DEF_CHARACTERISTIC c_tco_dif_min_ectpwm_i c_tco_dif_max_ectpwm_i c_ectpwm_i_min c_ectpwm_i_max c_tco_2_max_ectpwm_tol c_ectpwm_sub c_ectpwm_max c_ectpwm_min c_tco_2_max_ectpwm_bol c_ectpwm_sub_st c_ectpwm_sub_pwl c_t_ast_min_ectpwm ldp_tco_dif__ectpwm_i ip_ectpwm_i ldp_tco_dif__ectpwm_bas ldp_tco_sp__ectpwm_bas ip_ectpwm_bas /end DEF_CHARACTERISTIC
 /begin OUT_MEASUREMENT ectpwm ectpwm_bas ectpwm_i ectpwm_raw ectpwm_inter_1 ectpwm_inter_2 /end OUT_MEASUREMENT
/end FUNCTION
/end MODULE
/end PROJECT
