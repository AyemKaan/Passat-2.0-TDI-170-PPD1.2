ASAP2_VERSION 1 41
/begin PROJECT SN0 "SIMOS PPD"
/begin HEADER "_default_HeaderComment" PROJECT_NO PRJ_NUM /end HEADER
/begin MODULE _default_ModuleName "_default_ModuleLongIdentifier"
/begin MOD_COMMON "_default_ModCommonComment" DEPOSIT ABSOLUTE BYTE_ORDER MSB_FIRST ALIGNMENT_BYTE 1 ALIGNMENT_WORD 2 ALIGNMENT_LONG 4 ALIGNMENT_FLOAT32_IEEE 4 ALIGNMENT_FLOAT64_IEEE 8 /end MOD_COMMON
/begin CHARACTERISTIC c_abc_inc_mon_3 "anti bounce counter increment for diagnosis instance MON_3" VALUE 0x84faac _REC_VAL_20_u1 255. _CNV_A_R_LINEAR_____0_CM 0. 255. DISPLAY_IDENTIFIER C_ABC_INC_MON_3 FORMAT "%3.0" /end CHARACTERISTIC
/begin CHARACTERISTIC c_abc_max_mon_3 "maximum value of anti bounce counter for diagnosis instance MON_3" VALUE 0x84fb38 _REC_VAL_20_u1 255. _CNV_A_R_LINEAR_____0_CM 0. 255. DISPLAY_IDENTIFIER C_ABC_MAX_MON_3 FORMAT "%3.0" /end CHARACTERISTIC
/begin CHARACTERISTIC c_abc_inc_v_tco_1_rng "" VALUE 0x84faec _REC_VAL_20_u1 255. _CNV_A_R_LINEAR_____0_CM 0. 255. DISPLAY_IDENTIFIER C_ABC_INC_V_TCO_1_RNG FORMAT "%3.0" /end CHARACTERISTIC
/begin CHARACTERISTIC c_abc_max_v_tco_1_rng "" VALUE 0x84fb78 _REC_VAL_20_u1 255. _CNV_A_R_LINEAR_____0_CM 0. 255. DISPLAY_IDENTIFIER C_ABC_MAX_V_TCO_1_RNG FORMAT "%3.0" /end CHARACTERISTIC
/begin CHARACTERISTIC c_abc_inc_v_tco_2_rng "" VALUE 0x84faed _REC_VAL_20_u1 255. _CNV_A_R_LINEAR_____0_CM 0. 255. DISPLAY_IDENTIFIER C_ABC_INC_V_TCO_2_RNG FORMAT "%3.0" /end CHARACTERISTIC
/begin CHARACTERISTIC c_abc_max_v_tco_2_rng "" VALUE 0x84fb79 _REC_VAL_20_u1 255. _CNV_A_R_LINEAR_____0_CM 0. 255. DISPLAY_IDENTIFIER C_ABC_MAX_V_TCO_2_RNG FORMAT "%3.0" /end CHARACTERISTIC
/begin CHARACTERISTIC c_abc_inc_tco_1_mes_grd "" VALUE 0x84fad1 _REC_VAL_20_u1 255. _CNV_A_R_LINEAR_____0_CM 0. 255. DISPLAY_IDENTIFIER C_ABC_INC_TCO_1_MES_GRD FORMAT "%3.0" /end CHARACTERISTIC
/begin CHARACTERISTIC c_abc_max_tco_1_mes_grd "" VALUE 0x84fb5d _REC_VAL_20_u1 255. _CNV_A_R_LINEAR_____0_CM 0. 255. DISPLAY_IDENTIFIER C_ABC_MAX_TCO_1_MES_GRD FORMAT "%3.0" /end CHARACTERISTIC
/begin CHARACTERISTIC c_abc_inc_tco_2_mes_grd "" VALUE 0x84fad2 _REC_VAL_20_u1 255. _CNV_A_R_LINEAR_____0_CM 0. 255. DISPLAY_IDENTIFIER C_ABC_INC_TCO_2_MES_GRD FORMAT "%3.0" /end CHARACTERISTIC
/begin CHARACTERISTIC c_abc_max_tco_2_mes_grd "" VALUE 0x84fb5e _REC_VAL_20_u1 255. _CNV_A_R_LINEAR_____0_CM 0. 255. DISPLAY_IDENTIFIER C_ABC_MAX_TCO_2_MES_GRD FORMAT "%3.0" /end CHARACTERISTIC
/begin CHARACTERISTIC c_abc_inc_tco_mes_plaus "" VALUE 0x84fad3 _REC_VAL_20_u1 255. _CNV_A_R_LINEAR_____0_CM 0. 255. DISPLAY_IDENTIFIER C_ABC_INC_TCO_MES_PLAUS FORMAT "%3.0" /end CHARACTERISTIC
/begin CHARACTERISTIC c_abc_max_tco_mes_plaus "" VALUE 0x84fb5f _REC_VAL_20_u1 255. _CNV_A_R_LINEAR_____0_CM 0. 255. DISPLAY_IDENTIFIER C_ABC_MAX_TCO_MES_PLAUS FORMAT "%3.0" /end CHARACTERISTIC
/begin CHARACTERISTIC c_v_tco_max_diag "" VALUE 0x85cdde _REC_VAL_20_u2 4.9951171875 _CNV_A_R_LINEAR_____28_CM 0. 4.9951171875 DISPLAY_IDENTIFIER C_V_TCO_MAX_DIAG FORMAT "%3.2" /end CHARACTERISTIC
/begin CHARACTERISTIC c_v_tco_min_diag "" VALUE 0x85cde0 _REC_VAL_20_u2 4.9951171875 _CNV_A_R_LINEAR_____28_CM 0. 4.9951171875 DISPLAY_IDENTIFIER C_V_TCO_MIN_DIAG FORMAT "%3.2" /end CHARACTERISTIC
/begin MEASUREMENT lv_err_tco_mes "" UBYTE _CNV_S_2_RANGE______23_CM 1 0. 0. 1. DISPLAY_IDENTIFIER LV_ERR_TCO_MES ECU_ADDRESS 0x7fb820 /end MEASUREMENT
/begin MEASUREMENT lv_err_tco_1_mes "" UBYTE _CNV_S_2_RANGE______23_CM 1 0. 0. 1. DISPLAY_IDENTIFIER LV_ERR_TCO_1_MES ECU_ADDRESS 0x7fb821 /end MEASUREMENT
/begin MEASUREMENT lv_err_tco_2_mes "" UBYTE _CNV_S_2_RANGE______23_CM 1 0. 0. 1. DISPLAY_IDENTIFIER LV_ERR_TCO_2_MES ECU_ADDRESS 0x7fb822 /end MEASUREMENT
/begin CHARACTERISTIC c_tfu_min_tco_diag "" VALUE 0x85ccfa _REC_VAL_20_u1 255. _CNV_A_R_LINEAR_____18_CM -50. 205. DISPLAY_IDENTIFIER C_TFU_MIN_TCO_DIAG FORMAT "%4.3" /end CHARACTERISTIC
/begin MEASUREMENT lv_rst_diag_tco_mes_plaus "" UBYTE _CNV_S_2_RANGE______11_CM 1 0. 0. 1. DISPLAY_IDENTIFIER LV_RST_DIAG_TCO_MES_PLAUS ECU_ADDRESS 0x7fbdf7 /end MEASUREMENT
/begin MEASUREMENT tco_mes_st_diag "" UBYTE _CNV_A_R_LINEAR_____18_CM 1 0. -50. 205. DISPLAY_IDENTIFIER TCO_MES_ST_DIAG ECU_ADDRESS 0x7fbdf6 FORMAT "%3.0" /end MEASUREMENT
/begin MEASUREMENT ctr_inh_temp_diag "" UWORD _CNV_A_R_LINEAR_____16_CM 1 0. 0. 65535. DISPLAY_IDENTIFIER CTR_INH_TEMP_DIAG ECU_ADDRESS 0x7fa63c BYTE_ORDER MSB_LAST FORMAT "%5.0" /end MEASUREMENT
/begin CHARACTERISTIC c_abc_inc_v_map_rng "" VALUE 0x84fae9 _REC_VAL_20_u1 255. _CNV_A_R_LINEAR_____0_CM 0. 255. DISPLAY_IDENTIFIER C_ABC_INC_V_MAP_RNG FORMAT "%3.0" /end CHARACTERISTIC
/begin CHARACTERISTIC c_abc_max_v_map_rng "" VALUE 0x84fb75 _REC_VAL_20_u1 255. _CNV_A_R_LINEAR_____0_CM 0. 255. DISPLAY_IDENTIFIER C_ABC_MAX_V_MAP_RNG FORMAT "%3.0" /end CHARACTERISTIC
/begin CHARACTERISTIC c_abc_inc_map_amp_ofs "" VALUE 0x84faa5 _REC_VAL_20_u1 255. _CNV_A_R_LINEAR_____0_CM 0. 255. DISPLAY_IDENTIFIER C_ABC_INC_MAP_AMP_OFS FORMAT "%3.0" /end CHARACTERISTIC
/begin CHARACTERISTIC c_abc_max_map_amp_ofs "" VALUE 0x84fb31 _REC_VAL_20_u1 255. _CNV_A_R_LINEAR_____0_CM 0. 255. DISPLAY_IDENTIFIER C_ABC_MAX_MAP_AMP_OFS FORMAT "%3.0" /end CHARACTERISTIC
/begin CHARACTERISTIC c_abc_inc_map_is_ofs "" VALUE 0x84faa9 _REC_VAL_20_u1 255. _CNV_A_R_LINEAR_____0_CM 0. 255. DISPLAY_IDENTIFIER C_ABC_INC_MAP_IS_OFS FORMAT "%3.0" /end CHARACTERISTIC
/begin CHARACTERISTIC c_abc_max_map_is_ofs "" VALUE 0x84fb35 _REC_VAL_20_u1 255. _CNV_A_R_LINEAR_____0_CM 0. 255. DISPLAY_IDENTIFIER C_ABC_MAX_MAP_IS_OFS FORMAT "%3.0" /end CHARACTERISTIC
/begin CHARACTERISTIC c_v_map_min_diag "" VALUE 0x85cd9a _REC_VAL_20_u2 4.9999237 _CNV_A_R_LINEAR_____47_CM 0. 4.9999237 DISPLAY_IDENTIFIER C_V_MAP_MIN_DIAG FORMAT "%6.5" /end CHARACTERISTIC
/begin CHARACTERISTIC c_v_map_max_diag "" VALUE 0x85cd98 _REC_VAL_20_u2 4.9999237 _CNV_A_R_LINEAR_____47_CM 0. 4.9999237 DISPLAY_IDENTIFIER C_V_MAP_MAX_DIAG FORMAT "%6.5" /end CHARACTERISTIC
/begin CHARACTERISTIC c_map_amp_ofs_min_diag "" VALUE 0x85cab8 _REC_VAL_20_u2 5434. _CNV_A_R_LINEAR_____45_CM 0. 5434. DISPLAY_IDENTIFIER C_MAP_AMP_OFS_MIN_DIAG FORMAT "%6.2" /end CHARACTERISTIC
/begin CHARACTERISTIC c_map_is_ofs_max_diag "" VALUE 0x85cabe _REC_VAL_20_u2 5434. _CNV_A_R_LINEAR_____45_CM 0. 5434. DISPLAY_IDENTIFIER C_MAP_IS_OFS_MAX_DIAG FORMAT "%6.2" /end CHARACTERISTIC
/begin CHARACTERISTIC c_map_amp_ofs_max_diag "" VALUE 0x85cab6 _REC_VAL_20_u2 5434. _CNV_A_R_LINEAR_____45_CM 0. 5434. DISPLAY_IDENTIFIER C_MAP_AMP_OFS_MAX_DIAG FORMAT "%6.2" /end CHARACTERISTIC
/begin CHARACTERISTIC c_map_is_ofs_min_diag "" VALUE 0x85cac0 _REC_VAL_20_u2 5434. _CNV_A_R_LINEAR_____45_CM 0. 5434. DISPLAY_IDENTIFIER C_MAP_IS_OFS_MIN_DIAG FORMAT "%6.2" /end CHARACTERISTIC
/begin AXIS_PTS ldp_amp_ip_fac_map_is_ofs_diag "" 0x84116c amp _REC_AXS_20_u2 5434. _CNV_A_R_LINEAR_____45_CM 4 0. 5434. FORMAT "%4.3" /end AXIS_PTS
/begin CHARACTERISTIC ip_fac_map_is_ofs_diag__amp "BPA_SP: TIA correction on MAP setpoint" CURVE 0x85271a _REC_CUR_20_u2_u2 1.9999696 _CNV_A_R_LINEAR_____48_CM 0. 1.9999696 DISPLAY_IDENTIFIER IP_FAC_MAP_IS_OFS_DIAG__AMP FORMAT "%6.5"
 /begin AXIS_DESCR COM_AXIS amp _CNV_A_R_LINEAR_____45_CM 4 0. 5434. FORMAT "%4.3" AXIS_PTS_REF ldp_amp_ip_fac_map_is_ofs_diag /end AXIS_DESCR
/end CHARACTERISTIC
/begin CHARACTERISTIC c_ctr_map_is_ofs_diag "" VALUE 0x85c963 _REC_VAL_20_u1 255. _CNV_A_R_LINEAR_____0_CM 0. 255. DISPLAY_IDENTIFIER C_CTR_MAP_IS_OFS_DIAG FORMAT "%3.0" /end CHARACTERISTIC
/begin MEASUREMENT lv_err_map_mes "" UBYTE _CNV_S_2_RANGE______23_CM 1 0. 0. 1. DISPLAY_IDENTIFIER LV_ERR_MAP_MES ECU_ADDRESS 0x7fb823 /end MEASUREMENT
/begin MEASUREMENT ctr_map_is_ofs "" UBYTE _CNV_A_R_LINEAR_____0_CM 1 0. 0. 255. DISPLAY_IDENTIFIER CTR_MAP_IS_OFS ECU_ADDRESS 0x7fbdfb FORMAT "%3.0" /end MEASUREMENT
/begin CHARACTERISTIC c_abc_inc_map_mes_grd "" VALUE 0x84faaa _REC_VAL_20_u1 255. _CNV_A_R_LINEAR_____0_CM 0. 255. DISPLAY_IDENTIFIER C_ABC_INC_MAP_MES_GRD FORMAT "%3.0" /end CHARACTERISTIC
/begin CHARACTERISTIC c_abc_max_map_mes_grd "" VALUE 0x84fb36 _REC_VAL_20_u1 255. _CNV_A_R_LINEAR_____0_CM 0. 255. DISPLAY_IDENTIFIER C_ABC_MAX_MAP_MES_GRD FORMAT "%3.0" /end CHARACTERISTIC
/begin MEASUREMENT lv_err_vcc_map "" UBYTE _CNV_S_2_RANGE______23_CM 1 0. 0. 1. DISPLAY_IDENTIFIER LV_ERR_VCC_MAP ECU_ADDRESS 0x7fb824 /end MEASUREMENT
/begin MEASUREMENT lv_inh_map_amp_ofs "" UBYTE _CNV_S_2_RANGE______11_CM 1 0. 0. 1. DISPLAY_IDENTIFIER LV_INH_MAP_AMP_OFS ECU_ADDRESS 0x7fb825 /end MEASUREMENT
/begin MEASUREMENT lv_inh_map_is_ofs "" UBYTE _CNV_S_2_RANGE______11_CM 1 0. 0. 1. DISPLAY_IDENTIFIER LV_INH_MAP_IS_OFS ECU_ADDRESS 0x7fb826 /end MEASUREMENT
/begin CHARACTERISTIC c_map_mes_grd_diag "" VALUE 0x85cac6 _REC_VAL_20_u2 5434. _CNV_A_R_LINEAR_____49_CM 0. 5434. DISPLAY_IDENTIFIER C_MAP_MES_GRD_DIAG FORMAT "%6.2" /end CHARACTERISTIC
/begin CHARACTERISTIC c_tco_map_amp_ofs_diag "" VALUE 0x85ccb8 _REC_VAL_20_u2 255. _CNV_A_R_LINEAR_____18_CM -50. 205. DISPLAY_IDENTIFIER C_TCO_MAP_AMP_OFS_DIAG FORMAT "%6.2" /end CHARACTERISTIC
/begin CHARACTERISTIC c_vb_min_maf_diag "" VALUE 0x85ce16 _REC_VAL_20_u1 28.8 _CNV_A_R_LINEAR_____43_CM 0. 28.8 DISPLAY_IDENTIFIER C_VB_MIN_MAF_DIAG FORMAT "%3.1" /end CHARACTERISTIC
/begin MEASUREMENT lv_err_maf_0_mes "" UBYTE _CNV_S_2_RANGE______23_CM 1 0. 0. 1. DISPLAY_IDENTIFIER LV_ERR_MAF_0_MES ECU_ADDRESS 0x7fb828 /end MEASUREMENT
/begin MEASUREMENT lv_err_maf_mes "" UBYTE _CNV_S_2_RANGE______23_CM 1 0. 0. 1. DISPLAY_IDENTIFIER LV_ERR_MAF_MES ECU_ADDRESS 0x7fb827 /end MEASUREMENT
/begin CHARACTERISTIC c_abc_inc_egrv_0_ctl "" VALUE 0x84fa9b _REC_VAL_20_u1 255. _CNV_A_R_LINEAR_____0_CM 0. 255. DISPLAY_IDENTIFIER C_ABC_INC_EGRV_0_CTL FORMAT "%3.0" /end CHARACTERISTIC
/begin CHARACTERISTIC c_abc_max_egrv_0_ctl "" VALUE 0x84fb27 _REC_VAL_20_u1 255. _CNV_A_R_LINEAR_____0_CM 0. 255. DISPLAY_IDENTIFIER C_ABC_MAX_EGRV_0_CTL FORMAT "%3.0" /end CHARACTERISTIC
/begin CHARACTERISTIC c_abc_inc_v_egrv_0_bol_ad "" VALUE 0x84fae3 _REC_VAL_20_u1 255. _CNV_A_R_LINEAR_____0_CM 0. 255. DISPLAY_IDENTIFIER C_ABC_INC_V_EGRV_0_BOL_AD FORMAT "%3.0" /end CHARACTERISTIC
/begin CHARACTERISTIC c_abc_max_v_egrv_0_bol_ad "" VALUE 0x84fb6f _REC_VAL_20_u1 255. _CNV_A_R_LINEAR_____0_CM 0. 255. DISPLAY_IDENTIFIER C_ABC_MAX_V_EGRV_0_BOL_AD FORMAT "%3.0" /end CHARACTERISTIC
/begin MEASUREMENT ctr_bas_egrv_0_ctl "" UBYTE _CNV_A_R_LINEAR_____0_CM 1 0. 0. 255. DISPLAY_IDENTIFIER CTR_BAS_EGRV_0_CTL ECU_ADDRESS 0x7fb834 FORMAT "%3.0" /end MEASUREMENT
/begin MEASUREMENT ctr_eve_egrv_0_ctl "" UBYTE _CNV_A_R_LINEAR_____0_CM 1 0. 0. 255. DISPLAY_IDENTIFIER CTR_EVE_EGRV_0_CTL ECU_ADDRESS 0x7fb833 FORMAT "%3.0" /end MEASUREMENT
/begin MEASUREMENT t_dly_diag_egrv_ctl_0 "" UWORD _CNV_A_R_LINEAR_____56_CM 1 0. 0. 655.35 DISPLAY_IDENTIFIER T_DLY_DIAG_EGRV_CTL_0 ECU_ADDRESS 0x7fa648 BYTE_ORDER MSB_LAST FORMAT "%5.2" /end MEASUREMENT
/begin CHARACTERISTIC c_ctl_dif_egrv_0_min_diag "" VALUE 0x85c92e _REC_VAL_20_s2 99.99694800000002 _CNV_A_R_LINEAR_____12_CM -100. -3.052e-003 DISPLAY_IDENTIFIER C_CTL_DIF_EGRV_0_MIN_DIAG /end CHARACTERISTIC
/begin CHARACTERISTIC c_ctl_dif_egrv_0_max_diag "" VALUE 0x85c92c _REC_VAL_20_s2 99.996948242 _CNV_A_R_LINEAR_____46_CM 0. 99.996948242 DISPLAY_IDENTIFIER C_CTL_DIF_EGRV_0_MAX_DIAG /end CHARACTERISTIC
/begin CHARACTERISTIC c_ctr_eve_egrv_0_ctl "" VALUE 0x85c957 _REC_VAL_20_u1 255. _CNV_A_R_LINEAR_____0_CM 0. 255. DISPLAY_IDENTIFIER C_CTR_EVE_EGRV_0_CTL FORMAT "%3.0" /end CHARACTERISTIC
/begin CHARACTERISTIC c_ctr_bas_egrv_0_ctl "" VALUE 0x85c94e _REC_VAL_20_u1 255. _CNV_A_R_LINEAR_____0_CM 0. 255. DISPLAY_IDENTIFIER C_CTR_BAS_EGRV_0_CTL FORMAT "%3.0" /end CHARACTERISTIC
/begin CHARACTERISTIC c_t_dly_diag_egrv_ctl "" VALUE 0x85cc1c _REC_VAL_20_u2 655.35 _CNV_A_R_LINEAR_____56_CM 0. 655.35 DISPLAY_IDENTIFIER C_T_DLY_DIAG_EGRV_CTL FORMAT "%5.2" /end CHARACTERISTIC
/begin CHARACTERISTIC c_abc_inc_thr_0_ctl "" VALUE 0x84fad7 _REC_VAL_20_u1 255. _CNV_A_R_LINEAR_____0_CM 0. 255. DISPLAY_IDENTIFIER C_ABC_INC_THR_0_CTL FORMAT "%3.0" /end CHARACTERISTIC
/begin CHARACTERISTIC c_abc_max_thr_0_ctl "" VALUE 0x84fb63 _REC_VAL_20_u1 255. _CNV_A_R_LINEAR_____0_CM 0. 255. DISPLAY_IDENTIFIER C_ABC_MAX_THR_0_CTL FORMAT "%3.0" /end CHARACTERISTIC
/begin CHARACTERISTIC c_abc_inc_v_thr_0_bol_ad "" VALUE 0x84faf0 _REC_VAL_20_u1 255. _CNV_A_R_LINEAR_____0_CM 0. 255. DISPLAY_IDENTIFIER C_ABC_INC_V_THR_0_BOL_AD FORMAT "%3.0" /end CHARACTERISTIC
/begin CHARACTERISTIC c_abc_max_v_thr_0_bol_ad "" VALUE 0x84fb7c _REC_VAL_20_u1 255. _CNV_A_R_LINEAR_____0_CM 0. 255. DISPLAY_IDENTIFIER C_ABC_MAX_V_THR_0_BOL_AD FORMAT "%3.0" /end CHARACTERISTIC
/begin MEASUREMENT ctr_bas_thr_0_ctl "" UBYTE _CNV_A_R_LINEAR_____0_CM 1 0. 0. 255. DISPLAY_IDENTIFIER CTR_BAS_THR_0_CTL ECU_ADDRESS 0x7fb836 FORMAT "%3.0" /end MEASUREMENT
/begin MEASUREMENT ctr_eve_thr_0_ctl "" UBYTE _CNV_A_R_LINEAR_____0_CM 1 0. 0. 255. DISPLAY_IDENTIFIER CTR_EVE_THR_0_CTL ECU_ADDRESS 0x7fb835 FORMAT "%3.0" /end MEASUREMENT
/begin MEASUREMENT t_dly_diag_thr_ctl_0 "" UWORD _CNV_A_R_LINEAR_____56_CM 1 0. 0. 655.35 DISPLAY_IDENTIFIER T_DLY_DIAG_THR_CTL_0 ECU_ADDRESS 0x7fa64a BYTE_ORDER MSB_LAST FORMAT "%5.2" /end MEASUREMENT
/begin CHARACTERISTIC c_ctl_dif_thr_0_min_diag "" VALUE 0x85c936 _REC_VAL_20_s2 99.99694800000002 _CNV_A_R_LINEAR_____12_CM -100. -3.052e-003 DISPLAY_IDENTIFIER C_CTL_DIF_THR_0_MIN_DIAG /end CHARACTERISTIC
/begin CHARACTERISTIC c_ctl_dif_thr_0_max_diag "" VALUE 0x85c934 _REC_VAL_20_s2 99.996948242 _CNV_A_R_LINEAR_____46_CM 0. 99.996948242 DISPLAY_IDENTIFIER C_CTL_DIF_THR_0_MAX_DIAG /end CHARACTERISTIC
/begin CHARACTERISTIC c_ctr_eve_thr_0_ctl "" VALUE 0x85c959 _REC_VAL_20_u1 255. _CNV_A_R_LINEAR_____0_CM 0. 255. DISPLAY_IDENTIFIER C_CTR_EVE_THR_0_CTL FORMAT "%3.0" /end CHARACTERISTIC
/begin CHARACTERISTIC c_ctr_bas_thr_0_ctl "" VALUE 0x85c950 _REC_VAL_20_u1 255. _CNV_A_R_LINEAR_____0_CM 0. 255. DISPLAY_IDENTIFIER C_CTR_BAS_THR_0_CTL FORMAT "%3.0" /end CHARACTERISTIC
/begin CHARACTERISTIC c_t_dly_diag_thr_ctl "" VALUE 0x85cc1e _REC_VAL_20_u2 655.35 _CNV_A_R_LINEAR_____56_CM 0. 655.35 DISPLAY_IDENTIFIER C_T_DLY_DIAG_THR_CTL FORMAT "%5.2" /end CHARACTERISTIC
/begin CHARACTERISTIC c_abc_inc_bpa_0_ctl "" VALUE 0x84fa72 _REC_VAL_20_u1 255. _CNV_A_R_LINEAR_____0_CM 0. 255. DISPLAY_IDENTIFIER C_ABC_INC_BPA_0_CTL FORMAT "%3.0" /end CHARACTERISTIC
/begin CHARACTERISTIC c_abc_max_bpa_0_ctl "" VALUE 0x84fafe _REC_VAL_20_u1 255. _CNV_A_R_LINEAR_____0_CM 0. 255. DISPLAY_IDENTIFIER C_ABC_MAX_BPA_0_CTL FORMAT "%3.0" /end CHARACTERISTIC
/begin CHARACTERISTIC c_abc_inc_v_bpa_0_bol_ad "" VALUE 0x84fade _REC_VAL_20_u1 255. _CNV_A_R_LINEAR_____0_CM 0. 255. DISPLAY_IDENTIFIER C_ABC_INC_V_BPA_0_BOL_AD FORMAT "%3.0" /end CHARACTERISTIC
/begin CHARACTERISTIC c_abc_max_v_bpa_0_bol_ad "" VALUE 0x84fb6a _REC_VAL_20_u1 255. _CNV_A_R_LINEAR_____0_CM 0. 255. DISPLAY_IDENTIFIER C_ABC_MAX_V_BPA_0_BOL_AD FORMAT "%3.0" /end CHARACTERISTIC
/begin MEASUREMENT ctr_bas_bpa_0_ctl "" UBYTE _CNV_A_R_LINEAR_____0_CM 1 0. 0. 255. DISPLAY_IDENTIFIER CTR_BAS_BPA_0_CTL ECU_ADDRESS 0x7fce2d FORMAT "%3.0" /end MEASUREMENT
/begin MEASUREMENT ctr_eve_bpa_0_ctl "" UBYTE _CNV_A_R_LINEAR_____0_CM 1 0. 0. 255. DISPLAY_IDENTIFIER CTR_EVE_BPA_0_CTL ECU_ADDRESS 0x7fce2c FORMAT "%3.0" /end MEASUREMENT
/begin MEASUREMENT t_dly_diag_bpa_ctl_0 "" UWORD _CNV_A_R_LINEAR_____56_CM 1 0. 0. 655.35 DISPLAY_IDENTIFIER T_DLY_DIAG_BPA_CTL_0 ECU_ADDRESS 0x7fcd2c BYTE_ORDER MSB_LAST FORMAT "%5.2" /end MEASUREMENT
/begin CHARACTERISTIC c_ctl_dif_bpa_0_min_diag "" VALUE 0x85c922 _REC_VAL_20_s2 99.99694800000002 _CNV_A_R_LINEAR_____12_CM -100. -3.052e-003 DISPLAY_IDENTIFIER C_CTL_DIF_BPA_0_MIN_DIAG /end CHARACTERISTIC
/begin CHARACTERISTIC c_ctl_dif_bpa_0_max_diag "" VALUE 0x85c920 _REC_VAL_20_s2 99.996948242 _CNV_A_R_LINEAR_____46_CM 0. 99.996948242 DISPLAY_IDENTIFIER C_CTL_DIF_BPA_0_MAX_DIAG /end CHARACTERISTIC
/begin CHARACTERISTIC c_ctr_eve_bpa_0_ctl "" VALUE 0x85c953 _REC_VAL_20_u1 255. _CNV_A_R_LINEAR_____0_CM 0. 255. DISPLAY_IDENTIFIER C_CTR_EVE_BPA_0_CTL FORMAT "%3.0" /end CHARACTERISTIC
/begin CHARACTERISTIC c_ctr_bas_bpa_0_ctl "" VALUE 0x85c94a _REC_VAL_20_u1 255. _CNV_A_R_LINEAR_____0_CM 0. 255. DISPLAY_IDENTIFIER C_CTR_BAS_BPA_0_CTL FORMAT "%3.0" /end CHARACTERISTIC
/begin CHARACTERISTIC c_t_dly_diag_bpa_ctl "" VALUE 0x85cc1a _REC_VAL_20_u2 655.35 _CNV_A_R_LINEAR_____56_CM 0. 655.35 DISPLAY_IDENTIFIER C_T_DLY_DIAG_BPA_CTL FORMAT "%5.2" /end CHARACTERISTIC
/begin CHARACTERISTIC c_abc_inc_byp_0_ctl "" VALUE 0x84fa74 _REC_VAL_20_u1 255. _CNV_A_R_LINEAR_____0_CM 0. 255. DISPLAY_IDENTIFIER C_ABC_INC_BYP_0_CTL FORMAT "%3.0" /end CHARACTERISTIC
/begin CHARACTERISTIC c_abc_max_byp_0_ctl "" VALUE 0x84fb00 _REC_VAL_20_u1 255. _CNV_A_R_LINEAR_____0_CM 0. 255. DISPLAY_IDENTIFIER C_ABC_MAX_BYP_0_CTL FORMAT "%3.0" /end CHARACTERISTIC
/begin CHARACTERISTIC c_abc_inc_v_byp_0_bol_ad "" VALUE 0x84fae0 _REC_VAL_20_u1 255. _CNV_A_R_LINEAR_____0_CM 0. 255. DISPLAY_IDENTIFIER C_ABC_INC_V_BYP_0_BOL_AD FORMAT "%3.0" /end CHARACTERISTIC
/begin CHARACTERISTIC c_abc_max_v_byp_0_bol_ad "" VALUE 0x84fb6c _REC_VAL_20_u1 255. _CNV_A_R_LINEAR_____0_CM 0. 255. DISPLAY_IDENTIFIER C_ABC_MAX_V_BYP_0_BOL_AD FORMAT "%3.0" /end CHARACTERISTIC
/begin MEASUREMENT ctr_bas_byp_0_ctl "" UBYTE _CNV_A_R_LINEAR_____0_CM 1 0. 0. 255. DISPLAY_IDENTIFIER CTR_BAS_BYP_0_CTL ECU_ADDRESS 0x7fce2f FORMAT "%3.0" /end MEASUREMENT
/begin MEASUREMENT ctr_eve_byp_0_ctl "" UBYTE _CNV_A_R_LINEAR_____0_CM 1 0. 0. 255. DISPLAY_IDENTIFIER CTR_EVE_BYP_0_CTL ECU_ADDRESS 0x7fce2e FORMAT "%3.0" /end MEASUREMENT
/begin CHARACTERISTIC c_ctl_dif_byp_0_min_diag "" VALUE 0x85c92a _REC_VAL_20_s2 99.99694800000002 _CNV_A_R_LINEAR_____12_CM -100. -3.052e-003 DISPLAY_IDENTIFIER C_CTL_DIF_BYP_0_MIN_DIAG /end CHARACTERISTIC
/begin CHARACTERISTIC c_ctl_dif_byp_0_max_diag "" VALUE 0x85c928 _REC_VAL_20_s2 99.996948242 _CNV_A_R_LINEAR_____46_CM 0. 99.996948242 DISPLAY_IDENTIFIER C_CTL_DIF_BYP_0_MAX_DIAG /end CHARACTERISTIC
/begin CHARACTERISTIC c_ctr_eve_byp_0_ctl "" VALUE 0x85c955 _REC_VAL_20_u1 255. _CNV_A_R_LINEAR_____0_CM 0. 255. DISPLAY_IDENTIFIER C_CTR_EVE_BYP_0_CTL FORMAT "%3.0" /end CHARACTERISTIC
/begin CHARACTERISTIC c_ctr_bas_byp_0_ctl "" VALUE 0x85c94c _REC_VAL_20_u1 255. _CNV_A_R_LINEAR_____0_CM 0. 255. DISPLAY_IDENTIFIER C_CTR_BAS_BYP_0_CTL FORMAT "%3.0" /end CHARACTERISTIC
/begin CHARACTERISTIC c_abc_inc_map_ctl_min "" VALUE 0x84faa7 _REC_VAL_20_u1 255. _CNV_A_R_LINEAR_____0_CM 0. 255. DISPLAY_IDENTIFIER C_ABC_INC_MAP_CTL_MIN FORMAT "%3.0" /end CHARACTERISTIC
/begin CHARACTERISTIC c_abc_max_map_ctl_min "" VALUE 0x84fb33 _REC_VAL_20_u1 255. _CNV_A_R_LINEAR_____0_CM 0. 255. DISPLAY_IDENTIFIER C_ABC_MAX_MAP_CTL_MIN FORMAT "%3.0" /end CHARACTERISTIC
/begin CHARACTERISTIC c_abc_inc_map_ctl_max "" VALUE 0x84faa6 _REC_VAL_20_u1 255. _CNV_A_R_LINEAR_____0_CM 0. 255. DISPLAY_IDENTIFIER C_ABC_INC_MAP_CTL_MAX FORMAT "%3.0" /end CHARACTERISTIC
/begin CHARACTERISTIC c_abc_max_map_ctl_max "" VALUE 0x84fb32 _REC_VAL_20_u1 255. _CNV_A_R_LINEAR_____0_CM 0. 255. DISPLAY_IDENTIFIER C_ABC_MAX_MAP_CTL_MAX FORMAT "%3.0" /end CHARACTERISTIC
/begin MEASUREMENT ctr_map_ctl_min "counter yields information how often the ctl deviation has been continuously below lower threshold" UBYTE _CNV_A_R_LINEAR_____0_CM 1 0. 0. 255. DISPLAY_IDENTIFIER CTR_MAP_CTL_MIN ECU_ADDRESS 0x7fbe01 FORMAT "%3.0" /end MEASUREMENT
/begin MEASUREMENT ctr_map_ctl_max "counter yields information how often the ctl deviation has been continuously above upper threshold" UBYTE _CNV_A_R_LINEAR_____0_CM 1 0. 0. 255. DISPLAY_IDENTIFIER CTR_MAP_CTL_MAX ECU_ADDRESS 0x7fbe02 FORMAT "%3.0" /end MEASUREMENT
/begin CHARACTERISTIC c_map_dif_min_diag "lower limit for diagnosis of MAP-control deviation" VALUE 0x85cabc _REC_VAL_20_s2 2716.917080000001 _CNV_A_R_LINEAR_____57_CM -2717. -8.291999999999999e-002 DISPLAY_IDENTIFIER C_MAP_DIF_MIN_DIAG /end CHARACTERISTIC
/begin CHARACTERISTIC c_map_dif_max_diag "upper limit for diagnosis of MAP-control deviation" VALUE 0x85caba _REC_VAL_20_s2 2716.917080000001 _CNV_A_R_LINEAR_____58_CM 0. 2716.91708 DISPLAY_IDENTIFIER C_MAP_DIF_MAX_DIAG FORMAT "%7.3" /end CHARACTERISTIC
/begin CHARACTERISTIC c_n_min_map_ctl_diag "DIAG_MAP_CTL: minimum engine speed for activation of MAP-control diagnosis" VALUE 0x85cb3c _REC_VAL_20_u2 6375. _CNV_A_R_LINEAR_____5_CM 0. 6375. DISPLAY_IDENTIFIER C_N_MIN_MAP_CTL_DIAG FORMAT "%4.0" /end CHARACTERISTIC
/begin CHARACTERISTIC c_tqi_sp_min_map_ctl_diag "DIAG_MAP_CTL: minimum TQI_SP for activation of MAP-control diagnosis" VALUE 0x85cd46 _REC_VAL_20_s2 2047.96875 _CNV_A_R_LINEAR_____52_CM -1024. 1023.96875 DISPLAY_IDENTIFIER C_TQI_SP_MIN_MAP_CTL_DIAG FORMAT "%4.1" /end CHARACTERISTIC
/begin CHARACTERISTIC ip_ctr_max_map_ctl_min__n "DIAG_MAP_CTL: maximum value of CTR_MAP_CTL_MIN" CURVE 0x851d8e _REC_CUR_20_u1_u2 255. _CNV_A_R_LINEAR_____0_CM 0. 255. DISPLAY_IDENTIFIER IP_CTR_MAX_MAP_CTL_MIN__N FORMAT "%3.0"
 /begin AXIS_DESCR COM_AXIS n _CNV_A_R_LINEAR_____5_CM 8 0. 6375. FORMAT "%4.0" AXIS_PTS_REF ldpm_n__ip_ctr_max_map_ctl_diag /end AXIS_DESCR
/end CHARACTERISTIC
/begin CHARACTERISTIC ip_ctr_max_map_ctl_max__n "DIAG_MAP_CTL: maximum value of CTR_MAP_CTL_MAX" CURVE 0x851d86 _REC_CUR_20_u1_u2 255. _CNV_A_R_LINEAR_____0_CM 0. 255. DISPLAY_IDENTIFIER IP_CTR_MAX_MAP_CTL_MAX__N FORMAT "%3.0"
 /begin AXIS_DESCR COM_AXIS n _CNV_A_R_LINEAR_____5_CM 8 0. 6375. FORMAT "%4.0" AXIS_PTS_REF ldpm_n__ip_ctr_max_map_ctl_diag /end AXIS_DESCR
/end CHARACTERISTIC
/begin AXIS_PTS ldpm_n__ip_ctr_max_map_ctl_diag "" 0x842ee0 n _REC_AXS_20_u2 6375. _CNV_A_R_LINEAR_____5_CM 8 0. 6375. FORMAT "%4.0" /end AXIS_PTS
/begin CHARACTERISTIC ip_fac_map_ctl_diag__amp "DIAG_MAP_CTL: ambient pressure dependent factor for MAP-control deviation limit" CURVE 0x8526e2 _REC_CUR_20_u2_u2 3.99998471 _CNV_A_R_LINEAR_____59_CM 0. 3.99998471 DISPLAY_IDENTIFIER IP_FAC_MAP_CTL_DIAG__AMP FORMAT "%6.5"
 /begin AXIS_DESCR COM_AXIS amp _CNV_A_R_LINEAR_____45_CM 6 0. 5434. FORMAT "%6.2" AXIS_PTS_REF ldp_amp__ip_fac_map_ctl_diag /end AXIS_DESCR
/end CHARACTERISTIC
/begin AXIS_PTS ldp_amp__ip_fac_map_ctl_diag "" 0x841086 amp _REC_AXS_20_u2 5434. _CNV_A_R_LINEAR_____45_CM 6 0. 5434. FORMAT "%6.2" /end AXIS_PTS
/begin CHARACTERISTIC ip_fac_map_ctl_diag__tia "DIAG_MAP_CTL: intake air temperature dependent factor for MAP-control deviation limit" CURVE 0x8526ee _REC_CUR_20_u2_u1 3.99998471 _CNV_A_R_LINEAR_____59_CM 0. 3.99998471 DISPLAY_IDENTIFIER IP_FAC_MAP_CTL_DIAG__TIA FORMAT "%6.5"
 /begin AXIS_DESCR COM_AXIS tia _CNV_A_R_LINEAR_____18_CM 6 -50. 205. FORMAT "%3.0" AXIS_PTS_REF ldp_tia__ip_fac_map_ctl_diag /end AXIS_DESCR
/end CHARACTERISTIC
/begin AXIS_PTS ldp_tia__ip_fac_map_ctl_diag "" 0x842576 tia _REC_AXS_20_u1 255. _CNV_A_R_LINEAR_____18_CM 6 -50. 205. FORMAT "%3.0" /end AXIS_PTS
/begin MEASUREMENT lv_inh_diag_map_ctl "flag for disablement of MAP_CTL_MIN and MAP_CTL_MAX diagnosis" UBYTE _CNV_S_2_RANGE______11_CM 1 0. 0. 1. DISPLAY_IDENTIFIER LV_INH_DIAG_MAP_CTL ECU_ADDRESS 0x7fb837 /end MEASUREMENT
/begin CHARACTERISTIC c_cdn_obd_map_ctl "bitwise calibration to ignore the inputs for 'temporary disablement' of MAP_CTL diagnostic selectively" VALUE 0x85c8dc _REC_VAL_20_u1 255. _CNV_A_R_LINEAR_____0_CM 0. 255. DISPLAY_IDENTIFIER C_CDN_OBD_MAP_CTL FORMAT "%3.0" /end CHARACTERISTIC
/begin CHARACTERISTIC c_abc_inc_cs "" VALUE 0x84fa89 _REC_VAL_20_u1 255. _CNV_A_R_LINEAR_____0_CM 0. 255. DISPLAY_IDENTIFIER C_ABC_INC_CS FORMAT "%3.0" /end CHARACTERISTIC
/begin CHARACTERISTIC c_abc_max_cs "" VALUE 0x84fb15 _REC_VAL_20_u1 255. _CNV_A_R_LINEAR_____0_CM 0. 255. DISPLAY_IDENTIFIER C_ABC_MAX_CS FORMAT "%3.0" /end CHARACTERISTIC
/begin MEASUREMENT ctr_cs_plaus_1 "" UBYTE _CNV_A_R_LINEAR_____0_CM 1 0. 0. 255. DISPLAY_IDENTIFIER CTR_CS_PLAUS_1 ECU_ADDRESS 0x7fce30 FORMAT "%3.0" /end MEASUREMENT
/begin MEASUREMENT ctr_cs_plaus_2 "" UBYTE _CNV_A_R_LINEAR_____0_CM 1 0. 0. 255. DISPLAY_IDENTIFIER CTR_CS_PLAUS_2 ECU_ADDRESS 0x7fce31 FORMAT "%3.0" /end MEASUREMENT
/begin MEASUREMENT lv_cs_chg_1 "" UBYTE _CNV_S_2_RANGE______11_CM 1 0. 0. 1. DISPLAY_IDENTIFIER LV_CS_CHG_1 ECU_ADDRESS 0x7fce32 /end MEASUREMENT
/begin MEASUREMENT lv_cs_chg_2 "" UBYTE _CNV_S_2_RANGE______11_CM 1 0. 0. 1. DISPLAY_IDENTIFIER LV_CS_CHG_2 ECU_ADDRESS 0x7fce33 /end MEASUREMENT
/begin CHARACTERISTIC c_vs_cs_plaus_2_diag "" VALUE 0x85ce31 _REC_VAL_20_u1 255. _CNV_A_R_LINEAR_____34_CM 0. 255. DISPLAY_IDENTIFIER C_VS_CS_PLAUS_2_DIAG FORMAT "%3.0" /end CHARACTERISTIC
/begin CHARACTERISTIC c_ctr_max_cs_plaus_1 "" VALUE 0x85c964 _REC_VAL_20_u1 254. _CNV_A_R_LINEAR_____0_CM 0. 254. DISPLAY_IDENTIFIER C_CTR_MAX_CS_PLAUS_1 FORMAT "%3.0" /end CHARACTERISTIC
/begin CHARACTERISTIC c_ctr_max_cs_plaus_2 "" VALUE 0x85c965 _REC_VAL_20_u1 254. _CNV_A_R_LINEAR_____0_CM 0. 254. DISPLAY_IDENTIFIER C_CTR_MAX_CS_PLAUS_2 FORMAT "%3.0" /end CHARACTERISTIC
/begin CHARACTERISTIC lc_act_plaus_1_diag "" VALUE 0x85ce49 _REC_VAL_20_u1 1. _CNV_A_R_LINEAR_____0_CM 0. 1. DISPLAY_IDENTIFIER LC_ACT_PLAUS_1_DIAG FORMAT "%1.0" /end CHARACTERISTIC
/begin CHARACTERISTIC c_vs_cs_plaus_1_diag "" VALUE 0x85ce30 _REC_VAL_20_u1 255. _CNV_A_R_LINEAR_____34_CM 0. 255. DISPLAY_IDENTIFIER C_VS_CS_PLAUS_1_DIAG FORMAT "%3.0" /end CHARACTERISTIC
/begin CHARACTERISTIC c_abc_inc_bls "" VALUE 0x84fa6f _REC_VAL_20_u1 255. _CNV_A_R_LINEAR_____0_CM 0. 255. DISPLAY_IDENTIFIER C_ABC_INC_BLS FORMAT "%3.0" /end CHARACTERISTIC
/begin CHARACTERISTIC c_abc_max_bls "" VALUE 0x84fafb _REC_VAL_20_u1 255. _CNV_A_R_LINEAR_____0_CM 0. 255. DISPLAY_IDENTIFIER C_ABC_MAX_BLS FORMAT "%3.0" /end CHARACTERISTIC
/begin CHARACTERISTIC c_abc_inc_bls_bts_dece "" VALUE 0x84fa70 _REC_VAL_20_u1 255. _CNV_A_R_LINEAR_____0_CM 0. 255. DISPLAY_IDENTIFIER C_ABC_INC_BLS_BTS_DECE FORMAT "%3.0" /end CHARACTERISTIC
/begin CHARACTERISTIC c_abc_max_bls_bts_dece "" VALUE 0x84fafc _REC_VAL_20_u1 255. _CNV_A_R_LINEAR_____0_CM 0. 255. DISPLAY_IDENTIFIER C_ABC_MAX_BLS_BTS_DECE FORMAT "%3.0" /end CHARACTERISTIC
/begin CHARACTERISTIC c_abc_inc_bls_bts_plaus "" VALUE 0x84fa71 _REC_VAL_20_u1 255. _CNV_A_R_LINEAR_____0_CM 0. 255. DISPLAY_IDENTIFIER C_ABC_INC_BLS_BTS_PLAUS FORMAT "%3.0" /end CHARACTERISTIC
/begin CHARACTERISTIC c_abc_max_bls_bts_plaus "" VALUE 0x84fafd _REC_VAL_20_u1 255. _CNV_A_R_LINEAR_____0_CM 0. 255. DISPLAY_IDENTIFIER C_ABC_MAX_BLS_BTS_PLAUS FORMAT "%3.0" /end CHARACTERISTIC
/begin MEASUREMENT lv_err_bls_bts "" UBYTE _CNV_S_2_RANGE______23_CM 1 0. 0. 1. DISPLAY_IDENTIFIER LV_ERR_BLS_BTS ECU_ADDRESS 0x7fb83b /end MEASUREMENT
/begin MEASUREMENT t_bls_bts_plaus "" UWORD _CNV_A_R_LINEAR_____56_CM 1 0. 0. 655.35 DISPLAY_IDENTIFIER T_BLS_BTS_PLAUS ECU_ADDRESS 0x7fa652 BYTE_ORDER MSB_LAST FORMAT "%5.2" /end MEASUREMENT
/begin CHARACTERISTIC c_vs_ac_bls_bts_diag "" VALUE 0x85ce2e _REC_VAL_20_u1 20.31 _CNV_A_R_LINEAR_____72_CM -14. 6.31 DISPLAY_IDENTIFIER C_VS_AC_BLS_BTS_DIAG FORMAT "%3.2" /end CHARACTERISTIC
/begin CHARACTERISTIC c_dri_bls_bts_diag "" VALUE 0x85c982 _REC_VAL_20_u1 6. _CNV_A_R_LINEAR_____0_CM 0. 6. DISPLAY_IDENTIFIER C_DRI_BLS_BTS_DIAG FORMAT "%1.0" /end CHARACTERISTIC
/begin CHARACTERISTIC lc_bls_bts_plaus_conf "" VALUE 0x85ce4c _REC_VAL_20_u1 1. _CNV_A_R_LINEAR_____0_CM 0. 1. DISPLAY_IDENTIFIER LC_BLS_BTS_PLAUS_CONF FORMAT "%1.0" /end CHARACTERISTIC
/begin CHARACTERISTIC c_t_max_1_bls_bts_plaus "" VALUE 0x85cc58 _REC_VAL_20_u2 655.35 _CNV_A_R_LINEAR_____56_CM 0. 655.35 DISPLAY_IDENTIFIER C_T_MAX_1_BLS_BTS_PLAUS FORMAT "%5.2" /end CHARACTERISTIC
/begin CHARACTERISTIC c_t_max_2_bls_bts_plaus "" VALUE 0x85cc5a _REC_VAL_20_u2 655.35 _CNV_A_R_LINEAR_____56_CM 0. 655.35 DISPLAY_IDENTIFIER C_T_MAX_2_BLS_BTS_PLAUS FORMAT "%5.2" /end CHARACTERISTIC
/begin MEASUREMENT lv_err_can_boff "Fehler CAN_BOFF entprellt" UBYTE _CNV_S_2_RANGE__0___85_CM 1 0. 0. 1. DISPLAY_IDENTIFIER LV_ERR_CAN_BOFF ECU_ADDRESS 0x7fb8f6 BIT_MASK 0x1 /end MEASUREMENT
/begin MEASUREMENT lv_err_can_tcs "Fehler CAN_TCS entprellt" UBYTE _CNV_S_2_RANGE__0___85_CM 1 0. 0. 1. DISPLAY_IDENTIFIER LV_ERR_CAN_TCS ECU_ADDRESS 0x7fb8ef BIT_MASK 0x1 /end MEASUREMENT
/begin MEASUREMENT lv_ack_tcs "logische Variable fuer unplausible TCS-Botschaft" UBYTE _CNV_S_2_RANGE__0___85_CM 1 0. 0. 1. DISPLAY_IDENTIFIER LV_ACK_TCS ECU_ADDRESS 0x7fb773 BIT_MASK 0x1 /end MEASUREMENT
/begin MEASUREMENT lv_err_can_smls "Fehler CAN_SMLS entprellt" UBYTE _CNV_S_2_RANGE__0___85_CM 1 0. 0. 1. DISPLAY_IDENTIFIER LV_ERR_CAN_SMLS ECU_ADDRESS 0x7fb8f5 BIT_MASK 0x1 /end MEASUREMENT
/begin CHARACTERISTIC c_abc_inc_can_boff "Inkrement Entprellzaehler" VALUE 0x84fa77 _REC_VAL_20_u1 255. _CNV_A_R_LINEAR_____1_CM 0. 255. DISPLAY_IDENTIFIER C_ABC_INC_CAN_BOFF FORMAT "%3.0" /end CHARACTERISTIC
/begin MEASUREMENT lv_err_can_if_cft "Fehler CAN_IF_CFT entprellt" UBYTE _CNV_S_2_RANGE__0___85_CM 1 0. 0. 1. DISPLAY_IDENTIFIER LV_ERR_CAN_IF_CFT ECU_ADDRESS 0x7fb8f7 BIT_MASK 0x1 /end MEASUREMENT
/begin CHARACTERISTIC c_abc_max_can_boff "Maximum Entprellzaehler" VALUE 0x84fb03 _REC_VAL_20_u1 254. _CNV_A_R_LINEAR_____1_CM 1. 255. DISPLAY_IDENTIFIER C_ABC_MAX_CAN_BOFF FORMAT "%3.0" /end CHARACTERISTIC
/begin CHARACTERISTIC c_abc_inc_can_tcs "Inkrement Entprellzaehler" VALUE 0x84fa82 _REC_VAL_20_u1 255. _CNV_A_R_LINEAR_____1_CM 0. 255. DISPLAY_IDENTIFIER C_ABC_INC_CAN_TCS FORMAT "%3.0" /end CHARACTERISTIC
/begin CHARACTERISTIC c_abc_inc_can_tcu "Inkrement Entprellzaehler" VALUE 0x84fa83 _REC_VAL_20_u1 255. _CNV_A_R_LINEAR_____1_CM 0. 255. DISPLAY_IDENTIFIER C_ABC_INC_CAN_TCU FORMAT "%3.0" /end CHARACTERISTIC
/begin CHARACTERISTIC c_abc_max_can_tcu "Maximum Entprellzaehler" VALUE 0x84fb0f _REC_VAL_20_u1 254. _CNV_A_R_LINEAR_____1_CM 1. 255. DISPLAY_IDENTIFIER C_ABC_MAX_CAN_TCU FORMAT "%3.0" /end CHARACTERISTIC
/begin CHARACTERISTIC c_abc_max_can_ccu "Maximum Entprellzaehler" VALUE 0x84fb04 _REC_VAL_20_u1 254. _CNV_A_R_LINEAR_____1_CM 1. 255. DISPLAY_IDENTIFIER C_ABC_MAX_CAN_CCU FORMAT "%3.0" /end CHARACTERISTIC
/begin CHARACTERISTIC c_abc_inc_can_icl "Inkrement Entprellzaehler" VALUE 0x84fa7b _REC_VAL_20_u1 255. _CNV_A_R_LINEAR_____1_CM 0. 255. DISPLAY_IDENTIFIER C_ABC_INC_CAN_ICL FORMAT "%3.0" /end CHARACTERISTIC
/begin CHARACTERISTIC c_abc_max_can_icl "Maximum Entprellzaehler" VALUE 0x84fb07 _REC_VAL_20_u1 254. _CNV_A_R_LINEAR_____1_CM 1. 255. DISPLAY_IDENTIFIER C_ABC_MAX_CAN_ICL FORMAT "%3.0" /end CHARACTERISTIC
/begin CHARACTERISTIC c_abc_inc_can_vecu "Inkrement Entprellzaehler" VALUE 0x84fa85 _REC_VAL_20_u1 255. _CNV_A_R_LINEAR_____1_CM 0. 255. DISPLAY_IDENTIFIER C_ABC_INC_CAN_VECU FORMAT "%3.0" /end CHARACTERISTIC
/begin CHARACTERISTIC c_abc_max_can_vecu "Maximum Entprellzaehler" VALUE 0x84fb11 _REC_VAL_20_u1 254. _CNV_A_R_LINEAR_____1_CM 1. 255. DISPLAY_IDENTIFIER C_ABC_MAX_CAN_VECU FORMAT "%3.0" /end CHARACTERISTIC
/begin CHARACTERISTIC c_abc_inc_can_smls "Inkrement Entprellzaehler" VALUE 0x84fa80 _REC_VAL_20_u1 255. _CNV_A_R_LINEAR_____1_CM 0. 255. DISPLAY_IDENTIFIER C_ABC_INC_CAN_SMLS FORMAT "%3.0" /end CHARACTERISTIC
/begin CHARACTERISTIC c_abc_max_can_smls "Maximum Entprellzaehler" VALUE 0x84fb0c _REC_VAL_20_u1 254. _CNV_A_R_LINEAR_____1_CM 1. 255. DISPLAY_IDENTIFIER C_ABC_MAX_CAN_SMLS FORMAT "%3.0" /end CHARACTERISTIC
/begin CHARACTERISTIC c_abc_inc_can_bem "Inkrement Entprellzaehler" VALUE 0x84fa76 _REC_VAL_20_u1 255. _CNV_A_R_LINEAR_____1_CM 0. 255. DISPLAY_IDENTIFIER C_ABC_INC_CAN_BEM FORMAT "%3.0" /end CHARACTERISTIC
/begin CHARACTERISTIC c_abc_max_can_bem "Maximum Entprellzaehler" VALUE 0x84fb02 _REC_VAL_20_u1 254. _CNV_A_R_LINEAR_____1_CM 1. 255. DISPLAY_IDENTIFIER C_ABC_MAX_CAN_BEM FORMAT "%3.0" /end CHARACTERISTIC
/begin CHARACTERISTIC c_abc_inc_can_if_cft "Inkrement Entprellzaehler" VALUE 0x84fa7c _REC_VAL_20_u1 255. _CNV_A_R_LINEAR_____1_CM 0. 255. DISPLAY_IDENTIFIER C_ABC_INC_CAN_IF_CFT FORMAT "%3.0" /end CHARACTERISTIC
/begin CHARACTERISTIC c_abc_max_can_if_cft "Maximum Entprellzaehler" VALUE 0x84fb08 _REC_VAL_20_u1 254. _CNV_A_R_LINEAR_____1_CM 1. 255. DISPLAY_IDENTIFIER C_ABC_MAX_CAN_IF_CFT FORMAT "%3.0" /end CHARACTERISTIC
/begin MEASUREMENT tout_ctr_if_cft_1 "" UBYTE _CNV_A_R_LINEAR_____226_CM 1 0. 0. 2.55 DISPLAY_IDENTIFIER TOUT_CTR_IF_CFT_1 ECU_ADDRESS 0x7fb6e5 FORMAT "%4.2" /end MEASUREMENT
/begin MEASUREMENT tout_ctr_icl2 "" UBYTE _CNV_A_R_LINEAR_____226_CM 1 0. 0. 2.55 DISPLAY_IDENTIFIER TOUT_CTR_ICL2 ECU_ADDRESS 0x7fb6e3 FORMAT "%4.2" /end MEASUREMENT
/begin MEASUREMENT tout_ctr_icl3 "" UBYTE _CNV_A_R_LINEAR_____226_CM 1 0. 0. 2.55 DISPLAY_IDENTIFIER TOUT_CTR_ICL3 ECU_ADDRESS 0x7fb6e4 FORMAT "%4.2" /end MEASUREMENT
/begin MEASUREMENT tout_ctr_icl1 "" UBYTE _CNV_A_R_LINEAR_____226_CM 1 0. 0. 2.55 DISPLAY_IDENTIFIER TOUT_CTR_ICL1 ECU_ADDRESS 0x7fb6d8 FORMAT "%4.2" /end MEASUREMENT
/begin MEASUREMENT tout_ctr_tcs2 "" UBYTE _CNV_A_R_LINEAR_____226_CM 1 0. 0. 2.55 DISPLAY_IDENTIFIER TOUT_CTR_TCS2 ECU_ADDRESS 0x7fb6d3 FORMAT "%4.2" /end MEASUREMENT
/begin MEASUREMENT tout_ctr_tcs3 "" UBYTE _CNV_A_R_LINEAR_____226_CM 1 0. 0. 2.55 DISPLAY_IDENTIFIER TOUT_CTR_TCS3 ECU_ADDRESS 0x7fb6d4 FORMAT "%4.2" /end MEASUREMENT
/begin MEASUREMENT tout_ctr_tcs8 "" UBYTE _CNV_A_R_LINEAR_____226_CM 1 0. 0. 2.55 DISPLAY_IDENTIFIER TOUT_CTR_TCS8 ECU_ADDRESS 0x7fb6d5 FORMAT "%4.2" /end MEASUREMENT
/begin MEASUREMENT tout_ctr_tcs1 "" UBYTE _CNV_A_R_LINEAR_____226_CM 1 0. 0. 2.55 DISPLAY_IDENTIFIER TOUT_CTR_TCS1 ECU_ADDRESS 0x7fb6d2 FORMAT "%4.2" /end MEASUREMENT
/begin MEASUREMENT tout_ctr_tcu1 "" UBYTE _CNV_A_R_LINEAR_____226_CM 1 0. 0. 2.55 DISPLAY_IDENTIFIER TOUT_CTR_TCU1 ECU_ADDRESS 0x7fb6d6 FORMAT "%4.2" /end MEASUREMENT
/begin MEASUREMENT tout_ctr_bem "" UBYTE _CNV_A_R_LINEAR_____226_CM 1 0. 0. 2.55 DISPLAY_IDENTIFIER TOUT_CTR_BEM ECU_ADDRESS 0x7fb6d9 FORMAT "%4.2" /end MEASUREMENT
/begin MEASUREMENT tout_ctr_cru "" UBYTE _CNV_A_R_LINEAR_____226_CM 1 0. 0. 2.55 DISPLAY_IDENTIFIER TOUT_CTR_CRU ECU_ADDRESS 0x7fb6db FORMAT "%4.2" /end MEASUREMENT
/begin MEASUREMENT tout_ctr_tcu2 "" UBYTE _CNV_A_R_LINEAR_____226_CM 1 0. 0. 2.55 DISPLAY_IDENTIFIER TOUT_CTR_TCU2 ECU_ADDRESS 0x7fb6d7 FORMAT "%4.2" /end MEASUREMENT
/begin MEASUREMENT tout_ctr_vecu1 "" UBYTE _CNV_A_R_LINEAR_____226_CM 1 0. 0. 2.55 DISPLAY_IDENTIFIER TOUT_CTR_VECU1 ECU_ADDRESS 0x7fb6e6 FORMAT "%4.2" /end MEASUREMENT
/begin MEASUREMENT tout_ctr_tog1 "" UWORD _CNV_A_R_LINEAR_____227_CM 1 0. 0. 655.35 DISPLAY_IDENTIFIER TOUT_CTR_TOG1 ECU_ADDRESS 0x7f97e0 BYTE_ORDER MSB_LAST FORMAT "%6.2" /end MEASUREMENT
/begin MEASUREMENT tout_ctr_acu1 "" UBYTE _CNV_A_R_LINEAR_____226_CM 1 0. 0. 2.55 DISPLAY_IDENTIFIER TOUT_CTR_ACU1 ECU_ADDRESS 0x7fb6da FORMAT "%4.2" /end MEASUREMENT
/begin MEASUREMENT dly_diag_can_10ms "" UBYTE _CNV_A_R_LINEAR_____226_CM 1 0. 0. 2.55 DISPLAY_IDENTIFIER DLY_DIAG_CAN_10MS ECU_ADDRESS 0x7fbd9b FORMAT "%4.2" /end MEASUREMENT
/begin MEASUREMENT max_hld_tcs "Merkwert fuer Timeout-Ueberschreitung ABS" UBYTE _CNV_A_R_LINEAR_____228_CM 1 0. 0. 12750. DISPLAY_IDENTIFIER MAX_HLD_TCS ECU_ADDRESS 0x7fb775 FORMAT "%5.0" /end MEASUREMENT
/begin MEASUREMENT max_hld_tcs_av "Messwert fuer Timeout-Ueberschreitung ABS" UBYTE _CNV_A_R_LINEAR_____228_CM 1 0. 0. 12750. DISPLAY_IDENTIFIER MAX_HLD_TCS_AV ECU_ADDRESS 0x7fb776 FORMAT "%5.0" /end MEASUREMENT
/begin MEASUREMENT max_hld_tcu "Merkwert fuer Timeout-Ueberschreitung Getriebesteuergeraet" UBYTE _CNV_A_R_LINEAR_____228_CM 1 0. 0. 12750. DISPLAY_IDENTIFIER MAX_HLD_TCU ECU_ADDRESS 0x7fb777 FORMAT "%5.0" /end MEASUREMENT
/begin MEASUREMENT max_hld_tcu_av "Messwert fuer Timeout-Ueberschreitung Getriebesteuergeraet" UBYTE _CNV_A_R_LINEAR_____228_CM 1 0. 0. 12750. DISPLAY_IDENTIFIER MAX_HLD_TCU_AV ECU_ADDRESS 0x7fb778 FORMAT "%5.0" /end MEASUREMENT
/begin MEASUREMENT max_hld_acu "Merkwert fuer Timeout-Ueberschreitung Airbag" UBYTE _CNV_A_R_LINEAR_____228_CM 1 0. 0. 12750. DISPLAY_IDENTIFIER MAX_HLD_ACU ECU_ADDRESS 0x7fb779 FORMAT "%5.0" /end MEASUREMENT
/begin MEASUREMENT max_hld_acu_av "Messwert fuer Timeout-Ueberschreitung Airbag" UBYTE _CNV_A_R_LINEAR_____228_CM 1 0. 0. 12750. DISPLAY_IDENTIFIER MAX_HLD_ACU_AV ECU_ADDRESS 0x7fb77a FORMAT "%5.0" /end MEASUREMENT
/begin MEASUREMENT max_hld_ccu_av "Messwert fuer Timeout-Ueberschreitung Klimaanlage" UBYTE _CNV_A_R_LINEAR_____228_CM 1 0. 0. 12750. DISPLAY_IDENTIFIER MAX_HLD_CCU_AV ECU_ADDRESS 0x7fb77c FORMAT "%5.0" /end MEASUREMENT
/begin MEASUREMENT max_hld_icl "Merkwert fuer Timeout-Ueberschreitung Kombi" UBYTE _CNV_A_R_LINEAR_____228_CM 1 0. 0. 12750. DISPLAY_IDENTIFIER MAX_HLD_ICL ECU_ADDRESS 0x7fb77d FORMAT "%5.0" /end MEASUREMENT
/begin MEASUREMENT max_hld_icl_av "Messwert fuer Timeout-Ueberschreitung Kombi" UBYTE _CNV_A_R_LINEAR_____228_CM 1 0. 0. 12750. DISPLAY_IDENTIFIER MAX_HLD_ICL_AV ECU_ADDRESS 0x7fb77e FORMAT "%5.0" /end MEASUREMENT
/begin MEASUREMENT max_hld_vecu "Merkwert fuer Timeout-Ueberschreitung Bordnetz" UBYTE _CNV_A_R_LINEAR_____229_CM 1 0. 0. 51000. DISPLAY_IDENTIFIER MAX_HLD_VECU ECU_ADDRESS 0x7fb77f FORMAT "%5.0" /end MEASUREMENT
/begin MEASUREMENT max_hld_vecu_av "Messwert fuer Timeout-Ueberschreitung Bordnetz" UBYTE _CNV_A_R_LINEAR_____229_CM 1 0. 0. 51000. DISPLAY_IDENTIFIER MAX_HLD_VECU_AV ECU_ADDRESS 0x7fb780 FORMAT "%5.0" /end MEASUREMENT
/begin MEASUREMENT max_hld_smls "Merkwert fuer Timeout-Ueberschreitung Lenkstocksaeule" UBYTE _CNV_A_R_LINEAR_____228_CM 1 0. 0. 12750. DISPLAY_IDENTIFIER MAX_HLD_SMLS ECU_ADDRESS 0x7fb781 FORMAT "%5.0" /end MEASUREMENT
/begin MEASUREMENT max_hld_smls_av "Messwert fuer Timeout-Ueberschreitung Lenkstocksaeule" UBYTE _CNV_A_R_LINEAR_____228_CM 1 0. 0. 12750. DISPLAY_IDENTIFIER MAX_HLD_SMLS_AV ECU_ADDRESS 0x7fb782 FORMAT "%5.0" /end MEASUREMENT
/begin MEASUREMENT max_hld_if_cft "Merkwert fuer Timeout-Ueberschreitung Gateway Komfort" UBYTE _CNV_A_R_LINEAR_____229_CM 1 0. 0. 51000. DISPLAY_IDENTIFIER MAX_HLD_IF_CFT ECU_ADDRESS 0x7fb783 FORMAT "%5.0" /end MEASUREMENT
/begin MEASUREMENT max_hld_if_cft_av "Messwert fuer Timeout-Ueberschreitung Gateway Komfort" UBYTE _CNV_A_R_LINEAR_____229_CM 1 0. 0. 51000. DISPLAY_IDENTIFIER MAX_HLD_IF_CFT_AV ECU_ADDRESS 0x7fb784 FORMAT "%5.0" /end MEASUREMENT
/begin CHARACTERISTIC c_abc_inc_can_acu "Inkrement Entprellzaehler" VALUE 0x84fa75 _REC_VAL_20_u1 255. _CNV_A_R_LINEAR_____1_CM 0. 255. DISPLAY_IDENTIFIER C_ABC_INC_CAN_ACU FORMAT "%3.0" /end CHARACTERISTIC
/begin CHARACTERISTIC c_abc_max_can_tcs "Maximum Entprellzaehler" VALUE 0x84fb0e _REC_VAL_20_u1 254. _CNV_A_R_LINEAR_____1_CM 1. 255. DISPLAY_IDENTIFIER C_ABC_MAX_CAN_TCS FORMAT "%3.0" /end CHARACTERISTIC
/begin MEASUREMENT lv_err_can_acu_all "" UBYTE _CNV_S_2_RANGE__0___85_CM 1 0. 0. 1. DISPLAY_IDENTIFIER LV_ERR_CAN_ACU_ALL ECU_ADDRESS 0x7fbda1 BIT_MASK 0x1 /end MEASUREMENT
/begin MEASUREMENT lv_err_can_ccu_all "" UBYTE _CNV_S_2_RANGE__0___85_CM 1 0. 0. 1. DISPLAY_IDENTIFIER LV_ERR_CAN_CCU_ALL ECU_ADDRESS 0x7fbda2 BIT_MASK 0x1 /end MEASUREMENT
/begin MEASUREMENT lv_err_can_icl_all "" UBYTE _CNV_S_2_RANGE__0___85_CM 1 0. 0. 1. DISPLAY_IDENTIFIER LV_ERR_CAN_ICL_ALL ECU_ADDRESS 0x7fbda3 BIT_MASK 0x1 /end MEASUREMENT
/begin MEASUREMENT lv_err_can_smls_all "" UBYTE _CNV_S_2_RANGE__0___85_CM 1 0. 0. 1. DISPLAY_IDENTIFIER LV_ERR_CAN_SMLS_ALL ECU_ADDRESS 0x7fbda5 BIT_MASK 0x1 /end MEASUREMENT
/begin MEASUREMENT lv_err_can_tcu_all "" UBYTE _CNV_S_2_RANGE__0___85_CM 1 0. 0. 1. DISPLAY_IDENTIFIER LV_ERR_CAN_TCU_ALL ECU_ADDRESS 0x7fbda0 BIT_MASK 0x1 /end MEASUREMENT
/begin MEASUREMENT lv_err_can_if_cft_all "" UBYTE _CNV_S_2_RANGE__0___85_CM 1 0. 0. 1. DISPLAY_IDENTIFIER LV_ERR_CAN_IF_CFT_ALL ECU_ADDRESS 0x7fbda6 BIT_MASK 0x1 /end MEASUREMENT
/begin MEASUREMENT lv_err_can_vecu "Fehler CAN_VECU entprellt" UBYTE _CNV_S_2_RANGE__0___85_CM 1 0. 0. 1. DISPLAY_IDENTIFIER LV_ERR_CAN_VECU ECU_ADDRESS 0x7fb8f4 BIT_MASK 0x1 /end MEASUREMENT
/begin MEASUREMENT lv_err_can_vecu_all "" UBYTE _CNV_S_2_RANGE__0___85_CM 1 0. 0. 1. DISPLAY_IDENTIFIER LV_ERR_CAN_VECU_ALL ECU_ADDRESS 0x7fbda4 BIT_MASK 0x1 /end MEASUREMENT
/begin MEASUREMENT ctr_boff_diag "" UBYTE _CNV_A_R_LINEAR_____1_CM 1 0. 0. 255. DISPLAY_IDENTIFIER CTR_BOFF_DIAG ECU_ADDRESS 0x7fb6dd FORMAT "%3.0" /end MEASUREMENT
/begin MEASUREMENT can_status "" UWORD _CNV_A_R_LINEAR_____230_CM 1 0. 0. 65535. DISPLAY_IDENTIFIER CAN_STATUS ECU_ADDRESS 0x7fa5da BYTE_ORDER MSB_LAST FORMAT "%5.0" /end MEASUREMENT
/begin MEASUREMENT t_can_boff_dly "" UBYTE _CNV_A_R_LINEAR_____226_CM 1 0. 0. 2.55 DISPLAY_IDENTIFIER T_CAN_BOFF_DLY ECU_ADDRESS 0x7fbd68 FORMAT "%4.2" /end MEASUREMENT
/begin MEASUREMENT lv_fmy_can_boff "logische Variable fuer ABS-Bremsung" UBYTE _CNV_S_2_RANGE__0___85_CM 1 0. 0. 1. DISPLAY_IDENTIFIER LV_FMY_CAN_BOFF ECU_ADDRESS 0x7fb6e9 BIT_MASK 0x1 /end MEASUREMENT
/begin MEASUREMENT lv_can_boff_first "logische Variable fuer ABS-Bremsung" UBYTE _CNV_S_2_RANGE__0___85_CM 1 0. 0. 1. DISPLAY_IDENTIFIER LV_CAN_BOFF_FIRST ECU_ADDRESS 0x7fbd6a BIT_MASK 0x1 /end MEASUREMENT
/begin MEASUREMENT lv_can_boff_next "logische Variable fuer ABS-Bremsung" UBYTE _CNV_S_2_RANGE__0___85_CM 1 0. 0. 1. DISPLAY_IDENTIFIER LV_CAN_BOFF_NEXT ECU_ADDRESS 0x7fbd6b BIT_MASK 0x1 /end MEASUREMENT
/begin CHARACTERISTIC c_abc_max_can_tot "Maximum Entprellzaehler" VALUE 0x84fb10 _REC_VAL_20_u1 254. _CNV_A_R_LINEAR_____1_CM 1. 255. DISPLAY_IDENTIFIER C_ABC_MAX_CAN_TOT FORMAT "%3.0" /end CHARACTERISTIC
/begin CHARACTERISTIC c_abc_inc_can_tot "Inkrement Entprellzaehler" VALUE 0x84fa84 _REC_VAL_20_u1 255. _CNV_A_R_LINEAR_____1_CM 0. 255. DISPLAY_IDENTIFIER C_ABC_INC_CAN_TOT FORMAT "%3.0" /end CHARACTERISTIC
/begin MEASUREMENT tmp_can_cod "" UWORD _CNV_A_R_LINEAR_____1_CM 1 0. 0. 65535. DISPLAY_IDENTIFIER TMP_CAN_COD ECU_ADDRESS 0x7fa5ec BYTE_ORDER MSB_LAST FORMAT "%5.0" /end MEASUREMENT
/begin MEASUREMENT tmp_can_diag "" UWORD _CNV_A_R_LINEAR_____1_CM 1 0. 0. 65535. DISPLAY_IDENTIFIER TMP_CAN_DIAG ECU_ADDRESS 0x7fa5ee BYTE_ORDER MSB_LAST FORMAT "%5.0" /end MEASUREMENT
/begin MEASUREMENT lv_err_can_ccu "Fehler CAN_CCU entprellt" UBYTE _CNV_S_2_RANGE__0___85_CM 1 0. 0. 1. DISPLAY_IDENTIFIER LV_ERR_CAN_CCU ECU_ADDRESS 0x7fb8f2 BIT_MASK 0x1 /end MEASUREMENT
/begin MEASUREMENT lv_err_can_tot "Fehler CAN_TOT entprellt" UBYTE _CNV_S_2_RANGE__0___85_CM 1 0. 0. 1. DISPLAY_IDENTIFIER LV_ERR_CAN_TOT ECU_ADDRESS 0x7fb8fd BIT_MASK 0x1 /end MEASUREMENT
/begin MEASUREMENT lv_err_can_acu "Fehler CAN_ACU entprellt" UBYTE _CNV_S_2_RANGE__0___85_CM 1 0. 0. 1. DISPLAY_IDENTIFIER LV_ERR_CAN_ACU ECU_ADDRESS 0x7fb8f1 BIT_MASK 0x1 /end MEASUREMENT
/begin MEASUREMENT lv_err_can_stop "" UBYTE _CNV_S_2_RANGE__0___85_CM 1 0. 0. 1. DISPLAY_IDENTIFIER LV_ERR_CAN_STOP ECU_ADDRESS 0x7fbda9 BIT_MASK 0x1 /end MEASUREMENT
/begin MEASUREMENT lv_err_can_icl "Fehler CAN_ICL entprellt" UBYTE _CNV_S_2_RANGE__0___85_CM 1 0. 0. 1. DISPLAY_IDENTIFIER LV_ERR_CAN_ICL ECU_ADDRESS 0x7fb8f3 BIT_MASK 0x1 /end MEASUREMENT
/begin MEASUREMENT lv_err_can_dcc "Fehler CAN_DCC entprellt" UBYTE _CNV_S_2_RANGE__0___85_CM 1 0. 0. 1. DISPLAY_IDENTIFIER LV_ERR_CAN_DCC ECU_ADDRESS 0x7fb8f9 BIT_MASK 0x1 /end MEASUREMENT
/begin MEASUREMENT lv_err_can_dcc_all "" UBYTE _CNV_S_2_RANGE__0___85_CM 1 0. 0. 1. DISPLAY_IDENTIFIER LV_ERR_CAN_DCC_ALL ECU_ADDRESS 0x7fbda7 BIT_MASK 0x1 /end MEASUREMENT
/begin MEASUREMENT lv_err_can_eilu_all "" UBYTE _CNV_S_2_RANGE__0___85_CM 1 0. 0. 1. DISPLAY_IDENTIFIER LV_ERR_CAN_EILU_ALL ECU_ADDRESS 0x7fbda8 BIT_MASK 0x1 /end MEASUREMENT
/begin MEASUREMENT lv_err_can_eilu "Fehler CAN_EILU entprellt" UBYTE _CNV_S_2_RANGE__0___85_CM 1 0. 0. 1. DISPLAY_IDENTIFIER LV_ERR_CAN_EILU ECU_ADDRESS 0x7fb8f8 BIT_MASK 0x1 /end MEASUREMENT
/begin MEASUREMENT tout_ctr_ccu1 "" UBYTE _CNV_A_R_LINEAR_____226_CM 1 0. 0. 2.55 DISPLAY_IDENTIFIER TOUT_CTR_CCU1 ECU_ADDRESS 0x7fb6dc FORMAT "%4.2" /end MEASUREMENT
/begin MEASUREMENT tout_ctr_eilu1 "" UBYTE _CNV_A_R_LINEAR_____226_CM 1 0. 0. 2.55 DISPLAY_IDENTIFIER TOUT_CTR_EILU1 ECU_ADDRESS 0x7fb6e7 FORMAT "%4.2" /end MEASUREMENT
/begin CHARACTERISTIC c_abc_inc_can_ccu "Inkrement Entprellzaehler" VALUE 0x84fa78 _REC_VAL_20_u1 255. _CNV_A_R_LINEAR_____1_CM 0. 255. DISPLAY_IDENTIFIER C_ABC_INC_CAN_CCU FORMAT "%3.0" /end CHARACTERISTIC
/begin CHARACTERISTIC c_abc_max_can_acu "Maximum Entprellzaehler" VALUE 0x84fb01 _REC_VAL_20_u1 254. _CNV_A_R_LINEAR_____1_CM 1. 255. DISPLAY_IDENTIFIER C_ABC_MAX_CAN_ACU FORMAT "%3.0" /end CHARACTERISTIC
/begin CHARACTERISTIC c_abc_max_can_dcc "Maximum Entprellzaehler" VALUE 0x84fb05 _REC_VAL_20_u1 254. _CNV_A_R_LINEAR_____1_CM 1. 255. DISPLAY_IDENTIFIER C_ABC_MAX_CAN_DCC FORMAT "%3.0" /end CHARACTERISTIC
/begin CHARACTERISTIC c_abc_inc_can_dcc "Inkrement Entprellzaehler" VALUE 0x84fa79 _REC_VAL_20_u1 255. _CNV_A_R_LINEAR_____1_CM 0. 255. DISPLAY_IDENTIFIER C_ABC_INC_CAN_DCC FORMAT "%3.0" /end CHARACTERISTIC
/begin MEASUREMENT max_hld_dcc "" UBYTE _CNV_A_R_LINEAR_____228_CM 1 0. 0. 12750. DISPLAY_IDENTIFIER MAX_HLD_DCC ECU_ADDRESS 0x7fb785 FORMAT "%5.0" /end MEASUREMENT
/begin MEASUREMENT max_hld_dcc_av "" UBYTE _CNV_A_R_LINEAR_____228_CM 1 0. 0. 12750. DISPLAY_IDENTIFIER MAX_HLD_DCC_AV ECU_ADDRESS 0x7fb786 FORMAT "%5.0" /end MEASUREMENT
/begin MEASUREMENT max_hld_eilu "" UBYTE _CNV_A_R_LINEAR_____229_CM 1 0. 0. 51000. DISPLAY_IDENTIFIER MAX_HLD_EILU ECU_ADDRESS 0x7fb787 FORMAT "%5.0" /end MEASUREMENT
/begin MEASUREMENT max_hld_ccu "Merkwert fuer Timeout-Ueberschreitung Klimaanlage" UBYTE _CNV_A_R_LINEAR_____228_CM 1 0. 0. 12750. DISPLAY_IDENTIFIER MAX_HLD_CCU ECU_ADDRESS 0x7fb77b FORMAT "%5.0" /end MEASUREMENT
/begin MEASUREMENT max_hld_eilu_av "" UBYTE _CNV_A_R_LINEAR_____229_CM 1 0. 0. 51000. DISPLAY_IDENTIFIER MAX_HLD_EILU_AV ECU_ADDRESS 0x7fb788 FORMAT "%5.0" /end MEASUREMENT
/begin CHARACTERISTIC c_abc_inc_can_eilu "Inkrement Entprellzaehler" VALUE 0x84fa7a _REC_VAL_20_u1 255. _CNV_A_R_LINEAR_____1_CM 0. 255. DISPLAY_IDENTIFIER C_ABC_INC_CAN_EILU FORMAT "%3.0" /end CHARACTERISTIC
/begin CHARACTERISTIC c_abc_inc_can_pste "Inkrement Entprellzaehler" VALUE 0x84fa7f _REC_VAL_20_u1 255. _CNV_A_R_LINEAR_____1_CM 0. 255. DISPLAY_IDENTIFIER C_ABC_INC_CAN_PSTE FORMAT "%3.0" /end CHARACTERISTIC
/begin CHARACTERISTIC c_abc_max_can_eilu "Maximum Entprellzaehler" VALUE 0x84fb06 _REC_VAL_20_u1 254. _CNV_A_R_LINEAR_____1_CM 1. 255. DISPLAY_IDENTIFIER C_ABC_MAX_CAN_EILU FORMAT "%3.0" /end CHARACTERISTIC
/begin CHARACTERISTIC c_abc_max_can_pste "Maximum Entprellzaehler" VALUE 0x84fb0b _REC_VAL_20_u1 254. _CNV_A_R_LINEAR_____1_CM 1. 255. DISPLAY_IDENTIFIER C_ABC_MAX_CAN_PSTE FORMAT "%3.0" /end CHARACTERISTIC
/begin MEASUREMENT lv_err_can_tcu "Fehler CAN_TCU entprellt" UBYTE _CNV_S_2_RANGE__0___85_CM 1 0. 0. 1. DISPLAY_IDENTIFIER LV_ERR_CAN_TCU ECU_ADDRESS 0x7fb8f0 BIT_MASK 0x1 /end MEASUREMENT
/begin MEASUREMENT lv_err_can_tcs_all "" UBYTE _CNV_S_2_RANGE__0___85_CM 1 0. 0. 1. DISPLAY_IDENTIFIER LV_ERR_CAN_TCS_ALL ECU_ADDRESS 0x7fbd9f BIT_MASK 0x1 /end MEASUREMENT
/begin CHARACTERISTIC lc_ena_can_tot_diag "" VALUE 0x850122 _REC_VAL_20_u1 1. _CNV_A_R_LINEAR_____1_CM 0. 1. DISPLAY_IDENTIFIER LC_ENA_CAN_TOT_DIAG FORMAT "%1.0" /end CHARACTERISTIC
/begin MEASUREMENT lv_err_can_icl_sym_3 "" UBYTE _CNV_S_2_RANGE__0___85_CM 1 0. 0. 1. DISPLAY_IDENTIFIER LV_ERR_CAN_ICL_SYM_3 ECU_ADDRESS 0x7fbdaa BIT_MASK 0x1 /end MEASUREMENT
/begin CHARACTERISTIC c_abc_max_can_sys_info "Maximum Entprellzaehler" VALUE 0x84fb0d _REC_VAL_20_u1 254. _CNV_A_R_LINEAR_____1_CM 1. 255. DISPLAY_IDENTIFIER C_ABC_MAX_CAN_SYS_INFO FORMAT "%3.0" /end CHARACTERISTIC
/begin CHARACTERISTIC c_abc_max_can_whl "Maximum Entprellzaehler" VALUE 0x84fb12 _REC_VAL_20_u1 254. _CNV_A_R_LINEAR_____1_CM 1. 255. DISPLAY_IDENTIFIER C_ABC_MAX_CAN_WHL FORMAT "%3.0" /end CHARACTERISTIC
/begin CHARACTERISTIC c_abc_max_can_nom_sys "Maximum Entprellzaehler" VALUE 0x84fb0a _REC_VAL_20_u1 254. _CNV_A_R_LINEAR_____1_CM 1. 255. DISPLAY_IDENTIFIER C_ABC_MAX_CAN_NOM_SYS FORMAT "%3.0" /end CHARACTERISTIC
/begin CHARACTERISTIC c_abc_inc_can_sys_info "Inkrement Entprellzaehler" VALUE 0x84fa81 _REC_VAL_20_u1 255. _CNV_A_R_LINEAR_____1_CM 0. 255. DISPLAY_IDENTIFIER C_ABC_INC_CAN_SYS_INFO FORMAT "%3.0" /end CHARACTERISTIC
/begin CHARACTERISTIC c_abc_inc_can_whl "Inkrement Entprellzaehler" VALUE 0x84fa86 _REC_VAL_20_u1 255. _CNV_A_R_LINEAR_____1_CM 0. 255. DISPLAY_IDENTIFIER C_ABC_INC_CAN_WHL FORMAT "%3.0" /end CHARACTERISTIC
/begin CHARACTERISTIC c_abc_inc_can_nom_sys "Inkrement Entprellzaehler" VALUE 0x84fa7e _REC_VAL_20_u1 255. _CNV_A_R_LINEAR_____1_CM 0. 255. DISPLAY_IDENTIFIER C_ABC_INC_CAN_NOM_SYS FORMAT "%3.0" /end CHARACTERISTIC
/begin MEASUREMENT lv_err_can_whl "Fehler CAN_WHL entprellt" UBYTE _CNV_S_2_RANGE__0___85_CM 1 0. 0. 1. DISPLAY_IDENTIFIER LV_ERR_CAN_WHL ECU_ADDRESS 0x7fb8fa BIT_MASK 0x1 /end MEASUREMENT
/begin MEASUREMENT tout_ctr_dcc "" UBYTE _CNV_A_R_LINEAR_____226_CM 1 0. 0. 2.55 DISPLAY_IDENTIFIER TOUT_CTR_DCC ECU_ADDRESS 0x7fb6e2 FORMAT "%4.2" /end MEASUREMENT
/begin MEASUREMENT tout_ctr_sys_info "" UBYTE _CNV_A_R_LINEAR_____226_CM 1 0. 0. 2.55 DISPLAY_IDENTIFIER TOUT_CTR_SYS_INFO ECU_ADDRESS 0x7fb6e0 FORMAT "%4.2" /end MEASUREMENT
/begin MEASUREMENT tout_ctr_whl "" UBYTE _CNV_A_R_LINEAR_____226_CM 1 0. 0. 2.55 DISPLAY_IDENTIFIER TOUT_CTR_WHL ECU_ADDRESS 0x7fb6df FORMAT "%4.2" /end MEASUREMENT
/begin MEASUREMENT tout_ctr_nom_sys "" UBYTE _CNV_A_R_LINEAR_____226_CM 1 0. 0. 2.55 DISPLAY_IDENTIFIER TOUT_CTR_NOM_SYS ECU_ADDRESS 0x7fb6e1 FORMAT "%4.2" /end MEASUREMENT
/begin MEASUREMENT lv_err_can_sys_info "Fehler CAN_SYS_INFO entprellt" UBYTE _CNV_S_2_RANGE__0___85_CM 1 0. 0. 1. DISPLAY_IDENTIFIER LV_ERR_CAN_SYS_INFO ECU_ADDRESS 0x7fb8fb BIT_MASK 0x1 /end MEASUREMENT
/begin MEASUREMENT lv_err_can_nom_sys "Fehler CAN_NOM_SYS entprellt" UBYTE _CNV_S_2_RANGE__0___85_CM 1 0. 0. 1. DISPLAY_IDENTIFIER LV_ERR_CAN_NOM_SYS ECU_ADDRESS 0x7fb8fc BIT_MASK 0x1 /end MEASUREMENT
/begin MEASUREMENT max_hld_whl "" UBYTE _CNV_A_R_LINEAR_____228_CM 1 0. 0. 12750. DISPLAY_IDENTIFIER MAX_HLD_WHL ECU_ADDRESS 0x7fb789 FORMAT "%5.0" /end MEASUREMENT
/begin MEASUREMENT max_hld_whl_av "" UBYTE _CNV_A_R_LINEAR_____228_CM 1 0. 0. 12750. DISPLAY_IDENTIFIER MAX_HLD_WHL_AV ECU_ADDRESS 0x7fb78a FORMAT "%5.0" /end MEASUREMENT
/begin MEASUREMENT max_hld_sys_info "" UBYTE _CNV_A_R_LINEAR_____229_CM 1 0. 0. 51000. DISPLAY_IDENTIFIER MAX_HLD_SYS_INFO ECU_ADDRESS 0x7fb78b FORMAT "%5.0" /end MEASUREMENT
/begin MEASUREMENT max_hld_nom_sys "" UBYTE _CNV_A_R_LINEAR_____229_CM 1 0. 0. 51000. DISPLAY_IDENTIFIER MAX_HLD_NOM_SYS ECU_ADDRESS 0x7fb78d FORMAT "%5.0" /end MEASUREMENT
/begin MEASUREMENT max_hld_sys_info_av "" UBYTE _CNV_A_R_LINEAR_____229_CM 1 0. 0. 51000. DISPLAY_IDENTIFIER MAX_HLD_SYS_INFO_AV ECU_ADDRESS 0x7fb78c FORMAT "%5.0" /end MEASUREMENT
/begin MEASUREMENT max_hld_nom_sys_av "" UBYTE _CNV_A_R_LINEAR_____229_CM 1 0. 0. 51000. DISPLAY_IDENTIFIER MAX_HLD_NOM_SYS_AV ECU_ADDRESS 0x7fb78e FORMAT "%5.0" /end MEASUREMENT
/begin CHARACTERISTIC c_acp_mes_max_diag "upper threshold for ACP_MES signal" VALUE 0x85c866 _REC_VAL_20_u1 3100. _CNV_A_R_LINEAR_____209_CM 0. 3100. DISPLAY_IDENTIFIER C_ACP_MES_MAX_DIAG FORMAT "%4.0" /end CHARACTERISTIC
/begin CHARACTERISTIC c_acp_mes_min_diag "lower threshold for ACP_MES signal" VALUE 0x85c867 _REC_VAL_20_u1 3100. _CNV_A_R_LINEAR_____209_CM 0. 3100. DISPLAY_IDENTIFIER C_ACP_MES_MIN_DIAG FORMAT "%4.0" /end CHARACTERISTIC
/begin CHARACTERISTIC c_acp_mes_grd_diag "c_acp_mes_grd_diag" VALUE 0x85c865 _REC_VAL_20_u1 255. _CNV_A_R_LINEAR_____237_CM 0. 255. DISPLAY_IDENTIFIER C_ACP_MES_GRD_DIAG FORMAT "%3.0" /end CHARACTERISTIC
/begin MEASUREMENT cool_req_ecf_1 "cooling request for electrical cooling fan 1" UBYTE _CNV_A_R_LINEAR_____79_CM 1 0. 0. 99.609375 DISPLAY_IDENTIFIER COOL_REQ_ECF_1 ECU_ADDRESS 0x7fbc09 FORMAT "%4.1" /end MEASUREMENT
/begin MEASUREMENT cool_req_ecf_2 "cooling request for electrical cooling fan 2" UBYTE _CNV_A_R_LINEAR_____79_CM 1 0. 0. 99.609375 DISPLAY_IDENTIFIER COOL_REQ_ECF_2 ECU_ADDRESS 0x7fbc0a FORMAT "%4.1" /end MEASUREMENT
/begin MEASUREMENT cool_req_tot_inter "Intermediate value" UBYTE _CNV_A_R_LINEAR_____79_CM 1 0. 0. 99.609375 DISPLAY_IDENTIFIER COOL_REQ_TOT_INTER ECU_ADDRESS 0x7fbff0 FORMAT "%4.1" /end MEASUREMENT
/begin MEASUREMENT cool_req_tcu "cooling request of transmission control unit" UBYTE _CNV_A_R_LINEAR_____79_CM 1 0. 0. 99.609375 DISPLAY_IDENTIFIER COOL_REQ_TCU ECU_ADDRESS 0x7fbc0b FORMAT "%4.1" /end MEASUREMENT
/begin MEASUREMENT cool_req_tot_inter_save "Saved value for support function for DIACPS" UBYTE _CNV_A_R_LINEAR_____79_CM 1 0. 0. 99.609375 DISPLAY_IDENTIFIER COOL_REQ_TOT_INTER_SAVE ECU_ADDRESS 0x7fbff1 FORMAT "%4.1" /end MEASUREMENT
/begin MEASUREMENT lv_cool_req_save_diagcps "Support function for DIACPS for ECF active" UBYTE _CNV_S_2_RANGE__0___85_CM 1 0. 0. 1. DISPLAY_IDENTIFIER LV_COOL_REQ_SAVE_DIAGCPS ECU_ADDRESS 0x7fc00a BIT_MASK 0x1 /end MEASUREMENT
/begin MEASUREMENT cool_req_ecf_clc "Cooling request for electrical cooling fan 1 after support function for DIACPS" UBYTE _CNV_A_R_LINEAR_____79_CM 1 0. 0. 99.609375 DISPLAY_IDENTIFIER COOL_REQ_ECF_CLC ECU_ADDRESS 0x7fbff2 FORMAT "%4.1" /end MEASUREMENT
/begin MEASUREMENT cool_req_ac_save "saved value for support function for DIACPS" UBYTE _CNV_A_R_LINEAR_____79_CM 1 0. 0. 99.609375 DISPLAY_IDENTIFIER COOL_REQ_AC_SAVE ECU_ADDRESS 0x7fbff3 FORMAT "%4.1" /end MEASUREMENT
/begin CHARACTERISTIC lc_cool_req_save_diagcps_ena "Activation switch for CPSDIAG support function" VALUE 0x850111 _REC_VAL_20_u1 1. _CNV_A_R_LINEAR_____1_CM 0. 1. DISPLAY_IDENTIFIER LC_COOL_REQ_SAVE_DIAGCPS_ENA FORMAT "%1.0" /end CHARACTERISTIC
/begin CHARACTERISTIC c_tco_max_cool_req_save_diagcps "maximum TCO threshold for activation of CPSDIAG support function" VALUE 0x850018 _REC_VAL_20_u1 190.5 _CNV_A_R_LINEAR_____241_CM -48. 142.5 DISPLAY_IDENTIFIER C_TCO_MAX_COOL_REQ_SAVE_DIAGCPS FORMAT "%5.1" /end CHARACTERISTIC
/begin CHARACTERISTIC c_cool_req_ac_save_ofs "offset on COOL_REQ_AC for activation of CPSDIAG support function" VALUE 0x84fbf0 _REC_VAL_20_u1 99.609375 _CNV_A_R_LINEAR_____79_CM 0. 99.609375 DISPLAY_IDENTIFIER C_COOL_REQ_AC_SAVE_OFS FORMAT "%4.1" /end CHARACTERISTIC
/begin CHARACTERISTIC c_cool_req_ecf_1_lgrd "limitation gradient for COOL_REQ_ECF_1" VALUE 0x84fbf1 _REC_VAL_20_u1 99.609375 _CNV_A_R_LINEAR_____242_CM 0. 99.609375 DISPLAY_IDENTIFIER C_COOL_REQ_ECF_1_LGRD FORMAT "%4.1" /end CHARACTERISTIC
/begin CHARACTERISTIC c_cool_req_ecf_2_lgrd "limitation gradient for COOL_REQ_ECF_2" VALUE 0x84fbf2 _REC_VAL_20_u1 99.609375 _CNV_A_R_LINEAR_____242_CM 0. 99.609375 DISPLAY_IDENTIFIER C_COOL_REQ_ECF_2_LGRD FORMAT "%4.1" /end CHARACTERISTIC
/begin AXIS_PTS ldp_cool_req_tcu_can__cool_req "" 0x843f9e cool_req_tcu_can _REC_AXS_20_u1 3. _CNV_A_R_LINEAR_____0_CM 4 0. 3. FORMAT "%1.0" /end AXIS_PTS
/begin CHARACTERISTIC ip_cool_req_tcu "cooling request of TCU" CURVE 0x8450c6 _REC_CUR_20_u1_u1 99.609375 _CNV_A_R_LINEAR_____79_CM 0. 99.609375 DISPLAY_IDENTIFIER IP_COOL_REQ_TCU FORMAT "%4.1"
 /begin AXIS_DESCR COM_AXIS cool_req_tcu_can _CNV_A_R_LINEAR_____0_CM 4 0. 3. FORMAT "%1.0" AXIS_PTS_REF ldp_cool_req_tcu_can__cool_req /end AXIS_DESCR
/end CHARACTERISTIC
/begin MEASUREMENT n_sp_ecf_1 "" UBYTE _CNV_A_R_LINEAR_____243_CM 1 0. 0. 4080. DISPLAY_IDENTIFIER N_SP_ECF_1 ECU_ADDRESS 0x7fbc0c FORMAT "%4.0" /end MEASUREMENT
/begin MEASUREMENT n_sp_ecf_2 "" UBYTE _CNV_A_R_LINEAR_____243_CM 1 0. 0. 4080. DISPLAY_IDENTIFIER N_SP_ECF_2 ECU_ADDRESS 0x7fbc0d FORMAT "%4.0" /end MEASUREMENT
/begin MEASUREMENT lv_n_sp_ecf_1_hys "activation hysteresis for ECF_1 active" UBYTE _CNV_S_2_RANGE__0___85_CM 1 0. 0. 1. DISPLAY_IDENTIFIER LV_N_SP_ECF_1_HYS ECU_ADDRESS 0x7fc00b BIT_MASK 0x1 /end MEASUREMENT
/begin MEASUREMENT lv_n_sp_ecf_2_hys "activation hysteresis for ECF_2 active" UBYTE _CNV_S_2_RANGE__0___85_CM 1 0. 0. 1. DISPLAY_IDENTIFIER LV_N_SP_ECF_2_HYS ECU_ADDRESS 0x7fc00c BIT_MASK 0x1 /end MEASUREMENT
/begin MEASUREMENT n_sp_ecf_1_raw "raw ECF_1 speed setpoint" UBYTE _CNV_A_R_LINEAR_____243_CM 1 0. 0. 4080. DISPLAY_IDENTIFIER N_SP_ECF_1_RAW ECU_ADDRESS 0x7fbff5 FORMAT "%4.0" /end MEASUREMENT
/begin MEASUREMENT n_sp_ecf_2_raw "raw ECF_2 speed setpoint" UBYTE _CNV_A_R_LINEAR_____243_CM 1 0. 0. 4080. DISPLAY_IDENTIFIER N_SP_ECF_2_RAW ECU_ADDRESS 0x7fbff6 FORMAT "%4.0" /end MEASUREMENT
/begin MEASUREMENT n_sp_ecf_1_inter_1 "Raw ECF_1 speed setpoint after air density correction" UBYTE _CNV_A_R_LINEAR_____243_CM 1 0. 0. 4080. DISPLAY_IDENTIFIER N_SP_ECF_1_INTER_1 ECU_ADDRESS 0x7fbff7 FORMAT "%4.0" /end MEASUREMENT
/begin MEASUREMENT n_sp_ecf_2_inter_1 "Raw ECF_2 speed setpoint after air density correction" UBYTE _CNV_A_R_LINEAR_____243_CM 1 0. 0. 4080. DISPLAY_IDENTIFIER N_SP_ECF_2_INTER_1 ECU_ADDRESS 0x7fbff8 FORMAT "%4.0" /end MEASUREMENT
/begin MEASUREMENT n_sp_ecf_1_inter_2 "raw ECF_1 speed setpoint before fade out ECF speed areas" UBYTE _CNV_A_R_LINEAR_____243_CM 1 0. 0. 4080. DISPLAY_IDENTIFIER N_SP_ECF_1_INTER_2 ECU_ADDRESS 0x7fbff9 FORMAT "%4.0" /end MEASUREMENT
/begin MEASUREMENT n_sp_ecf_2_inter_2 "raw ECF_2 speed setpoint before fade out ECF speed areas" UBYTE _CNV_A_R_LINEAR_____243_CM 1 0. 0. 4080. DISPLAY_IDENTIFIER N_SP_ECF_2_INTER_2 ECU_ADDRESS 0x7fbffa FORMAT "%4.0" /end MEASUREMENT
/begin MEASUREMENT lv_n_sp_ecf_1_fout "raw ECF_1 speed setpoint within fade out area" UBYTE _CNV_S_2_RANGE__0___85_CM 1 0. 0. 1. DISPLAY_IDENTIFIER LV_N_SP_ECF_1_FOUT ECU_ADDRESS 0x7fc00d BIT_MASK 0x1 /end MEASUREMENT
/begin MEASUREMENT lv_n_sp_ecf_2_fout "raw ECF_2 speed setpoint within fade out area" UBYTE _CNV_S_2_RANGE__0___85_CM 1 0. 0. 1. DISPLAY_IDENTIFIER LV_N_SP_ECF_2_FOUT ECU_ADDRESS 0x7fc00e BIT_MASK 0x1 /end MEASUREMENT
/begin MEASUREMENT fac_n_sp_ecf_1 "Air density correction for N_SP_ECF_1" UBYTE _CNV_A_R_LINEAR_____244_CM 1 0. 0. 3.984375 DISPLAY_IDENTIFIER FAC_N_SP_ECF_1 ECU_ADDRESS 0x7fbffb FORMAT "%4.2" /end MEASUREMENT
/begin MEASUREMENT fac_n_sp_ecf_2 "Air density correction for N_SP_ECF_2" UBYTE _CNV_A_R_LINEAR_____244_CM 1 0. 0. 3.984375 DISPLAY_IDENTIFIER FAC_N_SP_ECF_2 ECU_ADDRESS 0x7fbffc FORMAT "%4.2" /end MEASUREMENT
/begin CHARACTERISTIC c_n_sp_ecf_1_min_tol "top level for activation hysteresis for ECF_1" VALUE 0x84fe0c _REC_VAL_20_u1 4080. _CNV_A_R_LINEAR_____243_CM 0. 4080. DISPLAY_IDENTIFIER C_N_SP_ECF_1_MIN_TOL FORMAT "%4.0" /end CHARACTERISTIC
/begin CHARACTERISTIC c_n_sp_ecf_1_min_bol "bottom level for activation hysteresis for ECF_1" VALUE 0x84fe0b _REC_VAL_20_u1 4080. _CNV_A_R_LINEAR_____243_CM 0. 4080. DISPLAY_IDENTIFIER C_N_SP_ECF_1_MIN_BOL FORMAT "%4.0" /end CHARACTERISTIC
/begin CHARACTERISTIC c_n_sp_ecf_2_min_tol "top level for activation hysteresis for ECF_2" VALUE 0x84fe19 _REC_VAL_20_u1 4080. _CNV_A_R_LINEAR_____243_CM 0. 4080. DISPLAY_IDENTIFIER C_N_SP_ECF_2_MIN_TOL FORMAT "%4.0" /end CHARACTERISTIC
/begin CHARACTERISTIC c_n_sp_ecf_2_min_bol "bottom level for activation hysteresis for ECF_2" VALUE 0x84fe18 _REC_VAL_20_u1 4080. _CNV_A_R_LINEAR_____243_CM 0. 4080. DISPLAY_IDENTIFIER C_N_SP_ECF_2_MIN_BOL FORMAT "%4.0" /end CHARACTERISTIC
/begin CHARACTERISTIC c_n_sp_ecf_1_min "absolute minimum ECF_1 speed" VALUE 0x84fe0a _REC_VAL_20_u1 4080. _CNV_A_R_LINEAR_____243_CM 0. 4080. DISPLAY_IDENTIFIER C_N_SP_ECF_1_MIN FORMAT "%4.0" /end CHARACTERISTIC
/begin CHARACTERISTIC c_n_sp_ecf_2_min "absolute minimum ECF_2 speed" VALUE 0x84fe17 _REC_VAL_20_u1 4080. _CNV_A_R_LINEAR_____243_CM 0. 4080. DISPLAY_IDENTIFIER C_N_SP_ECF_2_MIN FORMAT "%4.0" /end CHARACTERISTIC
/begin CHARACTERISTIC c_n_sp_ecf_1_fout_1_bol "bottom limit for ECF_1 fade out area 1" VALUE 0x84fe00 _REC_VAL_20_u1 4080. _CNV_A_R_LINEAR_____243_CM 0. 4080. DISPLAY_IDENTIFIER C_N_SP_ECF_1_FOUT_1_BOL FORMAT "%4.0" /end CHARACTERISTIC
/begin CHARACTERISTIC c_n_sp_ecf_1_fout_1_tol "top limit for ECF_1 fade out area 1" VALUE 0x84fe01 _REC_VAL_20_u1 4080. _CNV_A_R_LINEAR_____243_CM 0. 4080. DISPLAY_IDENTIFIER C_N_SP_ECF_1_FOUT_1_TOL FORMAT "%4.0" /end CHARACTERISTIC
/begin CHARACTERISTIC c_n_sp_ecf_1_fout_2_bol "bottom limit for ECF_1 fade out area 2" VALUE 0x84fe02 _REC_VAL_20_u1 4080. _CNV_A_R_LINEAR_____243_CM 0. 4080. DISPLAY_IDENTIFIER C_N_SP_ECF_1_FOUT_2_BOL FORMAT "%4.0" /end CHARACTERISTIC
/begin CHARACTERISTIC c_n_sp_ecf_1_fout_2_tol "top limit for ECF_1 fade out area 2" VALUE 0x84fe03 _REC_VAL_20_u1 4080. _CNV_A_R_LINEAR_____243_CM 0. 4080. DISPLAY_IDENTIFIER C_N_SP_ECF_1_FOUT_2_TOL FORMAT "%4.0" /end CHARACTERISTIC
/begin CHARACTERISTIC c_n_sp_ecf_1_fout_3_bol "bottom limit for ECF_1 fade out area 3" VALUE 0x84fe04 _REC_VAL_20_u1 4080. _CNV_A_R_LINEAR_____243_CM 0. 4080. DISPLAY_IDENTIFIER C_N_SP_ECF_1_FOUT_3_BOL FORMAT "%4.0" /end CHARACTERISTIC
/begin CHARACTERISTIC c_n_sp_ecf_1_fout_3_tol "top limit for ECF_1 fade out area 3" VALUE 0x84fe05 _REC_VAL_20_u1 4080. _CNV_A_R_LINEAR_____243_CM 0. 4080. DISPLAY_IDENTIFIER C_N_SP_ECF_1_FOUT_3_TOL FORMAT "%4.0" /end CHARACTERISTIC
/begin CHARACTERISTIC c_n_sp_ecf_1_fout_4_bol "bottom limit for ECF_1 fade out area 4" VALUE 0x84fe06 _REC_VAL_20_u1 4080. _CNV_A_R_LINEAR_____243_CM 0. 4080. DISPLAY_IDENTIFIER C_N_SP_ECF_1_FOUT_4_BOL FORMAT "%4.0" /end CHARACTERISTIC
/begin CHARACTERISTIC c_n_sp_ecf_1_fout_4_tol "top limit for ECF_1 fade out area 4" VALUE 0x84fe07 _REC_VAL_20_u1 4080. _CNV_A_R_LINEAR_____243_CM 0. 4080. DISPLAY_IDENTIFIER C_N_SP_ECF_1_FOUT_4_TOL FORMAT "%4.0" /end CHARACTERISTIC
/begin CHARACTERISTIC c_n_sp_ecf_1_fout_5_bol "bottom limit for ECF_1 fade out area 5" VALUE 0x84fe08 _REC_VAL_20_u1 4080. _CNV_A_R_LINEAR_____243_CM 0. 4080. DISPLAY_IDENTIFIER C_N_SP_ECF_1_FOUT_5_BOL FORMAT "%4.0" /end CHARACTERISTIC
/begin CHARACTERISTIC c_n_sp_ecf_1_fout_5_tol "top limit for ECF_1 fade out area 5" VALUE 0x84fe09 _REC_VAL_20_u1 4080. _CNV_A_R_LINEAR_____243_CM 0. 4080. DISPLAY_IDENTIFIER C_N_SP_ECF_1_FOUT_5_TOL FORMAT "%4.0" /end CHARACTERISTIC
/begin CHARACTERISTIC c_n_sp_ecf_2_fout_1_bol "bottom limit for ECF_2 fade out area 1" VALUE 0x84fe0d _REC_VAL_20_u1 4080. _CNV_A_R_LINEAR_____243_CM 0. 4080. DISPLAY_IDENTIFIER C_N_SP_ECF_2_FOUT_1_BOL FORMAT "%4.0" /end CHARACTERISTIC
/begin CHARACTERISTIC c_n_sp_ecf_2_fout_1_tol "top limit for ECF_2 fade out area 1" VALUE 0x84fe0e _REC_VAL_20_u1 4080. _CNV_A_R_LINEAR_____243_CM 0. 4080. DISPLAY_IDENTIFIER C_N_SP_ECF_2_FOUT_1_TOL FORMAT "%4.0" /end CHARACTERISTIC
/begin CHARACTERISTIC c_n_sp_ecf_2_fout_2_bol "bottom limit for ECF_2 fade out area 2" VALUE 0x84fe0f _REC_VAL_20_u1 4080. _CNV_A_R_LINEAR_____243_CM 0. 4080. DISPLAY_IDENTIFIER C_N_SP_ECF_2_FOUT_2_BOL FORMAT "%4.0" /end CHARACTERISTIC
/begin CHARACTERISTIC c_n_sp_ecf_2_fout_2_tol "top limit for ECF_2 fade out area 2" VALUE 0x84fe10 _REC_VAL_20_u1 4080. _CNV_A_R_LINEAR_____243_CM 0. 4080. DISPLAY_IDENTIFIER C_N_SP_ECF_2_FOUT_2_TOL FORMAT "%4.0" /end CHARACTERISTIC
/begin CHARACTERISTIC c_n_sp_ecf_2_fout_3_bol "bottom limit for ECF_2 fade out area 3" VALUE 0x84fe11 _REC_VAL_20_u1 4080. _CNV_A_R_LINEAR_____243_CM 0. 4080. DISPLAY_IDENTIFIER C_N_SP_ECF_2_FOUT_3_BOL FORMAT "%4.0" /end CHARACTERISTIC
/begin CHARACTERISTIC c_n_sp_ecf_2_fout_3_tol "top limit for ECF_2 fade out area 3" VALUE 0x84fe12 _REC_VAL_20_u1 4080. _CNV_A_R_LINEAR_____243_CM 0. 4080. DISPLAY_IDENTIFIER C_N_SP_ECF_2_FOUT_3_TOL FORMAT "%4.0" /end CHARACTERISTIC
/begin CHARACTERISTIC c_n_sp_ecf_2_fout_4_bol "bottom limit for ECF_2 fade out area 4" VALUE 0x84fe13 _REC_VAL_20_u1 4080. _CNV_A_R_LINEAR_____243_CM 0. 4080. DISPLAY_IDENTIFIER C_N_SP_ECF_2_FOUT_4_BOL FORMAT "%4.0" /end CHARACTERISTIC
/begin CHARACTERISTIC c_n_sp_ecf_2_fout_4_tol "top limit for ECF_2 fade out area 4" VALUE 0x84fe14 _REC_VAL_20_u1 4080. _CNV_A_R_LINEAR_____243_CM 0. 4080. DISPLAY_IDENTIFIER C_N_SP_ECF_2_FOUT_4_TOL FORMAT "%4.0" /end CHARACTERISTIC
/begin CHARACTERISTIC c_n_sp_ecf_2_fout_5_bol "bottom limit for ECF_2 fade out area 5" VALUE 0x84fe15 _REC_VAL_20_u1 4080. _CNV_A_R_LINEAR_____243_CM 0. 4080. DISPLAY_IDENTIFIER C_N_SP_ECF_2_FOUT_5_BOL FORMAT "%4.0" /end CHARACTERISTIC
/begin CHARACTERISTIC c_n_sp_ecf_2_fout_5_tol "top limit for ECF_2 fade out area 5" VALUE 0x84fe16 _REC_VAL_20_u1 4080. _CNV_A_R_LINEAR_____243_CM 0. 4080. DISPLAY_IDENTIFIER C_N_SP_ECF_2_FOUT_5_TOL FORMAT "%4.0" /end CHARACTERISTIC
/begin CHARACTERISTIC lc_ena_fac_n_sp_ecf_1 "EC-fan ECF_1 built in; 1 = correction needed" VALUE 0x850124 _REC_VAL_20_u1 1. _CNV_A_R_LINEAR_____1_CM 0. 1. DISPLAY_IDENTIFIER LC_ENA_FAC_N_SP_ECF_1 FORMAT "%1.0" /end CHARACTERISTIC
/begin CHARACTERISTIC lc_ena_fac_n_sp_ecf_2 "EC-fan ECF_2 built in; 1 = correction needed" VALUE 0x850125 _REC_VAL_20_u1 1. _CNV_A_R_LINEAR_____1_CM 0. 1. DISPLAY_IDENTIFIER LC_ENA_FAC_N_SP_ECF_2 FORMAT "%1.0" /end CHARACTERISTIC
/begin AXIS_PTS ldp_cool_req_ecf_1 "" 0x843f87 cool_req_ecf_1 _REC_AXS_20_u1 99.609375 _CNV_A_R_LINEAR_____79_CM 6 0. 99.609375 FORMAT "%4.1" /end AXIS_PTS
/begin AXIS_PTS ldp_cool_req_ecf_2 "" 0x843f8e cool_req_ecf_2 _REC_AXS_20_u1 99.609375 _CNV_A_R_LINEAR_____79_CM 6 0. 99.609375 FORMAT "%4.1" /end AXIS_PTS
/begin AXIS_PTS ldpm_n_32__n_sp_ecf "" 0x844407 n_32 _REC_AXS_20_u1 8160. _CNV_A_R_LINEAR_____81_CM 6 0. 8160. FORMAT "%4.0" /end AXIS_PTS
/begin CHARACTERISTIC ip_n_sp_ecf_1 "raw ECF_1 speed setpoint" MAP 0x84d38c _REC_MAP_20_u1_u1_u1 4080. _CNV_A_R_LINEAR_____243_CM 0. 4080. DISPLAY_IDENTIFIER IP_N_SP_ECF_1 FORMAT "%4.0"
 /begin AXIS_DESCR COM_AXIS cool_req_ecf_1 _CNV_A_R_LINEAR_____79_CM 6 0. 99.609375 FORMAT "%4.1" AXIS_PTS_REF ldp_cool_req_ecf_1 /end AXIS_DESCR
 /begin AXIS_DESCR COM_AXIS n_32 _CNV_A_R_LINEAR_____81_CM 6 0. 8160. FORMAT "%4.0" AXIS_PTS_REF ldpm_n_32__n_sp_ecf /end AXIS_DESCR
/end CHARACTERISTIC
/begin CHARACTERISTIC ip_n_sp_ecf_2 "Raw ECF_2 speed setpoint" MAP 0x84d3b0 _REC_MAP_20_u1_u1_u1 4080. _CNV_A_R_LINEAR_____243_CM 0. 4080. DISPLAY_IDENTIFIER IP_N_SP_ECF_2 FORMAT "%4.0"
 /begin AXIS_DESCR COM_AXIS cool_req_ecf_2 _CNV_A_R_LINEAR_____79_CM 6 0. 99.609375 FORMAT "%4.1" AXIS_PTS_REF ldp_cool_req_ecf_2 /end AXIS_DESCR
 /begin AXIS_DESCR COM_AXIS n_32 _CNV_A_R_LINEAR_____81_CM 6 0. 8160. FORMAT "%4.0" AXIS_PTS_REF ldpm_n_32__n_sp_ecf /end AXIS_DESCR
/end CHARACTERISTIC
/begin AXIS_PTS ldp_vs__n_sp_ecf "" 0x84434f vs _REC_AXS_20_u1 255. _CNV_A_R_LINEAR_____245_CM 8 0. 255. FORMAT "%3.0" /end AXIS_PTS
/begin CHARACTERISTIC ip_fac_n_sp_ecf_vs "Factor on N_SP_ECF vs. vehicle speed" CURVE 0x8482ae _REC_CUR_20_u1_u1 1.9921875 _CNV_A_R_LINEAR_____246_CM 0. 1.9921875 DISPLAY_IDENTIFIER IP_FAC_N_SP_ECF_VS FORMAT "%5.3"
 /begin AXIS_DESCR COM_AXIS vs _CNV_A_R_LINEAR_____245_CM 8 0. 255. FORMAT "%3.0" AXIS_PTS_REF ldp_vs__n_sp_ecf /end AXIS_DESCR
/end CHARACTERISTIC
/begin AXIS_PTS ldp_tam__fac_n_sp_ecf "" 0x8441cd tam _REC_AXS_20_u1 190.5 _CNV_A_R_LINEAR_____241_CM 8 -48. 142.5 FORMAT "%5.1" /end AXIS_PTS
/begin AXIS_PTS ldp_amp__fac_n_sp_ecf "" 0x843f64 amp _REC_AXS_20_u2 5434. _CNV_A_R_LINEAR_____247_CM 8 0. 5434. FORMAT "%7.2" /end AXIS_PTS
/begin CHARACTERISTIC ip_fac_n_sp_ecf_amp "Factor on N_SP_ECF vs. TAM and AMP" MAP 0x84826e _REC_MAP_20_u1_u1_u2 2. _CNV_A_R_LINEAR_____244_CM 0. 2. DISPLAY_IDENTIFIER IP_FAC_N_SP_ECF_AMP FORMAT "%4.2"
 /begin AXIS_DESCR COM_AXIS tam _CNV_A_R_LINEAR_____241_CM 8 -48. 142.5 FORMAT "%5.1" AXIS_PTS_REF ldp_tam__fac_n_sp_ecf /end AXIS_DESCR
 /begin AXIS_DESCR COM_AXIS amp _CNV_A_R_LINEAR_____247_CM 8 0. 5434. FORMAT "%7.2" AXIS_PTS_REF ldp_amp__fac_n_sp_ecf /end AXIS_DESCR
/end CHARACTERISTIC
/begin MEASUREMENT ecfpwm_1 "output ECFPWM to drive ECF_1" UBYTE _CNV_A_R_LINEAR_____79_CM 1 0. 5.078125 87.890625 DISPLAY_IDENTIFIER ECFPWM_1 ECU_ADDRESS 0x7fbc0e FORMAT "%4.1" /end MEASUREMENT
/begin MEASUREMENT ecfpwm_2 "output ECFPWM to drive ECF_2" UBYTE _CNV_A_R_LINEAR_____79_CM 1 0. 5.078125 87.890625 DISPLAY_IDENTIFIER ECFPWM_2 ECU_ADDRESS 0x7fbc0f FORMAT "%4.1" /end MEASUREMENT
/begin MEASUREMENT ecfpwm_1_raw "raw value for ECFPWM_1" UBYTE _CNV_A_R_LINEAR_____79_CM 1 0. 5.078125 87.890625 DISPLAY_IDENTIFIER ECFPWM_1_RAW ECU_ADDRESS 0x7fbffd FORMAT "%4.1" /end MEASUREMENT
/begin MEASUREMENT ecfpwm_2_raw "raw value for ECFPWM_2" UBYTE _CNV_A_R_LINEAR_____79_CM 1 0. 5.078125 87.890625 DISPLAY_IDENTIFIER ECFPWM_2_RAW ECU_ADDRESS 0x7fbffe FORMAT "%4.1" /end MEASUREMENT
/begin MEASUREMENT lv_ecfpwm_tco_max "flag for critical TCO reached" UBYTE _CNV_S_2_RANGE__0___85_CM 1 0. 0. 1. DISPLAY_IDENTIFIER LV_ECFPWM_TCO_MAX ECU_ADDRESS 0x7fc00f BIT_MASK 0x1 /end MEASUREMENT
/begin MEASUREMENT lv_ecfpwm_tco_2_max "flag for critical TCO_2 reached" UBYTE _CNV_S_2_RANGE__0___85_CM 1 0. 0. 1. DISPLAY_IDENTIFIER LV_ECFPWM_TCO_2_MAX ECU_ADDRESS 0x7fc010 BIT_MASK 0x1 /end MEASUREMENT
/begin MEASUREMENT lv_ecfpwm_max "flag for critical TCO or TCO_2 reached" UBYTE _CNV_S_2_RANGE__0___85_CM 1 0. 0. 1. DISPLAY_IDENTIFIER LV_ECFPWM_MAX ECU_ADDRESS 0x7fc011 BIT_MASK 0x1 /end MEASUREMENT
/begin MEASUREMENT ecfpwm_1_inter_1 "ECFPWM_2 after regarding engine start phase" UBYTE _CNV_A_R_LINEAR_____79_CM 1 0. 5.078125 87.890625 DISPLAY_IDENTIFIER ECFPWM_1_INTER_1 ECU_ADDRESS 0x7fbfff FORMAT "%4.1" /end MEASUREMENT
/begin MEASUREMENT ecfpwm_2_inter_1 "ECFPWM_2 regarding status critical coolant temperatures" UBYTE _CNV_A_R_LINEAR_____79_CM 1 0. 5.078125 87.890625 DISPLAY_IDENTIFIER ECFPWM_2_INTER_1 ECU_ADDRESS 0x7fc000 FORMAT "%4.1" /end MEASUREMENT
/begin MEASUREMENT n_rel_ecf_can "relative cooling power for CAN output" UBYTE _CNV_A_R_LINEAR_____248_CM 1 0. 0. 101.6 DISPLAY_IDENTIFIER N_REL_ECF_CAN ECU_ADDRESS 0x7fbc10 FORMAT "%4.1" /end MEASUREMENT
/begin MEASUREMENT ecfpwm_1_inter_4_lgrd "Limitation gradient for ramp down ECFPWM_1 before end of power latch phase" UBYTE _CNV_A_R_LINEAR_____79_CM 1 0. 0. 99.609375 DISPLAY_IDENTIFIER ECFPWM_1_INTER_4_LGRD ECU_ADDRESS 0x7fc004 FORMAT "%4.1" /end MEASUREMENT
/begin MEASUREMENT ecfpwm_2_inter_4_lgrd "Limitation gradient for ramp down ECFPWM_2 before end of power latch phase" UBYTE _CNV_A_R_LINEAR_____79_CM 1 0. 0. 99.609375 DISPLAY_IDENTIFIER ECFPWM_2_INTER_4_LGRD ECU_ADDRESS 0x7fc005 FORMAT "%4.1" /end MEASUREMENT
/begin MEASUREMENT ecfpwm_sub_vecu "ECFPWM in case of request set by VECU in case of VB error" UBYTE _CNV_A_R_LINEAR_____79_CM 1 0. 5.078125 87.890625 DISPLAY_IDENTIFIER ECFPWM_SUB_VECU ECU_ADDRESS 0x7fc001 FORMAT "%4.1" /end MEASUREMENT
/begin MEASUREMENT ecfpwm_1_inter_4 "ECFPWM_1 after regarding engine power latch phase" UBYTE _CNV_A_R_LINEAR_____79_CM 1 0. 5.078125 87.890625 DISPLAY_IDENTIFIER ECFPWM_1_INTER_4 ECU_ADDRESS 0x7fc002 FORMAT "%4.1" /end MEASUREMENT
/begin MEASUREMENT ecfpwm_2_inter_4 "ECFPWM_2 after regarding engine power latch phase" UBYTE _CNV_A_R_LINEAR_____79_CM 1 0. 5.078125 87.890625 DISPLAY_IDENTIFIER ECFPWM_2_INTER_4 ECU_ADDRESS 0x7fc003 FORMAT "%4.1" /end MEASUREMENT
/begin CHARACTERISTIC lc_ecf_1_dc "switch to select if ECF_1 is a DC fan (1 means DC)" VALUE 0x85011a _REC_VAL_20_u1 1. _CNV_A_R_LINEAR_____1_CM 0. 1. DISPLAY_IDENTIFIER LC_ECF_1_DC FORMAT "%1.0" /end CHARACTERISTIC
/begin CHARACTERISTIC lc_ecf_2_dc "switch to select if ECF_2 is a DC fan (1 means DC)" VALUE 0x85011b _REC_VAL_20_u1 1. _CNV_A_R_LINEAR_____1_CM 0. 1. DISPLAY_IDENTIFIER LC_ECF_2_DC FORMAT "%1.0" /end CHARACTERISTIC
/begin CHARACTERISTIC c_tco_max_ecf_hys "hysteresis for activation of maximum ECFPWM" VALUE 0x85001b _REC_VAL_20_u1 190.5 _CNV_A_R_LINEAR_____249_CM 0. 190.5 DISPLAY_IDENTIFIER C_TCO_MAX_ECF_HYS FORMAT "%5.1" /end CHARACTERISTIC
/begin CHARACTERISTIC c_tco_2_max_ecf "critical TCO_2 for activating maximum ECFPWM" VALUE 0x85000c _REC_VAL_20_u1 190.5 _CNV_A_R_LINEAR_____241_CM -48. 142.5 DISPLAY_IDENTIFIER C_TCO_2_MAX_ECF FORMAT "%5.1" /end CHARACTERISTIC
/begin CHARACTERISTIC lc_equip_tco_2 "logical switch to activate regarding of TCO_2 (1 means TCO_2 sensor available)" VALUE 0x850129 _REC_VAL_20_u1 1. _CNV_A_R_LINEAR_____1_CM 0. 1. DISPLAY_IDENTIFIER LC_EQUIP_TCO_2 FORMAT "%1.0" /end CHARACTERISTIC
/begin CHARACTERISTIC c_ecfpwm_1_tco_max "constant for ECFPWM_1 while LV_ECFPWM_MAX = 1" VALUE 0x84fcb1 _REC_VAL_20_u1 82.8125 _CNV_A_R_LINEAR_____79_CM 5.078125 87.890625 DISPLAY_IDENTIFIER C_ECFPWM_1_TCO_MAX FORMAT "%4.1" /end CHARACTERISTIC
/begin CHARACTERISTIC c_ecfpwm_2_tco_max "constant for ECFPWM_2 while LV_ECFPWM_MAX = 1" VALUE 0x84fcb5 _REC_VAL_20_u1 82.8125 _CNV_A_R_LINEAR_____79_CM 5.078125 87.890625 DISPLAY_IDENTIFIER C_ECFPWM_2_TCO_MAX FORMAT "%4.1" /end CHARACTERISTIC
/begin CHARACTERISTIC c_t_ecf_ast_act "time after start while start ECFPWM is constant" VALUE 0x84ff6e _REC_VAL_20_u2 6553.5 _CNV_A_R_LINEAR_____240_CM 0. 6553.5 DISPLAY_IDENTIFIER C_T_ECF_AST_ACT FORMAT "%6.1" /end CHARACTERISTIC
/begin CHARACTERISTIC c_ecfpwm_1_st_ast "ECFPWM_1 while start and after start" VALUE 0x84fcb0 _REC_VAL_20_u1 82.8125 _CNV_A_R_LINEAR_____79_CM 5.078125 87.890625 DISPLAY_IDENTIFIER C_ECFPWM_1_ST_AST FORMAT "%4.1" /end CHARACTERISTIC
/begin CHARACTERISTIC c_ecfpwm_2_st_ast "ECFPWM_2 while start and after start" VALUE 0x84fcb4 _REC_VAL_20_u1 82.8125 _CNV_A_R_LINEAR_____79_CM 5.078125 87.890625 DISPLAY_IDENTIFIER C_ECFPWM_2_ST_AST FORMAT "%4.1" /end CHARACTERISTIC
/begin CHARACTERISTIC c_ecfpwm_1_lgrd "limitation gradient for ECFPWM_1" VALUE 0x84fcae _REC_VAL_20_u1 99.609375 _CNV_A_R_LINEAR_____242_CM 0. 99.609375 DISPLAY_IDENTIFIER C_ECFPWM_1_LGRD FORMAT "%4.1" /end CHARACTERISTIC
/begin CHARACTERISTIC c_ecfpwm_2_lgrd "limitation gradient for ECFPWM_2" VALUE 0x84fcb2 _REC_VAL_20_u1 99.609375 _CNV_A_R_LINEAR_____242_CM 0. 99.609375 DISPLAY_IDENTIFIER C_ECFPWM_2_LGRD FORMAT "%4.1" /end CHARACTERISTIC
/begin CHARACTERISTIC c_t_ecfpwm_pwl_lgrd "ramp down time for ECFPWM_1/_2 before end of power latch phase" VALUE 0x84ff70 _REC_VAL_20_u1 25.5 _CNV_A_R_LINEAR_____240_CM 0. 25.5 DISPLAY_IDENTIFIER C_T_ECFPWM_PWL_LGRD FORMAT "%4.1" /end CHARACTERISTIC
/begin CHARACTERISTIC c_tco_2_max_ecf_hys "Hysteresis for activation of maximum ECFPWM" VALUE 0x85000d _REC_VAL_20_u1 190.5 _CNV_A_R_LINEAR_____249_CM 0. 190.5 DISPLAY_IDENTIFIER C_TCO_2_MAX_ECF_HYS FORMAT "%5.1" /end CHARACTERISTIC
/begin CHARACTERISTIC c_ecfpwm_vecu_lgrd "Gradient limitation in case of VECU request via CAN" VALUE 0x84fcb7 _REC_VAL_20_u1 82.8125 _CNV_A_R_LINEAR_____242_CM 5.078125 87.890625 DISPLAY_IDENTIFIER C_ECFPWM_VECU_LGRD FORMAT "%4.1" /end CHARACTERISTIC
/begin CHARACTERISTIC c_ecfpwm_vecu_max "Resulting value in case of VECU request via CAN" VALUE 0x84fcb8 _REC_VAL_20_u1 82.8125 _CNV_A_R_LINEAR_____79_CM 5.078125 87.890625 DISPLAY_IDENTIFIER C_ECFPWM_VECU_MAX FORMAT "%4.1" /end CHARACTERISTIC
/begin CHARACTERISTIC c_ecfpwm_deac "Minimum ECFPWM while power latch phase and engine stop (default: 10%)" VALUE 0x84fcb6 _REC_VAL_20_u1 82.8125 _CNV_A_R_LINEAR_____79_CM 5.078125 87.890625 DISPLAY_IDENTIFIER C_ECFPWM_DEAC FORMAT "%4.1" /end CHARACTERISTIC
/begin CHARACTERISTIC c_ecfpwm_1_max "Maximum value for ECFPWM_1" VALUE 0x84fcaf _REC_VAL_20_u1 82.8125 _CNV_A_R_LINEAR_____79_CM 5.078125 87.890625 DISPLAY_IDENTIFIER C_ECFPWM_1_MAX FORMAT "%4.1" /end CHARACTERISTIC
/begin CHARACTERISTIC c_ecfpwm_2_max "Maximum value for ECFPWM_2" VALUE 0x84fcb3 _REC_VAL_20_u1 82.8125 _CNV_A_R_LINEAR_____79_CM 5.078125 87.890625 DISPLAY_IDENTIFIER C_ECFPWM_2_MAX FORMAT "%4.1" /end CHARACTERISTIC
/begin AXIS_PTS ldpm_vb_mmv__ecfpwm "" 0x844450 vb_mmv _REC_AXS_20_u1 3.12 _CNV_A_R_LINEAR_____250_CM 6 0. 26. FORMAT "%4.1" /end AXIS_PTS
/begin CHARACTERISTIC ip_ecfpwm_1_fac_vb "factor to increase ECFPWM_1 vs. VB" CURVE 0x8462b4 _REC_CUR_20_u1_u1 15.9375 _CNV_A_R_LINEAR_____251_CM 0. 15.9375 DISPLAY_IDENTIFIER IP_ECFPWM_1_FAC_VB FORMAT "%5.2"
 /begin AXIS_DESCR COM_AXIS vb_mmv _CNV_A_R_LINEAR_____250_CM 6 0. 26. FORMAT "%4.1" AXIS_PTS_REF ldpm_vb_mmv__ecfpwm /end AXIS_DESCR
/end CHARACTERISTIC
/begin CHARACTERISTIC ip_ecfpwm_2_fac_vb "factor to increase ECFPWM_2 vs. VB" CURVE 0x8462e8 _REC_CUR_20_u1_u1 15.9375 _CNV_A_R_LINEAR_____251_CM 0. 15.9375 DISPLAY_IDENTIFIER IP_ECFPWM_2_FAC_VB FORMAT "%5.2"
 /begin AXIS_DESCR COM_AXIS vb_mmv _CNV_A_R_LINEAR_____250_CM 6 0. 26. FORMAT "%4.1" AXIS_PTS_REF ldpm_vb_mmv__ecfpwm /end AXIS_DESCR
/end CHARACTERISTIC
/begin AXIS_PTS ldp_n_sp_ecf_1__ecfpwm "" 0x8440c2 n_sp_ecf_1 _REC_AXS_20_u1 4080. _CNV_A_R_LINEAR_____243_CM 10 0. 4080. FORMAT "%4.0" /end AXIS_PTS
/begin CHARACTERISTIC ip_ecfpwm_1 "Basic ECFPWM_1 map" CURVE 0x8462aa _REC_CUR_20_u1_u1 82.8125 _CNV_A_R_LINEAR_____79_CM 5.078125 87.890625 DISPLAY_IDENTIFIER IP_ECFPWM_1 FORMAT "%4.1"
 /begin AXIS_DESCR COM_AXIS n_sp_ecf_1 _CNV_A_R_LINEAR_____243_CM 10 0. 4080. FORMAT "%4.0" AXIS_PTS_REF ldp_n_sp_ecf_1__ecfpwm /end AXIS_DESCR
/end CHARACTERISTIC
/begin AXIS_PTS ldp_n_sp_ecf_2__ecfpwm "" 0x8440cd n_sp_ecf_2 _REC_AXS_20_u1 4080. _CNV_A_R_LINEAR_____243_CM 10 0. 4080. FORMAT "%4.0" /end AXIS_PTS
/begin CHARACTERISTIC ip_ecfpwm_2 "basic ECFPWM_2 map" CURVE 0x8462de _REC_CUR_20_u1_u1 82.8125 _CNV_A_R_LINEAR_____79_CM 5.078125 87.890625 DISPLAY_IDENTIFIER IP_ECFPWM_2 FORMAT "%4.1"
 /begin AXIS_DESCR COM_AXIS n_sp_ecf_2 _CNV_A_R_LINEAR_____243_CM 10 0. 4080. FORMAT "%4.0" AXIS_PTS_REF ldp_n_sp_ecf_2__ecfpwm /end AXIS_DESCR
/end CHARACTERISTIC
/begin AXIS_PTS ldpm_tco__ecfpwm_pwl "" 0x844436 tco _REC_AXS_20_u1 190.5 _CNV_A_R_LINEAR_____241_CM 6 -48. 142.5 FORMAT "%5.1" /end AXIS_PTS
/begin AXIS_PTS ldpm_tam__ecfpwm_pwl "" 0x84442f tam _REC_AXS_20_u1 190.5 _CNV_A_R_LINEAR_____241_CM 6 -48. 142.5 FORMAT "%5.1" /end AXIS_PTS
/begin CHARACTERISTIC ip_ecfpwm_1_pwl "ECFPWM_1 while ECF power latch phase" MAP 0x8462ba _REC_MAP_20_u1_u1_u1 82.8125 _CNV_A_R_LINEAR_____79_CM 5.078125 87.890625 DISPLAY_IDENTIFIER IP_ECFPWM_1_PWL FORMAT "%4.1"
 /begin AXIS_DESCR COM_AXIS tco _CNV_A_R_LINEAR_____241_CM 6 -48. 142.5 FORMAT "%5.1" AXIS_PTS_REF ldpm_tco__ecfpwm_pwl /end AXIS_DESCR
 /begin AXIS_DESCR COM_AXIS tam _CNV_A_R_LINEAR_____241_CM 6 -48. 142.5 FORMAT "%5.1" AXIS_PTS_REF ldpm_tam__ecfpwm_pwl /end AXIS_DESCR
/end CHARACTERISTIC
/begin CHARACTERISTIC ip_ecfpwm_2_pwl "ECFPWM_2 while ECF power latch phase" MAP 0x8462ee _REC_MAP_20_u1_u1_u1 82.8125 _CNV_A_R_LINEAR_____79_CM 5.078125 87.890625 DISPLAY_IDENTIFIER IP_ECFPWM_2_PWL FORMAT "%4.1"
 /begin AXIS_DESCR COM_AXIS tco _CNV_A_R_LINEAR_____241_CM 6 -48. 142.5 FORMAT "%5.1" AXIS_PTS_REF ldpm_tco__ecfpwm_pwl /end AXIS_DESCR
 /begin AXIS_DESCR COM_AXIS tam _CNV_A_R_LINEAR_____241_CM 6 -48. 142.5 FORMAT "%5.1" AXIS_PTS_REF ldpm_tam__ecfpwm_pwl /end AXIS_DESCR
/end CHARACTERISTIC
/begin AXIS_PTS ldp_ecfpwm_1__n_rel_ecf_can "" 0x843fc5 ecfpwm_1 _REC_AXS_20_u1 82.8125 _CNV_A_R_LINEAR_____79_CM 10 5.078125 87.890625 FORMAT "%4.1" /end AXIS_PTS
/begin AXIS_PTS ldp_ecfpwm_2__n_rel_ecf_can "" 0x843fd0 ecfpwm_2 _REC_AXS_20_u1 82.8125 _CNV_A_R_LINEAR_____79_CM 10 5.078125 87.890625 FORMAT "%4.1" /end AXIS_PTS
/begin CHARACTERISTIC ip_n_rel_ecf_can "transition from ECFPWM_1 and _2 to N_REL_ECF_CAN for CAN output" MAP 0x84d2f8 _REC_MAP_20_u1_u1_u1 101.6 _CNV_A_R_LINEAR_____248_CM 0. 101.6 DISPLAY_IDENTIFIER IP_N_REL_ECF_CAN FORMAT "%4.1"
 /begin AXIS_DESCR COM_AXIS ecfpwm_1 _CNV_A_R_LINEAR_____79_CM 10 5.078125 87.890625 FORMAT "%4.1" AXIS_PTS_REF ldp_ecfpwm_1__n_rel_ecf_can /end AXIS_DESCR
 /begin AXIS_DESCR COM_AXIS ecfpwm_2 _CNV_A_R_LINEAR_____79_CM 10 5.078125 87.890625 FORMAT "%4.1" AXIS_PTS_REF ldp_ecfpwm_2__n_rel_ecf_can /end AXIS_DESCR
/end CHARACTERISTIC
/begin MEASUREMENT t_pop_coc "engine cooling management post operating phase timer" UWORD _CNV_A_R_LINEAR_____240_CM 1 0. 0. 6553.5 DISPLAY_IDENTIFIER T_POP_COC ECU_ADDRESS 0x7fb4ea BYTE_ORDER MSB_LAST FORMAT "%6.1" /end MEASUREMENT
/begin MEASUREMENT t_pop_bas "basic post operating time vs. TCO and FCO_VS" UWORD _CNV_A_R_LINEAR_____240_CM 1 0. 0. 6553.5 DISPLAY_IDENTIFIER T_POP_BAS ECU_ADDRESS 0x7fb4ec BYTE_ORDER MSB_LAST FORMAT "%6.1" /end MEASUREMENT
/begin MEASUREMENT t_pop_bas_cor "basic post operating time including factor" UWORD _CNV_A_R_LINEAR_____240_CM 1 0. 0. 6553.5 DISPLAY_IDENTIFIER T_POP_BAS_COR ECU_ADDRESS 0x7fb4ee BYTE_ORDER MSB_LAST FORMAT "%6.1" /end MEASUREMENT
/begin MEASUREMENT t_pop_cor "maximum post operating time vs. TCO and TAM" UWORD _CNV_A_R_LINEAR_____240_CM 1 0. 0. 6553.5 DISPLAY_IDENTIFIER T_POP_COR ECU_ADDRESS 0x7fb4f0 BYTE_ORDER MSB_LAST FORMAT "%6.1" /end MEASUREMENT
/begin MEASUREMENT t_pop_toil "maximum post operating time vs. TOIL_POP_COC" UWORD _CNV_A_R_LINEAR_____240_CM 1 0. 0. 6553.5 DISPLAY_IDENTIFIER T_POP_TOIL ECU_ADDRESS 0x7fb4f2 BYTE_ORDER MSB_LAST FORMAT "%6.1" /end MEASUREMENT
/begin MEASUREMENT tco_sp_pop_stop "TCO threshold to cancel post operating if post operating phase 2 is active" UBYTE _CNV_A_R_LINEAR_____241_CM 1 0. -48. 142.5 DISPLAY_IDENTIFIER TCO_SP_POP_STOP ECU_ADDRESS 0x7fc009 FORMAT "%5.1" /end MEASUREMENT
/begin MEASUREMENT t_pop_2 "post operating time for phase 2" UWORD _CNV_A_R_LINEAR_____240_CM 1 0. 0. 6553.5 DISPLAY_IDENTIFIER T_POP_2 ECU_ADDRESS 0x7fb4f4 BYTE_ORDER MSB_LAST FORMAT "%6.1" /end MEASUREMENT
/begin MEASUREMENT state_pop_coc "" UBYTE _CNV_S_4_STATE_POP__252_CM 1 0. 0. 3. DISPLAY_IDENTIFIER STATE_POP_COC ECU_ADDRESS 0x7fbc11 /end MEASUREMENT
/begin MEASUREMENT t_pop_coc_end "" UWORD _CNV_A_R_LINEAR_____240_CM 1 0. 0. 6553.5 DISPLAY_IDENTIFIER T_POP_COC_END ECU_ADDRESS 0x7fa31a BYTE_ORDER MSB_LAST FORMAT "%6.1" /end MEASUREMENT
/begin CHARACTERISTIC c_fac_t_pop_phase_2 "percentage of time of T_PWL_1 elapsed for check of phase 2 activation" VALUE 0x84fd4c _REC_VAL_20_u1 99.609375 _CNV_A_R_LINEAR_____79_CM 0. 99.609375 DISPLAY_IDENTIFIER C_FAC_T_POP_PHASE_2 FORMAT "%4.1" /end CHARACTERISTIC
/begin CHARACTERISTIC c_t_pop_coc_max "maximum PWL time for engine cooling management power latch" VALUE 0x84ffe2 _REC_VAL_20_u2 6553.5 _CNV_A_R_LINEAR_____240_CM 0. 6553.5 DISPLAY_IDENTIFIER C_T_POP_COC_MAX FORMAT "%6.1" /end CHARACTERISTIC
/begin AXIS_PTS ldp_tco__t_pop_bas "" 0x844238 tco _REC_AXS_20_u1 190.5 _CNV_A_R_LINEAR_____241_CM 6 -48. 142.5 FORMAT "%5.1" /end AXIS_PTS
/begin AXIS_PTS ldp_fco_vs__t_pop_bas "" 0x844022 fco_vs _REC_AXS_20_u2 92.52 _CNV_A_R_LINEAR_____253_CM 6 0. 92.52 /end AXIS_PTS
/begin AXIS_PTS ldp_tam__t_pop_fac "" 0x8441e4 tam _REC_AXS_20_u1 190.5 _CNV_A_R_LINEAR_____241_CM 6 -48. 142.5 FORMAT "%5.1" /end AXIS_PTS
/begin AXIS_PTS ldp_tco__t_pop_2 "" 0x844231 tco _REC_AXS_20_u1 190.5 _CNV_A_R_LINEAR_____241_CM 6 -48. 142.5 FORMAT "%5.1" /end AXIS_PTS
/begin AXIS_PTS ldp_tam__t_pop_2 "" 0x8441d6 tam _REC_AXS_20_u1 190.5 _CNV_A_R_LINEAR_____241_CM 6 -48. 142.5 FORMAT "%5.1" /end AXIS_PTS
/begin AXIS_PTS ldp_tco_stop__tco_sp_pop_stop "" 0x8442b4 tco_stop _REC_AXS_20_u1 190.5 _CNV_A_R_LINEAR_____241_CM 6 -48. 142.5 FORMAT "%5.1" /end AXIS_PTS
/begin AXIS_PTS ldp_tco__t_pop_cor "" 0x84423f tco _REC_AXS_20_u1 190.5 _CNV_A_R_LINEAR_____241_CM 6 -48. 142.5 FORMAT "%5.1" /end AXIS_PTS
/begin AXIS_PTS ldp_tam__t_pop_cor "" 0x8441dd tam _REC_AXS_20_u1 190.5 _CNV_A_R_LINEAR_____241_CM 6 -48. 142.5 FORMAT "%5.1" /end AXIS_PTS
/begin AXIS_PTS ldp_toil__t_pop_toil "" 0x8442cb toil _REC_AXS_20_u1 200. _CNV_A_R_LINEAR_____65_CM 4 -40. 160. FORMAT "%3.0" /end AXIS_PTS
/begin CHARACTERISTIC ip_t_pop_bas "basic post operating time" MAP 0x84f04a _REC_MAP_20_u2_u1_u2 6553.5 _CNV_A_R_LINEAR_____240_CM 0. 6553.5 DISPLAY_IDENTIFIER IP_T_POP_BAS FORMAT "%6.1"
 /begin AXIS_DESCR COM_AXIS tco _CNV_A_R_LINEAR_____241_CM 6 -48. 142.5 FORMAT "%5.1" AXIS_PTS_REF ldp_tco__t_pop_bas /end AXIS_DESCR
 /begin AXIS_DESCR COM_AXIS fco_vs _CNV_A_R_LINEAR_____253_CM 6 0. 92.52 AXIS_PTS_REF ldp_fco_vs__t_pop_bas /end AXIS_DESCR
/end CHARACTERISTIC
/begin CHARACTERISTIC ip_t_pop_fac "factor on basic post operating time" CURVE 0x84f0da _REC_CUR_20_u1_u1 0.99609375 _CNV_A_R_LINEAR_____254_CM 0. 0.99609375 DISPLAY_IDENTIFIER IP_T_POP_FAC FORMAT "%5.3"
 /begin AXIS_DESCR COM_AXIS tam _CNV_A_R_LINEAR_____241_CM 6 -48. 142.5 FORMAT "%5.1" AXIS_PTS_REF ldp_tam__t_pop_fac /end AXIS_DESCR
/end CHARACTERISTIC
/begin CHARACTERISTIC ip_t_pop_2 "maximum post operating time for phase 2 vs. TCO and TAM" MAP 0x84f002 _REC_MAP_20_u2_u1_u1 6553.5 _CNV_A_R_LINEAR_____240_CM 0. 6553.5 DISPLAY_IDENTIFIER IP_T_POP_2 FORMAT "%6.1"
 /begin AXIS_DESCR COM_AXIS tco _CNV_A_R_LINEAR_____241_CM 6 -48. 142.5 FORMAT "%5.1" AXIS_PTS_REF ldp_tco__t_pop_2 /end AXIS_DESCR
 /begin AXIS_DESCR COM_AXIS tam _CNV_A_R_LINEAR_____241_CM 6 -48. 142.5 FORMAT "%5.1" AXIS_PTS_REF ldp_tam__t_pop_2 /end AXIS_DESCR
/end CHARACTERISTIC
/begin CHARACTERISTIC ip_tco_sp_pop_stop "TCO_STOP threshold to cancel PWL phase while phase 2" CURVE 0x84f4ac _REC_CUR_20_u1_u1 190.5 _CNV_A_R_LINEAR_____241_CM -48. 142.5 DISPLAY_IDENTIFIER IP_TCO_SP_POP_STOP FORMAT "%5.1"
 /begin AXIS_DESCR COM_AXIS tco_stop _CNV_A_R_LINEAR_____241_CM 6 -48. 142.5 FORMAT "%5.1" AXIS_PTS_REF ldp_tco_stop__tco_sp_pop_stop /end AXIS_DESCR
/end CHARACTERISTIC
/begin CHARACTERISTIC ip_t_pop_cor "maximum post operating time vs. TCO and TAM" MAP 0x84f092 _REC_MAP_20_u2_u1_u1 6553.5 _CNV_A_R_LINEAR_____240_CM 0. 6553.5 DISPLAY_IDENTIFIER IP_T_POP_COR FORMAT "%6.1"
 /begin AXIS_DESCR COM_AXIS tco _CNV_A_R_LINEAR_____241_CM 6 -48. 142.5 FORMAT "%5.1" AXIS_PTS_REF ldp_tco__t_pop_cor /end AXIS_DESCR
 /begin AXIS_DESCR COM_AXIS tam _CNV_A_R_LINEAR_____241_CM 6 -48. 142.5 FORMAT "%5.1" AXIS_PTS_REF ldp_tam__t_pop_cor /end AXIS_DESCR
/end CHARACTERISTIC
/begin CHARACTERISTIC ip_t_pop_toil "maximum post operating time vs. TOIL" CURVE 0x84f0e0 _REC_CUR_20_u2_u1 6553.5 _CNV_A_R_LINEAR_____240_CM 0. 6553.5 DISPLAY_IDENTIFIER IP_T_POP_TOIL FORMAT "%6.1"
 /begin AXIS_DESCR COM_AXIS toil _CNV_A_R_LINEAR_____65_CM 4 -40. 160. FORMAT "%3.0" AXIS_PTS_REF ldp_toil__t_pop_toil /end AXIS_DESCR
/end CHARACTERISTIC
/begin MEASUREMENT cool_req_ac_clc "Normalized cooling request by AC" UBYTE _CNV_A_R_LINEAR_____79_CM 1 0. 0. 99.609375 DISPLAY_IDENTIFIER COOL_REQ_AC_CLC ECU_ADDRESS 0x7fbff4 FORMAT "%4.1" /end MEASUREMENT
/begin AXIS_PTS ldp_cool_req_ac_ip_cool_ac_clc "" 0x843f82 cool_req_ac _REC_AXS_20_u1 99.609375 _CNV_A_R_LINEAR_____79_CM 4 0. 99.609375 FORMAT "%4.1" /end AXIS_PTS
/begin CHARACTERISTIC ip_cool_req_ac_clc "Adaptation table for Cooling Request of AC" CURVE 0x844fb1 _REC_CUR_20_u1_u1 99.609375 _CNV_A_R_LINEAR_____79_CM 0. 99.609375 DISPLAY_IDENTIFIER IP_COOL_REQ_AC_CLC FORMAT "%4.1"
 /begin AXIS_DESCR COM_AXIS cool_req_ac _CNV_A_R_LINEAR_____79_CM 4 0. 99.609375 FORMAT "%4.1" AXIS_PTS_REF ldp_cool_req_ac_ip_cool_ac_clc /end AXIS_DESCR
/end CHARACTERISTIC
/begin MEASUREMENT t_hld_ecfpwm_max "Time for max. ECFPWM due to high cooling requests by AC" UBYTE _CNV_A_R_LINEAR_____240_CM 1 0. 0. 25.5 DISPLAY_IDENTIFIER T_HLD_ECFPWM_MAX ECU_ADDRESS 0x7fc006 FORMAT "%4.1" /end MEASUREMENT
/begin AXIS_PTS ldp_tco__ecfpwm_max "" 0x84422a tco _REC_AXS_20_u1 190.5 _CNV_A_R_LINEAR_____241_CM 6 -48. 142.5 FORMAT "%5.1" /end AXIS_PTS
/begin AXIS_PTS ldp_fco_t__ecfpwm_max "" 0x844006 fco_t _REC_AXS_20_u2 16.38375 _CNV_A_R_LINEAR_____255_CM 6 0. 16.38375 FORMAT "%7.2" /end AXIS_PTS
/begin CHARACTERISTIC ip_tco_fco_t_max_ecf "critical TCO for activating maximum ECFPWM" MAP 0x84f1fe _REC_MAP_20_u1_u1_u2 190.5 _CNV_A_R_LINEAR_____241_CM -48. 142.5 DISPLAY_IDENTIFIER IP_TCO_FCO_T_MAX_ECF FORMAT "%5.1"
 /begin AXIS_DESCR COM_AXIS tco _CNV_A_R_LINEAR_____241_CM 6 -48. 142.5 FORMAT "%5.1" AXIS_PTS_REF ldp_tco__ecfpwm_max /end AXIS_DESCR
 /begin AXIS_DESCR COM_AXIS fco_t _CNV_A_R_LINEAR_____255_CM 6 0. 16.38375 FORMAT "%7.2" AXIS_PTS_REF ldp_fco_t__ecfpwm_max /end AXIS_DESCR
/end CHARACTERISTIC
/begin CHARACTERISTIC c_acp_ecfpwm_max "Air Conditioning pressure for map ECFPWM" VALUE 0x84fb89 _REC_VAL_20_u1 40. _CNV_A_R_LINEAR_____256_CM 0. 40. DISPLAY_IDENTIFIER C_ACP_ECFPWM_MAX FORMAT "%4.1" /end CHARACTERISTIC
/begin CHARACTERISTIC c_tam_ecfpwm_max "Ambient temperature for max ECFPWM" VALUE 0x850008 _REC_VAL_20_u1 190.5 _CNV_A_R_LINEAR_____257_CM -48. 142.5 DISPLAY_IDENTIFIER C_TAM_ECFPWM_MAX FORMAT "%6.2" /end CHARACTERISTIC
/begin CHARACTERISTIC c_t_hld_ecfpwm_max "Max. time for max. ECFPWM due to high cooling requests by AC" VALUE 0x84ff84 _REC_VAL_20_u1 25.5 _CNV_A_R_LINEAR_____240_CM 0. 25.5 DISPLAY_IDENTIFIER C_T_HLD_ECFPWM_MAX FORMAT "%4.1" /end CHARACTERISTIC
/begin CHARACTERISTIC c_cool_req_ac_ecfpwm_max "Cooling request by AC to enable max ECFPWM" VALUE 0x84fbef _REC_VAL_20_u1 99.609375 _CNV_A_R_LINEAR_____79_CM 0. 99.609375 DISPLAY_IDENTIFIER C_COOL_REQ_AC_ECFPWM_MAX FORMAT "%4.1" /end CHARACTERISTIC
/begin MEASUREMENT t_pop_coc_inter_1 "Engine cooling management post operating phase timer 1" UWORD _CNV_A_R_LINEAR_____240_CM 1 0. 0. 6553.5 DISPLAY_IDENTIFIER T_POP_COC_INTER_1 ECU_ADDRESS 0x7fb4f6 BYTE_ORDER MSB_LAST FORMAT "%6.1" /end MEASUREMENT
/begin MEASUREMENT t_pop_coc_inter_2 "Engine cooling management post operating phase timer 2" UWORD _CNV_A_R_LINEAR_____240_CM 1 0. 0. 6553.5 DISPLAY_IDENTIFIER T_POP_COC_INTER_2 ECU_ADDRESS 0x7fb4f8 BYTE_ORDER MSB_LAST FORMAT "%6.1" /end MEASUREMENT
/begin CHARACTERISTIC c_t_ast_tol_pop_coc "Maximum engine run time to reduce POP_COC" VALUE 0x84ff2a _REC_VAL_20_u2 6553.5 _CNV_A_R_LINEAR_____240_CM 0. 6553.5 DISPLAY_IDENTIFIER C_T_AST_TOL_POP_COC FORMAT "%6.1" /end CHARACTERISTIC
/begin CHARACTERISTIC c_t_ast_bol_pop_coc "Minimum engine run time to reduce POP_COC" VALUE 0x84ff1e _REC_VAL_20_u2 6553.5 _CNV_A_R_LINEAR_____240_CM 0. 6553.5 DISPLAY_IDENTIFIER C_T_AST_BOL_POP_COC FORMAT "%6.1" /end CHARACTERISTIC
/begin MEASUREMENT cool_req_eng "additional relative engine cooling request" UBYTE _CNV_A_R_LINEAR_____79_CM 1 0. 0. 99.609375 DISPLAY_IDENTIFIER COOL_REQ_ENG ECU_ADDRESS 0x7fbb00 FORMAT "%4.1" /end MEASUREMENT
/begin MEASUREMENT cool_req_eng_inter "relative engine cooling request" UBYTE _CNV_A_R_LINEAR_____79_CM 1 0. 0. 99.609375 DISPLAY_IDENTIFIER COOL_REQ_ENG_INTER ECU_ADDRESS 0x7fbf21 FORMAT "%4.1" /end MEASUREMENT
/begin MEASUREMENT cool_req_eng_dyn "dynamic relative engine cooling request" UBYTE _CNV_A_R_LINEAR_____79_CM 1 0. 0. 99.609375 DISPLAY_IDENTIFIER COOL_REQ_ENG_DYN ECU_ADDRESS 0x7fbf22 FORMAT "%4.1" /end MEASUREMENT
/begin MEASUREMENT cool_req_eng_tco "relative engine cooling request depending on TCP and TAM" UBYTE _CNV_A_R_LINEAR_____79_CM 1 0. 0. 99.609375 DISPLAY_IDENTIFIER COOL_REQ_ENG_TCO ECU_ADDRESS 0x7fbf23 FORMAT "%4.1" /end MEASUREMENT
/begin MEASUREMENT cool_req_eng_clc "relative engine cooling request, intermediate value" UBYTE _CNV_A_R_LINEAR_____79_CM 1 0. 0. 99.609375 DISPLAY_IDENTIFIER COOL_REQ_ENG_CLC ECU_ADDRESS 0x7fbf24 FORMAT "%4.1" /end MEASUREMENT
/begin MEASUREMENT t_dly_1_tco_2_sp_add "Timer for activating additional TCO_2_SP_COR_2" UBYTE _CNV_A_R_LINEAR_____27_CM 1 0. 0. 255. DISPLAY_IDENTIFIER T_DLY_1_TCO_2_SP_ADD ECU_ADDRESS 0x7fbf25 FORMAT "%3.0" /end MEASUREMENT
/begin MEASUREMENT t_dly_2_tco_2_sp_add "Timer for activating additional TCO_2_SP_COR_2" UBYTE _CNV_A_R_LINEAR_____27_CM 1 0. 0. 255. DISPLAY_IDENTIFIER T_DLY_2_TCO_2_SP_ADD ECU_ADDRESS 0x7fbf26 FORMAT "%3.0" /end MEASUREMENT
/begin MEASUREMENT tco_2_sp_1 "TCO_2_SP intermediate value" UBYTE _CNV_A_R_LINEAR_____241_CM 1 0. -48. 142.5 DISPLAY_IDENTIFIER TCO_2_SP_1 ECU_ADDRESS 0x7fbf27 FORMAT "%5.1" /end MEASUREMENT
/begin MEASUREMENT tco_2_sp_2 "TCO_2_SP intermediate value" UBYTE _CNV_A_R_LINEAR_____241_CM 1 0. -48. 142.5 DISPLAY_IDENTIFIER TCO_2_SP_2 ECU_ADDRESS 0x7fbf28 FORMAT "%5.1" /end MEASUREMENT
/begin MEASUREMENT tco_2_sp_3 "TCO_2_SP intermediate value" UBYTE _CNV_A_R_LINEAR_____241_CM 1 0. -48. 142.5 DISPLAY_IDENTIFIER TCO_2_SP_3 ECU_ADDRESS 0x7fbf29 FORMAT "%5.1" /end MEASUREMENT
/begin MEASUREMENT tco_2_sp_4 "TCO_2_SP intermediate value" UBYTE _CNV_A_R_LINEAR_____241_CM 1 0. -48. 142.5 DISPLAY_IDENTIFIER TCO_2_SP_4 ECU_ADDRESS 0x7fbf2a FORMAT "%5.1" /end MEASUREMENT
/begin MEASUREMENT tco_2_sp_5 "TCO_2_SP intermediate value" UBYTE _CNV_A_R_LINEAR_____241_CM 1 0. -48. 142.5 DISPLAY_IDENTIFIER TCO_2_SP_5 ECU_ADDRESS 0x7fbf2b FORMAT "%5.1" /end MEASUREMENT
/begin MEASUREMENT tco_2_sp_6 "TCO_2_SP intermediate value" UBYTE _CNV_A_R_LINEAR_____241_CM 1 0. -48. 142.5 DISPLAY_IDENTIFIER TCO_2_SP_6 ECU_ADDRESS 0x7fbf2c FORMAT "%5.1" /end MEASUREMENT
/begin MEASUREMENT tco_2_sp_cor_2 "TCO_2_SP corrective value" UBYTE _CNV_A_R_LINEAR_____241_CM 1 0. -48. 142.5 DISPLAY_IDENTIFIER TCO_2_SP_COR_2 ECU_ADDRESS 0x7fbf2d FORMAT "%5.1" /end MEASUREMENT
/begin MEASUREMENT tco_2_sp "TCO_2_SP resulting value for COOL_REQ_ENG calculation" UBYTE _CNV_A_R_LINEAR_____241_CM 1 0. -48. 142.5 DISPLAY_IDENTIFIER TCO_2_SP ECU_ADDRESS 0x7fbb02 FORMAT "%5.1" /end MEASUREMENT
/begin MEASUREMENT tco_2_dif "Diference between TCO_2_SP and TCO_2" SBYTE _CNV_A_R_LINEAR_____260_CM 1 0. -96. 95.25 DISPLAY_IDENTIFIER TCO_2_DIF ECU_ADDRESS 0x7fbf3a FORMAT "%4.1" /end MEASUREMENT
/begin MEASUREMENT tco_2_sp_mmv "Filtered value of TCO_2_SP_1" UBYTE _CNV_A_R_LINEAR_____241_CM 1 0. -48. 142.5 DISPLAY_IDENTIFIER TCO_2_SP_MMV ECU_ADDRESS 0x7fbf2e FORMAT "%5.1" /end MEASUREMENT
/begin MEASUREMENT vs_cool_req "Vehicle speed as input value for basic cooling map (IP_COOL_REQ_ENG_BAS)" UBYTE _CNV_A_R_LINEAR_____245_CM 1 0. 0. 255. DISPLAY_IDENTIFIER VS_COOL_REQ ECU_ADDRESS 0x7fbf2f FORMAT "%3.0" /end MEASUREMENT
/begin MEASUREMENT cool_req_eng_bas "Basic value for engine cooling request derived from map IP_COOL_REQ_ENG_BAS" UBYTE _CNV_A_R_LINEAR_____79_CM 1 0. 0. 99.609375 DISPLAY_IDENTIFIER COOL_REQ_ENG_BAS ECU_ADDRESS 0x7fbf30 FORMAT "%4.1" /end MEASUREMENT
/begin MEASUREMENT cool_req_eng_cor "Corrective (controler) value for engine cooling request; derived from map IP_COOL_REQ_ENG_I" UBYTE _CNV_A_R_LINEAR_____79_CM 1 0. 0. 99.609375 DISPLAY_IDENTIFIER COOL_REQ_ENG_COR ECU_ADDRESS 0x7fbf31 FORMAT "%4.1" /end MEASUREMENT
/begin CHARACTERISTIC c_cool_req_eng_inter_sub "Default value in case of failure entries" VALUE 0x84fbf3 _REC_VAL_20_u1 99.609375 _CNV_A_R_LINEAR_____79_CM 0. 99.609375 DISPLAY_IDENTIFIER C_COOL_REQ_ENG_INTER_SUB FORMAT "%4.1" /end CHARACTERISTIC
/begin CHARACTERISTIC c_cool_req_eng_min "minimum value for COOL_REQ" VALUE 0x84fbf5 _REC_VAL_20_u1 99.609375 _CNV_A_R_LINEAR_____79_CM 0. 99.609375 DISPLAY_IDENTIFIER C_COOL_REQ_ENG_MIN FORMAT "%4.1" /end CHARACTERISTIC
/begin CHARACTERISTIC c_cool_req_eng_max "maximum value for COOL_REQ" VALUE 0x84fbf4 _REC_VAL_20_u1 99.609375 _CNV_A_R_LINEAR_____79_CM 0. 99.609375 DISPLAY_IDENTIFIER C_COOL_REQ_ENG_MAX FORMAT "%4.1" /end CHARACTERISTIC
/begin CHARACTERISTIC lc_tco_2_sp_mdl_ena "Switch to activate cooling request calculation based on a TCO_2_SP model (1 = model based; Version 1)" VALUE 0x85016d _REC_VAL_20_u1 1. _CNV_A_R_LINEAR_____1_CM 0. 1. DISPLAY_IDENTIFIER LC_TCO_2_SP_MDL_ENA FORMAT "%1.0" /end CHARACTERISTIC
/begin CHARACTERISTIC c_crlc_tco_2_sp_inc "PT1 filter constant for increasing TCO_2_SP_1 value" VALUE 0x84fbfb _REC_VAL_20_u1 1. _CNV_A_R_LINEAR_____262_CM 0. 1. DISPLAY_IDENTIFIER C_CRLC_TCO_2_SP_INC FORMAT "%5.3" /end CHARACTERISTIC
/begin CHARACTERISTIC c_crlc_tco_2_sp_dec "PT1 filter constant for decreasing TCO_2_SP_1 value" VALUE 0x84fbfa _REC_VAL_20_u1 1. _CNV_A_R_LINEAR_____262_CM 0. 1. DISPLAY_IDENTIFIER C_CRLC_TCO_2_SP_DEC FORMAT "%5.3" /end CHARACTERISTIC
/begin CHARACTERISTIC lc_inp_tco_sp "Switch to choose TCO or TCO_SP as input for Kf IP_TCO_2_SP_3 (1 = TCO)" VALUE 0x850132 _REC_VAL_20_u1 1. _CNV_A_R_LINEAR_____1_CM 0. 1. DISPLAY_IDENTIFIER LC_INP_TCO_SP FORMAT "%1.0" /end CHARACTERISTIC
/begin CHARACTERISTIC c_ectpwm_1_tco_2_sp_add "ECTPWM threshold to activate TCO_2_SP_COR_2 offset" VALUE 0x84fcba _REC_VAL_20_u2 99.99847412109381 _CNV_A_R_LINEAR_____258_CM 0. 99.99847412109381 DISPLAY_IDENTIFIER C_ECTPWM_1_TCO_2_SP_ADD /end CHARACTERISTIC
/begin CHARACTERISTIC c_ectpwm_2_tco_2_sp_add "ECTPWM threshold to deactivate TCO_2_SP_COR_2 offset" VALUE 0x84fcbc _REC_VAL_20_u2 99.99847412109381 _CNV_A_R_LINEAR_____258_CM 0. 99.99847412109381 DISPLAY_IDENTIFIER C_ECTPWM_2_TCO_2_SP_ADD /end CHARACTERISTIC
/begin CHARACTERISTIC c_tco_dif_1_tco_2_sp_add "TCO_DIF threshold to activate TCO_2_SP_COR_2 offset" VALUE 0x850014 _REC_VAL_20_s1 191.25 _CNV_A_R_LINEAR_____260_CM -96. 95.25 DISPLAY_IDENTIFIER C_TCO_DIF_1_TCO_2_SP_ADD FORMAT "%4.1" /end CHARACTERISTIC
/begin CHARACTERISTIC c_tco_dif_2_tco_2_sp_add "TCO_DIF threshold to activate TCO_2_SP_COR_2 offset" VALUE 0x850015 _REC_VAL_20_s1 191.25 _CNV_A_R_LINEAR_____260_CM -96. 95.25 DISPLAY_IDENTIFIER C_TCO_DIF_2_TCO_2_SP_ADD FORMAT "%4.1" /end CHARACTERISTIC
/begin CHARACTERISTIC c_t_dly_1_tco_2_sp_add "Time to activate TCO_2_SP_COR_2 offset" VALUE 0x84ff60 _REC_VAL_20_u1 255. _CNV_A_R_LINEAR_____27_CM 0. 255. DISPLAY_IDENTIFIER C_T_DLY_1_TCO_2_SP_ADD FORMAT "%3.0" /end CHARACTERISTIC
/begin CHARACTERISTIC c_t_dly_2_tco_2_sp_add "Time to deactivate TCO_2_SP_COR_2 offset" VALUE 0x84ff61 _REC_VAL_20_u1 255. _CNV_A_R_LINEAR_____27_CM 0. 255. DISPLAY_IDENTIFIER C_T_DLY_2_TCO_2_SP_ADD FORMAT "%3.0" /end CHARACTERISTIC
/begin CHARACTERISTIC c_tco_2_sp_sub "TCO_2_SP substitute value in case of relevant error active" VALUE 0x850010 _REC_VAL_20_u1 190.5 _CNV_A_R_LINEAR_____257_CM -48. 142.5 DISPLAY_IDENTIFIER C_TCO_2_SP_SUB FORMAT "%6.2" /end CHARACTERISTIC
/begin CHARACTERISTIC c_tco_2_sub_cool_req "TCO_2 substitute value in case of relevant error active" VALUE 0x850011 _REC_VAL_20_u1 190.5 _CNV_A_R_LINEAR_____257_CM -48. 142.5 DISPLAY_IDENTIFIER C_TCO_2_SUB_COOL_REQ FORMAT "%6.2" /end CHARACTERISTIC
/begin CHARACTERISTIC c_vs_cool_req_sub "VS substitute value in case of relevant error active" VALUE 0x8500f2 _REC_VAL_20_u1 255. _CNV_A_R_LINEAR_____245_CM 0. 255. DISPLAY_IDENTIFIER C_VS_COOL_REQ_SUB FORMAT "%3.0" /end CHARACTERISTIC
/begin CHARACTERISTIC c_tco_2_dif_hys "Hysteresis for activation COOL_REQ_ENG integral controler" VALUE 0x85000b _REC_VAL_20_s1 191.25 _CNV_A_R_LINEAR_____260_CM -96. 95.25 DISPLAY_IDENTIFIER C_TCO_2_DIF_HYS FORMAT "%4.1" /end CHARACTERISTIC
/begin AXIS_PTS ldp_tco__cool_req_eng_tco "" 0x844221 tco _REC_AXS_20_u1 190.5 _CNV_A_R_LINEAR_____241_CM 8 -48. 142.5 FORMAT "%5.1" /end AXIS_PTS
/begin AXIS_PTS ldp_tam__cool_req_eng_tco "" 0x8441c4 tam _REC_AXS_20_u1 190.5 _CNV_A_R_LINEAR_____241_CM 8 -48. 142.5 FORMAT "%5.1" /end AXIS_PTS
/begin CHARACTERISTIC ip_cool_req_eng_tco "relative engine cooling request vs. TCO and TAM" MAP 0x845086 _REC_MAP_20_u1_u1_u1 99.609375 _CNV_A_R_LINEAR_____79_CM 0. 99.609375 DISPLAY_IDENTIFIER IP_COOL_REQ_ENG_TCO FORMAT "%4.1"
 /begin AXIS_DESCR COM_AXIS tco _CNV_A_R_LINEAR_____241_CM 8 -48. 142.5 FORMAT "%5.1" AXIS_PTS_REF ldp_tco__cool_req_eng_tco /end AXIS_DESCR
 /begin AXIS_DESCR COM_AXIS tam _CNV_A_R_LINEAR_____241_CM 8 -48. 142.5 FORMAT "%5.1" AXIS_PTS_REF ldp_tam__cool_req_eng_tco /end AXIS_DESCR
/end CHARACTERISTIC
/begin AXIS_PTS ldp_tco_dif__cool_req_eng_dyn "" 0x84425e tco_dif _REC_AXS_20_u1 191.25 _CNV_A_R_LINEAR_____261_CM 8 -96. 95.25 FORMAT "%4.1" /end AXIS_PTS
/begin AXIS_PTS ldp_tco_1_2__cool_req_eng_dyn "" 0x8441f4 tco_1_2 _REC_AXS_20_u1 190.5 _CNV_A_R_LINEAR_____249_CM 8 0. 190.5 FORMAT "%5.1" /end AXIS_PTS
/begin CHARACTERISTIC ip_cool_req_eng_dyn "relative engine cooling request vs. TCO_DIF and TCO_1_2" MAP 0x845035 _REC_MAP_20_u1_u1_u1 99.609375 _CNV_A_R_LINEAR_____79_CM 0. 99.609375 DISPLAY_IDENTIFIER IP_COOL_REQ_ENG_DYN FORMAT "%4.1"
 /begin AXIS_DESCR COM_AXIS tco_dif _CNV_A_R_LINEAR_____261_CM 8 -96. 95.25 FORMAT "%4.1" AXIS_PTS_REF ldp_tco_dif__cool_req_eng_dyn /end AXIS_DESCR
 /begin AXIS_DESCR COM_AXIS tco_1_2 _CNV_A_R_LINEAR_____249_CM 8 0. 190.5 FORMAT "%5.1" AXIS_PTS_REF ldp_tco_1_2__cool_req_eng_dyn /end AXIS_DESCR
/end CHARACTERISTIC
/begin AXIS_PTS ldp_cool_req_eng_inter__cool_req_eng_cor "" 0x843f95 cool_req_eng_inter _REC_AXS_20_u1 99.609375 _CNV_A_R_LINEAR_____79_CM 8 0. 99.609375 FORMAT "%4.1" /end AXIS_PTS
/begin AXIS_PTS ldp_vs_cool_req__cool_req_eng_cor "" 0x84436a vs_cool_req _REC_AXS_20_u1 255. _CNV_A_R_LINEAR_____245_CM 8 0. 255. FORMAT "%3.0" /end AXIS_PTS
/begin CHARACTERISTIC ip_cool_req_eng_cor "Correction map for additional relative engine cooling request vs vehicle speed" MAP 0x844ff5 _REC_MAP_20_u1_u1_u1 99.609375 _CNV_A_R_LINEAR_____79_CM 0. 99.609375 DISPLAY_IDENTIFIER IP_COOL_REQ_ENG_COR FORMAT "%4.1"
 /begin AXIS_DESCR COM_AXIS cool_req_eng_inter _CNV_A_R_LINEAR_____79_CM 8 0. 99.609375 FORMAT "%4.1" AXIS_PTS_REF ldp_cool_req_eng_inter__cool_req_eng_cor /end AXIS_DESCR
 /begin AXIS_DESCR COM_AXIS vs_cool_req _CNV_A_R_LINEAR_____245_CM 8 0. 255. FORMAT "%3.0" AXIS_PTS_REF ldp_vs_cool_req__cool_req_eng_cor /end AXIS_DESCR
/end CHARACTERISTIC
/begin AXIS_PTS ldp_n__tco_2_sp_1 "" 0x844096 n _REC_AXS_20_u2 8160. _CNV_A_R_LINEAR_____154_CM 8 0. 8160. FORMAT "%4.0" /end AXIS_PTS
/begin AXIS_PTS ldp_tqi_req_slow__tco_2_sp_1 "" 0x844300 tqi_req_slow _REC_AXS_20_u2 2047.97875 _CNV_A_R_LINEAR_____80_CM 8 -1024. 1023.97875 FORMAT "%8.2" /end AXIS_PTS
/begin CHARACTERISTIC ip_tco_2_sp_1 "Basic TCO_2_SP map" MAP 0x84f0fe _REC_MAP_20_u1_u2_u2 190.5 _CNV_A_R_LINEAR_____241_CM -48. 142.5 DISPLAY_IDENTIFIER IP_TCO_2_SP_1 FORMAT "%5.1"
 /begin AXIS_DESCR COM_AXIS n _CNV_A_R_LINEAR_____154_CM 8 0. 8160. FORMAT "%4.0" AXIS_PTS_REF ldp_n__tco_2_sp_1 /end AXIS_DESCR
 /begin AXIS_DESCR COM_AXIS tqi_req_slow _CNV_A_R_LINEAR_____80_CM 8 -1024. 1023.97875 FORMAT "%8.2" AXIS_PTS_REF ldp_tqi_req_slow__tco_2_sp_1 /end AXIS_DESCR
/end CHARACTERISTIC
/begin AXIS_PTS ldp_tco_inp__tco_2_sp_3 "" 0x844286 tco_inp _REC_AXS_20_u1 190.5 _CNV_A_R_LINEAR_____241_CM 8 -48. 142.5 FORMAT "%5.1" /end AXIS_PTS
/begin AXIS_PTS ldp_tco_2_sp_mmv__tco_2_sp_3 "" 0x844218 tco_2_sp_mmv _REC_AXS_20_u1 190.5 _CNV_A_R_LINEAR_____241_CM 8 -48. 142.5 FORMAT "%5.1" /end AXIS_PTS
/begin CHARACTERISTIC ip_tco_2_sp_3 "Correction map for TCO_2_SP" MAP 0x84f17e _REC_MAP_20_u1_u1_u1 190.5 _CNV_A_R_LINEAR_____241_CM -48. 142.5 DISPLAY_IDENTIFIER IP_TCO_2_SP_3 FORMAT "%5.1"
 /begin AXIS_DESCR COM_AXIS tco_inp _CNV_A_R_LINEAR_____241_CM 8 -48. 142.5 FORMAT "%5.1" AXIS_PTS_REF ldp_tco_inp__tco_2_sp_3 /end AXIS_DESCR
 /begin AXIS_DESCR COM_AXIS tco_2_sp_mmv _CNV_A_R_LINEAR_____241_CM 8 -48. 142.5 FORMAT "%5.1" AXIS_PTS_REF ldp_tco_2_sp_mmv__tco_2_sp_3 /end AXIS_DESCR
/end CHARACTERISTIC
/begin AXIS_PTS ldp_tco__tco_2_sp_2 "" 0x844246 tco _REC_AXS_20_u1 190.5 _CNV_A_R_LINEAR_____241_CM 8 -48. 142.5 FORMAT "%5.1" /end AXIS_PTS
/begin AXIS_PTS ldp_tam__tco_2_sp_2 "" 0x8441eb tam _REC_AXS_20_u1 190.5 _CNV_A_R_LINEAR_____241_CM 8 -48. 142.5 FORMAT "%5.1" /end AXIS_PTS
/begin CHARACTERISTIC ip_tco_2_sp_2 "Correction map for TCO_2_SP" MAP 0x84f13e _REC_MAP_20_u1_u1_u1 190.5 _CNV_A_R_LINEAR_____241_CM -48. 142.5 DISPLAY_IDENTIFIER IP_TCO_2_SP_2 FORMAT "%5.1"
 /begin AXIS_DESCR COM_AXIS tco _CNV_A_R_LINEAR_____241_CM 8 -48. 142.5 FORMAT "%5.1" AXIS_PTS_REF ldp_tco__tco_2_sp_2 /end AXIS_DESCR
 /begin AXIS_DESCR COM_AXIS tam _CNV_A_R_LINEAR_____241_CM 8 -48. 142.5 FORMAT "%5.1" AXIS_PTS_REF ldp_tam__tco_2_sp_2 /end AXIS_DESCR
/end CHARACTERISTIC
/begin AXIS_PTS ldp_n__fac_tco_2_sp_cor "" 0x844070 n _REC_AXS_20_u2 8160. _CNV_A_R_LINEAR_____154_CM 8 0. 8160. FORMAT "%4.0" /end AXIS_PTS
/begin CHARACTERISTIC ip_fac_tco_2_sp_cor "Factor on TCO_2_SP_2 to regard volumetric flow of coolant" CURVE 0x84841d _REC_CUR_20_u1_u2 25.5 _CNV_A_R_LINEAR_____263_CM 0. 25.5 DISPLAY_IDENTIFIER IP_FAC_TCO_2_SP_COR FORMAT "%4.1"
 /begin AXIS_DESCR COM_AXIS n _CNV_A_R_LINEAR_____154_CM 8 0. 8160. FORMAT "%4.0" AXIS_PTS_REF ldp_n__fac_tco_2_sp_cor /end AXIS_DESCR
/end CHARACTERISTIC
/begin AXIS_PTS ldp_tco_dif__tco_2_sp_cor_2 "" 0x84427d tco_dif _REC_AXS_20_u1 191.25 _CNV_A_R_LINEAR_____261_CM 8 -96. 95.25 FORMAT "%4.1" /end AXIS_PTS
/begin AXIS_PTS ldp_tco_1_2__tco_2_sp_cor_2 "" 0x8441fd tco_1_2 _REC_AXS_20_u1 190.5 _CNV_A_R_LINEAR_____249_CM 8 0. 190.5 FORMAT "%5.1" /end AXIS_PTS
/begin CHARACTERISTIC ip_tco_2_sp_cor_2 "Correction map on TCO_2_SP_5" MAP 0x84f1be _REC_MAP_20_u1_u1_u1 190.5 _CNV_A_R_LINEAR_____241_CM -48. 142.5 DISPLAY_IDENTIFIER IP_TCO_2_SP_COR_2 FORMAT "%5.1"
 /begin AXIS_DESCR COM_AXIS tco_dif _CNV_A_R_LINEAR_____261_CM 8 -96. 95.25 FORMAT "%4.1" AXIS_PTS_REF ldp_tco_dif__tco_2_sp_cor_2 /end AXIS_DESCR
 /begin AXIS_DESCR COM_AXIS tco_1_2 _CNV_A_R_LINEAR_____249_CM 8 0. 190.5 FORMAT "%5.1" AXIS_PTS_REF ldp_tco_1_2__tco_2_sp_cor_2 /end AXIS_DESCR
/end CHARACTERISTIC
/begin AXIS_PTS ldp_vs_cool_req__cool_req_eng_bas "" 0x844361 vs_cool_req _REC_AXS_20_u1 255. _CNV_A_R_LINEAR_____245_CM 8 0. 255. FORMAT "%3.0" /end AXIS_PTS
/begin AXIS_PTS ldp_tco_2_dif__cool_req_eng_bas "" 0x844206 tco_2_dif _REC_AXS_20_u1 191.25 _CNV_A_R_LINEAR_____261_CM 8 -96. 95.25 FORMAT "%4.1" /end AXIS_PTS
/begin CHARACTERISTIC ip_cool_req_eng_bas "Basic map for engine cooling request if TCO_2_SP model is used" MAP 0x844fb5 _REC_MAP_20_u1_u1_u1 99.609375 _CNV_A_R_LINEAR_____79_CM 0. 99.609375 DISPLAY_IDENTIFIER IP_COOL_REQ_ENG_BAS FORMAT "%4.1"
 /begin AXIS_DESCR COM_AXIS vs_cool_req _CNV_A_R_LINEAR_____245_CM 8 0. 255. FORMAT "%3.0" AXIS_PTS_REF ldp_vs_cool_req__cool_req_eng_bas /end AXIS_DESCR
 /begin AXIS_DESCR COM_AXIS tco_2_dif _CNV_A_R_LINEAR_____261_CM 8 -96. 95.25 FORMAT "%4.1" AXIS_PTS_REF ldp_tco_2_dif__cool_req_eng_bas /end AXIS_DESCR
/end CHARACTERISTIC
/begin AXIS_PTS ldp_tco_2_dif__cool_req_eng_i "" 0x84420f tco_2_dif _REC_AXS_20_u1 191.25 _CNV_A_R_LINEAR_____261_CM 8 -96. 95.25 FORMAT "%4.1" /end AXIS_PTS
/begin CHARACTERISTIC ip_cool_req_eng_i "Integral controler for small deviations between TCO_2_SP and TCO_2" CURVE 0x845076 _REC_CUR_20_u2_u1 199.9969482 _CNV_A_R_LINEAR_____161_CM -100. 99.99694820000001 DISPLAY_IDENTIFIER IP_COOL_REQ_ENG_I FORMAT "%8.3"
 /begin AXIS_DESCR COM_AXIS tco_2_dif _CNV_A_R_LINEAR_____261_CM 8 -96. 95.25 FORMAT "%4.1" AXIS_PTS_REF ldp_tco_2_dif__cool_req_eng_i /end AXIS_DESCR
/end CHARACTERISTIC
/begin MEASUREMENT cool_req_ac "" UBYTE _CNV_A_R_LINEAR_____79_CM 1 0. 0. 40. DISPLAY_IDENTIFIER COOL_REQ_AC ECU_ADDRESS 0x7fbb01 FORMAT "%4.1" /end MEASUREMENT
/begin MEASUREMENT acp_cor "corrected air conditioning pressure value" UBYTE _CNV_A_R_LINEAR_____256_CM 1 0. 0. 40. DISPLAY_IDENTIFIER ACP_COR ECU_ADDRESS 0x7fbf32 FORMAT "%5.1" /end MEASUREMENT
/begin MEASUREMENT cool_req_ac_acp "relative cooling request by calculation based on ACP" UBYTE _CNV_A_R_LINEAR_____79_CM 1 0. 0. 40. DISPLAY_IDENTIFIER COOL_REQ_AC_ACP ECU_ADDRESS 0x7fbf33 FORMAT "%4.1" /end MEASUREMENT
/begin MEASUREMENT cool_req_ac_can "relative cooling request by calculation based on ACC_CAN message" UBYTE _CNV_A_R_LINEAR_____79_CM 1 0. 0. 40. DISPLAY_IDENTIFIER COOL_REQ_AC_CAN ECU_ADDRESS 0x7fbf34 FORMAT "%4.1" /end MEASUREMENT
/begin MEASUREMENT cool_req_ac_inter "Relative cooling request intermediate value" UBYTE _CNV_A_R_LINEAR_____79_CM 1 0. 0. 99.609375 DISPLAY_IDENTIFIER COOL_REQ_AC_INTER ECU_ADDRESS 0x7fbf35 FORMAT "%4.1" /end MEASUREMENT
/begin CHARACTERISTIC c_acp_cool_req_hys "hysteresis for ACP_COR calculation" VALUE 0x84fb87 _REC_VAL_20_u1 40. _CNV_A_R_LINEAR_____256_CM 0. 40. DISPLAY_IDENTIFIER C_ACP_COOL_REQ_HYS FORMAT "%4.1" /end CHARACTERISTIC
/begin CHARACTERISTIC c_acp_sub_cool_req_ac "substitute value for ACP_COR in case of failure ACP" VALUE 0x84fb8e _REC_VAL_20_u1 40. _CNV_A_R_LINEAR_____256_CM 0. 40. DISPLAY_IDENTIFIER C_ACP_SUB_COOL_REQ_AC FORMAT "%4.1" /end CHARACTERISTIC
/begin CHARACTERISTIC c_acp_cool_req_inc "Increment for ACP quantizer" VALUE 0x84fb88 _REC_VAL_20_u1 40. _CNV_A_R_LINEAR_____256_CM 0. 40. DISPLAY_IDENTIFIER C_ACP_COOL_REQ_INC FORMAT "%4.1" /end CHARACTERISTIC
/begin CHARACTERISTIC c_acp_cool_req_dec "Decrement for ACP quantizer" VALUE 0x84fb86 _REC_VAL_20_u1 40. _CNV_A_R_LINEAR_____256_CM 0. 40. DISPLAY_IDENTIFIER C_ACP_COOL_REQ_DEC FORMAT "%4.1" /end CHARACTERISTIC
/begin AXIS_PTS ldp_ecf_req_ac_can__cool_req "" 0x843fbc ecf_req_ac_can _REC_AXS_20_u1 99.609375 _CNV_A_R_LINEAR_____79_CM 8 0. 99.609375 FORMAT "%4.1" /end AXIS_PTS
/begin CHARACTERISTIC ip_cool_req_ac_can "map to derive relative cooling request out of CAN cooling request message" CURVE 0x844fa9 _REC_CUR_20_u1_u1 99.609375 _CNV_A_R_LINEAR_____79_CM 0. 99.609375 DISPLAY_IDENTIFIER IP_COOL_REQ_AC_CAN FORMAT "%4.1"
 /begin AXIS_DESCR COM_AXIS ecf_req_ac_can _CNV_A_R_LINEAR_____79_CM 8 0. 99.609375 FORMAT "%4.1" AXIS_PTS_REF ldp_ecf_req_ac_can__cool_req /end AXIS_DESCR
/end CHARACTERISTIC
/begin AXIS_PTS ldpm_acp_cor__cool_req_acp "" 0x8443fe acp_cor _REC_AXS_20_u1 40. _CNV_A_R_LINEAR_____256_CM 8 0. 40. FORMAT "%4.1" /end AXIS_PTS
/begin CHARACTERISTIC ip_cool_req_ac_acp_act "Map to derive relative cooling request out of ACP message (ACC active)" CURVE 0x844f99 _REC_CUR_20_u1_u1 99.609375 _CNV_A_R_LINEAR_____79_CM 0. 99.609375 DISPLAY_IDENTIFIER IP_COOL_REQ_AC_ACP_ACT FORMAT "%4.1"
 /begin AXIS_DESCR COM_AXIS acp_cor _CNV_A_R_LINEAR_____256_CM 8 0. 40. FORMAT "%4.1" AXIS_PTS_REF ldpm_acp_cor__cool_req_acp /end AXIS_DESCR
/end CHARACTERISTIC
/begin CHARACTERISTIC ip_cool_req_ac_acp_deac "Map to derive relative cooling request out of ACP message (ACC inactive)" CURVE 0x844fa1 _REC_CUR_20_u1_u1 99.609375 _CNV_A_R_LINEAR_____79_CM 0. 99.609375 DISPLAY_IDENTIFIER IP_COOL_REQ_AC_ACP_DEAC FORMAT "%4.1"
 /begin AXIS_DESCR COM_AXIS acp_cor _CNV_A_R_LINEAR_____256_CM 8 0. 40. FORMAT "%4.1" AXIS_PTS_REF ldpm_acp_cor__cool_req_acp /end AXIS_DESCR
/end CHARACTERISTIC
/begin AXIS_PTS ldp_vs__fac_cool_req_ac_vs "" 0x844346 vs _REC_AXS_20_u1 255. _CNV_A_R_LINEAR_____245_CM 8 0. 255. FORMAT "%3.0" /end AXIS_PTS
/begin CHARACTERISTIC ip_fac_cool_req_ac_vs "Factor on COOL_REQ_AC_INTER regarding VS" CURVE 0x847f1f _REC_CUR_20_u1_u1 15.9375 _CNV_A_R_LINEAR_____251_CM 0. 15.9375 DISPLAY_IDENTIFIER IP_FAC_COOL_REQ_AC_VS FORMAT "%5.2"
 /begin AXIS_DESCR COM_AXIS vs _CNV_A_R_LINEAR_____245_CM 8 0. 255. FORMAT "%3.0" AXIS_PTS_REF ldp_vs__fac_cool_req_ac_vs /end AXIS_DESCR
/end CHARACTERISTIC
/begin MEASUREMENT tco_inp "" UBYTE _CNV_A_R_LINEAR_____241_CM 1 0. -48. 142.5 DISPLAY_IDENTIFIER TCO_INP ECU_ADDRESS 0x7fbf36 FORMAT "%5.1" /end MEASUREMENT
/begin MEASUREMENT lv_err_tia "Error flag for diagnostics instance ACP_MES_GRD" UBYTE _CNV_S_2_RANGE______11_CM 1 0. 0. 1. DISPLAY_IDENTIFIER LV_ERR_TIA ECU_ADDRESS 0x7fb840 /end MEASUREMENT
/begin CHARACTERISTIC c_abc_inc_v_dcdc_rng "anti bounce counter increment for diagnosis instance V_DCDC_RNG" VALUE 0x84fae1 _REC_VAL_20_u1 255. _CNV_A_R_LINEAR_____0_CM 0. 255. DISPLAY_IDENTIFIER C_ABC_INC_V_DCDC_RNG FORMAT "%3.0" /end CHARACTERISTIC
/begin CHARACTERISTIC c_abc_max_v_dcdc_rng "maximum value of anti bounce counter for diagnosis instance V_DCDC_RNG" VALUE 0x84fb6d _REC_VAL_20_u1 255. _CNV_A_R_LINEAR_____0_CM 0. 255. DISPLAY_IDENTIFIER C_ABC_MAX_V_DCDC_RNG FORMAT "%3.0" /end CHARACTERISTIC
/begin MEASUREMENT t_dcdc_diag "" UBYTE _CNV_A_R_LINEAR_____19_CM 1 0. 0. 25.5 DISPLAY_IDENTIFIER T_DCDC_DIAG ECU_ADDRESS 0x7fbdf3 FORMAT "%3.1" /end MEASUREMENT
/begin CHARACTERISTIC c_t_dcdc_diag "" VALUE 0x85cc14 _REC_VAL_20_u1 25.5 _CNV_A_R_LINEAR_____19_CM 0. 25.5 DISPLAY_IDENTIFIER C_T_DCDC_DIAG FORMAT "%3.2" /end CHARACTERISTIC
/begin CHARACTERISTIC c_v_dcdc_min_diag "" VALUE 0x85cd72 _REC_VAL_20_u2 96.32231400000001 _CNV_A_R_LINEAR_____269_CM 0. 96.32231400000001 DISPLAY_IDENTIFIER C_V_DCDC_MIN_DIAG FORMAT "%4.2" /end CHARACTERISTIC
/begin CHARACTERISTIC c_v_dcdc_max_diag "" VALUE 0x85cd70 _REC_VAL_20_u2 96.32231400000001 _CNV_A_R_LINEAR_____269_CM 0. 96.32231400000001 DISPLAY_IDENTIFIER C_V_DCDC_MAX_DIAG FORMAT "%4.2" /end CHARACTERISTIC
/begin MEASUREMENT lv_oil_level1_nplaus "Fuellstand 1 unplausibel" UBYTE _CNV_S_2_RANGE__0___85_CM 1 0. 0. 1. DISPLAY_IDENTIFIER LV_OIL_LEVEL1_NPLAUS ECU_ADDRESS 0x7fc027 BIT_MASK 0x1 /end MEASUREMENT
/begin MEASUREMENT lv_oil_level2_nplaus "Fuellstand 2 unplausibel" UBYTE _CNV_S_2_RANGE__0___85_CM 1 0. 0. 1. DISPLAY_IDENTIFIER LV_OIL_LEVEL2_NPLAUS ECU_ADDRESS 0x7fc028 BIT_MASK 0x1 /end MEASUREMENT
/begin MEASUREMENT lv_oil_level3_nplaus "Fuellstand 3 unplausibel" UBYTE _CNV_S_2_RANGE__0___85_CM 1 0. 0. 1. DISPLAY_IDENTIFIER LV_OIL_LEVEL3_NPLAUS ECU_ADDRESS 0x7fc029 BIT_MASK 0x1 /end MEASUREMENT
/begin MEASUREMENT lv_oil_level4_nplaus "Fuellstand 4 unplausibel" UBYTE _CNV_S_2_RANGE__0___85_CM 1 0. 0. 1. DISPLAY_IDENTIFIER LV_OIL_LEVEL4_NPLAUS ECU_ADDRESS 0x7fc02a BIT_MASK 0x1 /end MEASUREMENT
/begin MEASUREMENT lv_oil_level4_chk "Bereichsckeck Fuellstand 4" UBYTE _CNV_S_2_RANGE__0___85_CM 1 0. 0. 1. DISPLAY_IDENTIFIER LV_OIL_LEVEL4_CHK ECU_ADDRESS 0x7fc026 BIT_MASK 0x1 /end MEASUREMENT
/begin MEASUREMENT lv_oil_level1_chk "Bereichsckeck Fuellstand 1" UBYTE _CNV_S_2_RANGE__0___85_CM 1 0. 0. 1. DISPLAY_IDENTIFIER LV_OIL_LEVEL1_CHK ECU_ADDRESS 0x7fc023 BIT_MASK 0x1 /end MEASUREMENT
/begin MEASUREMENT lv_oil_level2_chk "Bereichsckeck Fuellstand 2" UBYTE _CNV_S_2_RANGE__0___85_CM 1 0. 0. 1. DISPLAY_IDENTIFIER LV_OIL_LEVEL2_CHK ECU_ADDRESS 0x7fc024 BIT_MASK 0x1 /end MEASUREMENT
/begin MEASUREMENT lv_oil_level3_chk "Bereichsckeck Fuellstand 3" UBYTE _CNV_S_2_RANGE__0___85_CM 1 0. 0. 1. DISPLAY_IDENTIFIER LV_OIL_LEVEL3_CHK ECU_ADDRESS 0x7fc025 BIT_MASK 0x1 /end MEASUREMENT
/begin MEASUREMENT oil_level2_vol "Fuellstand 2 in l" SWORD _CNV_A_R_LINEAR_____293_CM 1 0. -2.048 2.0479375 DISPLAY_IDENTIFIER OIL_LEVEL2_VOL ECU_ADDRESS 0x7fb51a BYTE_ORDER MSB_LAST FORMAT "%8.6" /end MEASUREMENT
/begin MEASUREMENT oil_level3_vol "Fuellstand 3 in l" SWORD _CNV_A_R_LINEAR_____293_CM 1 0. -2.048 2.0479375 DISPLAY_IDENTIFIER OIL_LEVEL3_VOL ECU_ADDRESS 0x7fb51c BYTE_ORDER MSB_LAST FORMAT "%8.6" /end MEASUREMENT
/begin MEASUREMENT oil_level4_vol "Fuellstand 4 in l" SWORD _CNV_A_R_LINEAR_____293_CM 1 0. -2.048 2.0479375 DISPLAY_IDENTIFIER OIL_LEVEL4_VOL ECU_ADDRESS 0x7fb51e BYTE_ORDER MSB_LAST FORMAT "%8.6" /end MEASUREMENT
/begin MEASUREMENT oil_level_sum_cor "Summe Oelstand mit Guetefaktor" SWORD _CNV_A_R_LINEAR_____294_CM 1 0. -8192. 8191.75 DISPLAY_IDENTIFIER OIL_LEVEL_SUM_COR ECU_ADDRESS 0x7fa33e BYTE_ORDER MSB_LAST FORMAT "%7.2" /end MEASUREMENT
/begin CHARACTERISTIC c_t_oil_level_min "minimale Fuellstandszeit" VALUE 0x84ffdc _REC_VAL_20_u2 1023.5 _CNV_A_R_LINEAR_____295_CM 100. 1123.5 DISPLAY_IDENTIFIER C_T_OIL_LEVEL_MIN FORMAT "%6.1" /end CHARACTERISTIC
/begin CHARACTERISTIC c_t_oil_level_max "maximale Fuellstandszeit" VALUE 0x84ffda _REC_VAL_20_u2 1023.5 _CNV_A_R_LINEAR_____295_CM 100. 1123.5 DISPLAY_IDENTIFIER C_T_OIL_LEVEL_MAX FORMAT "%6.1" /end CHARACTERISTIC
/begin AXIS_PTS ldp_t_oil_level1_can "" 0x8441ae online_dummy _REC_AXS_20_u2 1023.5 _CNV_A_R_LINEAR_____295_CM 10 100. 1123.5 FORMAT "%6.1" /end AXIS_PTS
/begin CHARACTERISTIC ip_oil_level_t_cool_wiv "Kennlinie Kuehlstand-Fuellstand" CURVE 0x84d51e _REC_CUR_20_u2_u2 127. _CNV_A_R_LINEAR_____296_CM 0. 127. DISPLAY_IDENTIFIER IP_OIL_LEVEL_T_COOL_WIV FORMAT "%8.4"
 /begin AXIS_DESCR COM_AXIS online_dummy _CNV_A_R_LINEAR_____295_CM 10 100. 1123.5 FORMAT "%6.1" AXIS_PTS_REF ldp_t_oil_level1_can /end AXIS_DESCR
/end CHARACTERISTIC
/begin MEASUREMENT oil_level_ctr "Oelstandszaehler" UBYTE _CNV_A_R_LINEAR_____1_CM 1 0. 0. 255. DISPLAY_IDENTIFIER OIL_LEVEL_CTR ECU_ADDRESS 0x7fbc21 FORMAT "%3.0" /end MEASUREMENT
/begin MEASUREMENT oil_level_dif_mv_sho "Kurzzeitmittelwert" UBYTE _CNV_A_R_LINEAR_____297_CM 1 0. -1905. 1920. DISPLAY_IDENTIFIER OIL_LEVEL_DIF_MV_SHO ECU_ADDRESS 0x7fbc22 FORMAT "%5.0" /end MEASUREMENT
/begin MEASUREMENT lv_oil_warn "Oelwarnung" UBYTE _CNV_S_2_RANGE__0___85_CM 1 0. 0. 1. DISPLAY_IDENTIFIER LV_OIL_WARN ECU_ADDRESS 0x7fbc2a BIT_MASK 0x1 /end MEASUREMENT
/begin MEASUREMENT lv_oil_sens_warn "Sensorwarnung" UBYTE _CNV_S_2_RANGE__0___85_CM 1 0. 0. 1. DISPLAY_IDENTIFIER LV_OIL_SENS_WARN ECU_ADDRESS 0x7fbc29 BIT_MASK 0x1 /end MEASUREMENT
/begin CHARACTERISTIC c_oil_level_ctr_sub "Ersatzwert Oelstandszaehler" VALUE 0x84feb5 _REC_VAL_20_u1 255. _CNV_A_R_LINEAR_____1_CM 0. 255. DISPLAY_IDENTIFIER C_OIL_LEVEL_CTR_SUB FORMAT "%3.0" /end CHARACTERISTIC
/begin CHARACTERISTIC c_oil_level_dif_mv_sho_sub "Ersatzwert Kurzeitmittelwert" VALUE 0x84feb6 _REC_VAL_20_u1 3825. _CNV_A_R_LINEAR_____297_CM -1905. 1920. DISPLAY_IDENTIFIER C_OIL_LEVEL_DIF_MV_SHO_SUB FORMAT "%5.0" /end CHARACTERISTIC
/begin MEASUREMENT lv_emsf_state_2 "Toggelbit Oefuellstand" UBYTE _CNV_S_2_RANGE__0___85_CM 1 0. 0. 1. DISPLAY_IDENTIFIER LV_EMSF_STATE_2 ECU_ADDRESS 0x7fbc28 BIT_MASK 0x1 /end MEASUREMENT
/begin MEASUREMENT lv_fcn_clc_4400 "Trigger 4400 ms" UBYTE _CNV_S_2_RANGE__0___85_CM 1 0. 0. 1. DISPLAY_IDENTIFIER LV_FCN_CLC_4400 ECU_ADDRESS 0x7fc02b BIT_MASK 0x1 /end MEASUREMENT
/begin MEASUREMENT lv_fcn_clc_2400 "Trigger 2400 ms" UBYTE _CNV_S_2_RANGE__0___85_CM 1 0. 0. 1. DISPLAY_IDENTIFIER LV_FCN_CLC_2400 ECU_ADDRESS 0x7fc021 BIT_MASK 0x1 /end MEASUREMENT
/begin MEASUREMENT ctr_fcn_clc_4400 "Zaehler 4400 ms" UBYTE _CNV_A_R_LINEAR_____1_CM 1 0. 0. 255. DISPLAY_IDENTIFIER CTR_FCN_CLC_4400 ECU_ADDRESS 0x7fc01a FORMAT "%3.0" /end MEASUREMENT
/begin MEASUREMENT ctr_fcn_clc_2400 "Zaehler 2400 ms" UBYTE _CNV_A_R_LINEAR_____1_CM 1 0. 0. 255. DISPLAY_IDENTIFIER CTR_FCN_CLC_2400 ECU_ADDRESS 0x7fc016 FORMAT "%3.0" /end MEASUREMENT
/begin MEASUREMENT wear_fco_equ "Verbrauchaequivalent" UWORD _CNV_A_R_LINEAR_____298_CM 1 0. 0. 1.3107e-003 DISPLAY_IDENTIFIER WEAR_FCO_EQU ECU_ADDRESS 0x7fa336 BYTE_ORDER MSB_LAST FORMAT "%10.8" /end MEASUREMENT
/begin MEASUREMENT lv_emsf_state_1_tmp "Toggelbit Aequivalent lokal" UBYTE _CNV_S_2_RANGE__0___85_CM 1 0. 0. 1. DISPLAY_IDENTIFIER LV_EMSF_STATE_1_TMP ECU_ADDRESS 0x7fc020 BIT_MASK 0x1 /end MEASUREMENT
/begin MEASUREMENT fac_oil_wiv "Bewertungsfaktor" UWORD _CNV_A_R_LINEAR_____299_CM 1 0. 0. 0.13107 DISPLAY_IDENTIFIER FAC_OIL_WIV ECU_ADDRESS 0x7fb514 BYTE_ORDER MSB_LAST FORMAT "%8.6" /end MEASUREMENT
/begin MEASUREMENT toil_wiv "Oeltemperatur aus WIV-Funktion" UBYTE _CNV_A_R_LINEAR_____300_CM 1 0. -60. 195. DISPLAY_IDENTIFIER TOIL_WIV ECU_ADDRESS 0x7fbc1e FORMAT "%3.0" /end MEASUREMENT
/begin MEASUREMENT lv_emsf_state_1 "Toggelbit Aequivalent" UBYTE _CNV_S_2_RANGE__0___85_CM 1 0. 0. 1. DISPLAY_IDENTIFIER LV_EMSF_STATE_1 ECU_ADDRESS 0x7fbc26 BIT_MASK 0x1 /end MEASUREMENT
/begin MEASUREMENT lv_oil_level_not_vld "Fuellstandsbereich nicht ok" UBYTE _CNV_S_2_RANGE__0___85_CM 1 0. 0. 1. DISPLAY_IDENTIFIER LV_OIL_LEVEL_NOT_VLD ECU_ADDRESS 0x7fbc24 BIT_MASK 0x1 /end MEASUREMENT
/begin MEASUREMENT oil_level_cor_wiv "kompensierte Oelniveauschwelle" UWORD _CNV_A_R_LINEAR_____301_CM 1 0. 0. 4095.9375 DISPLAY_IDENTIFIER OIL_LEVEL_COR_WIV ECU_ADDRESS 0x7fa338 BYTE_ORDER MSB_LAST FORMAT "%9.4" /end MEASUREMENT
/begin MEASUREMENT fac_qly_wiv_cor "Guetefaktor" UBYTE _CNV_A_R_LINEAR_____1_CM 1 0. 0. 255. DISPLAY_IDENTIFIER FAC_QLY_WIV_COR ECU_ADDRESS 0x7fbc1f FORMAT "%3.0" /end MEASUREMENT
/begin MEASUREMENT fac_level_estim_wiv "fuellstandsabhaengige Verbrauchsbewertung" UBYTE _CNV_A_R_LINEAR_____302_CM 1 0. 0. 12.75 DISPLAY_IDENTIFIER FAC_LEVEL_ESTIM_WIV ECU_ADDRESS 0x7fc01f FORMAT "%4.2" /end MEASUREMENT
/begin MEASUREMENT ac_trv_wiv_fil "Querbeschleunigung gefiltert" SWORD _CNV_A_R_LINEAR_____303_CM 1 0. -12.7 12.899609375 DISPLAY_IDENTIFIER AC_TRV_WIV_FIL ECU_ADDRESS 0x7fb516 BYTE_ORDER MSB_LAST FORMAT "%7.4" /end MEASUREMENT
/begin MEASUREMENT toil_wiv_clc "Oeltemperatur gerechnet" UBYTE _CNV_A_R_LINEAR_____300_CM 1 0. -60. 195. DISPLAY_IDENTIFIER TOIL_WIV_CLC ECU_ADDRESS 0x7fc015 FORMAT "%3.0" /end MEASUREMENT
/begin MEASUREMENT toil_wiv_raw "Oeltemperatur nach Kennlinie" UBYTE _CNV_A_R_LINEAR_____300_CM 1 0. -60. 195. DISPLAY_IDENTIFIER TOIL_WIV_RAW ECU_ADDRESS 0x7fc018 FORMAT "%3.0" /end MEASUREMENT
/begin CHARACTERISTIC c_toil_max_fac_chrg "Grenztemperatur Turbofaktor" VALUE 0x850045 _REC_VAL_20_u1 255. _CNV_A_R_LINEAR_____300_CM -60. 195. DISPLAY_IDENTIFIER C_TOIL_MAX_FAC_CHRG FORMAT "%3.0" /end CHARACTERISTIC
/begin CHARACTERISTIC c_fac_chrg "Turbofaktor" VALUE 0x84fcfa _REC_VAL_20_u1 7.96875 _CNV_A_R_LINEAR_____304_CM 0. 7.96875 DISPLAY_IDENTIFIER C_FAC_CHRG FORMAT "%4.2" /end CHARACTERISTIC
/begin CHARACTERISTIC c_fac_level_estim_wiv_cor "Ersatzwert oelabhaengige Verbrauchsbewertung" VALUE 0x84fd2e _REC_VAL_20_u1 12.75 _CNV_A_R_LINEAR_____302_CM 0. 12.75 DISPLAY_IDENTIFIER C_FAC_LEVEL_ESTIM_WIV_COR FORMAT "%4.2" /end CHARACTERISTIC
/begin CHARACTERISTIC lc_ac_trv_wiv_fil_use "Schalter Filterung Querbeschleunigung" VALUE 0x850106 _REC_VAL_20_u1 1. _CNV_A_R_LINEAR_____1_CM 0. 1. DISPLAY_IDENTIFIER LC_AC_TRV_WIV_FIL_USE FORMAT "%1.0" /end CHARACTERISTIC
/begin CHARACTERISTIC c_fac_ac_trv_wiv "Filterfaktor Querbeschleunigung" VALUE 0x84fcf8 _REC_VAL_20_u2 0.9999847412109381 _CNV_A_R_LINEAR_____137_CM 0. 0.9999847412109381 DISPLAY_IDENTIFIER C_FAC_AC_TRV_WIV FORMAT "%7.5" /end CHARACTERISTIC
/begin CHARACTERISTIC c_fac_n_wiv "Filterfaktor Motordrezahl" VALUE 0x84fd40 _REC_VAL_20_u2 0.9999847412109381 _CNV_A_R_LINEAR_____137_CM 0. 0.9999847412109381 DISPLAY_IDENTIFIER C_FAC_N_WIV FORMAT "%7.5" /end CHARACTERISTIC
/begin CHARACTERISTIC lc_toil_wiv_sub_use "Schalter Oelersatztemperatur" VALUE 0x850173 _REC_VAL_20_u1 1. _CNV_A_R_LINEAR_____1_CM 0. 1. DISPLAY_IDENTIFIER LC_TOIL_WIV_SUB_USE FORMAT "%1.0" /end CHARACTERISTIC
/begin CHARACTERISTIC lc_fac_qly_wiv_sub_use "Schalter Guetefaktor" VALUE 0x85012c _REC_VAL_20_u1 1. _CNV_A_R_LINEAR_____1_CM 0. 1. DISPLAY_IDENTIFIER LC_FAC_QLY_WIV_SUB_USE FORMAT "%1.0" /end CHARACTERISTIC
/begin CHARACTERISTIC c_n_max_oil_level "maximale Drehzahl fuer Fuellstaende" VALUE 0x84fdf6 _REC_VAL_20_u1 8160. _CNV_A_R_LINEAR_____81_CM 0. 8160. DISPLAY_IDENTIFIER C_N_MAX_OIL_LEVEL FORMAT "%4.0" /end CHARACTERISTIC
/begin CHARACTERISTIC c_n_min_oil_level "minimale Drehzahl fuer Fuellstaende" VALUE 0x84fdf8 _REC_VAL_20_u1 8160. _CNV_A_R_LINEAR_____81_CM 0. 8160. DISPLAY_IDENTIFIER C_N_MIN_OIL_LEVEL FORMAT "%4.0" /end CHARACTERISTIC
/begin CHARACTERISTIC c_toil_max_oil_level "maximale Oeltemperatur fuer Fuellstaende" VALUE 0x850046 _REC_VAL_20_u1 255. _CNV_A_R_LINEAR_____300_CM -60. 195. DISPLAY_IDENTIFIER C_TOIL_MAX_OIL_LEVEL FORMAT "%3.0" /end CHARACTERISTIC
/begin CHARACTERISTIC c_toil_min_oil_level "minimale Oeltemperatur fuer Fuellstaende" VALUE 0x850049 _REC_VAL_20_u1 255. _CNV_A_R_LINEAR_____300_CM -60. 195. DISPLAY_IDENTIFIER C_TOIL_MIN_OIL_LEVEL FORMAT "%3.0" /end CHARACTERISTIC
/begin CHARACTERISTIC c_toil_wiv_err "Fehlerwert Oeltemperatur" VALUE 0x850050 _REC_VAL_20_u1 255. _CNV_A_R_LINEAR_____300_CM -60. 195. DISPLAY_IDENTIFIER C_TOIL_WIV_ERR FORMAT "%3.0" /end CHARACTERISTIC
/begin CHARACTERISTIC c_toil_wiv_nvld "kein Wert Oeltemperatur" VALUE 0x850052 _REC_VAL_20_u1 255. _CNV_A_R_LINEAR_____300_CM -60. 195. DISPLAY_IDENTIFIER C_TOIL_WIV_NVLD FORMAT "%3.0" /end CHARACTERISTIC
/begin CHARACTERISTIC c_toil_wiv_sub "Ersatzwert Oeltemperatur" VALUE 0x850053 _REC_VAL_20_u1 255. _CNV_A_R_LINEAR_____300_CM -60. 195. DISPLAY_IDENTIFIER C_TOIL_WIV_SUB FORMAT "%3.0" /end CHARACTERISTIC
/begin CHARACTERISTIC c_toil_wiv_ini "Initwert Oeltemperatur" VALUE 0x850051 _REC_VAL_20_u1 255. _CNV_A_R_LINEAR_____300_CM -60. 195. DISPLAY_IDENTIFIER C_TOIL_WIV_INI FORMAT "%3.0" /end CHARACTERISTIC
/begin CHARACTERISTIC c_t_toil_max "maximale Oeltemperaturzeit" VALUE 0x84fffc _REC_VAL_20_u2 127.875 _CNV_A_R_LINEAR_____305_CM 0. 127.875 DISPLAY_IDENTIFIER C_T_TOIL_MAX FORMAT "%7.3" /end CHARACTERISTIC
/begin CHARACTERISTIC c_t_toil_min "minimale Oeltemperaturzeit" VALUE 0x84fffe _REC_VAL_20_u2 127.875 _CNV_A_R_LINEAR_____305_CM 0. 127.875 DISPLAY_IDENTIFIER C_T_TOIL_MIN FORMAT "%7.3" /end CHARACTERISTIC
/begin CHARACTERISTIC c_fco_cyl_max "zugestandene Menge pro Zylinder" VALUE 0x84fd5a _REC_VAL_20_u2 5119.921875 _CNV_A_R_LINEAR_____306_CM 0. 5119.921875 DISPLAY_IDENTIFIER C_FCO_CYL_MAX FORMAT "%11.6" /end CHARACTERISTIC
/begin MEASUREMENT ctr_oil_level_sum_cor "Zaehler Oelstand mit Guetefaktor" UBYTE _CNV_A_R_LINEAR_____1_CM 1 0. 0. 255. DISPLAY_IDENTIFIER CTR_OIL_LEVEL_SUM_COR ECU_ADDRESS 0x7fbc20 FORMAT "%3.0" /end MEASUREMENT
/begin MEASUREMENT ctr_oil_level_sum "Zaehler Oelstand aufsummiert" UBYTE _CNV_A_R_LINEAR_____1_CM 1 0. 0. 255. DISPLAY_IDENTIFIER CTR_OIL_LEVEL_SUM ECU_ADDRESS 0x7fc019 FORMAT "%3.0" /end MEASUREMENT
/begin MEASUREMENT oil_level_sum "Oelstand aufsummiert" SWORD _CNV_A_R_LINEAR_____307_CM 1 0. -65536. 65534. DISPLAY_IDENTIFIER OIL_LEVEL_SUM ECU_ADDRESS 0x7fb520 BYTE_ORDER MSB_LAST FORMAT "%5.0" /end MEASUREMENT
/begin MEASUREMENT oil_level_vol_sum "Oelstand aufsummiert" SWORD _CNV_A_R_LINEAR_____308_CM 1 0. -8.192 8.191750000000001 DISPLAY_IDENTIFIER OIL_LEVEL_VOL_SUM ECU_ADDRESS 0x7fb522 BYTE_ORDER MSB_LAST FORMAT "%7.5" /end MEASUREMENT
/begin AXIS_PTS ldp_t_oil_can "" 0x844192 online_dummy _REC_AXS_20_u2 127.875 _CNV_A_R_LINEAR_____305_CM 13 0. 127.875 FORMAT "%7.3" /end AXIS_PTS
/begin AXIS_PTS ldp_n_wiv "" 0x8440ec n_wiv _REC_AXS_20_u2 8160. _CNV_A_R_LINEAR_____154_CM 10 0. 8160. FORMAT "%4.0" /end AXIS_PTS
/begin MEASUREMENT n_wiv "Motordrehzahl gefiltert" UWORD _CNV_A_R_LINEAR_____154_CM 1 0. 0. 8160. DISPLAY_IDENTIFIER N_WIV ECU_ADDRESS 0x7fb500 BYTE_ORDER MSB_LAST FORMAT "%4.0" /end MEASUREMENT
/begin AXIS_PTS ldpm_toil_wiv_clc "" 0x84443d toil_wiv_clc _REC_AXS_20_u1 255. _CNV_A_R_LINEAR_____300_CM 9 -60. 195. FORMAT "%3.0" /end AXIS_PTS
/begin AXIS_PTS ldp_ac_trv_tcs2 "" 0x843f3c ac_trv_wiv_fil _REC_AXS_20_u2 25.599609375 _CNV_A_R_LINEAR_____309_CM 5 -12.7 12.899609375 FORMAT "%7.4" /end AXIS_PTS
/begin AXIS_PTS ldp_n_wiv_oil_level_cor_wiv "" 0x84412e n_wiv _REC_AXS_20_u2 8160. _CNV_A_R_LINEAR_____154_CM 10 0. 8160. FORMAT "%4.0" /end AXIS_PTS
/begin AXIS_PTS ldp_toil_wiv_temp2 "" 0x8442f5 toil_wiv_clc _REC_AXS_20_u1 255. _CNV_A_R_LINEAR_____300_CM 10 -60. 195. FORMAT "%3.0" /end AXIS_PTS
/begin CHARACTERISTIC id_fac_fco_estim_wiv "Kennfeld zur Ermittlung der oeltemperaturabhaengigen Verbrauchsbewertung" CURVE 0x84451c _REC_CUR_20_u1_u1 15.9375 _CNV_A_R_LINEAR_____251_CM 0. 15.9375 DISPLAY_IDENTIFIER ID_FAC_FCO_ESTIM_WIV FORMAT "%5.2"
 /begin AXIS_DESCR COM_AXIS toil_wiv_clc _CNV_A_R_LINEAR_____300_CM 9 -60. 195. FORMAT "%3.0" AXIS_PTS_REF ldpm_toil_wiv_clc /end AXIS_DESCR
/end CHARACTERISTIC
/begin CHARACTERISTIC ip_fac_qly_wiv "Kennfeld zur Ermittlung Guetefaktoren" MAP 0x848376 _REC_MAP_20_u1_u2_u2 255. _CNV_A_R_LINEAR_____1_CM 0. 255. DISPLAY_IDENTIFIER IP_FAC_QLY_WIV FORMAT "%3.0"
 /begin AXIS_DESCR COM_AXIS n_wiv _CNV_A_R_LINEAR_____154_CM 10 0. 8160. FORMAT "%4.0" AXIS_PTS_REF ldp_n_wiv /end AXIS_DESCR
 /begin AXIS_DESCR COM_AXIS ac_trv_wiv_fil _CNV_A_R_LINEAR_____309_CM 5 -12.7 12.899609375 FORMAT "%7.4" AXIS_PTS_REF ldp_ac_trv_tcs2 /end AXIS_DESCR
/end CHARACTERISTIC
/begin CHARACTERISTIC ip_toil_wiv_temp "Oeltemperatur" CURVE 0x84f724 _REC_CUR_20_u1_u2 255. _CNV_A_R_LINEAR_____300_CM -60. 195. DISPLAY_IDENTIFIER IP_TOIL_WIV_TEMP FORMAT "%3.0"
 /begin AXIS_DESCR COM_AXIS online_dummy _CNV_A_R_LINEAR_____305_CM 13 0. 127.875 FORMAT "%7.3" AXIS_PTS_REF ldp_t_oil_can /end AXIS_DESCR
/end CHARACTERISTIC
/begin CHARACTERISTIC ip_oil_level_cor_wiv "Kompensationskennfeld" MAP 0x84d456 _REC_MAP_20_u2_u2_u1 127. _CNV_A_R_LINEAR_____296_CM 0. 127. DISPLAY_IDENTIFIER IP_OIL_LEVEL_COR_WIV FORMAT "%8.4"
 /begin AXIS_DESCR COM_AXIS n_wiv _CNV_A_R_LINEAR_____154_CM 10 0. 8160. FORMAT "%4.0" AXIS_PTS_REF ldp_n_wiv_oil_level_cor_wiv /end AXIS_DESCR
 /begin AXIS_DESCR COM_AXIS toil_wiv_clc _CNV_A_R_LINEAR_____300_CM 10 -60. 195. FORMAT "%3.0" AXIS_PTS_REF ldp_toil_wiv_temp2 /end AXIS_DESCR
/end CHARACTERISTIC
/begin MEASUREMENT lv_toil_wiv_nplaus_tmp "Oeltemperatur unplausibel" UBYTE _CNV_S_2_RANGE__0___85_CM 1 0. 0. 1. DISPLAY_IDENTIFIER LV_TOIL_WIV_NPLAUS_TMP ECU_ADDRESS 0x7fbc25 BIT_MASK 0x1 /end MEASUREMENT
/begin MEASUREMENT fac_qly_wiv "Guetefaktor ungerundet" UBYTE _CNV_A_R_LINEAR_____310_CM 1 0. 0. 5.1 DISPLAY_IDENTIFIER FAC_QLY_WIV ECU_ADDRESS 0x7fc017 FORMAT "%4.2" /end MEASUREMENT
/begin MEASUREMENT fac_fco_estim_wiv "oeltemperaturabhaengige Verbrauchsbewertung" UBYTE _CNV_A_R_LINEAR_____251_CM 1 0. 0. 15.9375 DISPLAY_IDENTIFIER FAC_FCO_ESTIM_WIV ECU_ADDRESS 0x7fc01e FORMAT "%5.2" /end MEASUREMENT
/begin MEASUREMENT oil_level1_vol "Fuellstand 1 in l" SWORD _CNV_A_R_LINEAR_____293_CM 1 0. -2.048 2.0479375 DISPLAY_IDENTIFIER OIL_LEVEL1_VOL ECU_ADDRESS 0x7fb518 BYTE_ORDER MSB_LAST FORMAT "%8.6" /end MEASUREMENT
/begin MEASUREMENT oil_level1 "Fuellstand 1 in mm" UWORD _CNV_A_R_LINEAR_____296_CM 1 0. 0. 127. DISPLAY_IDENTIFIER OIL_LEVEL1 ECU_ADDRESS 0x7fa33c BYTE_ORDER MSB_LAST FORMAT "%8.4" /end MEASUREMENT
/begin MEASUREMENT oil_level2 "Fuellstand 2 in mm" UWORD _CNV_A_R_LINEAR_____296_CM 1 0. 0. 127. DISPLAY_IDENTIFIER OIL_LEVEL2 ECU_ADDRESS 0x7fb502 BYTE_ORDER MSB_LAST FORMAT "%8.4" /end MEASUREMENT
/begin MEASUREMENT oil_level4 "Fuellstand 4 in mm" UWORD _CNV_A_R_LINEAR_____296_CM 1 0. 0. 127. DISPLAY_IDENTIFIER OIL_LEVEL4 ECU_ADDRESS 0x7fb506 BYTE_ORDER MSB_LAST FORMAT "%8.4" /end MEASUREMENT
/begin MEASUREMENT oil_level3 "Fuellstand 3 in mm" UWORD _CNV_A_R_LINEAR_____296_CM 1 0. 0. 127. DISPLAY_IDENTIFIER OIL_LEVEL3 ECU_ADDRESS 0x7fb504 BYTE_ORDER MSB_LAST FORMAT "%8.4" /end MEASUREMENT
/begin CHARACTERISTIC c_t_fout_oil_sens_caut "Dauer Ausblendung Sensorwarnung" VALUE 0x84ff80 _REC_VAL_20_u2 655.35 _CNV_A_R_LINEAR_____226_CM 0. 655.35 DISPLAY_IDENTIFIER C_T_FOUT_OIL_SENS_CAUT FORMAT "%6.2" /end CHARACTERISTIC
/begin CHARACTERISTIC c_t_fout_oil_level_dif_mv_sho "Dauer Ausblendung Kurzzeitmittelwert" VALUE 0x84ff7e _REC_VAL_20_u2 655.35 _CNV_A_R_LINEAR_____226_CM 0. 655.35 DISPLAY_IDENTIFIER C_T_FOUT_OIL_LEVEL_DIF_MV_SHO FORMAT "%6.2" /end CHARACTERISTIC
/begin MEASUREMENT fco_dif_wiv "Kraftstoffverbrauch aufsummiert" UWORD _CNV_A_R_LINEAR_____311_CM 1 0. 0. 65535. DISPLAY_IDENTIFIER FCO_DIF_WIV ECU_ADDRESS 0x7fb510 BYTE_ORDER MSB_LAST FORMAT "%5.0" /end MEASUREMENT
/begin MEASUREMENT soot_equ "Russaequivalent" UWORD _CNV_A_R_LINEAR_____298_CM 1 0. 0. 1.3107e-003 DISPLAY_IDENTIFIER SOOT_EQU ECU_ADDRESS 0x7fa33a BYTE_ORDER MSB_LAST FORMAT "%10.8" /end MEASUREMENT
/begin MEASUREMENT lv_emsf_state_1_ds "Toggelbit fuer Verbrauchsaequivalent Diesel" UBYTE _CNV_S_2_RANGE__0___85_CM 1 0. 0. 1. DISPLAY_IDENTIFIER LV_EMSF_STATE_1_DS ECU_ADDRESS 0x7fc030 BIT_MASK 0x1 /end MEASUREMENT
/begin MEASUREMENT soot_wiv_value "gemittelter Russindexwert fuer Dieselmotor" UWORD _CNV_A_R_LINEAR_____312_CM 1 0. 0. 65535. DISPLAY_IDENTIFIER SOOT_WIV_VALUE ECU_ADDRESS 0x7fb508 BYTE_ORDER MSB_LAST FORMAT "%5.0" /end MEASUREMENT
/begin MEASUREMENT soot_equ_ds "Russaequivalent fuer Dieselmotor mit Bewertungsfaktor" UWORD _CNV_A_R_LINEAR_____298_CM 1 0. 0. 1.3107e-003 DISPLAY_IDENTIFIER SOOT_EQU_DS ECU_ADDRESS 0x7fb50a BYTE_ORDER MSB_LAST FORMAT "%10.8" /end MEASUREMENT
/begin MEASUREMENT wear_equ_ds "Verbrauchaequivalent" UWORD _CNV_A_R_LINEAR_____298_CM 1 0. 0. 1.3107e-003 DISPLAY_IDENTIFIER WEAR_EQU_DS ECU_ADDRESS 0x7fb50c BYTE_ORDER MSB_LAST FORMAT "%10.8" /end MEASUREMENT
/begin CHARACTERISTIC c_fac_soot_wiv "applizierter Bewertungsfaktor Russaequivalent (DS)" VALUE 0x84fd46 _REC_VAL_20_u1 2.55e-003 _CNV_A_R_LINEAR_____313_CM 0. 2.55e-003 DISPLAY_IDENTIFIER C_FAC_SOOT_WIV FORMAT "%7.5" /end CHARACTERISTIC
/begin CHARACTERISTIC c_fac_wear_wiv "applizierbarer Bewertungsfaktor Verbrauchsaequivalent (DS)" VALUE 0x84fd58 _REC_VAL_20_u1 2.55e-003 _CNV_A_R_LINEAR_____313_CM 0. 2.55e-003 DISPLAY_IDENTIFIER C_FAC_WEAR_WIV FORMAT "%7.5" /end CHARACTERISTIC
/begin CHARACTERISTIC c_fac_equ_wiv "normierte Bezugsgroesse zur Aequivalentberechnung (DS)" VALUE 0x84fd26 _REC_VAL_20_u1 127500. _CNV_A_R_LINEAR_____314_CM 0. 127500. DISPLAY_IDENTIFIER C_FAC_EQU_WIV FORMAT "%6.0" /end CHARACTERISTIC
/begin AXIS_PTS ldp_fco_dif "FCO_DIF" 0x843ff0 fco_dif _REC_AXS_20_u2 65535. _CNV_A_R_LINEAR_____315_CM 10 0. 65535. FORMAT "%5.0" /end AXIS_PTS
/begin CHARACTERISTIC ip_soot_equ "Kennfeld Russindexwerte Diesel fuer spaetere Russaequivalentberechnung (DS)" MAP 0x84ed1c _REC_MAP_20_u2_u2_u2 65535. _CNV_A_R_LINEAR_____312_CM 0. 65535. DISPLAY_IDENTIFIER IP_SOOT_EQU FORMAT "%5.0"
 /begin AXIS_DESCR COM_AXIS n_wiv _CNV_A_R_LINEAR_____154_CM 10 0. 8160. FORMAT "%4.0" AXIS_PTS_REF ldp_n_wiv__ip_soot_equ /end AXIS_DESCR
 /begin AXIS_DESCR COM_AXIS fco_dif _CNV_A_R_LINEAR_____315_CM 10 0. 65535. FORMAT "%5.0" AXIS_PTS_REF ldp_fco_dif /end AXIS_DESCR
/end CHARACTERISTIC
/begin AXIS_PTS ldp_n_wiv__ip_wear_equ "N_WIV" 0x844118 n_wiv _REC_AXS_20_u2 8160. _CNV_A_R_LINEAR_____154_CM 10 0. 8160. FORMAT "%4.0" /end AXIS_PTS
/begin AXIS_PTS ldp_toil_wiv_clc "TOIL_WIV" 0x8442ea toil_wiv_clc _REC_AXS_20_u1 255. _CNV_A_R_LINEAR_____300_CM 10 -60. 195. FORMAT "%3.0" /end AXIS_PTS
/begin CHARACTERISTIC ip_wear_equ "Kennfeld Verbrauchsindexwerte Diesel fuer spaetere Verbrauchsaequivalentberechnung (DS)" MAP 0x84f9a4 _REC_MAP_20_u2_u2_u1 65535. _CNV_A_R_LINEAR_____312_CM 0. 65535. DISPLAY_IDENTIFIER IP_WEAR_EQU FORMAT "%5.0"
 /begin AXIS_DESCR COM_AXIS n_wiv _CNV_A_R_LINEAR_____154_CM 10 0. 8160. FORMAT "%4.0" AXIS_PTS_REF ldp_n_wiv__ip_wear_equ /end AXIS_DESCR
 /begin AXIS_DESCR COM_AXIS toil_wiv_clc _CNV_A_R_LINEAR_____300_CM 10 -60. 195. FORMAT "%3.0" AXIS_PTS_REF ldp_toil_wiv_clc /end AXIS_DESCR
/end CHARACTERISTIC
/begin AXIS_PTS ldp_n_wiv__ip_soot_equ "N_WIV" 0x844102 n_wiv _REC_AXS_20_u2 8160. _CNV_A_R_LINEAR_____154_CM 10 0. 8160. FORMAT "%4.0" /end AXIS_PTS
/begin MEASUREMENT oil_level_ctr_tmp "Oelstandszaehler" UBYTE _CNV_A_R_LINEAR_____1_CM 1 0. 0. 255. DISPLAY_IDENTIFIER OIL_LEVEL_CTR_TMP ECU_ADDRESS 0x7fc01d FORMAT "%3.0" /end MEASUREMENT
/begin MEASUREMENT oil_level_dif_mv_sho_tmp "Kurzzeitmittelwert" UBYTE _CNV_A_R_LINEAR_____297_CM 1 0. -1905. 1920. DISPLAY_IDENTIFIER OIL_LEVEL_DIF_MV_SHO_TMP ECU_ADDRESS 0x7fc01c FORMAT "%5.0" /end MEASUREMENT
/begin MEASUREMENT wear_wiv_value "Gemittelter Verschleissindexwert fuer Dieselmotor" UWORD _CNV_A_R_LINEAR_____312_CM 1 0. 0. 65535. DISPLAY_IDENTIFIER WEAR_WIV_VALUE ECU_ADDRESS 0x7fb50e BYTE_ORDER MSB_LAST FORMAT "%5.0" /end MEASUREMENT
/begin MEASUREMENT lv_emsf_state_1_gs "togglebit fuer Verbrauchsaequivalent Benziner" UBYTE _CNV_S_2_RANGE__0___85_CM 1 0. 0. 1. DISPLAY_IDENTIFIER LV_EMSF_STATE_1_GS ECU_ADDRESS 0x7fc031 BIT_MASK 0x1 /end MEASUREMENT
/begin MEASUREMENT wear_fco_equ_gs "Verbrauchsaequivalent" UWORD _CNV_A_R_LINEAR_____298_CM 1 0. 0. 1.3107e-003 DISPLAY_IDENTIFIER WEAR_FCO_EQU_GS ECU_ADDRESS 0x7fb512 BYTE_ORDER MSB_LAST FORMAT "%10.8" /end MEASUREMENT
/begin CHARACTERISTIC c_oil_slop_level "Steigung der Befuellungskennlinie" VALUE 0x84febb _REC_VAL_20_u1 0.255 _CNV_A_R_LINEAR_____316_CM 0. 0.255 DISPLAY_IDENTIFIER C_OIL_SLOP_LEVEL FORMAT "%5.3" /end CHARACTERISTIC
/begin MEASUREMENT lv_err_t_toil_can "Fehlerstatus Oeltemperatur" UBYTE _CNV_S_2_RANGE__0___85_CM 1 0. 0. 1. DISPLAY_IDENTIFIER LV_ERR_T_TOIL_CAN ECU_ADDRESS 0x7fbc23 BIT_MASK 0x1 /end MEASUREMENT
/begin MEASUREMENT fco_sum_can "summierter Kraftstoffverbrauch zur Ausgabe in der EMS5-CAN-Botschaft" UWORD _CNV_A_R_LINEAR_____311_CM 1 0. 0. 32767. DISPLAY_IDENTIFIER FCO_SUM_CAN ECU_ADDRESS 0x7fa328 BYTE_ORDER MSB_LAST FORMAT "%5.0" /end MEASUREMENT
/begin MEASUREMENT fco_vs "streckenbezogener Kraftstoffverbrauch" UWORD _CNV_A_R_LINEAR_____253_CM 1 0. 0. 92.52 DISPLAY_IDENTIFIER FCO_VS ECU_ADDRESS 0x7fa32c BYTE_ORDER MSB_LAST /end MEASUREMENT
/begin MEASUREMENT lv_fco_sum_ovfl "logische Variable fuer Ueberlauf des Verbrauchssignals" UBYTE _CNV_S_2_RANGE__0___85_CM 1 0. 0. 1. DISPLAY_IDENTIFIER LV_FCO_SUM_OVFL ECU_ADDRESS 0x7fbc1b BIT_MASK 0x1 /end MEASUREMENT
/begin CHARACTERISTIC c_fco_stnd "Normierungskonstante Kraftstoffverbrauch" VALUE 0x84fd5c _REC_VAL_20_u2 65535. _CNV_A_R_LINEAR_____1_CM 0. 65535. DISPLAY_IDENTIFIER C_FCO_STND FORMAT "%5.0" /end CHARACTERISTIC
/begin CHARACTERISTIC c_crlc_fco_vs "Mittelungskonstante fuer die Mittelung des streckenbezogenen Kraftstoffverbrauch" VALUE 0x84fbf6 _REC_VAL_20_u2 0.9999847412109381 _CNV_A_R_LINEAR_____137_CM 0. 0.9999847412109381 DISPLAY_IDENTIFIER C_CRLC_FCO_VS FORMAT "%7.5" /end CHARACTERISTIC
/begin MEASUREMENT fco_sum "summierter Kraftstoffverbrauch" UWORD _CNV_A_R_LINEAR_____311_CM 1 0. 0. 65535. DISPLAY_IDENTIFIER FCO_SUM ECU_ADDRESS 0x7fa32a BYTE_ORDER MSB_LAST FORMAT "%5.0" /end MEASUREMENT
/begin MEASUREMENT fco_t "gefilterter Kraftstoffverbrauch pro Zeit" UWORD _CNV_A_R_LINEAR_____255_CM 1 0. 0. 16.38375 DISPLAY_IDENTIFIER FCO_T ECU_ADDRESS 0x7fa32e BYTE_ORDER MSB_LAST FORMAT "%7.2" /end MEASUREMENT
/begin MEASUREMENT fco_t_raw "Kraftstoffverbrauch pro Zeit" UWORD _CNV_A_R_LINEAR_____317_CM 1 0. 0. 65.535 DISPLAY_IDENTIFIER FCO_T_RAW ECU_ADDRESS 0x7fb4fc BYTE_ORDER MSB_LAST /end MEASUREMENT
/begin CHARACTERISTIC c_t_fco_t_clc "Mittelungskonstante fuer die Mittelung des zeitbezogenen Kraftstoffverbrauchs" VALUE 0x84ff7c _REC_VAL_20_u1 255. _CNV_A_R_LINEAR_____27_CM 0. 255. DISPLAY_IDENTIFIER C_T_FCO_T_CLC FORMAT "%3.0" /end CHARACTERISTIC
/begin MEASUREMENT fco_dif "Difference of fuel consumption related to 100 ms" UWORD _CNV_A_R_LINEAR_____315_CM 1 0. 0. 65535. DISPLAY_IDENTIFIER FCO_DIF ECU_ADDRESS 0x7fa334 BYTE_ORDER MSB_LAST FORMAT "%5.0" /end MEASUREMENT
/begin MEASUREMENT lv_tog1_can_nvld "Logical variable for \"CAN-message TOG1 not valid\"" UBYTE _CNV_S_2_RANGE__0___85_CM 1 0. 0. 1. DISPLAY_IDENTIFIER LV_TOG1_CAN_NVLD ECU_ADDRESS 0x7fbc1c BIT_MASK 0x1 /end MEASUREMENT
/begin MEASUREMENT lv_tcs2_can_nvld "Logical variable for \"CAN-message TCS2 not valid\"" UBYTE _CNV_S_2_RANGE__0___85_CM 1 0. 0. 1. DISPLAY_IDENTIFIER LV_TCS2_CAN_NVLD ECU_ADDRESS 0x7fbc1d BIT_MASK 0x1 /end MEASUREMENT
/begin MEASUREMENT lv_cdn_amp_obd "o v" UBYTE _CNV_A_R_LINEAR_____0_CM 1 0. 0. 1. DISPLAY_IDENTIFIER LV_CDN_AMP_OBD ECU_ADDRESS 0x7fb842 FORMAT "%1.0" /end MEASUREMENT
/begin MEASUREMENT lv_cdn_tam_st_obd "o v" UBYTE _CNV_A_R_LINEAR_____0_CM 1 0. 0. 1. DISPLAY_IDENTIFIER LV_CDN_TAM_ST_OBD ECU_ADDRESS 0x7fb843 FORMAT "%1.0" /end MEASUREMENT
/begin MEASUREMENT lv_cdn_ftl_obd "o v" UBYTE _CNV_A_R_LINEAR_____0_CM 1 0. 0. 1. DISPLAY_IDENTIFIER LV_CDN_FTL_OBD ECU_ADDRESS 0x7fb844 FORMAT "%1.0" /end MEASUREMENT
/begin MEASUREMENT lv_cdn_pf_obd "o v" UBYTE _CNV_A_R_LINEAR_____0_CM 1 0. 0. 1. DISPLAY_IDENTIFIER LV_CDN_PF_OBD ECU_ADDRESS 0x7fb845 FORMAT "%1.0" /end MEASUREMENT
/begin CHARACTERISTIC c_amp_cdn_obd "" VALUE 0x85c874 _REC_VAL_20_u2 5434. _CNV_A_R_LINEAR_____45_CM 0. 5434. DISPLAY_IDENTIFIER C_AMP_CDN_OBD FORMAT "%6.2" /end CHARACTERISTIC
/begin CHARACTERISTIC c_tam_st_cdn_obd "" VALUE 0x85cc9e _REC_VAL_20_u1 255. _CNV_A_R_LINEAR_____18_CM -50. 205. DISPLAY_IDENTIFIER C_TAM_ST_CDN_OBD FORMAT "%3.0" /end CHARACTERISTIC
/begin CHARACTERISTIC c_ftl_cdn_obd "" VALUE 0x85ca38 _REC_VAL_20_u1 100. _CNV_A_R_LINEAR_____39_CM 0. 100. DISPLAY_IDENTIFIER C_FTL_CDN_OBD FORMAT "%3.0" /end CHARACTERISTIC
/begin CHARACTERISTIC c_abc_inc_v_amp_rng "anti bounce counter increment for diagnosis instance V_AMP_RNG" VALUE 0x84fadd _REC_VAL_20_u1 255. _CNV_A_R_LINEAR_____0_CM 0. 255. DISPLAY_IDENTIFIER C_ABC_INC_V_AMP_RNG FORMAT "%3.0" /end CHARACTERISTIC
/begin CHARACTERISTIC c_abc_max_v_amp_rng "maximum value of anti bounce counter for diagnosis instance V_AMP_RNG" VALUE 0x84fb69 _REC_VAL_20_u1 255. _CNV_A_R_LINEAR_____0_CM 0. 255. DISPLAY_IDENTIFIER C_ABC_MAX_V_AMP_RNG FORMAT "%3.0" /end CHARACTERISTIC
/begin CHARACTERISTIC c_abc_inc_amp_mes_grd "anti bounce counter increment for diagnosis instance AMP_MES_GRD" VALUE 0x84fa6e _REC_VAL_20_u1 255. _CNV_A_R_LINEAR_____0_CM 0. 255. DISPLAY_IDENTIFIER C_ABC_INC_AMP_MES_GRD FORMAT "%3.0" /end CHARACTERISTIC
/begin CHARACTERISTIC c_abc_max_amp_mes_grd "maximum value of anti bounce counter for diagnosis instance AMP_MES_GRD" VALUE 0x84fafa _REC_VAL_20_u1 255. _CNV_A_R_LINEAR_____0_CM 0. 255. DISPLAY_IDENTIFIER C_ABC_MAX_AMP_MES_GRD FORMAT "%3.0" /end CHARACTERISTIC
/begin CHARACTERISTIC c_v_amp_min_diag "AMP minimum threshold for error detection" VALUE 0x85cd4c _REC_VAL_20_u2 4.9951171875 _CNV_A_R_LINEAR_____28_CM 0. 4.9951171875 DISPLAY_IDENTIFIER C_V_AMP_MIN_DIAG FORMAT "%3.2" /end CHARACTERISTIC
/begin CHARACTERISTIC c_v_amp_max_diag "AMP maximum threshold for error detection" VALUE 0x85cd4a _REC_VAL_20_u2 4.9951171875 _CNV_A_R_LINEAR_____28_CM 0. 4.9951171875 DISPLAY_IDENTIFIER C_V_AMP_MAX_DIAG FORMAT "%3.2" /end CHARACTERISTIC
/begin MEASUREMENT lv_err_amp_mes "global error flag" UBYTE _CNV_S_2_RANGE______23_CM 1 0. 0. 1. DISPLAY_IDENTIFIER LV_ERR_AMP_MES ECU_ADDRESS 0x7fb846 /end MEASUREMENT
/begin CHARACTERISTIC c_amp_mes_grd_diag "threshold for AMP gradient check" VALUE 0x85c87a _REC_VAL_20_u2 5434. _CNV_A_R_LINEAR_____347_CM 0. 5434. DISPLAY_IDENTIFIER C_AMP_MES_GRD_DIAG FORMAT "%3.2" /end CHARACTERISTIC
/begin CHARACTERISTIC c_abc_inc_v_egrv_0_rng "anti bounce counter increment for diagnosis instance V_EGRV_0_RNG" VALUE 0x84fae5 _REC_VAL_20_u1 255. _CNV_A_R_LINEAR_____0_CM 0. 255. DISPLAY_IDENTIFIER C_ABC_INC_V_EGRV_0_RNG FORMAT "%3.0" /end CHARACTERISTIC
/begin CHARACTERISTIC c_abc_max_v_egrv_0_rng "maximum value of anti bounce counter for diagnosis instance V_EGRV_0_RNG" VALUE 0x84fb71 _REC_VAL_20_u1 255. _CNV_A_R_LINEAR_____0_CM 0. 255. DISPLAY_IDENTIFIER C_ABC_MAX_V_EGRV_0_RNG FORMAT "%3.0" /end CHARACTERISTIC
/begin CHARACTERISTIC c_abc_inc_v_egrv_0_grd "anti bounce counter increment for diagnosis instance V_EGRV_0_GRD" VALUE 0x84fae4 _REC_VAL_20_u1 255. _CNV_A_R_LINEAR_____0_CM 0. 255. DISPLAY_IDENTIFIER C_ABC_INC_V_EGRV_0_GRD FORMAT "%3.0" /end CHARACTERISTIC
/begin CHARACTERISTIC c_abc_max_v_egrv_0_grd "maximum value of anti bounce counter for diagnosis instance V_EGRV_0_GRD" VALUE 0x84fb70 _REC_VAL_20_u1 255. _CNV_A_R_LINEAR_____0_CM 0. 255. DISPLAY_IDENTIFIER C_ABC_MAX_V_EGRV_0_GRD FORMAT "%3.0" /end CHARACTERISTIC
/begin MEASUREMENT lv_err_vcc_v_egrv_0 "VCC_V_EGRV_j error flag  (voltage supply of EGR valve Potentiometer j) j = 0 .. NC_EGRV_NR - 1" UBYTE _CNV_S_2_RANGE______23_CM 1 0. 0. 1. DISPLAY_IDENTIFIER LV_ERR_VCC_V_EGRV_0 ECU_ADDRESS 0x7fb848 /end MEASUREMENT
/begin MEASUREMENT lv_err_v_egrv_0_mes "global error flag for potentiometer sensor of EGR valve j ( j = 0 .. NC_EGRV_NR - 1 )" UBYTE _CNV_S_2_RANGE______23_CM 1 0. 0. 1. DISPLAY_IDENTIFIER LV_ERR_V_EGRV_0_MES ECU_ADDRESS 0x7fb847 /end MEASUREMENT
/begin CHARACTERISTIC c_v_egrv_mes_max_diag "upper threshold for range check of  V_EGRV_j_MES (EGR valve potentiometers)" VALUE 0x85cd82 _REC_VAL_20_u2 4.9951171875 _CNV_A_R_LINEAR_____28_CM 0. 4.9951171875 DISPLAY_IDENTIFIER C_V_EGRV_MES_MAX_DIAG FORMAT "%4.3" /end CHARACTERISTIC
/begin CHARACTERISTIC c_v_egrv_mes_min_diag "lower threshold for range check of V_EGRV_j_MES (EGR valve potentiometers)" VALUE 0x85cd84 _REC_VAL_20_u2 4.9951171875 _CNV_A_R_LINEAR_____28_CM 0. 4.9951171875 DISPLAY_IDENTIFIER C_V_EGRV_MES_MIN_DIAG FORMAT "%4.3" /end CHARACTERISTIC
/begin CHARACTERISTIC c_v_egrv_mes_grd_diag "V_EGRV_MES_GRD threshold for error detection" VALUE 0x85cd80 _REC_VAL_20_u2 4.9951171875 _CNV_A_R_LINEAR_____348_CM 0. 4.9951171875 DISPLAY_IDENTIFIER C_V_EGRV_MES_GRD_DIAG FORMAT "%4.3" /end CHARACTERISTIC
/begin CHARACTERISTIC c_abc_inc_ges_maf_0_max "" VALUE 0x84fa9e _REC_VAL_20_u1 255. _CNV_A_R_LINEAR_____0_CM 0. 255. DISPLAY_IDENTIFIER C_ABC_INC_GES_MAF_0_MAX FORMAT "%3.0" /end CHARACTERISTIC
/begin CHARACTERISTIC c_abc_max_ges_maf_0_max "" VALUE 0x84fb2a _REC_VAL_20_u1 255. _CNV_A_R_LINEAR_____0_CM 0. 255. DISPLAY_IDENTIFIER C_ABC_MAX_GES_MAF_0_MAX FORMAT "%3.0" /end CHARACTERISTIC
/begin AXIS_PTS ldp_n__ip_maf_kgh_ges_maf_max "" 0x841944 n _REC_AXS_20_u2 6375. _CNV_A_R_LINEAR_____5_CM 6 0. 6375. FORMAT "%4.0" /end AXIS_PTS
/begin CHARACTERISTIC ip_maf_kgh_ges_maf_max__n "DIAG_GES: threshold for range check of MAF" CURVE 0x8536e8 _REC_CUR_20_u2_u2 1023.984375 _CNV_A_R_LINEAR_____110_CM 0. 1023.984375 DISPLAY_IDENTIFIER IP_MAF_KGH_GES_MAF_MAX__N FORMAT "%7.3"
 /begin AXIS_DESCR COM_AXIS n _CNV_A_R_LINEAR_____5_CM 6 0. 6375. FORMAT "%4.0" AXIS_PTS_REF ldp_n__ip_maf_kgh_ges_maf_max /end AXIS_DESCR
/end CHARACTERISTIC
/begin CHARACTERISTIC c_n_ges_maf_max_diag "" VALUE 0x85cb06 _REC_VAL_20_u2 6375. _CNV_A_R_LINEAR_____5_CM 0. 6375. DISPLAY_IDENTIFIER C_N_GES_MAF_MAX_DIAG FORMAT "%4.0" /end CHARACTERISTIC
/begin CHARACTERISTIC c_abc_inc_efp_rly_dps "" VALUE 0x84fa94 _REC_VAL_20_u1 255. _CNV_A_R_LINEAR_____0_CM 0. 255. DISPLAY_IDENTIFIER C_ABC_INC_EFP_RLY_DPS FORMAT "%3.0" /end CHARACTERISTIC
/begin CHARACTERISTIC c_abc_max_efp_rly_dps "" VALUE 0x84fb20 _REC_VAL_20_u1 255. _CNV_A_R_LINEAR_____0_CM 0. 255. DISPLAY_IDENTIFIER C_ABC_MAX_EFP_RLY_DPS FORMAT "%3.0" /end CHARACTERISTIC
/begin CHARACTERISTIC c_abc_inc_efp_rly_plaus_1 "" VALUE 0x84fa95 _REC_VAL_20_u1 255. _CNV_A_R_LINEAR_____0_CM 0. 255. DISPLAY_IDENTIFIER C_ABC_INC_EFP_RLY_PLAUS_1 FORMAT "%3.0" /end CHARACTERISTIC
/begin CHARACTERISTIC c_abc_max_efp_rly_plaus_1 "" VALUE 0x84fb21 _REC_VAL_20_u1 255. _CNV_A_R_LINEAR_____0_CM 0. 255. DISPLAY_IDENTIFIER C_ABC_MAX_EFP_RLY_PLAUS_1 FORMAT "%3.0" /end CHARACTERISTIC
/begin CHARACTERISTIC c_abc_inc_efp_rly_plaus_2 "" VALUE 0x84fa96 _REC_VAL_20_u1 255. _CNV_A_R_LINEAR_____0_CM 0. 255. DISPLAY_IDENTIFIER C_ABC_INC_EFP_RLY_PLAUS_2 FORMAT "%3.0" /end CHARACTERISTIC
/begin CHARACTERISTIC c_abc_max_efp_rly_plaus_2 "" VALUE 0x84fb22 _REC_VAL_20_u1 255. _CNV_A_R_LINEAR_____0_CM 0. 255. DISPLAY_IDENTIFIER C_ABC_MAX_EFP_RLY_PLAUS_2 FORMAT "%3.0" /end CHARACTERISTIC
/begin MEASUREMENT err_sym_mem_efp_rly_dps "" UBYTE _CNV_S_6_CONV_ERRM__22_CM 1 0. 0. 15. DISPLAY_IDENTIFIER ERR_SYM_MEM_EFP_RLY_DPS ECU_ADDRESS 0x7fce38 /end MEASUREMENT
/begin MEASUREMENT ctr_efp_rly_plaus_1_dly "" UBYTE _CNV_A_R_LINEAR_____0_CM 1 0. 0. 255. DISPLAY_IDENTIFIER CTR_EFP_RLY_PLAUS_1_DLY ECU_ADDRESS 0x7fce39 FORMAT "%3.0" /end MEASUREMENT
/begin MEASUREMENT ctr_efp_rly_plaus_2_dly "" UBYTE _CNV_A_R_LINEAR_____0_CM 1 0. 0. 255. DISPLAY_IDENTIFIER CTR_EFP_RLY_PLAUS_2_DLY ECU_ADDRESS 0x7fce3a FORMAT "%3.0" /end MEASUREMENT
/begin CHARACTERISTIC c_ctr_max_efp_rly_plaus_1_dly "" VALUE 0x85c966 _REC_VAL_20_u1 255. _CNV_A_R_LINEAR_____0_CM 0. 255. DISPLAY_IDENTIFIER C_CTR_MAX_EFP_RLY_PLAUS_1_DLY FORMAT "%3.0" /end CHARACTERISTIC
/begin CHARACTERISTIC c_ctr_max_efp_rly_plaus_2_dly "" VALUE 0x85c967 _REC_VAL_20_u1 255. _CNV_A_R_LINEAR_____0_CM 0. 255. DISPLAY_IDENTIFIER C_CTR_MAX_EFP_RLY_PLAUS_2_DLY FORMAT "%3.0" /end CHARACTERISTIC
/begin MEASUREMENT lv_scg_efp_rly "" UBYTE _CNV_A_R_LINEAR_____0_CM 1 0. 0. 1. DISPLAY_IDENTIFIER LV_SCG_EFP_RLY ECU_ADDRESS 0x7fce3b FORMAT "%1.0" /end MEASUREMENT
/begin MEASUREMENT lv_scg_vld_efp_rly "" UBYTE _CNV_A_R_LINEAR_____0_CM 1 0. 0. 1. DISPLAY_IDENTIFIER LV_SCG_VLD_EFP_RLY ECU_ADDRESS 0x7fce3c FORMAT "%1.0" /end MEASUREMENT
/begin MEASUREMENT lv_scb_efp_rly "" UBYTE _CNV_A_R_LINEAR_____0_CM 1 0. 0. 1. DISPLAY_IDENTIFIER LV_SCB_EFP_RLY ECU_ADDRESS 0x7fce3d FORMAT "%1.0" /end MEASUREMENT
/begin MEASUREMENT lv_scb_vld_efp_rly "" UBYTE _CNV_A_R_LINEAR_____0_CM 1 0. 0. 1. DISPLAY_IDENTIFIER LV_SCB_VLD_EFP_RLY ECU_ADDRESS 0x7fce3e FORMAT "%1.0" /end MEASUREMENT
/begin MEASUREMENT lv_ol_efp_rly "" UBYTE _CNV_A_R_LINEAR_____0_CM 1 0. 0. 1. DISPLAY_IDENTIFIER LV_OL_EFP_RLY ECU_ADDRESS 0x7fce3f FORMAT "%1.0" /end MEASUREMENT
/begin MEASUREMENT lv_ol_vld_efp_rly "" UBYTE _CNV_A_R_LINEAR_____0_CM 1 0. 0. 1. DISPLAY_IDENTIFIER LV_OL_VLD_EFP_RLY ECU_ADDRESS 0x7fce40 FORMAT "%1.0" /end MEASUREMENT
/begin MEASUREMENT lv_efp_rly_diag "" UBYTE _CNV_A_R_LINEAR_____0_CM 1 0. 0. 1. DISPLAY_IDENTIFIER LV_EFP_RLY_DIAG ECU_ADDRESS 0x7fce41 FORMAT "%1.0" /end MEASUREMENT
/begin CHARACTERISTIC c_abc_inc_rly_main "anti bounce counter increment for diagnosis instance RLY_MAIN" VALUE 0x84fac8 _REC_VAL_20_u1 255. _CNV_A_R_LINEAR_____0_CM 0. 255. DISPLAY_IDENTIFIER C_ABC_INC_RLY_MAIN FORMAT "%3.0" /end CHARACTERISTIC
/begin CHARACTERISTIC c_abc_max_rly_main "maximum value of anti bounce counter for diagnosis instance RLY_MAIN" VALUE 0x84fb54 _REC_VAL_20_u1 255. _CNV_A_R_LINEAR_____0_CM 0. 255. DISPLAY_IDENTIFIER C_ABC_MAX_RLY_MAIN FORMAT "%3.0" /end CHARACTERISTIC
/begin CHARACTERISTIC c_abc_inc_rly_power "anti bounce counter increment for diagnosis instance RLY_POWER" VALUE 0x84fac9 _REC_VAL_20_u1 255. _CNV_A_R_LINEAR_____0_CM 0. 255. DISPLAY_IDENTIFIER C_ABC_INC_RLY_POWER FORMAT "%3.0" /end CHARACTERISTIC
/begin CHARACTERISTIC c_abc_max_rly_power "maximum value of anti bounce counter for diagnosis instance RLY_POWER" VALUE 0x84fb55 _REC_VAL_20_u1 255. _CNV_A_R_LINEAR_____0_CM 0. 255. DISPLAY_IDENTIFIER C_ABC_MAX_RLY_POWER FORMAT "%3.0" /end CHARACTERISTIC
/begin CHARACTERISTIC c_vb_min_rly_diag "inhibition threshold for Main- / Powerrelay diagnosis" VALUE 0x85ce19 _REC_VAL_20_u1 28.8 _CNV_A_R_LINEAR_____43_CM 0. 28.8 DISPLAY_IDENTIFIER C_VB_MIN_RLY_DIAG FORMAT "%3.1" /end CHARACTERISTIC
/begin MEASUREMENT lv_scg_rly_main "diagnosis bit from SPI bus" UBYTE _CNV_A_R_LINEAR_____0_CM 1 0. 0. 1. DISPLAY_IDENTIFIER LV_SCG_RLY_MAIN ECU_ADDRESS 0x7fbe0d FORMAT "%1.0" /end MEASUREMENT
/begin MEASUREMENT lv_scg_vld_rly_main "diagnosis bit from SPI bus" UBYTE _CNV_A_R_LINEAR_____0_CM 1 0. 0. 1. DISPLAY_IDENTIFIER LV_SCG_VLD_RLY_MAIN ECU_ADDRESS 0x7fbe10 FORMAT "%1.0" /end MEASUREMENT
/begin MEASUREMENT lv_scb_rly_main "diagnosis bit from SPI bus" UBYTE _CNV_A_R_LINEAR_____0_CM 1 0. 0. 1. DISPLAY_IDENTIFIER LV_SCB_RLY_MAIN ECU_ADDRESS 0x7fbe0c FORMAT "%1.0" /end MEASUREMENT
/begin MEASUREMENT lv_scb_vld_rly_main "diagnosis bit from SPI bus" UBYTE _CNV_A_R_LINEAR_____0_CM 1 0. 0. 1. DISPLAY_IDENTIFIER LV_SCB_VLD_RLY_MAIN ECU_ADDRESS 0x7fbe0f FORMAT "%1.0" /end MEASUREMENT
/begin MEASUREMENT lv_ol_rly_main "diagnosis bit from SPI bus" UBYTE _CNV_A_R_LINEAR_____0_CM 1 0. 0. 1. DISPLAY_IDENTIFIER LV_OL_RLY_MAIN ECU_ADDRESS 0x7fbe0e FORMAT "%1.0" /end MEASUREMENT
/begin MEASUREMENT lv_ol_vld_rly_main "diagnosis bit from SPI bus" UBYTE _CNV_A_R_LINEAR_____0_CM 1 0. 0. 1. DISPLAY_IDENTIFIER LV_OL_VLD_RLY_MAIN ECU_ADDRESS 0x7fbe11 FORMAT "%1.0" /end MEASUREMENT
/begin MEASUREMENT lv_scg_rly_power "diagnosis bit from SPI bus" UBYTE _CNV_A_R_LINEAR_____0_CM 1 0. 0. 1. DISPLAY_IDENTIFIER LV_SCG_RLY_POWER ECU_ADDRESS 0x7fbe13 FORMAT "%1.0" /end MEASUREMENT
/begin MEASUREMENT lv_scg_vld_rly_power "diagnosis bit from SPI bus" UBYTE _CNV_A_R_LINEAR_____0_CM 1 0. 0. 1. DISPLAY_IDENTIFIER LV_SCG_VLD_RLY_POWER ECU_ADDRESS 0x7fbe16 FORMAT "%1.0" /end MEASUREMENT
/begin MEASUREMENT lv_scb_rly_power "diagnosis bit from SPI bus" UBYTE _CNV_A_R_LINEAR_____0_CM 1 0. 0. 1. DISPLAY_IDENTIFIER LV_SCB_RLY_POWER ECU_ADDRESS 0x7fbe12 FORMAT "%1.0" /end MEASUREMENT
/begin MEASUREMENT lv_scb_vld_rly_power "diagnosis bit from SPI bus" UBYTE _CNV_A_R_LINEAR_____0_CM 1 0. 0. 1. DISPLAY_IDENTIFIER LV_SCB_VLD_RLY_POWER ECU_ADDRESS 0x7fbe15 FORMAT "%1.0" /end MEASUREMENT
/begin MEASUREMENT lv_ol_rly_power "diagnosis bit from SPI bus" UBYTE _CNV_A_R_LINEAR_____0_CM 1 0. 0. 1. DISPLAY_IDENTIFIER LV_OL_RLY_POWER ECU_ADDRESS 0x7fbe14 FORMAT "%1.0" /end MEASUREMENT
/begin MEASUREMENT lv_ol_vld_rly_power "diagnosis bit from SPI bus" UBYTE _CNV_A_R_LINEAR_____0_CM 1 0. 0. 1. DISPLAY_IDENTIFIER LV_OL_VLD_RLY_POWER ECU_ADDRESS 0x7fbe17 FORMAT "%1.0" /end MEASUREMENT
/begin MEASUREMENT err_sym_mem_rly_main "memorized symptom of the diagnosis instance RLY_MAIN " UBYTE _CNV_S_6_CONV_ERRM__22_CM 1 0. 0. 15. DISPLAY_IDENTIFIER ERR_SYM_MEM_RLY_MAIN ECU_ADDRESS 0x7fbe0a /end MEASUREMENT
/begin MEASUREMENT err_sym_mem_rly_power "memorized symptom of the diagnosis instance RLY_POWER " UBYTE _CNV_S_6_CONV_ERRM__22_CM 1 0. 0. 15. DISPLAY_IDENTIFIER ERR_SYM_MEM_RLY_POWER ECU_ADDRESS 0x7fbe0b /end MEASUREMENT
/begin MEASUREMENT lv_err_toil "flag for oil temperature error (set to 0 because TOIL_MDL is used if no value from sensor or CAN is available" UBYTE _CNV_S_2_RANGE__0___85_CM 1 0. 0. 1. DISPLAY_IDENTIFIER LV_ERR_TOIL ECU_ADDRESS 0x7fbb6a BIT_MASK 0x1 /end MEASUREMENT
/begin MEASUREMENT lv_err_toil_sens "globales Fehlerflag Öltemperatursensor entprellt" UBYTE _CNV_S_2_RANGE__0___85_CM 1 0. 0. 1. DISPLAY_IDENTIFIER LV_ERR_TOIL_SENS ECU_ADDRESS 0x7fbb7e BIT_MASK 0x1 /end MEASUREMENT
/begin CHARACTERISTIC c_tco_max_toil_diag "TCO-heiss-Schwelle - TOIL-Diagnose" VALUE 0x85001d _REC_VAL_20_u1 190.5 _CNV_A_R_LINEAR_____241_CM -48. 142.5 DISPLAY_IDENTIFIER C_TCO_MAX_TOIL_DIAG FORMAT "%5.1" /end CHARACTERISTIC
/begin CHARACTERISTIC c_abc_inc_toil_el "Inkrement Entprellzähler - TOIL_EL-Diagnose" VALUE 0x84fad9 _REC_VAL_20_u1 255. _CNV_A_R_LINEAR_____1_CM 0. 255. DISPLAY_IDENTIFIER C_ABC_INC_TOIL_EL FORMAT "%3.0" /end CHARACTERISTIC
/begin CHARACTERISTIC c_abc_inc_toil_plaus "Inkrement Entprellzähler - TOIL_PLAUS-Diagnose" VALUE 0x84fada _REC_VAL_20_u1 255. _CNV_A_R_LINEAR_____1_CM 0. 255. DISPLAY_IDENTIFIER C_ABC_INC_TOIL_PLAUS FORMAT "%3.0" /end CHARACTERISTIC
/begin CHARACTERISTIC c_abc_max_toil_el "Maximalwert Entprellzähler - TOIL_EL-Diagnose" VALUE 0x84fb65 _REC_VAL_20_u1 254. _CNV_A_R_LINEAR_____1_CM 1. 255. DISPLAY_IDENTIFIER C_ABC_MAX_TOIL_EL FORMAT "%3.0" /end CHARACTERISTIC
/begin CHARACTERISTIC c_abc_max_toil_plaus "Maximalwert Entprellzähler - TOIL_PLAUS-Diagnose" VALUE 0x84fb66 _REC_VAL_20_u1 254. _CNV_A_R_LINEAR_____1_CM 1. 255. DISPLAY_IDENTIFIER C_ABC_MAX_TOIL_PLAUS FORMAT "%3.0" /end CHARACTERISTIC
/begin CHARACTERISTIC c_tco_min_toil_plaus_diag "min. TCO für Plausibilisierung TOIL-Sensor 'Signal unplausibel niedrig'" VALUE 0x850024 _REC_VAL_20_u1 190.5 _CNV_A_R_LINEAR_____241_CM -48. 142.5 DISPLAY_IDENTIFIER C_TCO_MIN_TOIL_PLAUS_DIAG FORMAT "%5.1" /end CHARACTERISTIC
/begin CHARACTERISTIC c_tco_min_toil_diag "TCO-kalt-Schwelle - TOIL-Diagnose" VALUE 0x850023 _REC_VAL_20_u1 190.5 _CNV_A_R_LINEAR_____241_CM -48. 142.5 DISPLAY_IDENTIFIER C_TCO_MIN_TOIL_DIAG FORMAT "%5.1" /end CHARACTERISTIC
/begin CHARACTERISTIC c_tco_max_toil_plaus_diag "max. TCO für Plausibilisierung TOIL-Sensor 'Signal unplausibel hoch'" VALUE 0x85001e _REC_VAL_20_u1 190.5 _CNV_A_R_LINEAR_____241_CM -48. 142.5 DISPLAY_IDENTIFIER C_TCO_MAX_TOIL_PLAUS_DIAG FORMAT "%5.1" /end CHARACTERISTIC
/begin CHARACTERISTIC c_toil_min_plaus_diag "TOIL-Schwelle für Plausibilisierung TOIL-Sensor 'Signal unplausibel niedrig'" VALUE 0x85004a _REC_VAL_20_u1 200. _CNV_A_R_LINEAR_____65_CM -40. 160. DISPLAY_IDENTIFIER C_TOIL_MIN_PLAUS_DIAG FORMAT "%3.0" /end CHARACTERISTIC
/begin CHARACTERISTIC c_toil_max_plaus_diag "TOIL-Schwelle für Plausibilisierung TOIL-Sensor 'Signal unplausibel hoch'" VALUE 0x850047 _REC_VAL_20_u1 200. _CNV_A_R_LINEAR_____65_CM -40. 160. DISPLAY_IDENTIFIER C_TOIL_MAX_PLAUS_DIAG FORMAT "%3.0" /end CHARACTERISTIC
/begin CHARACTERISTIC c_t_tco_toil_diag "Diagnosesperrzeit nach Übergang aus ES" VALUE 0x84fffa _REC_VAL_20_u2 6553.400000000001 _CNV_A_R_LINEAR_____240_CM 0.1 6553.5 DISPLAY_IDENTIFIER C_T_TCO_TOIL_DIAG FORMAT "%6.1" /end CHARACTERISTIC
/begin CHARACTERISTIC c_t_toil_plaus_diag "min. Zeit nach Erreichen der TCO-Schwelle bis TOIL-Sensor plausibilisiert wird" VALUE 0x850000 _REC_VAL_20_u2 65535. _CNV_A_R_LINEAR_____27_CM 0. 65535. DISPLAY_IDENTIFIER C_T_TOIL_PLAUS_DIAG FORMAT "%5.0" /end CHARACTERISTIC
/begin CHARACTERISTIC c_t_pwl_max_stb "threshold for max. PWL-standby" VALUE 0x84ffe6 _REC_VAL_20_u2 6553.5 _CNV_A_R_LINEAR_____240_CM 0. 6553.5 DISPLAY_IDENTIFIER C_T_PWL_MAX_STB FORMAT "%6.1" /end CHARACTERISTIC
/begin CHARACTERISTIC c_abc_inc_egr_byp_dps "anti bounce counter increment for diagnosis instance EGR_BYP_DPS" VALUE 0x84fa97 _REC_VAL_20_u1 255. _CNV_A_R_LINEAR_____0_CM 0. 255. DISPLAY_IDENTIFIER C_ABC_INC_EGR_BYP_DPS FORMAT "%3.0" /end CHARACTERISTIC
/begin CHARACTERISTIC c_abc_max_egr_byp_dps "maximum value of anti bounce counter for diagnosis instance EGR_BYP_DPS" VALUE 0x84fb23 _REC_VAL_20_u1 255. _CNV_A_R_LINEAR_____0_CM 0. 255. DISPLAY_IDENTIFIER C_ABC_MAX_EGR_BYP_DPS FORMAT "%3.0" /end CHARACTERISTIC
/begin MEASUREMENT err_sym_mem_egr_byp_dps "Memorized symptom of the diagnostics instance EGR_BYP_DPS" UBYTE _CNV_S_6_CONV_ERRM__22_CM 1 0. 0. 15. DISPLAY_IDENTIFIER ERR_SYM_MEM_EGR_BYP_DPS ECU_ADDRESS 0x7fbe1c /end MEASUREMENT
/begin MEASUREMENT lv_err_egr_byp "global error flag for diagnosis of EGR_BYP" UBYTE _CNV_S_2_RANGE______23_CM 1 0. 0. 1. DISPLAY_IDENTIFIER LV_ERR_EGR_BYP ECU_ADDRESS 0x7fbe1b /end MEASUREMENT
/begin MEASUREMENT lv_scg_egr_byp "" UBYTE _CNV_A_R_LINEAR_____0_CM 1 0. 0. 1. DISPLAY_IDENTIFIER LV_SCG_EGR_BYP ECU_ADDRESS 0x7fbe1e FORMAT "%1.0" /end MEASUREMENT
/begin MEASUREMENT lv_scg_vld_egr_byp "" UBYTE _CNV_A_R_LINEAR_____0_CM 1 0. 0. 1. DISPLAY_IDENTIFIER LV_SCG_VLD_EGR_BYP ECU_ADDRESS 0x7fbe21 FORMAT "%1.0" /end MEASUREMENT
/begin MEASUREMENT lv_scb_egr_byp "" UBYTE _CNV_A_R_LINEAR_____0_CM 1 0. 0. 1. DISPLAY_IDENTIFIER LV_SCB_EGR_BYP ECU_ADDRESS 0x7fbe1d FORMAT "%1.0" /end MEASUREMENT
/begin MEASUREMENT lv_scb_vld_egr_byp "" UBYTE _CNV_A_R_LINEAR_____0_CM 1 0. 0. 1. DISPLAY_IDENTIFIER LV_SCB_VLD_EGR_BYP ECU_ADDRESS 0x7fbe20 FORMAT "%1.0" /end MEASUREMENT
/begin MEASUREMENT lv_ol_egr_byp "" UBYTE _CNV_A_R_LINEAR_____0_CM 1 0. 0. 1. DISPLAY_IDENTIFIER LV_OL_EGR_BYP ECU_ADDRESS 0x7fbe1f FORMAT "%1.0" /end MEASUREMENT
/begin MEASUREMENT lv_ol_vld_egr_byp "" UBYTE _CNV_A_R_LINEAR_____0_CM 1 0. 0. 1. DISPLAY_IDENTIFIER LV_OL_VLD_EGR_BYP ECU_ADDRESS 0x7fbe22 FORMAT "%1.0" /end MEASUREMENT
/begin MEASUREMENT lv_err_varcod "Fehler Variantencodierung entprellt" UBYTE _CNV_S_2_RANGE__0___85_CM 1 0. 0. 1. DISPLAY_IDENTIFIER LV_ERR_VARCOD ECU_ADDRESS 0x7fb8fe BIT_MASK 0x1 /end MEASUREMENT
/begin CHARACTERISTIC c_abc_inc_varcod " Inkrement Entprellzaehler" VALUE 0x84faf3 _REC_VAL_20_u1 255. _CNV_A_R_LINEAR_____1_CM 0. 255. DISPLAY_IDENTIFIER C_ABC_INC_VARCOD FORMAT "%3.0" /end CHARACTERISTIC
/begin CHARACTERISTIC c_abc_max_varcod "Maximalwert Entprellzaehler" VALUE 0x84fb7f _REC_VAL_20_u1 254. _CNV_A_R_LINEAR_____1_CM 1. 255. DISPLAY_IDENTIFIER C_ABC_MAX_VARCOD FORMAT "%3.0" /end CHARACTERISTIC
/begin CHARACTERISTIC c_varcod_diag_di "Konfigurationsbyte fuer Diagnose Variantencodierung (Ausblendung der entsprechenden Diagnose)" VALUE 0x8500ea _REC_VAL_20_u1 31. _CNV_A_R_LINEAR_____1_CM 0. 31. DISPLAY_IDENTIFIER C_VARCOD_DIAG_DI FORMAT "%3.0" /end CHARACTERISTIC
/begin MEASUREMENT lv_lock_imob "Immobilizer lock" UBYTE _CNV_S_2_RANGE______11_CM 1 0. 0. 1. DISPLAY_IDENTIFIER LV_LOCK_IMOB ECU_ADDRESS 0x7fbabe /end MEASUREMENT
/begin COMPU_METHOD _CNV_A_R_LINEAR_____0_CM "" RAT_FUNC "%6.3" "[-]" COEFFS 0 1. 0. 0 0 1 /end COMPU_METHOD
/begin COMPU_METHOD _CNV_A_R_LINEAR_____1_CM "" RAT_FUNC "%6.3" "-" COEFFS 0 1. 0. 0 0 1 /end COMPU_METHOD
/begin COMPU_METHOD _CNV_A_R_LINEAR_____5_CM "" RAT_FUNC "%6.3" "[rpm]" COEFFS 0 1. 0. 0 0 1 /end COMPU_METHOD
/begin COMPU_METHOD _CNV_S_2_RANGE______11_CM "" TAB_VERB "%6.3" "[-]" COMPU_TAB_REF _CNV_S_2_RANGE______11 /end COMPU_METHOD
/begin COMPU_VTAB _CNV_S_2_RANGE______11 "" TAB_VERB 2 0 "0" 1 "1" /end COMPU_VTAB
/begin COMPU_METHOD _CNV_A_R_LINEAR_____12_CM "" RAT_FUNC "%6.3" "[%]" COEFFS 0 327.6800000003072 3.071909304708242e-008 0 0 1 /end COMPU_METHOD
/begin COMPU_METHOD _CNV_A_R_LINEAR_____16_CM "" RAT_FUNC "%6.3" "[s]" COEFFS 0 1. 0. 0 0 1 /end COMPU_METHOD
/begin COMPU_METHOD _CNV_A_R_LINEAR_____18_CM "" RAT_FUNC "%6.3" "[°C]" COEFFS 0 1. 50. 0 0 1 /end COMPU_METHOD
/begin COMPU_METHOD _CNV_A_R_LINEAR_____19_CM "" RAT_FUNC "%6.3" "[s]" COEFFS 0 10. 0. 0 0 1 /end COMPU_METHOD
/begin COMPU_METHOD _CNV_S_6_CONV_ERRM__22_CM "" TAB_VERB "%6.3" "[-]" COMPU_TAB_REF _CNV_S_6_CONV_ERRM__22 /end COMPU_METHOD
/begin COMPU_VTAB _CNV_S_6_CONV_ERRM__22 "" TAB_VERB 6 0 "NO_SYM" 1 "SYM_0" 2 "SYM_1" 4 "SYM_2" 8 "SYM_3" 15 "BENCH_MODE" /end COMPU_VTAB
/begin COMPU_METHOD _CNV_S_2_RANGE______23_CM "" TAB_VERB "%6.3" "[-]" COMPU_TAB_REF _CNV_S_2_RANGE______23 /end COMPU_METHOD
/begin COMPU_VTAB _CNV_S_2_RANGE______23 "" TAB_VERB 2 0 "passive" 1 "active" /end COMPU_VTAB
/begin COMPU_METHOD _CNV_A_R_LINEAR_____27_CM "" RAT_FUNC "%6.3" "s" COEFFS 0 1. 0. 0 0 1 /end COMPU_METHOD
/begin COMPU_METHOD _CNV_A_R_LINEAR_____28_CM "" RAT_FUNC "%6.3" "[V]" COEFFS 0 204.8 0. 0 0 1 /end COMPU_METHOD
/begin COMPU_METHOD _CNV_A_R_LINEAR_____34_CM "" RAT_FUNC "%6.3" "[km/h]" COEFFS 0 1. 0. 0 0 1 /end COMPU_METHOD
/begin COMPU_METHOD _CNV_A_R_LINEAR_____39_CM "" RAT_FUNC "%6.3" "[%]" COEFFS 0 2.55 0. 0 0 1 /end COMPU_METHOD
/begin COMPU_METHOD _CNV_A_R_LINEAR_____43_CM "" RAT_FUNC "%6.3" "[V]" COEFFS 0 8.854166666666666 0. 0 0 1 /end COMPU_METHOD
/begin COMPU_METHOD _CNV_A_R_LINEAR_____45_CM "" RAT_FUNC "%6.3" "[hPa]" COEFFS 0 12.06017666543982 0. 0 0 1 /end COMPU_METHOD
/begin COMPU_METHOD _CNV_A_R_LINEAR_____46_CM "" RAT_FUNC "%6.3" "[%]" COEFFS 0 327.6800000003072 3.071967512372036e-008 0 0 1 /end COMPU_METHOD
/begin COMPU_METHOD _CNV_A_R_LINEAR_____47_CM "" RAT_FUNC "%6.3" "[V]" COEFFS 0 13107.20001587224 0. 0 0 1 /end COMPU_METHOD
/begin COMPU_METHOD _CNV_A_R_LINEAR_____48_CM "" RAT_FUNC "%6.3" "[-]" COEFFS 0 32767.99807357072 0. 0 0 1 /end COMPU_METHOD
/begin COMPU_METHOD _CNV_A_R_LINEAR_____49_CM "" RAT_FUNC "%6.3" "[hPa/10ms]" COEFFS 0 12.06017666543982 0. 0 0 1 /end COMPU_METHOD
/begin COMPU_METHOD _CNV_A_R_LINEAR_____52_CM "" RAT_FUNC "%6.3" "[Nm]" COEFFS 0 32. 0. 0 0 1 /end COMPU_METHOD
/begin COMPU_METHOD _CNV_A_R_LINEAR_____56_CM "" RAT_FUNC "%6.3" "[s]" COEFFS 0 100. 0. 0 0 1 /end COMPU_METHOD
/begin COMPU_METHOD _CNV_A_R_LINEAR_____57_CM "" RAT_FUNC "%6.3" "[hPa]" COEFFS 0 12.06036070024094 2.255463186884299e-005 0 0 1 /end COMPU_METHOD
/begin COMPU_METHOD _CNV_A_R_LINEAR_____58_CM "" RAT_FUNC "%6.3" "[hPa]" COEFFS 0 12.06036070024094 2.255463233158328e-005 0 0 1 /end COMPU_METHOD
/begin COMPU_METHOD _CNV_A_R_LINEAR_____59_CM "" RAT_FUNC "%6.3" "[-]" COEFFS 0 16383.81262712377 0. 0 0 1 /end COMPU_METHOD
/begin COMPU_METHOD _CNV_A_R_LINEAR_____65_CM "" RAT_FUNC "%6.3" "°C" COEFFS 0 1. 40. 0 0 1 /end COMPU_METHOD
/begin COMPU_METHOD _CNV_A_R_LINEAR_____72_CM "" RAT_FUNC "%6.3" "[m/(s*s)]" COEFFS 0 12.5 175. 0 0 1 /end COMPU_METHOD
/begin COMPU_METHOD _CNV_A_R_LINEAR_____79_CM "" RAT_FUNC "%6.3" "[%]" COEFFS 0 2.56 0. 0 0 1 /end COMPU_METHOD
/begin COMPU_METHOD _CNV_A_R_LINEAR_____80_CM "" RAT_FUNC "%6.3" "[Nm]" COEFFS 0 31.99984374837874 32767.83999833983 0 0 1 /end COMPU_METHOD
/begin COMPU_METHOD _CNV_A_R_LINEAR_____81_CM "" RAT_FUNC "%6.3" "rpm" COEFFS 0 3.125e-002 0. 0 0 1 /end COMPU_METHOD
/begin COMPU_METHOD _CNV_S_2_RANGE__0___85_CM "" TAB_VERB "%6.3" "-" COMPU_TAB_REF _CNV_S_2_RANGE__0___85 /end COMPU_METHOD
/begin COMPU_VTAB _CNV_S_2_RANGE__0___85 "" TAB_VERB 2 0 "0" 1 "1" /end COMPU_VTAB
/begin COMPU_METHOD _CNV_A_R_LINEAR_____110_CM "" RAT_FUNC "%6.3" "[kg/h]" COEFFS 0 64. 0. 0 0 1 /end COMPU_METHOD
/begin COMPU_METHOD _CNV_A_R_LINEAR_____137_CM "" RAT_FUNC "%6.3" "-" COEFFS 0 65535.99999999996 0. 0 0 1 /end COMPU_METHOD
/begin COMPU_METHOD _CNV_A_R_LINEAR_____154_CM "" RAT_FUNC "%6.3" "rpm" COEFFS 0 1. 0. 0 0 1 /end COMPU_METHOD
/begin COMPU_METHOD _CNV_A_R_LINEAR_____161_CM "" RAT_FUNC "%6.3" "[%]" COEFFS 0 327.680000069121 32768.0000069121 0 0 1 /end COMPU_METHOD
/begin COMPU_METHOD _CNV_A_R_LINEAR_____209_CM "" RAT_FUNC "%6.3" "[kPa]" COEFFS 0 8.225806451612903e-002 0. 0 0 1 /end COMPU_METHOD
/begin COMPU_METHOD _CNV_A_R_LINEAR_____226_CM "" RAT_FUNC "%6.3" "s" COEFFS 0 100. 0. 0 0 1 /end COMPU_METHOD
/begin COMPU_METHOD _CNV_A_R_LINEAR_____227_CM "" RAT_FUNC "%6.3" "Nms" COEFFS 0 100. 0. 0 0 1 /end COMPU_METHOD
/begin COMPU_METHOD _CNV_A_R_LINEAR_____228_CM "" RAT_FUNC "%6.3" "ms" COEFFS 0 2.e-002 0. 0 0 1 /end COMPU_METHOD
/begin COMPU_METHOD _CNV_A_R_LINEAR_____229_CM "" RAT_FUNC "%6.3" "ms" COEFFS 0 5.e-003 0. 0 0 1 /end COMPU_METHOD
/begin COMPU_METHOD _CNV_A_R_LINEAR_____230_CM "" RAT_FUNC "%6.3" "µs" COEFFS 0 1. 0. 0 0 1 /end COMPU_METHOD
/begin COMPU_METHOD _CNV_A_R_LINEAR_____237_CM "" RAT_FUNC "%6.3" "[kPa/100ms]" COEFFS 0 1. 0. 0 0 1 /end COMPU_METHOD
/begin COMPU_METHOD _CNV_A_R_LINEAR_____240_CM "" RAT_FUNC "%6.3" "s" COEFFS 0 10. 0. 0 0 1 /end COMPU_METHOD
/begin COMPU_METHOD _CNV_A_R_LINEAR_____241_CM "" RAT_FUNC "%6.3" "[\260C]" COEFFS 0 1.333333333333333 64. 0 0 1 /end COMPU_METHOD
/begin COMPU_METHOD _CNV_A_R_LINEAR_____242_CM "" RAT_FUNC "%6.3" "%/100ms" COEFFS 0 2.56 0. 0 0 1 /end COMPU_METHOD
/begin COMPU_METHOD _CNV_A_R_LINEAR_____243_CM "" RAT_FUNC "%6.3" "[rpm]" COEFFS 0 6.25e-002 0. 0 0 1 /end COMPU_METHOD
/begin COMPU_METHOD _CNV_A_R_LINEAR_____244_CM "" RAT_FUNC "%6.3" "-" COEFFS 0 64. 0. 0 0 1 /end COMPU_METHOD
/begin COMPU_METHOD _CNV_A_R_LINEAR_____245_CM "" RAT_FUNC "%6.3" "km/h" COEFFS 0 1. 0. 0 0 1 /end COMPU_METHOD
/begin COMPU_METHOD _CNV_A_R_LINEAR_____246_CM "" RAT_FUNC "%6.3" "-" COEFFS 0 128. 0. 0 0 1 /end COMPU_METHOD
/begin COMPU_METHOD _CNV_A_R_LINEAR_____247_CM "" RAT_FUNC "%6.3" "hPa" COEFFS 0 12.06017666543982 0. 0 0 1 /end COMPU_METHOD
/begin COMPU_METHOD _CNV_A_R_LINEAR_____248_CM "" RAT_FUNC "%6.3" "[%]" COEFFS 0 2.5 0. 0 0 1 /end COMPU_METHOD
/begin COMPU_METHOD _CNV_A_R_LINEAR_____249_CM "" RAT_FUNC "%6.3" "[°C]" COEFFS 0 1.333333333333333 0. 0 0 1 /end COMPU_METHOD
/begin COMPU_METHOD _CNV_A_R_LINEAR_____250_CM "" RAT_FUNC "%6.3" "[V]" COEFFS 0 9.807692307692308 0. 0 0 1 /end COMPU_METHOD
/begin COMPU_METHOD _CNV_A_R_LINEAR_____251_CM "" RAT_FUNC "%6.3" "-" COEFFS 0 16. 0. 0 0 1 /end COMPU_METHOD
/begin COMPU_METHOD _CNV_S_4_STATE_POP__252_CM "" TAB_VERB "%6.3" "[-]" COMPU_TAB_REF _CNV_S_4_STATE_POP__252 /end COMPU_METHOD
/begin COMPU_VTAB _CNV_S_4_STATE_POP__252 "" TAB_VERB 4 0 "NO_POP_COC" 1 "PHASE_1" 2 "PHASE 2" 3 "Ramp down" /end COMPU_VTAB
/begin COMPU_METHOD _CNV_A_R_LINEAR_____253_CM "" RAT_FUNC "%6.3" "l/100km" COEFFS 0 708.3333333333334 0. 0 0 1 /end COMPU_METHOD
/begin COMPU_METHOD _CNV_A_R_LINEAR_____254_CM "" RAT_FUNC "%6.3" "-" COEFFS 0 256. 0. 0 0 1 /end COMPU_METHOD
/begin COMPU_METHOD _CNV_A_R_LINEAR_____255_CM "" RAT_FUNC "%6.3" "ml/s" COEFFS 0 4000. 0. 0 0 1 /end COMPU_METHOD
/begin COMPU_METHOD _CNV_A_R_LINEAR_____256_CM "" RAT_FUNC "%6.3" "[bar]" COEFFS 0 2. 0. 0 0 1 /end COMPU_METHOD
/begin COMPU_METHOD _CNV_A_R_LINEAR_____257_CM "" RAT_FUNC "%6.3" "°C" COEFFS 0 1.333333333333333 64. 0 0 1 /end COMPU_METHOD
/begin COMPU_METHOD _CNV_A_R_LINEAR_____258_CM "" RAT_FUNC "%6.3" "%" COEFFS 0 655.3599999999997 0. 0 0 1 /end COMPU_METHOD
/begin COMPU_METHOD _CNV_A_R_LINEAR_____260_CM "" RAT_FUNC "%6.3" "[C]" COEFFS 0 1.333333333333333 0. 0 0 1 /end COMPU_METHOD
/begin COMPU_METHOD _CNV_A_R_LINEAR_____261_CM "" RAT_FUNC "%6.3" "[C]" COEFFS 0 1.333333333333333 128. 0 0 1 /end COMPU_METHOD
/begin COMPU_METHOD _CNV_A_R_LINEAR_____262_CM "" RAT_FUNC "%6.3" "-" COEFFS 0 255. 0. 0 0 1 /end COMPU_METHOD
/begin COMPU_METHOD _CNV_A_R_LINEAR_____263_CM "" RAT_FUNC "%6.3" "[-]" COEFFS 0 10. 0. 0 0 1 /end COMPU_METHOD
/begin COMPU_METHOD _CNV_A_R_LINEAR_____269_CM "" RAT_FUNC "%6.3" "[V]" COEFFS 0 10.62059202605951 0. 0 0 1 /end COMPU_METHOD
/begin COMPU_METHOD _CNV_A_R_LINEAR_____293_CM "" RAT_FUNC "%6.3" "[l]" COEFFS 0 16000. 0. 0 0 1 /end COMPU_METHOD
/begin COMPU_METHOD _CNV_A_R_LINEAR_____294_CM "" RAT_FUNC "%6.3" "[ml]" COEFFS 0 4. 0. 0 0 1 /end COMPU_METHOD
/begin COMPU_METHOD _CNV_A_R_LINEAR_____295_CM "" RAT_FUNC "%6.3" "[ms]" COEFFS 0 2. -200. 0 0 1 /end COMPU_METHOD
/begin COMPU_METHOD _CNV_A_R_LINEAR_____296_CM "" RAT_FUNC "%6.3" "[mm]" COEFFS 0 16. 0. 0 0 1 /end COMPU_METHOD
/begin COMPU_METHOD _CNV_A_R_LINEAR_____297_CM "" RAT_FUNC "%6.3" "[ml]" COEFFS 0 6.666666666666667e-002 127. 0 0 1 /end COMPU_METHOD
/begin COMPU_METHOD _CNV_A_R_LINEAR_____298_CM "" RAT_FUNC "%6.3" "-" COEFFS 0 50000000. 0. 0 0 1 /end COMPU_METHOD
/begin COMPU_METHOD _CNV_A_R_LINEAR_____299_CM "" RAT_FUNC "%6.3" "-" COEFFS 0 500000.0000000001 0. 0 0 1 /end COMPU_METHOD
/begin COMPU_METHOD _CNV_A_R_LINEAR_____300_CM "" RAT_FUNC "%6.3" "°C" COEFFS 0 1. 60. 0 0 1 /end COMPU_METHOD
/begin COMPU_METHOD _CNV_A_R_LINEAR_____301_CM "" RAT_FUNC "%6.3" "mm" COEFFS 0 16. 0. 0 0 1 /end COMPU_METHOD
/begin COMPU_METHOD _CNV_A_R_LINEAR_____302_CM "" RAT_FUNC "%6.3" "-" COEFFS 0 20. 0. 0 0 1 /end COMPU_METHOD
/begin COMPU_METHOD _CNV_A_R_LINEAR_____303_CM "" RAT_FUNC "%6.3" "m/s²" COEFFS 0 2560. -256. 0 0 1 /end COMPU_METHOD
/begin COMPU_METHOD _CNV_A_R_LINEAR_____304_CM "" RAT_FUNC "%6.3" "-" COEFFS 0 32. 0. 0 0 1 /end COMPU_METHOD
/begin COMPU_METHOD _CNV_A_R_LINEAR_____305_CM "" RAT_FUNC "%6.3" "[ms]" COEFFS 0 8. 0. 0 0 1 /end COMPU_METHOD
/begin COMPU_METHOD _CNV_A_R_LINEAR_____306_CM "" RAT_FUNC "%6.3" "l" COEFFS 0 12.8 0. 0 0 1 /end COMPU_METHOD
/begin COMPU_METHOD _CNV_A_R_LINEAR_____307_CM "" RAT_FUNC "%6.3" "ml" COEFFS 0 0.5 0. 0 0 1 /end COMPU_METHOD
/begin COMPU_METHOD _CNV_A_R_LINEAR_____308_CM "" RAT_FUNC "%6.3" "l" COEFFS 0 4000. 0. 0 0 1 /end COMPU_METHOD
/begin COMPU_METHOD _CNV_A_R_LINEAR_____309_CM "" RAT_FUNC "%6.3" "m/s²" COEFFS 0 2560. 32512. 0 0 1 /end COMPU_METHOD
/begin COMPU_METHOD _CNV_A_R_LINEAR_____310_CM "" RAT_FUNC "%6.3" "-" COEFFS 0 50. 0. 0 0 1 /end COMPU_METHOD
/begin COMPU_METHOD _CNV_A_R_LINEAR_____311_CM "" RAT_FUNC "%6.3" "µl" COEFFS 0 1. 0. 0 0 1 /end COMPU_METHOD
/begin COMPU_METHOD _CNV_A_R_LINEAR_____312_CM "" RAT_FUNC "%6.3" "[m]" COEFFS 0 1. 0. 0 0 1 /end COMPU_METHOD
/begin COMPU_METHOD _CNV_A_R_LINEAR_____313_CM "" RAT_FUNC "%6.3" "-" COEFFS 0 100000. 0. 0 0 1 /end COMPU_METHOD
/begin COMPU_METHOD _CNV_A_R_LINEAR_____314_CM "" RAT_FUNC "%6.3" "[km]" COEFFS 0 2.e-003 0. 0 0 1 /end COMPU_METHOD
/begin COMPU_METHOD _CNV_A_R_LINEAR_____315_CM "" RAT_FUNC "%6.3" "µl/100ms" COEFFS 0 1. 0. 0 0 1 /end COMPU_METHOD
/begin COMPU_METHOD _CNV_A_R_LINEAR_____316_CM "" RAT_FUNC "%6.3" "[l/mm]" COEFFS 0 1000. 0. 0 0 1 /end COMPU_METHOD
/begin COMPU_METHOD _CNV_A_R_LINEAR_____317_CM "" RAT_FUNC "%6.3" "ml/s" COEFFS 0 1000. 0. 0 0 1 /end COMPU_METHOD
/begin COMPU_METHOD _CNV_A_R_LINEAR_____347_CM "" RAT_FUNC "%6.3" "[hPa/100ms]" COEFFS 0 12.06017666543982 0. 0 0 1 /end COMPU_METHOD
/begin COMPU_METHOD _CNV_A_R_LINEAR_____348_CM "" RAT_FUNC "%6.3" "[V/10ms]" COEFFS 0 204.8 0. 0 0 1 /end COMPU_METHOD
/begin RECORD_LAYOUT _REC_VAL_20_u1 FNC_VALUES 1 UBYTE COLUMN_DIR DIRECT /end RECORD_LAYOUT
/begin RECORD_LAYOUT _REC_AXS_20_u2 NO_AXIS_PTS_X 1 UWORD AXIS_PTS_X 2 UWORD INDEX_INCR DIRECT /end RECORD_LAYOUT
/begin RECORD_LAYOUT _REC_MAP_20_u2_u2_u2 FNC_VALUES 1 UWORD COLUMN_DIR DIRECT /end RECORD_LAYOUT
/begin RECORD_LAYOUT _REC_VAL_20_u2 FNC_VALUES 1 UWORD COLUMN_DIR DIRECT /end RECORD_LAYOUT
/begin RECORD_LAYOUT _REC_VAL_20_s2 FNC_VALUES 1 SWORD COLUMN_DIR DIRECT /end RECORD_LAYOUT
/begin RECORD_LAYOUT _REC_AXS_20_u1 NO_AXIS_PTS_X 1 UBYTE AXIS_PTS_X 2 UBYTE INDEX_INCR DIRECT /end RECORD_LAYOUT
/begin RECORD_LAYOUT _REC_CUR_20_u2_u2 FNC_VALUES 1 UWORD COLUMN_DIR DIRECT /end RECORD_LAYOUT
/begin RECORD_LAYOUT _REC_CUR_20_u2_u1 FNC_VALUES 1 UWORD COLUMN_DIR DIRECT /end RECORD_LAYOUT
/begin RECORD_LAYOUT _REC_MAP_20_u1_u2_u2 FNC_VALUES 1 UBYTE COLUMN_DIR DIRECT /end RECORD_LAYOUT
/begin RECORD_LAYOUT _REC_MAP_20_u2_u1_u1 FNC_VALUES 1 UWORD COLUMN_DIR DIRECT /end RECORD_LAYOUT
/begin RECORD_LAYOUT _REC_MAP_20_u2_u2_u1 FNC_VALUES 1 UWORD COLUMN_DIR DIRECT /end RECORD_LAYOUT
/begin RECORD_LAYOUT _REC_CUR_20_u1_u2 FNC_VALUES 1 UBYTE COLUMN_DIR DIRECT /end RECORD_LAYOUT
/begin RECORD_LAYOUT _REC_CUR_20_u1_u1 FNC_VALUES 1 UBYTE COLUMN_DIR DIRECT /end RECORD_LAYOUT
/begin RECORD_LAYOUT _REC_MAP_20_u2_u1_u2 FNC_VALUES 1 UWORD COLUMN_DIR DIRECT /end RECORD_LAYOUT
/begin RECORD_LAYOUT _REC_MAP_20_u1_u1_u1 FNC_VALUES 1 UBYTE COLUMN_DIR DIRECT /end RECORD_LAYOUT
/begin RECORD_LAYOUT _REC_MAP_20_u1_u1_u2 FNC_VALUES 1 UBYTE COLUMN_DIR DIRECT /end RECORD_LAYOUT
/begin RECORD_LAYOUT _REC_VAL_20_s1 FNC_VALUES 1 SBYTE COLUMN_DIR DIRECT /end RECORD_LAYOUT
/begin FUNCTION AUX_Electr_Cool_Fans ""
 /begin DEF_CHARACTERISTIC lc_cool_req_save_diagcps_ena c_tco_max_cool_req_save_diagcps c_cool_req_ac_save_ofs c_cool_req_ecf_1_lgrd c_cool_req_ecf_2_lgrd ldp_cool_req_tcu_can__cool_req ip_cool_req_tcu c_n_sp_ecf_1_min_tol c_n_sp_ecf_1_min_bol c_n_sp_ecf_2_min_tol c_n_sp_ecf_2_min_bol c_n_sp_ecf_1_min c_n_sp_ecf_2_min c_n_sp_ecf_1_fout_1_bol c_n_sp_ecf_1_fout_1_tol c_n_sp_ecf_1_fout_2_bol c_n_sp_ecf_1_fout_2_tol c_n_sp_ecf_1_fout_3_bol c_n_sp_ecf_1_fout_3_tol c_n_sp_ecf_1_fout_4_bol c_n_sp_ecf_1_fout_4_tol c_n_sp_ecf_1_fout_5_bol c_n_sp_ecf_1_fout_5_tol c_n_sp_ecf_2_fout_1_bol c_n_sp_ecf_2_fout_1_tol c_n_sp_ecf_2_fout_2_bol c_n_sp_ecf_2_fout_2_tol c_n_sp_ecf_2_fout_3_bol c_n_sp_ecf_2_fout_3_tol c_n_sp_ecf_2_fout_4_bol c_n_sp_ecf_2_fout_4_tol c_n_sp_ecf_2_fout_5_bol c_n_sp_ecf_2_fout_5_tol lc_ena_fac_n_sp_ecf_1 lc_ena_fac_n_sp_ecf_2 ldp_cool_req_ecf_1 ldp_cool_req_ecf_2 ldpm_n_32__n_sp_ecf ip_n_sp_ecf_1 ip_n_sp_ecf_2 ldp_vs__n_sp_ecf ip_fac_n_sp_ecf_vs ldp_tam__fac_n_sp_ecf ldp_amp__fac_n_sp_ecf ip_fac_n_sp_ecf_amp lc_ecf_1_dc lc_ecf_2_dc c_tco_max_ecf_hys c_tco_2_max_ecf lc_equip_tco_2 c_ecfpwm_1_tco_max c_ecfpwm_2_tco_max c_t_ecf_ast_act c_ecfpwm_1_st_ast c_ecfpwm_2_st_ast c_ecfpwm_1_lgrd c_ecfpwm_2_lgrd c_t_ecfpwm_pwl_lgrd c_tco_2_max_ecf_hys c_ecfpwm_vecu_lgrd c_ecfpwm_vecu_max c_ecfpwm_deac c_ecfpwm_1_max c_ecfpwm_2_max ldpm_vb_mmv__ecfpwm ip_ecfpwm_1_fac_vb ip_ecfpwm_2_fac_vb ldp_n_sp_ecf_1__ecfpwm ip_ecfpwm_1 ldp_n_sp_ecf_2__ecfpwm ip_ecfpwm_2 ldpm_tco__ecfpwm_pwl ldpm_tam__ecfpwm_pwl ip_ecfpwm_1_pwl ip_ecfpwm_2_pwl ldp_ecfpwm_1__n_rel_ecf_can ldp_ecfpwm_2__n_rel_ecf_can ip_n_rel_ecf_can c_fac_t_pop_phase_2 c_t_pop_coc_max ldp_tco__t_pop_bas ldp_fco_vs__t_pop_bas ldp_tam__t_pop_fac ldp_tco__t_pop_2 ldp_tam__t_pop_2 ldp_tco_stop__tco_sp_pop_stop ldp_tco__t_pop_cor ldp_tam__t_pop_cor ldp_toil__t_pop_toil ip_t_pop_bas ip_t_pop_fac ip_t_pop_2 ip_tco_sp_pop_stop ip_t_pop_cor ip_t_pop_toil ldp_cool_req_ac_ip_cool_ac_clc ip_cool_req_ac_clc ldp_tco__ecfpwm_max ldp_fco_t__ecfpwm_max ip_tco_fco_t_max_ecf c_acp_ecfpwm_max c_tam_ecfpwm_max c_t_hld_ecfpwm_max c_cool_req_ac_ecfpwm_max c_t_ast_tol_pop_coc c_t_ast_bol_pop_coc /end DEF_CHARACTERISTIC
 /begin OUT_MEASUREMENT cool_req_ecf_1 cool_req_ecf_2 cool_req_tot_inter cool_req_tcu cool_req_tot_inter_save lv_cool_req_save_diagcps cool_req_ecf_clc cool_req_ac_save n_sp_ecf_1 n_sp_ecf_2 lv_n_sp_ecf_1_hys lv_n_sp_ecf_2_hys n_sp_ecf_1_raw n_sp_ecf_2_raw n_sp_ecf_1_inter_1 n_sp_ecf_2_inter_1 n_sp_ecf_1_inter_2 n_sp_ecf_2_inter_2 lv_n_sp_ecf_1_fout lv_n_sp_ecf_2_fout fac_n_sp_ecf_1 fac_n_sp_ecf_2 ecfpwm_1 ecfpwm_2 ecfpwm_1_raw ecfpwm_2_raw lv_ecfpwm_tco_max lv_ecfpwm_tco_2_max lv_ecfpwm_max ecfpwm_1_inter_1 ecfpwm_2_inter_1 n_rel_ecf_can ecfpwm_1_inter_4_lgrd ecfpwm_2_inter_4_lgrd ecfpwm_sub_vecu ecfpwm_1_inter_4 ecfpwm_2_inter_4 t_pop_coc t_pop_bas t_pop_bas_cor t_pop_cor t_pop_toil tco_sp_pop_stop t_pop_2 state_pop_coc t_pop_coc_end cool_req_ac_clc t_hld_ecfpwm_max t_pop_coc_inter_1 t_pop_coc_inter_2 /end OUT_MEASUREMENT
/end FUNCTION
/begin FUNCTION AUX_Eng_Cool_Control ""
 /begin DEF_CHARACTERISTIC c_cool_req_eng_inter_sub c_cool_req_eng_min c_cool_req_eng_max lc_tco_2_sp_mdl_ena c_crlc_tco_2_sp_inc c_crlc_tco_2_sp_dec lc_inp_tco_sp c_ectpwm_1_tco_2_sp_add c_ectpwm_2_tco_2_sp_add c_tco_dif_1_tco_2_sp_add c_tco_dif_2_tco_2_sp_add c_t_dly_1_tco_2_sp_add c_t_dly_2_tco_2_sp_add c_tco_2_sp_sub c_tco_2_sub_cool_req c_vs_cool_req_sub c_tco_2_dif_hys ldp_tco__cool_req_eng_tco ldp_tam__cool_req_eng_tco ip_cool_req_eng_tco ldp_tco_dif__cool_req_eng_dyn ldp_tco_1_2__cool_req_eng_dyn ip_cool_req_eng_dyn ldp_cool_req_eng_inter__cool_req_eng_cor ldp_vs_cool_req__cool_req_eng_cor ip_cool_req_eng_cor ldp_n__tco_2_sp_1 ldp_tqi_req_slow__tco_2_sp_1 ip_tco_2_sp_1 ldp_tco_inp__tco_2_sp_3 ldp_tco_2_sp_mmv__tco_2_sp_3 ip_tco_2_sp_3 ldp_tco__tco_2_sp_2 ldp_tam__tco_2_sp_2 ip_tco_2_sp_2 ldp_n__fac_tco_2_sp_cor ip_fac_tco_2_sp_cor ldp_tco_dif__tco_2_sp_cor_2 ldp_tco_1_2__tco_2_sp_cor_2 ip_tco_2_sp_cor_2 ldp_vs_cool_req__cool_req_eng_bas ldp_tco_2_dif__cool_req_eng_bas ip_cool_req_eng_bas ldp_tco_2_dif__cool_req_eng_i ip_cool_req_eng_i c_acp_cool_req_hys c_acp_sub_cool_req_ac c_acp_cool_req_inc c_acp_cool_req_dec ldp_ecf_req_ac_can__cool_req ip_cool_req_ac_can ldpm_acp_cor__cool_req_acp ip_cool_req_ac_acp_act ip_cool_req_ac_acp_deac ldp_vs__fac_cool_req_ac_vs ip_fac_cool_req_ac_vs /end DEF_CHARACTERISTIC
 /begin OUT_MEASUREMENT cool_req_eng cool_req_eng_inter cool_req_eng_dyn cool_req_eng_tco cool_req_eng_clc t_dly_1_tco_2_sp_add t_dly_2_tco_2_sp_add tco_2_sp_1 tco_2_sp_2 tco_2_sp_3 tco_2_sp_4 tco_2_sp_5 tco_2_sp_6 tco_2_sp_cor_2 tco_2_sp tco_2_dif tco_2_sp_mmv vs_cool_req cool_req_eng_bas cool_req_eng_cor cool_req_ac acp_cor cool_req_ac_acp cool_req_ac_can cool_req_ac_inter tco_inp /end OUT_MEASUREMENT
/end FUNCTION
/begin FUNCTION AUX_Calc_Lubric_Maint_Interv ""
 /begin DEF_CHARACTERISTIC c_t_oil_level_min c_t_oil_level_max ldp_t_oil_level1_can ip_oil_level_t_cool_wiv c_oil_level_ctr_sub c_oil_level_dif_mv_sho_sub c_toil_max_fac_chrg c_fac_chrg c_fac_level_estim_wiv_cor lc_ac_trv_wiv_fil_use c_fac_ac_trv_wiv c_fac_n_wiv lc_toil_wiv_sub_use lc_fac_qly_wiv_sub_use c_n_max_oil_level c_n_min_oil_level c_toil_max_oil_level c_toil_min_oil_level c_toil_wiv_err c_toil_wiv_nvld c_toil_wiv_sub c_toil_wiv_ini c_t_toil_max c_t_toil_min c_fco_cyl_max ldp_t_oil_can ldp_n_wiv ldpm_toil_wiv_clc ldp_ac_trv_tcs2 ldp_n_wiv_oil_level_cor_wiv ldp_toil_wiv_temp2 id_fac_fco_estim_wiv ip_fac_qly_wiv ip_toil_wiv_temp ip_oil_level_cor_wiv c_t_fout_oil_sens_caut c_t_fout_oil_level_dif_mv_sho c_fac_soot_wiv c_fac_wear_wiv c_fac_equ_wiv ldp_fco_dif ip_soot_equ ldp_n_wiv__ip_wear_equ ldp_toil_wiv_clc ip_wear_equ ldp_n_wiv__ip_soot_equ c_oil_slop_level /end DEF_CHARACTERISTIC
 /begin OUT_MEASUREMENT lv_oil_level1_nplaus lv_oil_level2_nplaus lv_oil_level3_nplaus lv_oil_level4_nplaus lv_oil_level4_chk lv_oil_level1_chk lv_oil_level2_chk lv_oil_level3_chk oil_level2_vol oil_level3_vol oil_level4_vol oil_level_sum_cor oil_level_ctr oil_level_dif_mv_sho lv_oil_warn lv_oil_sens_warn lv_emsf_state_2 lv_fcn_clc_4400 lv_fcn_clc_2400 ctr_fcn_clc_4400 ctr_fcn_clc_2400 wear_fco_equ lv_emsf_state_1_tmp fac_oil_wiv toil_wiv lv_emsf_state_1 lv_oil_level_not_vld oil_level_cor_wiv fac_qly_wiv_cor fac_level_estim_wiv ac_trv_wiv_fil toil_wiv_clc toil_wiv_raw ctr_oil_level_sum_cor ctr_oil_level_sum oil_level_sum oil_level_vol_sum n_wiv lv_toil_wiv_nplaus_tmp fac_qly_wiv fac_fco_estim_wiv oil_level1_vol oil_level1 oil_level2 oil_level4 oil_level3 fco_dif_wiv soot_equ lv_emsf_state_1_ds soot_wiv_value soot_equ_ds wear_equ_ds oil_level_ctr_tmp oil_level_dif_mv_sho_tmp wear_wiv_value lv_emsf_state_1_gs wear_fco_equ_gs lv_err_t_toil_can /end OUT_MEASUREMENT
/end FUNCTION
/begin FUNCTION AUX_Calc_Lubric_Maint_Interv__AI "" /begin OUT_MEASUREMENT fco_dif lv_tog1_can_nvld lv_tcs2_can_nvld /end OUT_MEASUREMENT /end FUNCTION
/begin FUNCTION AUX_ECU_Power_Latch_Manag__AI "" /begin DEF_CHARACTERISTIC c_t_pwl_max_stb /end DEF_CHARACTERISTIC /end FUNCTION
/begin FUNCTION AUX_Fuel_Consumption_Calc "Fuel consumption calculation for VAG-Tester and CAN" /begin DEF_CHARACTERISTIC c_fco_stnd c_crlc_fco_vs c_t_fco_t_clc /end DEF_CHARACTERISTIC /begin OUT_MEASUREMENT fco_sum_can fco_vs lv_fco_sum_ovfl fco_sum fco_t fco_t_raw /end OUT_MEASUREMENT /end FUNCTION
/begin FUNCTION AUX_IMOB_INC "Electronic Immobilizer (Appl. Inc.)" /begin OUT_MEASUREMENT lv_lock_imob /end OUT_MEASUREMENT /end FUNCTION
/begin FUNCTION C_A_DIA ""
 /begin SUB_FUNCTION DIA_CAN_Diag DIA_Variant_Coding_Diag DIA_TOIL_Oil_Sensor_Diag /end SUB_FUNCTION
/end FUNCTION
/begin FUNCTION DIA_CAN_Diag "CAN_Diag"
 /begin DEF_CHARACTERISTIC c_abc_inc_can_boff c_abc_max_can_boff c_abc_inc_can_tcs c_abc_inc_can_tcu c_abc_max_can_tcu c_abc_max_can_ccu c_abc_inc_can_icl c_abc_max_can_icl c_abc_inc_can_vecu c_abc_max_can_vecu c_abc_inc_can_smls c_abc_max_can_smls c_abc_inc_can_bem c_abc_max_can_bem c_abc_inc_can_if_cft c_abc_max_can_if_cft c_abc_inc_can_acu c_abc_max_can_tcs c_abc_max_can_tot c_abc_inc_can_tot c_abc_inc_can_ccu c_abc_max_can_acu c_abc_max_can_dcc c_abc_inc_can_dcc c_abc_inc_can_eilu c_abc_inc_can_pste c_abc_max_can_eilu c_abc_max_can_pste lc_ena_can_tot_diag c_abc_max_can_sys_info c_abc_max_can_whl c_abc_max_can_nom_sys c_abc_inc_can_sys_info c_abc_inc_can_whl c_abc_inc_can_nom_sys /end DEF_CHARACTERISTIC
 /begin OUT_MEASUREMENT lv_err_can_boff lv_err_can_tcs lv_ack_tcs lv_err_can_smls lv_err_can_if_cft tout_ctr_if_cft_1 tout_ctr_icl2 tout_ctr_icl3 tout_ctr_icl1 tout_ctr_tcs2 tout_ctr_tcs3 tout_ctr_tcs8 tout_ctr_tcs1 tout_ctr_tcu1 tout_ctr_bem tout_ctr_cru tout_ctr_tcu2 tout_ctr_vecu1 tout_ctr_tog1 tout_ctr_acu1 dly_diag_can_10ms max_hld_tcs max_hld_tcs_av max_hld_tcu max_hld_tcu_av max_hld_acu max_hld_acu_av max_hld_ccu_av max_hld_icl max_hld_icl_av max_hld_vecu max_hld_vecu_av max_hld_smls max_hld_smls_av max_hld_if_cft max_hld_if_cft_av lv_err_can_acu_all lv_err_can_ccu_all lv_err_can_icl_all lv_err_can_smls_all lv_err_can_tcu_all lv_err_can_if_cft_all lv_err_can_vecu lv_err_can_vecu_all ctr_boff_diag can_status t_can_boff_dly lv_fmy_can_boff lv_can_boff_first lv_can_boff_next tmp_can_cod tmp_can_diag lv_err_can_ccu lv_err_can_tot lv_err_can_acu lv_err_can_stop lv_err_can_icl lv_err_can_dcc lv_err_can_dcc_all lv_err_can_eilu_all lv_err_can_eilu tout_ctr_ccu1 tout_ctr_eilu1 max_hld_dcc max_hld_dcc_av max_hld_eilu max_hld_ccu max_hld_eilu_av lv_err_can_tcu lv_err_can_tcs_all lv_err_can_icl_sym_3 lv_err_can_whl tout_ctr_dcc tout_ctr_sys_info tout_ctr_whl tout_ctr_nom_sys lv_err_can_sys_info lv_err_can_nom_sys max_hld_whl max_hld_whl_av max_hld_sys_info max_hld_nom_sys max_hld_sys_info_av max_hld_nom_sys_av /end OUT_MEASUREMENT
/end FUNCTION
/begin FUNCTION DIA_Variant_Coding_Diag "Variant_Coding_Diag" /begin DEF_CHARACTERISTIC c_abc_inc_varcod c_abc_max_varcod c_varcod_diag_di /end DEF_CHARACTERISTIC /begin OUT_MEASUREMENT lv_err_varcod /end OUT_MEASUREMENT /end FUNCTION
/begin FUNCTION DIA_TOIL_Oil_Sensor_Diag "Oil Temperature (Sensor/Modell)"
 /begin DEF_CHARACTERISTIC c_tco_max_toil_diag c_abc_inc_toil_el c_abc_inc_toil_plaus c_abc_max_toil_el c_abc_max_toil_plaus c_tco_min_toil_plaus_diag c_tco_min_toil_diag c_tco_max_toil_plaus_diag c_toil_min_plaus_diag c_toil_max_plaus_diag c_t_tco_toil_diag c_t_toil_plaus_diag /end DEF_CHARACTERISTIC
 /begin OUT_MEASUREMENT lv_err_toil lv_err_toil_sens /end OUT_MEASUREMENT
/end FUNCTION
/begin FUNCTION C_A_DIAG ""
 /begin SUB_FUNCTION DIAG_MON DIAG_ABPACAD_0 DIAG_ABYPCAD_0 DIAG_AEGRVCAD_0 DIAG_ATHRCAD_0 DIAG_ACSDIAG DIAG_ABRAKE_D DIAG_AMAPCTLD DIAG_AMAPDIAG DIAG_AMAFDIAG_0 DIAG_AAC_DIAG DIAG_ATIADIAG DIAG_ADCDCDGO DIAG_ATCODIAG1 DIAG_ATCODIAG2 DIAG_AEGRBYPD DIAG_EGRV_CTL_AD_0 DIAG_ATMPDI_D DIAG_AAMPDIAG DIAG_AVEGRVDG DIAG_ACAPDIAG_0 DIAG_AEFPDIAG DIAG_ARLYDIAG DIAG_MAF_0 DIAG_MAF_PLAD DIAG_AEGRCTLD_0 DIAG_ALTER DIAG_AALTDIAG DIAG_AAC_INPDIAG DIAG_ACP DIAG_AINJDIAG DIAG_AINJDIAG_I DIAG_AVB DIAG_ASPIDIAG DIAG_AEGRVDHB DIAG_ATFUDIAG DIAG_ATACDIAG DIAG_ADIPDIAG DIAG_ATEGTURD /end SUB_FUNCTION
/end FUNCTION
/begin FUNCTION DIAG_MON "Monitoring level 3 diagnosis" /begin DEF_CHARACTERISTIC c_abc_inc_mon_3 c_abc_max_mon_3 /end DEF_CHARACTERISTIC /end FUNCTION
/begin FUNCTION DIAG_ABPACAD_0 ""
 /begin DEF_CHARACTERISTIC c_abc_inc_bpa_0_ctl c_abc_max_bpa_0_ctl c_abc_inc_v_bpa_0_bol_ad c_abc_max_v_bpa_0_bol_ad c_ctl_dif_bpa_0_min_diag c_ctl_dif_bpa_0_max_diag c_ctr_eve_bpa_0_ctl c_ctr_bas_bpa_0_ctl c_t_dly_diag_bpa_ctl /end DEF_CHARACTERISTIC
 /begin OUT_MEASUREMENT ctr_bas_bpa_0_ctl ctr_eve_bpa_0_ctl t_dly_diag_bpa_ctl_0 /end OUT_MEASUREMENT
/end FUNCTION
/begin FUNCTION DIAG_ABYPCAD_0 ""
 /begin DEF_CHARACTERISTIC c_abc_inc_byp_0_ctl c_abc_max_byp_0_ctl c_abc_inc_v_byp_0_bol_ad c_abc_max_v_byp_0_bol_ad c_ctl_dif_byp_0_min_diag c_ctl_dif_byp_0_max_diag c_ctr_eve_byp_0_ctl c_ctr_bas_byp_0_ctl /end DEF_CHARACTERISTIC
 /begin OUT_MEASUREMENT ctr_bas_byp_0_ctl ctr_eve_byp_0_ctl /end OUT_MEASUREMENT
/end FUNCTION
/begin FUNCTION DIAG_AEGRVCAD_0 ""
 /begin DEF_CHARACTERISTIC c_abc_inc_egrv_0_ctl c_abc_max_egrv_0_ctl c_abc_inc_v_egrv_0_bol_ad c_abc_max_v_egrv_0_bol_ad c_ctl_dif_egrv_0_min_diag c_ctl_dif_egrv_0_max_diag c_ctr_eve_egrv_0_ctl c_ctr_bas_egrv_0_ctl c_t_dly_diag_egrv_ctl /end DEF_CHARACTERISTIC
 /begin OUT_MEASUREMENT ctr_bas_egrv_0_ctl ctr_eve_egrv_0_ctl t_dly_diag_egrv_ctl_0 /end OUT_MEASUREMENT
/end FUNCTION
/begin FUNCTION DIAG_ATHRCAD_0 ""
 /begin DEF_CHARACTERISTIC c_abc_inc_thr_0_ctl c_abc_max_thr_0_ctl c_abc_inc_v_thr_0_bol_ad c_abc_max_v_thr_0_bol_ad c_ctl_dif_thr_0_min_diag c_ctl_dif_thr_0_max_diag c_ctr_eve_thr_0_ctl c_ctr_bas_thr_0_ctl c_t_dly_diag_thr_ctl /end DEF_CHARACTERISTIC
 /begin OUT_MEASUREMENT ctr_bas_thr_0_ctl ctr_eve_thr_0_ctl t_dly_diag_thr_ctl_0 /end OUT_MEASUREMENT
/end FUNCTION
/begin FUNCTION DIAG_ACSDIAG ""
 /begin DEF_CHARACTERISTIC c_abc_inc_cs c_abc_max_cs c_vs_cs_plaus_2_diag c_ctr_max_cs_plaus_1 c_ctr_max_cs_plaus_2 lc_act_plaus_1_diag c_vs_cs_plaus_1_diag /end DEF_CHARACTERISTIC
 /begin OUT_MEASUREMENT ctr_cs_plaus_1 ctr_cs_plaus_2 lv_cs_chg_1 lv_cs_chg_2 /end OUT_MEASUREMENT
/end FUNCTION
/begin FUNCTION DIAG_ABRAKE_D ""
 /begin DEF_CHARACTERISTIC c_abc_inc_bls c_abc_max_bls c_abc_inc_bls_bts_dece c_abc_max_bls_bts_dece c_abc_inc_bls_bts_plaus c_abc_max_bls_bts_plaus c_vs_ac_bls_bts_diag c_dri_bls_bts_diag lc_bls_bts_plaus_conf c_t_max_1_bls_bts_plaus c_t_max_2_bls_bts_plaus /end DEF_CHARACTERISTIC
 /begin OUT_MEASUREMENT lv_err_bls_bts t_bls_bts_plaus /end OUT_MEASUREMENT
/end FUNCTION
/begin FUNCTION DIAG_AMAPCTLD ""
 /begin DEF_CHARACTERISTIC c_abc_inc_map_ctl_min c_abc_max_map_ctl_min c_abc_inc_map_ctl_max c_abc_max_map_ctl_max c_map_dif_min_diag c_map_dif_max_diag c_n_min_map_ctl_diag c_tqi_sp_min_map_ctl_diag ip_ctr_max_map_ctl_min__n ip_ctr_max_map_ctl_max__n ldpm_n__ip_ctr_max_map_ctl_diag ip_fac_map_ctl_diag__amp ldp_amp__ip_fac_map_ctl_diag ip_fac_map_ctl_diag__tia ldp_tia__ip_fac_map_ctl_diag c_cdn_obd_map_ctl /end DEF_CHARACTERISTIC
 /begin OUT_MEASUREMENT ctr_map_ctl_min ctr_map_ctl_max lv_inh_diag_map_ctl /end OUT_MEASUREMENT
/end FUNCTION
/begin FUNCTION DIAG_AMAPDIAG ""
 /begin DEF_CHARACTERISTIC c_abc_inc_v_map_rng c_abc_max_v_map_rng c_abc_inc_map_amp_ofs c_abc_max_map_amp_ofs c_abc_inc_map_is_ofs c_abc_max_map_is_ofs c_v_map_min_diag c_v_map_max_diag c_map_amp_ofs_min_diag c_map_is_ofs_max_diag c_map_amp_ofs_max_diag c_map_is_ofs_min_diag ldp_amp_ip_fac_map_is_ofs_diag ip_fac_map_is_ofs_diag__amp c_ctr_map_is_ofs_diag c_abc_inc_map_mes_grd c_abc_max_map_mes_grd c_map_mes_grd_diag c_tco_map_amp_ofs_diag /end DEF_CHARACTERISTIC
 /begin OUT_MEASUREMENT lv_err_map_mes ctr_map_is_ofs lv_err_vcc_map lv_inh_map_amp_ofs lv_inh_map_is_ofs /end OUT_MEASUREMENT
/end FUNCTION
/begin FUNCTION DIAG_AMAFDIAG_0 "" /begin DEF_CHARACTERISTIC c_vb_min_maf_diag /end DEF_CHARACTERISTIC /begin OUT_MEASUREMENT lv_err_maf_0_mes lv_err_maf_mes /end OUT_MEASUREMENT /end FUNCTION
/begin FUNCTION DIAG_AAC_DIAG "" /begin DEF_CHARACTERISTIC c_acp_mes_max_diag c_acp_mes_min_diag c_acp_mes_grd_diag /end DEF_CHARACTERISTIC /end FUNCTION
/begin FUNCTION DIAG_ATIADIAG "" /begin OUT_MEASUREMENT lv_err_tia /end OUT_MEASUREMENT /end FUNCTION
/begin FUNCTION DIAG_ADCDCDGO ""
 /begin DEF_CHARACTERISTIC c_abc_inc_v_dcdc_rng c_abc_max_v_dcdc_rng c_t_dcdc_diag c_v_dcdc_min_diag c_v_dcdc_max_diag /end DEF_CHARACTERISTIC
 /begin OUT_MEASUREMENT t_dcdc_diag /end OUT_MEASUREMENT
/end FUNCTION
/begin FUNCTION DIAG_ATCODIAG1 ""
 /begin DEF_CHARACTERISTIC c_abc_inc_v_tco_1_rng c_abc_max_v_tco_1_rng c_abc_inc_tco_1_mes_grd c_abc_max_tco_1_mes_grd c_abc_inc_tco_mes_plaus c_abc_max_tco_mes_plaus c_v_tco_max_diag c_v_tco_min_diag c_tfu_min_tco_diag /end DEF_CHARACTERISTIC
 /begin OUT_MEASUREMENT lv_err_tco_mes lv_err_tco_1_mes lv_rst_diag_tco_mes_plaus tco_mes_st_diag ctr_inh_temp_diag /end OUT_MEASUREMENT
/end FUNCTION
/begin FUNCTION DIAG_ATCODIAG2 ""
 /begin DEF_CHARACTERISTIC c_abc_inc_v_tco_2_rng c_abc_max_v_tco_2_rng c_abc_inc_tco_2_mes_grd c_abc_max_tco_2_mes_grd /end DEF_CHARACTERISTIC
 /begin OUT_MEASUREMENT lv_err_tco_2_mes /end OUT_MEASUREMENT
/end FUNCTION
/begin FUNCTION DIAG_AEGRBYPD "EGR Bypass Valve Diagnostics" /begin DEF_CHARACTERISTIC c_abc_inc_egr_byp_dps c_abc_max_egr_byp_dps /end DEF_CHARACTERISTIC
 /begin OUT_MEASUREMENT err_sym_mem_egr_byp_dps lv_err_egr_byp lv_scg_egr_byp lv_scg_vld_egr_byp lv_scb_egr_byp lv_scb_vld_egr_byp lv_ol_egr_byp lv_ol_vld_egr_byp /end OUT_MEASUREMENT
/end FUNCTION
/begin FUNCTION DIAG_EGRV_CTL_AD_0 "" /end FUNCTION
/begin FUNCTION DIAG_ATMPDI_D "" /begin DEF_CHARACTERISTIC c_amp_cdn_obd c_tam_st_cdn_obd c_ftl_cdn_obd /end DEF_CHARACTERISTIC
 /begin OUT_MEASUREMENT lv_cdn_amp_obd lv_cdn_tam_st_obd lv_cdn_ftl_obd lv_cdn_pf_obd /end OUT_MEASUREMENT
/end FUNCTION
/begin FUNCTION DIAG_AAMPDIAG ""
 /begin DEF_CHARACTERISTIC c_abc_inc_v_amp_rng c_abc_max_v_amp_rng c_abc_inc_amp_mes_grd c_abc_max_amp_mes_grd c_v_amp_min_diag c_v_amp_max_diag c_amp_mes_grd_diag /end DEF_CHARACTERISTIC
 /begin OUT_MEASUREMENT lv_err_amp_mes /end OUT_MEASUREMENT
/end FUNCTION
/begin FUNCTION DIAG_AVEGRVDG ""
 /begin DEF_CHARACTERISTIC c_abc_inc_v_egrv_0_rng c_abc_max_v_egrv_0_rng c_abc_inc_v_egrv_0_grd c_abc_max_v_egrv_0_grd c_v_egrv_mes_max_diag c_v_egrv_mes_min_diag c_v_egrv_mes_grd_diag /end DEF_CHARACTERISTIC
 /begin OUT_MEASUREMENT lv_err_vcc_v_egrv_0 lv_err_v_egrv_0_mes /end OUT_MEASUREMENT
/end FUNCTION
/begin FUNCTION DIAG_ACAPDIAG_0 ""
 /begin DEF_CHARACTERISTIC c_abc_inc_ges_maf_0_max c_abc_max_ges_maf_0_max ldp_n__ip_maf_kgh_ges_maf_max ip_maf_kgh_ges_maf_max__n c_n_ges_maf_max_diag /end DEF_CHARACTERISTIC
/end FUNCTION
/begin FUNCTION DIAG_AEFPDIAG ""
 /begin DEF_CHARACTERISTIC c_abc_inc_efp_rly_dps c_abc_max_efp_rly_dps c_abc_inc_efp_rly_plaus_1 c_abc_max_efp_rly_plaus_1 c_abc_inc_efp_rly_plaus_2 c_abc_max_efp_rly_plaus_2 c_ctr_max_efp_rly_plaus_1_dly c_ctr_max_efp_rly_plaus_2_dly /end DEF_CHARACTERISTIC
 /begin OUT_MEASUREMENT err_sym_mem_efp_rly_dps ctr_efp_rly_plaus_1_dly ctr_efp_rly_plaus_2_dly lv_scg_efp_rly lv_scg_vld_efp_rly lv_scb_efp_rly lv_scb_vld_efp_rly lv_ol_efp_rly lv_ol_vld_efp_rly lv_efp_rly_diag /end OUT_MEASUREMENT
/end FUNCTION
/begin FUNCTION DIAG_ARLYDIAG ""
 /begin DEF_CHARACTERISTIC c_abc_inc_rly_main c_abc_max_rly_main c_abc_inc_rly_power c_abc_max_rly_power c_vb_min_rly_diag /end DEF_CHARACTERISTIC
 /begin OUT_MEASUREMENT lv_scg_rly_main lv_scg_vld_rly_main lv_scb_rly_main lv_scb_vld_rly_main lv_ol_rly_main lv_ol_vld_rly_main lv_scg_rly_power lv_scg_vld_rly_power lv_scb_rly_power lv_scb_vld_rly_power lv_ol_rly_power lv_ol_vld_rly_power err_sym_mem_rly_main err_sym_mem_rly_power /end OUT_MEASUREMENT
/end FUNCTION
/end MODULE
/end PROJECT
