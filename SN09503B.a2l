ASAP2_VERSION 1 41
/begin PROJECT SN0 "SIMOS PPD"
/begin HEADER "_default_HeaderComment" PROJECT_NO PRJ_NUM /end HEADER
/begin MODULE _default_ModuleName "_default_ModuleLongIdentifier"
/begin MOD_COMMON "_default_ModCommonComment" DEPOSIT ABSOLUTE BYTE_ORDER MSB_FIRST ALIGNMENT_BYTE 1 ALIGNMENT_WORD 2 ALIGNMENT_LONG 4 ALIGNMENT_FLOAT32_IEEE 4 ALIGNMENT_FLOAT64_IEEE 8 /end MOD_COMMON
/begin AXIS_PTS ldp_gen_load__tq_loss_alter "" 0x844030 gen_load _REC_AXS_20_u1 99.609375 _CNV_A_R_LINEAR_____79_CM 8 0. 99.609375 FORMAT "%4.1" /end AXIS_PTS
/begin CHARACTERISTIC ip_tq_loss_alter "Alternator torque losses" MAP 0x84f842 _REC_MAP_20_u2_u1_u1 2047.97875 _CNV_A_R_LINEAR_____80_CM -1024. 1023.97875 DISPLAY_IDENTIFIER IP_TQ_LOSS_ALTER FORMAT "%8.2"
 /begin AXIS_DESCR COM_AXIS n_32 _CNV_A_R_LINEAR_____81_CM 8 0. 8160. FORMAT "%4.0" AXIS_PTS_REF ldp_n32_tq_loss_alter /end AXIS_DESCR
 /begin AXIS_DESCR COM_AXIS gen_load _CNV_A_R_LINEAR_____79_CM 8 0. 99.609375 FORMAT "%4.1" AXIS_PTS_REF ldp_gen_load__tq_loss_alter /end AXIS_DESCR
/end CHARACTERISTIC
/begin MEASUREMENT tq_loss_alter "engine torque losses alternator" SWORD _CNV_A_R_LINEAR_____82_CM 1 0. -1024. 1023.96875 DISPLAY_IDENTIFIER TQ_LOSS_ALTER ECU_ADDRESS 0x7fa310 BYTE_ORDER MSB_LAST FORMAT "%8.2" /end MEASUREMENT
/begin CHARACTERISTIC c_lgrd_tq_loss_alter "Alternator torque losses limitation gradient" VALUE 0x84fd88 _REC_VAL_20_u2 1023.96875 _CNV_A_R_LINEAR_____83_CM 0. 1023.96875 DISPLAY_IDENTIFIER C_LGRD_TQ_LOSS_ALTER FORMAT "%7.2" /end CHARACTERISTIC
/begin CHARACTERISTIC c_tq_loss_alter_sub "Substitute value for TQ_LOSS_ALTER in case of missed CAN messages" VALUE 0x85005e _REC_VAL_20_u2 2047.96875 _CNV_A_R_LINEAR_____84_CM -1024. 1023.96875 DISPLAY_IDENTIFIER C_TQ_LOSS_ALTER_SUB FORMAT "%11.5" /end CHARACTERISTIC
/begin CHARACTERISTIC lc_use_tq_loss_alter_can "Logical switch to select between TQ_LOSS_ALTER using discrete input or CAN input" VALUE 0x85017a _REC_VAL_20_u1 1. _CNV_S_2_RANGE__0___85_CM 0. 1. DISPLAY_IDENTIFIER LC_USE_TQ_LOSS_ALTER_CAN /end CHARACTERISTIC
/begin AXIS_PTS ldp_n32_tq_loss_alter "" 0x844043 n_32 _REC_AXS_20_u1 8160. _CNV_A_R_LINEAR_____81_CM 8 0. 8160. FORMAT "%4.0" /end AXIS_PTS
/begin MEASUREMENT maf_sp "air mass flow setpoint" UWORD _CNV_A_R_LINEAR_____60_CM 1 0. 0. 1389. DISPLAY_IDENTIFIER MAF_SP ECU_ADDRESS 0x7f9982 BYTE_ORDER MSB_LAST FORMAT "%6.2" /end MEASUREMENT
/begin MEASUREMENT map_sp "boost pressure setpoint before filter" UWORD _CNV_A_R_LINEAR_____45_CM 1 0. 0. 5434. DISPLAY_IDENTIFIER MAP_SP ECU_ADDRESS 0x7f9984 BYTE_ORDER MSB_LAST FORMAT "%6.2" /end MEASUREMENT
/begin MEASUREMENT egr_sp "EGR-rate setpoint" UWORD _CNV_A_R_LINEAR_____8_CM 1 0. 0. 99.99847412109381 DISPLAY_IDENTIFIER EGR_SP ECU_ADDRESS 0x7f9986 BYTE_ORDER MSB_LAST FORMAT "%5.3" /end MEASUREMENT
/begin MEASUREMENT maf_sp_mmv "air mass flow setpoint2" UWORD _CNV_A_R_LINEAR_____60_CM 1 0. 0. 1389. DISPLAY_IDENTIFIER MAF_SP_MMV ECU_ADDRESS 0x7f9988 BYTE_ORDER MSB_LAST FORMAT "%6.2" /end MEASUREMENT
/begin MEASUREMENT map_sp_mmv "boost pressure setpoint" UWORD _CNV_A_R_LINEAR_____45_CM 1 0. 0. 5434. DISPLAY_IDENTIFIER MAP_SP_MMV ECU_ADDRESS 0x7f998a BYTE_ORDER MSB_LAST FORMAT "%6.2" /end MEASUREMENT
/begin MEASUREMENT egr_sp_mmv "EGR-rate setpoint" UWORD _CNV_A_R_LINEAR_____8_CM 1 0. 0. 99.99847412109381 DISPLAY_IDENTIFIER EGR_SP_MMV ECU_ADDRESS 0x7f998c BYTE_ORDER MSB_LAST FORMAT "%5.3" /end MEASUREMENT
/begin CHARACTERISTIC c_conv_ges_sp "switch selectiong the kind of given setpoints" VALUE 0x85c8ef _REC_VAL_20_u1 2. _CNV_A_R_LINEAR_____0_CM 0. 2. DISPLAY_IDENTIFIER C_CONV_GES_SP FORMAT "%1.0" /end CHARACTERISTIC
/begin MEASUREMENT egr_sp_bas_sub "basic egr setpoint (inj. state GES = 1)" UWORD _CNV_A_R_LINEAR_____8_CM 1 0. 0. 99.99847412109381 DISPLAY_IDENTIFIER EGR_SP_BAS_SUB ECU_ADDRESS 0x7fa8b4 BYTE_ORDER MSB_LAST FORMAT "%5.3" /end MEASUREMENT
/begin MEASUREMENT egr_sp_bas "basic egr setpoint" UWORD _CNV_A_R_LINEAR_____8_CM 1 0. 0. 99.99847412109381 DISPLAY_IDENTIFIER EGR_SP_BAS ECU_ADDRESS 0x7fa8b6 BYTE_ORDER MSB_LAST FORMAT "%5.3" /end MEASUREMENT
/begin MEASUREMENT egr_sp_bas_clc "basic egr setpoint (inj. state GES = 1)" UWORD _CNV_A_R_LINEAR_____8_CM 1 0. 0. 99.99847412109381 DISPLAY_IDENTIFIER EGR_SP_BAS_CLC ECU_ADDRESS 0x7fa8b8 BYTE_ORDER MSB_LAST FORMAT "%5.3" /end MEASUREMENT
/begin MEASUREMENT egr_sp_bas_tco_0 "uncorrected basic egr setpoint (inj. state GES = 0)" UWORD _CNV_A_R_LINEAR_____8_CM 1 0. 0. 99.99847412109381 DISPLAY_IDENTIFIER EGR_SP_BAS_TCO_0 ECU_ADDRESS 0x7fa8ba BYTE_ORDER MSB_LAST FORMAT "%5.3" /end MEASUREMENT
/begin MEASUREMENT egr_sp_bas_0 "basic egr setpoint (inj. state GES = 0)" UWORD _CNV_A_R_LINEAR_____8_CM 1 0. 0. 99.99847412109381 DISPLAY_IDENTIFIER EGR_SP_BAS_0 ECU_ADDRESS 0x7fa8bc BYTE_ORDER MSB_LAST FORMAT "%5.3" /end MEASUREMENT
/begin MEASUREMENT egr_sp_bas_tco_1 "uncorrected basic egr setpoint (inj. state GES = 0)" UWORD _CNV_A_R_LINEAR_____8_CM 1 0. 0. 99.99847412109381 DISPLAY_IDENTIFIER EGR_SP_BAS_TCO_1 ECU_ADDRESS 0x7f9968 BYTE_ORDER MSB_LAST FORMAT "%5.3" /end MEASUREMENT
/begin MEASUREMENT egr_sp_bas_1 "basic egr setpoint (inj. state GES = 1)" UWORD _CNV_A_R_LINEAR_____8_CM 1 0. 0. 99.99847412109381 DISPLAY_IDENTIFIER EGR_SP_BAS_1 ECU_ADDRESS 0x7fa8be BYTE_ORDER MSB_LAST FORMAT "%5.3" /end MEASUREMENT
/begin MEASUREMENT egr_sp_rgn "basic egr setpoint (inj. state GES = 1)" UWORD _CNV_A_R_LINEAR_____8_CM 1 0. 0. 99.99847412109381 DISPLAY_IDENTIFIER EGR_SP_RGN ECU_ADDRESS 0x7fa8c0 BYTE_ORDER MSB_LAST FORMAT "%5.3" /end MEASUREMENT
/begin MEASUREMENT egr_sp_rgn_1 "basic egr setpoint (inj. state GES = 1)" UWORD _CNV_A_R_LINEAR_____8_CM 1 0. 0. 99.99847412109381 DISPLAY_IDENTIFIER EGR_SP_RGN_1 ECU_ADDRESS 0x7fa8c2 BYTE_ORDER MSB_LAST FORMAT "%5.3" /end MEASUREMENT
/begin MEASUREMENT egr_sp_rgn_2 "basic egr setpoint (inj. state GES = 1)" UWORD _CNV_A_R_LINEAR_____8_CM 1 0. 0. 99.99847412109381 DISPLAY_IDENTIFIER EGR_SP_RGN_2 ECU_ADDRESS 0x7fa8c4 BYTE_ORDER MSB_LAST FORMAT "%5.3" /end MEASUREMENT
/begin MEASUREMENT egr_sp_gen "general EGR_SP without increasing at idle" UWORD _CNV_A_R_LINEAR_____8_CM 1 0. 0. 99.99847412109381 DISPLAY_IDENTIFIER EGR_SP_GEN ECU_ADDRESS 0x7fa8c6 BYTE_ORDER MSB_LAST /end MEASUREMENT
/begin MEASUREMENT egr_sp_dyn "dynamic egr setpoint" SWORD _CNV_A_R_LINEAR_____96_CM 1 0. -50. 49.9984741210938 DISPLAY_IDENTIFIER EGR_SP_DYN ECU_ADDRESS 0x7fa8c8 BYTE_ORDER MSB_LAST FORMAT "%5.3" /end MEASUREMENT
/begin MEASUREMENT egr_sp_clc_sub "egr setpoint including idle correction" UWORD _CNV_A_R_LINEAR_____8_CM 1 0. 0. 99.99847412109381 DISPLAY_IDENTIFIER EGR_SP_CLC_SUB ECU_ADDRESS 0x7fa8ca BYTE_ORDER MSB_LAST FORMAT "%5.3" /end MEASUREMENT
/begin MEASUREMENT lv_act_egr_sp_is "active egr setpoint during idle speed" UBYTE _CNV_S_2_RANGE______11_CM 1 0. 0. 1. DISPLAY_IDENTIFIER LV_ACT_EGR_SP_IS ECU_ADDRESS 0x7fb86f /end MEASUREMENT
/begin MEASUREMENT egr_sp_sub "egr setpoint" UWORD _CNV_A_R_LINEAR_____8_CM 1 0. 0. 99.99847412109381 DISPLAY_IDENTIFIER EGR_SP_SUB ECU_ADDRESS 0x7f9964 BYTE_ORDER MSB_LAST FORMAT "%5.3" /end MEASUREMENT
/begin MEASUREMENT egr_sp_mmv_sub "moving mean value of the egr setpoint" UWORD _CNV_A_R_LINEAR_____8_CM 1 0. 0. 99.99847412109381 DISPLAY_IDENTIFIER EGR_SP_MMV_SUB ECU_ADDRESS 0x7f9966 BYTE_ORDER MSB_LAST FORMAT "%5.3" /end MEASUREMENT
/begin MEASUREMENT lv_cdn_egr_on_dly "delayed EGR controller enable" UBYTE _CNV_S_2_RANGE______11_CM 1 0. 0. 1. DISPLAY_IDENTIFIER LV_CDN_EGR_ON_DLY ECU_ADDRESS 0x7fb870 /end MEASUREMENT
/begin CHARACTERISTIC lc_egr_sp_dev "activation button for egr setpoint correction" VALUE 0x85011c _REC_VAL_20_u1 1. _CNV_A_R_LINEAR_____0_CM 0. 1. DISPLAY_IDENTIFIER LC_EGR_SP_DEV FORMAT "%1.0" /end CHARACTERISTIC
/begin CHARACTERISTIC c_fac_egr_sp_dev "basic egr setpoint: factor for development" VALUE 0x84fd16 _REC_VAL_20_u2 1.99996948242188 _CNV_A_R_LINEAR_____102_CM 0. 1.99996948242188 DISPLAY_IDENTIFIER C_FAC_EGR_SP_DEV FORMAT "%6.5" /end CHARACTERISTIC
/begin CHARACTERISTIC c_egr_sp_cor_dev "basic egr setpoint: add. value for development" VALUE 0x84fcce _REC_VAL_20_s2 199.9969482421875 _CNV_A_R_LINEAR_____136_CM -100. 99.9969482421875 DISPLAY_IDENTIFIER C_EGR_SP_COR_DEV FORMAT "%5.3" /end CHARACTERISTIC
/begin CHARACTERISTIC lc_egr_sp_dyn_on "button for dynamic EGR_SP" VALUE 0x85011d _REC_VAL_20_u1 1. _CNV_A_R_LINEAR_____0_CM 0. 1. DISPLAY_IDENTIFIER LC_EGR_SP_DYN_ON FORMAT "%1.0" /end CHARACTERISTIC
/begin CHARACTERISTIC c_t2_dt1_egr_sp "time value for dynamic EGR_SP calculation" VALUE 0x84ff16 _REC_VAL_20_u2 4.19424 _CNV_A_R_LINEAR_____64_CM 0. 4.19424 DISPLAY_IDENTIFIER C_T2_DT1_EGR_SP FORMAT "%6.5" /end CHARACTERISTIC
/begin CHARACTERISTIC c_egr_sp_thd_egr_sp_dyn "setpoint threshold for EGR_SP_DYN" VALUE 0x84fcd6 _REC_VAL_20_u2 99.99847412109381 _CNV_A_R_LINEAR_____8_CM 0. 99.99847412109381 DISPLAY_IDENTIFIER C_EGR_SP_THD_EGR_SP_DYN /end CHARACTERISTIC
/begin CHARACTERISTIC c_egr_sp_dyn_max "maximum of the dynamic egr setpoint" VALUE 0x84fcd0 _REC_VAL_20_s2 99.99847412109381 _CNV_A_R_LINEAR_____96_CM -50. 49.9984741210938 DISPLAY_IDENTIFIER C_EGR_SP_DYN_MAX FORMAT "%5.3" /end CHARACTERISTIC
/begin CHARACTERISTIC c_egr_sp_dyn_min "minimum of the dynamic egr setpoint" VALUE 0x84fcd2 _REC_VAL_20_s2 99.99847412109381 _CNV_A_R_LINEAR_____96_CM -50. 49.9984741210938 DISPLAY_IDENTIFIER C_EGR_SP_DYN_MIN FORMAT "%5.3" /end CHARACTERISTIC
/begin CHARACTERISTIC c_fac_egr_sp_is_fil "filter factor for EGR_SP increasing in idle" VALUE 0x84fd1c _REC_VAL_20_u2 0.9999847412109381 _CNV_A_R_LINEAR_____137_CM 0. 0.9999847412109381 DISPLAY_IDENTIFIER C_FAC_EGR_SP_IS_FIL FORMAT "%6.5" /end CHARACTERISTIC
/begin CHARACTERISTIC c_t_egr_sp_is "delay time for EGR_SP increasing in idle" VALUE 0x84ff72 _REC_VAL_20_u2 6553.5 _CNV_A_R_LINEAR_____19_CM 0. 6553.5 DISPLAY_IDENTIFIER C_T_EGR_SP_IS FORMAT "%5.1" /end CHARACTERISTIC
/begin CHARACTERISTIC lc_egr_sp_man "button for manual EGR_SP" VALUE 0x85011e _REC_VAL_20_u1 1. _CNV_A_R_LINEAR_____0_CM 0. 1. DISPLAY_IDENTIFIER LC_EGR_SP_MAN FORMAT "%1.0" /end CHARACTERISTIC
/begin CHARACTERISTIC c_egr_sp_man "manual egr setpoint" VALUE 0x84fcd4 _REC_VAL_20_u2 99.99847412109381 _CNV_A_R_LINEAR_____8_CM 0. 99.99847412109381 DISPLAY_IDENTIFIER C_EGR_SP_MAN /end CHARACTERISTIC
/begin CHARACTERISTIC c_fac_egr_sp_fil_ini "initial filter factor for EGR_SP" VALUE 0x84fd1a _REC_VAL_20_u2 0.9999847412109381 _CNV_A_R_LINEAR_____14_CM 0. 0.9999847412109381 DISPLAY_IDENTIFIER C_FAC_EGR_SP_FIL_INI FORMAT "%6.5" /end CHARACTERISTIC
/begin CHARACTERISTIC c_fac_egr_sp_fil "filter factor for EGR_SP" VALUE 0x84fd18 _REC_VAL_20_u2 0.9999847412109381 _CNV_A_R_LINEAR_____14_CM 0. 0.9999847412109381 DISPLAY_IDENTIFIER C_FAC_EGR_SP_FIL FORMAT "%6.5" /end CHARACTERISTIC
/begin CHARACTERISTIC ip_fac_tran_egr_sp_0 "GE_ESP: transition factor for the basic egr lsetpoints (inj. region 0)" CURVE 0x848454 _REC_CUR_20_u2_u1 1.99996948242188 _CNV_A_R_LINEAR_____102_CM 0. 1.99996948242188 DISPLAY_IDENTIFIER IP_FAC_TRAN_EGR_SP_0 FORMAT "%6.5"
 /begin AXIS_DESCR COM_AXIS tco _CNV_A_R_LINEAR_____18_CM 8 -50. 205. FORMAT "%3.0" AXIS_PTS_REF ldp_tco_ip_fac_tran_egr_sp_0 /end AXIS_DESCR
/end CHARACTERISTIC
/begin AXIS_PTS ldp_tco_ip_fac_tran_egr_sp_0 "" 0x84232f tco _REC_AXS_20_u1 255. _CNV_A_R_LINEAR_____18_CM 8 -50. 205. FORMAT "%3.0" /end AXIS_PTS
/begin CHARACTERISTIC ip_fac_egr_sp_cor_tgas_0 "GE_ESP: egr correction factor for temperature of the intake gas (inj. region GES = 0)" CURVE 0x84805e _REC_CUR_20_u2_u1 0.9999847412109381 _CNV_A_R_LINEAR_____14_CM 0. 0.9999847412109381 DISPLAY_IDENTIFIER IP_FAC_EGR_SP_COR_TGAS_0 FORMAT "%6.5"
 /begin AXIS_DESCR COM_AXIS tgas _CNV_A_R_LINEAR_____18_CM 8 -50. 205. FORMAT "%3.0" AXIS_PTS_REF ldp_tgas_ip_fac_egr_sp_cor_0 /end AXIS_DESCR
/end CHARACTERISTIC
/begin AXIS_PTS ldp_tgas_ip_fac_egr_sp_cor_0 "" 0x8424ac tgas _REC_AXS_20_u1 255. _CNV_A_R_LINEAR_____18_CM 8 -50. 205. FORMAT "%3.0" /end AXIS_PTS
/begin CHARACTERISTIC ip_fac_egr_sp_cor_amp_0 "GE_ESP: egr correction factor for ambient pressure (inj. region GES = 0)" CURVE 0x848036 _REC_CUR_20_u2_u2 0.9999847412109381 _CNV_A_R_LINEAR_____14_CM 0. 0.9999847412109381 DISPLAY_IDENTIFIER IP_FAC_EGR_SP_COR_AMP_0 FORMAT "%6.5"
 /begin AXIS_DESCR COM_AXIS amp _CNV_A_R_LINEAR_____45_CM 8 0. 5434. FORMAT "%6.2" AXIS_PTS_REF ldp_amp_ip_fac_egr_sp_cor_0 /end AXIS_DESCR
/end CHARACTERISTIC
/begin AXIS_PTS ldp_amp_ip_fac_egr_sp_cor_0 "" 0x8410d6 amp _REC_AXS_20_u2 5434. _CNV_A_R_LINEAR_____45_CM 8 0. 5434. FORMAT "%6.2" /end AXIS_PTS
/begin CHARACTERISTIC ip_fac_tran_egr_sp_1 "GE_ESP: transition factor for the basic egr setpoints (inj. region 1)" CURVE 0x848464 _REC_CUR_20_u2_u1 1.99996948242188 _CNV_A_R_LINEAR_____102_CM 0. 1.99996948242188 DISPLAY_IDENTIFIER IP_FAC_TRAN_EGR_SP_1 FORMAT "%6.5"
 /begin AXIS_DESCR COM_AXIS tco _CNV_A_R_LINEAR_____18_CM 8 -50. 205. FORMAT "%3.0" AXIS_PTS_REF ldp_tco_ip_fac_tran_egr_sp_1 /end AXIS_DESCR
/end CHARACTERISTIC
/begin AXIS_PTS ldp_tco_ip_fac_tran_egr_sp_1 "" 0x842338 tco _REC_AXS_20_u1 255. _CNV_A_R_LINEAR_____18_CM 8 -50. 205. FORMAT "%3.0" /end AXIS_PTS
/begin CHARACTERISTIC ip_fac_egr_sp_cor_tgas_1 "GE_ESP: egr correction factor for temperature of the intake gas (inj. region GES = 0)_a" CURVE 0x84806e _REC_CUR_20_u2_u1 0.9999847412109381 _CNV_A_R_LINEAR_____14_CM 0. 0.9999847412109381 DISPLAY_IDENTIFIER IP_FAC_EGR_SP_COR_TGAS_1 FORMAT "%6.5"
 /begin AXIS_DESCR COM_AXIS tgas _CNV_A_R_LINEAR_____18_CM 8 -50. 205. FORMAT "%3.0" AXIS_PTS_REF ldp_tgas_ip_fac_egr_sp_cor_1 /end AXIS_DESCR
/end CHARACTERISTIC
/begin AXIS_PTS ldp_tgas_ip_fac_egr_sp_cor_1 "" 0x8424b5 tgas _REC_AXS_20_u1 255. _CNV_A_R_LINEAR_____18_CM 8 -50. 205. FORMAT "%3.0" /end AXIS_PTS
/begin CHARACTERISTIC ip_fac_egr_sp_cor_amp_1 "GE_ESP: egr correction factor for ambient pressure (inj. region GES = 1)" CURVE 0x848046 _REC_CUR_20_u2_u2 0.9999847412109381 _CNV_A_R_LINEAR_____14_CM 0. 0.9999847412109381 DISPLAY_IDENTIFIER IP_FAC_EGR_SP_COR_AMP_1 FORMAT "%6.5"
 /begin AXIS_DESCR COM_AXIS amp _CNV_A_R_LINEAR_____45_CM 8 0. 5434. FORMAT "%6.2" AXIS_PTS_REF ldp_amp_ip_fac_egr_sp_cor_1 /end AXIS_DESCR
/end CHARACTERISTIC
/begin AXIS_PTS ldp_amp_ip_fac_egr_sp_cor_1 "" 0x8410e8 amp _REC_AXS_20_u2 5434. _CNV_A_R_LINEAR_____45_CM 8 0. 5434. FORMAT "%6.2" /end AXIS_PTS
/begin CHARACTERISTIC ip_fac_egr_sp_cor_amp_rgn_1 "GE_ESP: factor to correct ambient pressure influence on egr_sp during regeneration mode 1" CURVE 0x848056 _REC_CUR_20_u2_u2 0.9999847412109381 _CNV_A_R_LINEAR_____14_CM 0. 0.9999847412109381 DISPLAY_IDENTIFIER IP_FAC_EGR_SP_COR_AMP_RGN_1 FORMAT "%6.5"
 /begin AXIS_DESCR COM_AXIS amp _CNV_A_R_LINEAR_____45_CM 2 0. 5434. FORMAT "%6.2" AXIS_PTS_REF ldp_amp_ip_fac_egr_sp_cor_rgn_1 /end AXIS_DESCR
/end CHARACTERISTIC
/begin AXIS_PTS ldp_amp_ip_fac_egr_sp_cor_rgn_1 "" 0x8410fa amp _REC_AXS_20_u2 5434. _CNV_A_R_LINEAR_____45_CM 2 0. 5434. FORMAT "%6.2" /end AXIS_PTS
/begin CHARACTERISTIC ip_fac_egr_sp_cor_amp_rgn_2 "GE_ESP: pressure influence on egr_sp during regenerastion mode 2" CURVE 0x84805a _REC_CUR_20_u2_u2 0.9999847412109381 _CNV_A_R_LINEAR_____14_CM 0. 0.9999847412109381 DISPLAY_IDENTIFIER IP_FAC_EGR_SP_COR_AMP_RGN_2 FORMAT "%6.5"
 /begin AXIS_DESCR COM_AXIS amp _CNV_A_R_LINEAR_____45_CM 2 0. 5434. FORMAT "%6.2" AXIS_PTS_REF ldp_amp_ip_fac_egr_sp_cor_rgn_2 /end AXIS_DESCR
/end CHARACTERISTIC
/begin AXIS_PTS ldp_amp_ip_fac_egr_sp_cor_rgn_2 "" 0x841100 amp _REC_AXS_20_u2 5434. _CNV_A_R_LINEAR_____45_CM 2 0. 5434. FORMAT "%6.2" /end AXIS_PTS
/begin CHARACTERISTIC ip_kr_dt1_egr_sp_dyn "GE_ESP: gain value for dynamic EGR_SP calculation" CURVE 0x8484d4 _REC_CUR_20_u2_u2 6.5535 _CNV_A_R_LINEAR_____138_CM -3.2768 3.2767 DISPLAY_IDENTIFIER IP_KR_DT1_EGR_SP_DYN FORMAT "%5.4"
 /begin AXIS_DESCR COM_AXIS tqi_grd_egr _CNV_A_R_LINEAR_____139_CM 6 -32768. 32767. FORMAT "%5.0" AXIS_PTS_REF ldp_tqi_grd_ip_kr_dt1_egr_sp /end AXIS_DESCR
/end CHARACTERISTIC
/begin AXIS_PTS ldp_tqi_grd_ip_kr_dt1_egr_sp "" 0x8425d6 tqi_grd_egr _REC_AXS_20_u2 65535. _CNV_A_R_LINEAR_____139_CM 6 -32768. 32767. FORMAT "%5.0" /end AXIS_PTS
/begin CHARACTERISTIC ip_fac_egr_sp_fil_tra__n "GE_ESP: transition filter factor for egr setpoint" CURVE 0x84807e _REC_CUR_20_u2_u2 0.9999847412109381 _CNV_A_R_LINEAR_____14_CM 0. 0.9999847412109381 DISPLAY_IDENTIFIER IP_FAC_EGR_SP_FIL_TRA__N FORMAT "%6.5"
 /begin AXIS_DESCR COM_AXIS n _CNV_A_R_LINEAR_____5_CM 6 0. 6375. FORMAT "%4.0" AXIS_PTS_REF ldpm_n_ip_bpa_egr_sp_fil /end AXIS_DESCR
/end CHARACTERISTIC
/begin CHARACTERISTIC ip_t_dly_egr_on__n "GE_ESP: delay time for EGR-controller enable" CURVE 0x84ede4 _REC_CUR_20_u2_u2 4.19424 _CNV_A_R_LINEAR_____64_CM 0. 4.19424 DISPLAY_IDENTIFIER IP_T_DLY_EGR_ON__N FORMAT "%6.5"
 /begin AXIS_DESCR COM_AXIS n _CNV_A_R_LINEAR_____5_CM 6 0. 6375. FORMAT "%4.0" AXIS_PTS_REF ldp_n_ip_t_dly_egr_on /end AXIS_DESCR
/end CHARACTERISTIC
/begin AXIS_PTS ldp_n_ip_t_dly_egr_on "" 0x841e12 n _REC_AXS_20_u2 6375. _CNV_A_R_LINEAR_____5_CM 6 0. 6375. FORMAT "%4.0" /end AXIS_PTS
/begin CHARACTERISTIC ip_egr_sp_bas_0_0 "GE_ESP: basic egr setpoint (inj. region GES = 0; temp. level = 0)" MAP 0x846baa _REC_MAP_20_u2_u2_u2 99.99847412109381 _CNV_A_R_LINEAR_____8_CM 0. 99.99847412109381 DISPLAY_IDENTIFIER IP_EGR_SP_BAS_0_0
 /begin AXIS_DESCR COM_AXIS n _CNV_A_R_LINEAR_____5_CM 16 0. 6375. FORMAT "%4.0" AXIS_PTS_REF ldpm_n_ip_egr_sp_bas_0 /end AXIS_DESCR
 /begin AXIS_DESCR COM_AXIS tqi_egr _CNV_A_R_LINEAR_____52_CM 16 0. 1023.96875 FORMAT "%6.2" AXIS_PTS_REF ldpm_tqi_ip_egr_sp_bas_0 /end AXIS_DESCR
/end CHARACTERISTIC
/begin AXIS_PTS ldpm_n_ip_egr_sp_bas_0 "" 0x843022 n _REC_AXS_20_u2 6375. _CNV_A_R_LINEAR_____5_CM 16 0. 6375. FORMAT "%4.0" /end AXIS_PTS
/begin AXIS_PTS ldpm_tqi_ip_egr_sp_bas_0 "" 0x8438f8 tqi_egr _REC_AXS_20_u2 1023.96875 _CNV_A_R_LINEAR_____52_CM 16 0. 1023.96875 FORMAT "%6.2" /end AXIS_PTS
/begin CHARACTERISTIC ip_egr_sp_bas_0_1 "GE_ESP: basic egr setpoint (inj. region GES = 0; temp. level = 1)" MAP 0x846daa _REC_MAP_20_u2_u2_u2 99.99847412109381 _CNV_A_R_LINEAR_____8_CM 0. 99.99847412109381 DISPLAY_IDENTIFIER IP_EGR_SP_BAS_0_1
 /begin AXIS_DESCR COM_AXIS n _CNV_A_R_LINEAR_____5_CM 16 0. 6375. FORMAT "%4.0" AXIS_PTS_REF ldpm_n_ip_egr_sp_bas_0 /end AXIS_DESCR
 /begin AXIS_DESCR COM_AXIS tqi_egr _CNV_A_R_LINEAR_____52_CM 16 0. 1023.96875 FORMAT "%6.2" AXIS_PTS_REF ldpm_tqi_ip_egr_sp_bas_0 /end AXIS_DESCR
/end CHARACTERISTIC
/begin CHARACTERISTIC ip_egr_sp_bas_0_2 "GE_ESP: basic egr setpoint (inj. region GES = 0; temp. level = 2)" MAP 0x846faa _REC_MAP_20_u2_u2_u2 99.99847412109381 _CNV_A_R_LINEAR_____8_CM 0. 99.99847412109381 DISPLAY_IDENTIFIER IP_EGR_SP_BAS_0_2
 /begin AXIS_DESCR COM_AXIS n _CNV_A_R_LINEAR_____5_CM 16 0. 6375. FORMAT "%4.0" AXIS_PTS_REF ldpm_n_ip_egr_sp_bas_0 /end AXIS_DESCR
 /begin AXIS_DESCR COM_AXIS tqi_egr _CNV_A_R_LINEAR_____52_CM 16 0. 1023.96875 FORMAT "%6.2" AXIS_PTS_REF ldpm_tqi_ip_egr_sp_bas_0 /end AXIS_DESCR
/end CHARACTERISTIC
/begin CHARACTERISTIC ip_egr_sp_cor_tgas_0 "GE_ESP: basic egr setpoint correction map for temperature of the intake gas (inj. region GES = 0)" MAP 0x847caa _REC_MAP_20_u2_u2_u2 99.99847412 _CNV_A_R_LINEAR_____140_CM -50. 49.99847412 DISPLAY_IDENTIFIER IP_EGR_SP_COR_TGAS_0 FORMAT "%5.3"
 /begin AXIS_DESCR COM_AXIS n _CNV_A_R_LINEAR_____5_CM 8 0. 6375. FORMAT "%4.0" AXIS_PTS_REF ldp_n_ip_egr_sp_cor_tgas_0 /end AXIS_DESCR
 /begin AXIS_DESCR COM_AXIS tqi_egr _CNV_A_R_LINEAR_____52_CM 8 0. 1023.96875 FORMAT "%6.2" AXIS_PTS_REF ldp_tqi_ip_egr_sp_cor_tgas_0 /end AXIS_DESCR
/end CHARACTERISTIC
/begin AXIS_PTS ldp_n_ip_egr_sp_cor_tgas_0 "" 0x8419da n _REC_AXS_20_u2 6375. _CNV_A_R_LINEAR_____5_CM 8 0. 6375. FORMAT "%4.0" /end AXIS_PTS
/begin AXIS_PTS ldp_tqi_ip_egr_sp_cor_tgas_0 "" 0x84266c tqi_egr _REC_AXS_20_u2 1023.96875 _CNV_A_R_LINEAR_____52_CM 8 0. 1023.96875 FORMAT "%6.2" /end AXIS_PTS
/begin CHARACTERISTIC ip_egr_sp_cor_amp_0 "GE_ESP: basic egr setpoint correction map for ambient pressure (inj. region GES = 0)" MAP 0x8477aa _REC_MAP_20_u2_u2_u2 99.99847412 _CNV_A_R_LINEAR_____140_CM -50. 49.99847412 DISPLAY_IDENTIFIER IP_EGR_SP_COR_AMP_0 FORMAT "%5.3"
 /begin AXIS_DESCR COM_AXIS n _CNV_A_R_LINEAR_____5_CM 8 0. 6375. FORMAT "%4.0" AXIS_PTS_REF ldp_n_ip_egr_sp_cor_amp_0 /end AXIS_DESCR
 /begin AXIS_DESCR COM_AXIS tqi_egr _CNV_A_R_LINEAR_____52_CM 8 0. 1023.96875 FORMAT "%6.2" AXIS_PTS_REF ldp_tqi_ip_egr_sp_cor_amp_0 /end AXIS_DESCR
/end CHARACTERISTIC
/begin AXIS_PTS ldp_n_ip_egr_sp_cor_amp_0 "" 0x8419b6 n _REC_AXS_20_u2 6375. _CNV_A_R_LINEAR_____5_CM 8 0. 6375. FORMAT "%4.0" /end AXIS_PTS
/begin AXIS_PTS ldp_tqi_ip_egr_sp_cor_amp_0 "" 0x842648 tqi_egr _REC_AXS_20_u2 1023.96875 _CNV_A_R_LINEAR_____52_CM 8 0. 1023.96875 FORMAT "%6.2" /end AXIS_PTS
/begin CHARACTERISTIC ip_egr_sp_cor_lih_0 "GE_ESP: basic egr setpoint correction map for limp home (inj. region GES = 0)" MAP 0x8478aa _REC_MAP_20_u2_u2_u2 99.99847412 _CNV_A_R_LINEAR_____141_CM -50. 49.99847412 DISPLAY_IDENTIFIER IP_EGR_SP_COR_LIH_0 FORMAT "%5.3"
 /begin AXIS_DESCR COM_AXIS n _CNV_A_R_LINEAR_____5_CM 16 0. 6375. FORMAT "%4.0" AXIS_PTS_REF ldpm_n_ip_egr_sp_bas_0 /end AXIS_DESCR
 /begin AXIS_DESCR COM_AXIS tqi_egr _CNV_A_R_LINEAR_____52_CM 16 0. 1023.96875 FORMAT "%6.2" AXIS_PTS_REF ldpm_tqi_ip_egr_sp_bas_0 /end AXIS_DESCR
/end CHARACTERISTIC
/begin CHARACTERISTIC ip_egr_sp_bas_1_0 "GE_ESP: basic egr setpoint (inj. region GES = 1; temp. level = 0)" MAP 0x8471aa _REC_MAP_20_u2_u2_u2 99.99847412109381 _CNV_A_R_LINEAR_____8_CM 0. 99.99847412109381 DISPLAY_IDENTIFIER IP_EGR_SP_BAS_1_0
 /begin AXIS_DESCR COM_AXIS n _CNV_A_R_LINEAR_____5_CM 16 0. 6375. FORMAT "%4.0" AXIS_PTS_REF ldpm_n_ip_egr_sp_bas_1 /end AXIS_DESCR
 /begin AXIS_DESCR COM_AXIS tqi_egr _CNV_A_R_LINEAR_____52_CM 16 0. 1023.96875 FORMAT "%6.2" AXIS_PTS_REF ldpm_tqi_ip_egr_sp_bas_1 /end AXIS_DESCR
/end CHARACTERISTIC
/begin AXIS_PTS ldpm_n_ip_egr_sp_bas_1 "" 0x843044 n _REC_AXS_20_u2 6375. _CNV_A_R_LINEAR_____5_CM 16 0. 6375. FORMAT "%4.0" /end AXIS_PTS
/begin AXIS_PTS ldpm_tqi_ip_egr_sp_bas_1 "" 0x84391a tqi_egr _REC_AXS_20_u2 1023.96875 _CNV_A_R_LINEAR_____52_CM 16 0. 1023.96875 FORMAT "%6.2" /end AXIS_PTS
/begin CHARACTERISTIC ip_egr_sp_bas_1_1 "GE_ESP: basic egr setpoint (inj. region GES = 1; temp. level = 1)" MAP 0x8473aa _REC_MAP_20_u2_u2_u2 99.99847412109381 _CNV_A_R_LINEAR_____8_CM 0. 99.99847412109381 DISPLAY_IDENTIFIER IP_EGR_SP_BAS_1_1
 /begin AXIS_DESCR COM_AXIS n _CNV_A_R_LINEAR_____5_CM 16 0. 6375. FORMAT "%4.0" AXIS_PTS_REF ldpm_n_ip_egr_sp_bas_1 /end AXIS_DESCR
 /begin AXIS_DESCR COM_AXIS tqi_egr _CNV_A_R_LINEAR_____52_CM 16 0. 1023.96875 FORMAT "%6.2" AXIS_PTS_REF ldpm_tqi_ip_egr_sp_bas_1 /end AXIS_DESCR
/end CHARACTERISTIC
/begin CHARACTERISTIC ip_egr_sp_bas_1_2 "GE_ESP: basic egr setpoint (inj. region GES = 1; temp. level = 2)" MAP 0x8475aa _REC_MAP_20_u2_u2_u2 99.99847412109381 _CNV_A_R_LINEAR_____8_CM 0. 99.99847412109381 DISPLAY_IDENTIFIER IP_EGR_SP_BAS_1_2
 /begin AXIS_DESCR COM_AXIS n _CNV_A_R_LINEAR_____5_CM 16 0. 6375. FORMAT "%4.0" AXIS_PTS_REF ldpm_n_ip_egr_sp_bas_1 /end AXIS_DESCR
 /begin AXIS_DESCR COM_AXIS tqi_egr _CNV_A_R_LINEAR_____52_CM 16 0. 1023.96875 FORMAT "%6.2" AXIS_PTS_REF ldpm_tqi_ip_egr_sp_bas_1 /end AXIS_DESCR
/end CHARACTERISTIC
/begin CHARACTERISTIC ip_egr_sp_cor_tgas_1 "GE_ESP: basic egr setpoint correction map for temperature of the intake gas (inj. region GES = 1)" MAP 0x847d2a _REC_MAP_20_u2_u2_u2 99.99847412 _CNV_A_R_LINEAR_____140_CM -50. 49.99847412 DISPLAY_IDENTIFIER IP_EGR_SP_COR_TGAS_1 FORMAT "%5.3"
 /begin AXIS_DESCR COM_AXIS n _CNV_A_R_LINEAR_____5_CM 8 0. 6375. FORMAT "%4.0" AXIS_PTS_REF ldp_n_ip_egr_sp_cor_tgas_1 /end AXIS_DESCR
 /begin AXIS_DESCR COM_AXIS tqi_egr _CNV_A_R_LINEAR_____52_CM 8 0. 1023.96875 FORMAT "%6.2" AXIS_PTS_REF ldp_tqi_ip_egr_sp_cor_tgas_1 /end AXIS_DESCR
/end CHARACTERISTIC
/begin AXIS_PTS ldp_n_ip_egr_sp_cor_tgas_1 "" 0x8419ec n _REC_AXS_20_u2 6375. _CNV_A_R_LINEAR_____5_CM 8 0. 6375. FORMAT "%4.0" /end AXIS_PTS
/begin AXIS_PTS ldp_tqi_ip_egr_sp_cor_tgas_1 "" 0x84267e tqi_egr _REC_AXS_20_u2 1023.96875 _CNV_A_R_LINEAR_____52_CM 8 0. 1023.96875 FORMAT "%6.2" /end AXIS_PTS
/begin CHARACTERISTIC ip_egr_sp_cor_amp_1 "GE_ESP: basic egr setpoint correction map for ambient pressure (inj. region GES = 1)" MAP 0x84782a _REC_MAP_20_u2_u2_u2 99.99847412 _CNV_A_R_LINEAR_____140_CM -50. 49.99847412 DISPLAY_IDENTIFIER IP_EGR_SP_COR_AMP_1 FORMAT "%5.3"
 /begin AXIS_DESCR COM_AXIS n _CNV_A_R_LINEAR_____5_CM 8 0. 6375. FORMAT "%4.0" AXIS_PTS_REF ldp_n_ip_egr_sp_cor_amp_1 /end AXIS_DESCR
 /begin AXIS_DESCR COM_AXIS tqi_egr _CNV_A_R_LINEAR_____52_CM 8 0. 1023.96875 FORMAT "%6.2" AXIS_PTS_REF ldp_tqi_ip_egr_sp_cor_amp_1 /end AXIS_DESCR
/end CHARACTERISTIC
/begin AXIS_PTS ldp_n_ip_egr_sp_cor_amp_1 "" 0x8419c8 n _REC_AXS_20_u2 6375. _CNV_A_R_LINEAR_____5_CM 8 0. 6375. FORMAT "%4.0" /end AXIS_PTS
/begin AXIS_PTS ldp_tqi_ip_egr_sp_cor_amp_1 "" 0x84265a tqi_egr _REC_AXS_20_u2 1023.96875 _CNV_A_R_LINEAR_____52_CM 8 0. 1023.96875 FORMAT "%6.2" /end AXIS_PTS
/begin CHARACTERISTIC ip_egr_sp_cor_lih_1 "GE_ESP: basic egr setpoint correction map for limp home (inj. region GES = 1)" MAP 0x847aaa _REC_MAP_20_u2_u2_u2 99.99847412 _CNV_A_R_LINEAR_____141_CM -50. 49.99847412 DISPLAY_IDENTIFIER IP_EGR_SP_COR_LIH_1 FORMAT "%5.3"
 /begin AXIS_DESCR COM_AXIS n _CNV_A_R_LINEAR_____5_CM 16 0. 6375. FORMAT "%4.0" AXIS_PTS_REF ldpm_n_ip_egr_sp_bas_1 /end AXIS_DESCR
 /begin AXIS_DESCR COM_AXIS tqi_egr _CNV_A_R_LINEAR_____52_CM 16 0. 1023.96875 FORMAT "%6.2" AXIS_PTS_REF ldpm_tqi_ip_egr_sp_bas_1 /end AXIS_DESCR
/end CHARACTERISTIC
/begin CHARACTERISTIC ip_egr_sp_amp_h_rgn_1 "GE_ESP: basic egr setpoint during regeneration mode 1, high ambient pressure" MAP 0x8463aa _REC_MAP_20_u2_u2_u2 99.99847412109381 _CNV_A_R_LINEAR_____8_CM 0. 99.99847412109381 DISPLAY_IDENTIFIER IP_EGR_SP_AMP_H_RGN_1
 /begin AXIS_DESCR COM_AXIS n _CNV_A_R_LINEAR_____5_CM 16 0. 6375. FORMAT "%4.0" AXIS_PTS_REF ldpm_n_ip_egr_sp_amp_rgn_1 /end AXIS_DESCR
 /begin AXIS_DESCR COM_AXIS tqi_egr _CNV_A_R_LINEAR_____52_CM 16 0. 1023.96875 FORMAT "%6.2" AXIS_PTS_REF ldpm_tqi_egr_sp_amp_rgn_1 /end AXIS_DESCR
/end CHARACTERISTIC
/begin AXIS_PTS ldpm_n_ip_egr_sp_amp_rgn_1 "" 0x842fde n _REC_AXS_20_u2 6375. _CNV_A_R_LINEAR_____5_CM 16 0. 6375. FORMAT "%4.0" /end AXIS_PTS
/begin AXIS_PTS ldpm_tqi_egr_sp_amp_rgn_1 "" 0x843838 tqi_egr _REC_AXS_20_u2 1023.96875 _CNV_A_R_LINEAR_____52_CM 16 0. 1023.96875 FORMAT "%6.2" /end AXIS_PTS
/begin CHARACTERISTIC ip_egr_sp_amp_l_rgn_1 "GE_ESP: basic egr setpoint during regeneration mode 1, low ambient pressure" MAP 0x8467aa _REC_MAP_20_u2_u2_u2 99.99847412109381 _CNV_A_R_LINEAR_____8_CM 0. 99.99847412109381 DISPLAY_IDENTIFIER IP_EGR_SP_AMP_L_RGN_1
 /begin AXIS_DESCR COM_AXIS n _CNV_A_R_LINEAR_____5_CM 16 0. 6375. FORMAT "%4.0" AXIS_PTS_REF ldpm_n_ip_egr_sp_amp_rgn_1 /end AXIS_DESCR
 /begin AXIS_DESCR COM_AXIS tqi_egr _CNV_A_R_LINEAR_____52_CM 16 0. 1023.96875 FORMAT "%6.2" AXIS_PTS_REF ldpm_tqi_egr_sp_amp_rgn_1 /end AXIS_DESCR
/end CHARACTERISTIC
/begin CHARACTERISTIC ip_egr_sp_amp_h_rgn_2 "GE_ESP: basic egr setpoint during regeneration mode 2, high ambient pressure" MAP 0x8465aa _REC_MAP_20_u2_u2_u2 99.99847412109381 _CNV_A_R_LINEAR_____8_CM 0. 99.99847412109381 DISPLAY_IDENTIFIER IP_EGR_SP_AMP_H_RGN_2
 /begin AXIS_DESCR COM_AXIS n _CNV_A_R_LINEAR_____5_CM 16 0. 6375. FORMAT "%4.0" AXIS_PTS_REF ldpm_n_ip_egr_sp_amp_rgn_2 /end AXIS_DESCR
 /begin AXIS_DESCR COM_AXIS tqi_egr _CNV_A_R_LINEAR_____52_CM 16 0. 1023.96875 FORMAT "%6.2" AXIS_PTS_REF ldpm_tqi_egr_sp_amp_rgn_2 /end AXIS_DESCR
/end CHARACTERISTIC
/begin AXIS_PTS ldpm_n_ip_egr_sp_amp_rgn_2 "" 0x843000 n _REC_AXS_20_u2 6375. _CNV_A_R_LINEAR_____5_CM 16 0. 6375. FORMAT "%4.0" /end AXIS_PTS
/begin AXIS_PTS ldpm_tqi_egr_sp_amp_rgn_2 "" 0x84385a tqi_egr _REC_AXS_20_u2 1023.96875 _CNV_A_R_LINEAR_____52_CM 16 0. 1023.96875 FORMAT "%6.2" /end AXIS_PTS
/begin CHARACTERISTIC ip_egr_sp_amp_l_rgn_2 "GE_ESP: basic egr setpoint during regeneration mode 2, low ambient pressure" MAP 0x8469aa _REC_MAP_20_u2_u2_u2 99.99847412109381 _CNV_A_R_LINEAR_____8_CM 0. 99.99847412109381 DISPLAY_IDENTIFIER IP_EGR_SP_AMP_L_RGN_2
 /begin AXIS_DESCR COM_AXIS n _CNV_A_R_LINEAR_____5_CM 16 0. 6375. FORMAT "%4.0" AXIS_PTS_REF ldpm_n_ip_egr_sp_amp_rgn_2 /end AXIS_DESCR
 /begin AXIS_DESCR COM_AXIS tqi_egr _CNV_A_R_LINEAR_____52_CM 16 0. 1023.96875 FORMAT "%6.2" AXIS_PTS_REF ldpm_tqi_egr_sp_amp_rgn_2 /end AXIS_DESCR
/end CHARACTERISTIC
/begin CHARACTERISTIC ip_egr_sp_is "GE_ESP: egr setpoint during IS" MAP 0x847daa _REC_MAP_20_u2_u2_u1 99.99847412109381 _CNV_A_R_LINEAR_____8_CM 0. 99.99847412109381 DISPLAY_IDENTIFIER IP_EGR_SP_IS
 /begin AXIS_DESCR COM_AXIS amp _CNV_A_R_LINEAR_____45_CM 8 0. 5434. FORMAT "%6.2" AXIS_PTS_REF ldp_amp_ip_egr_sp_is /end AXIS_DESCR
 /begin AXIS_DESCR COM_AXIS tgas _CNV_A_R_LINEAR_____18_CM 8 -50. 205. FORMAT "%3.0" AXIS_PTS_REF ldp_tgas_ip_egr_sp_is /end AXIS_DESCR
/end CHARACTERISTIC
/begin AXIS_PTS ldp_amp_ip_egr_sp_is "" 0x841094 amp _REC_AXS_20_u2 5434. _CNV_A_R_LINEAR_____45_CM 8 0. 5434. FORMAT "%6.2" /end AXIS_PTS
/begin AXIS_PTS ldp_tgas_ip_egr_sp_is "" 0x842491 tgas _REC_AXS_20_u1 255. _CNV_A_R_LINEAR_____18_CM 8 -50. 205. FORMAT "%3.0" /end AXIS_PTS
/begin MEASUREMENT map_sp_lim "limited boost pressure setpoint" UWORD _CNV_A_R_LINEAR_____45_CM 1 0. 0. 5434. DISPLAY_IDENTIFIER MAP_SP_LIM ECU_ADDRESS 0x7fa73c BYTE_ORDER MSB_LAST FORMAT "%6.2" /end MEASUREMENT
/begin MEASUREMENT map_sp_max_prot_0 "maximum boost pressure setpoint regarding turbocharger 0 protection" UWORD _CNV_A_R_LINEAR_____45_CM 1 0. 0. 5434. DISPLAY_IDENTIFIER MAP_SP_MAX_PROT_0 ECU_ADDRESS 0x7fa73e BYTE_ORDER MSB_LAST FORMAT "%6.2" /end MEASUREMENT
/begin MEASUREMENT map_sp_max_prot_1 "maximum boost pressure setpoint regarding turbocharger 1 protection" UWORD _CNV_A_R_LINEAR_____45_CM 1 0. 0. 5434. DISPLAY_IDENTIFIER MAP_SP_MAX_PROT_1 ECU_ADDRESS 0x7fa740 BYTE_ORDER MSB_LAST FORMAT "%6.2" /end MEASUREMENT
/begin MEASUREMENT map_sp_max_prot "maximum boost pressure setpoint regarding turbocharger protection" UWORD _CNV_A_R_LINEAR_____45_CM 1 0. 0. 5434. DISPLAY_IDENTIFIER MAP_SP_MAX_PROT ECU_ADDRESS 0x7fa742 BYTE_ORDER MSB_LAST FORMAT "%6.2" /end MEASUREMENT
/begin MEASUREMENT fac_maf_stnd_cmp "factor to correct the mass air flow through the compressor(s)" UWORD _CNV_A_R_LINEAR_____102_CM 1 0. 0. 1.99996948242188 DISPLAY_IDENTIFIER FAC_MAF_STND_CMP ECU_ADDRESS 0x7fa744 BYTE_ORDER MSB_LAST FORMAT "%6.5" /end MEASUREMENT
/begin MEASUREMENT map_sp_bas_sub "boost pressure setpoint behind PF- intervention" UWORD _CNV_A_R_LINEAR_____45_CM 1 0. 0. 5434. DISPLAY_IDENTIFIER MAP_SP_BAS_SUB ECU_ADDRESS 0x7fa746 BYTE_ORDER MSB_LAST FORMAT "%6.2" /end MEASUREMENT
/begin MEASUREMENT map_sp_bas "basic boost pressure setpoint" UWORD _CNV_A_R_LINEAR_____45_CM 1 0. 0. 5434. DISPLAY_IDENTIFIER MAP_SP_BAS ECU_ADDRESS 0x7f98e6 BYTE_ORDER MSB_LAST FORMAT "%6.2" /end MEASUREMENT
/begin MEASUREMENT map_sp_bas_clc "boost pressure setpoint before PF- intervention" UWORD _CNV_A_R_LINEAR_____45_CM 1 0. 0. 5434. DISPLAY_IDENTIFIER MAP_SP_BAS_CLC ECU_ADDRESS 0x7fa748 BYTE_ORDER MSB_LAST FORMAT "%6.2" /end MEASUREMENT
/begin MEASUREMENT map_sp_bas_tco_0 "uncorrected basic boost pressure setpoint (inj. state GES = 0)" UWORD _CNV_A_R_LINEAR_____45_CM 1 0. 0. 5434. DISPLAY_IDENTIFIER MAP_SP_BAS_TCO_0 ECU_ADDRESS 0x7fa74a BYTE_ORDER MSB_LAST FORMAT "%6.2" /end MEASUREMENT
/begin MEASUREMENT map_sp_bas_0 "basic boost pressure setpoint (inj. state GES = 0)" UWORD _CNV_A_R_LINEAR_____45_CM 1 0. 0. 5434. DISPLAY_IDENTIFIER MAP_SP_BAS_0 ECU_ADDRESS 0x7fa74c BYTE_ORDER MSB_LAST FORMAT "%6.2" /end MEASUREMENT
/begin MEASUREMENT map_sp_bas_tco_1 "uncorrected basic boost pressure setpoint (inj. state GES = 1)" UWORD _CNV_A_R_LINEAR_____45_CM 1 0. 0. 5434. DISPLAY_IDENTIFIER MAP_SP_BAS_TCO_1 ECU_ADDRESS 0x7fa74e BYTE_ORDER MSB_LAST FORMAT "%6.2" /end MEASUREMENT
/begin MEASUREMENT map_sp_bas_1 "basic boost pressure setpoint (inj. state GES = 1)" UWORD _CNV_A_R_LINEAR_____45_CM 1 0. 0. 5434. DISPLAY_IDENTIFIER MAP_SP_BAS_1 ECU_ADDRESS 0x7fa750 BYTE_ORDER MSB_LAST FORMAT "%6.2" /end MEASUREMENT
/begin MEASUREMENT map_sp_rgn "basic boost pressure setpoint during regeneration" UWORD _CNV_A_R_LINEAR_____45_CM 1 0. 0. 5434. DISPLAY_IDENTIFIER MAP_SP_RGN ECU_ADDRESS 0x7fa752 BYTE_ORDER MSB_LAST FORMAT "%6.2" /end MEASUREMENT
/begin MEASUREMENT map_sp_rgn_1 "basic boost pressure setpoint during regeneration mode 1" UWORD _CNV_A_R_LINEAR_____45_CM 1 0. 0. 5434. DISPLAY_IDENTIFIER MAP_SP_RGN_1 ECU_ADDRESS 0x7fa754 BYTE_ORDER MSB_LAST FORMAT "%6.2" /end MEASUREMENT
/begin MEASUREMENT map_sp_rgn_2 "basic boost pressure setpoint during regeneration mode 2" UWORD _CNV_A_R_LINEAR_____45_CM 1 0. 0. 5434. DISPLAY_IDENTIFIER MAP_SP_RGN_2 ECU_ADDRESS 0x7fa756 BYTE_ORDER MSB_LAST FORMAT "%6.2" /end MEASUREMENT
/begin MEASUREMENT map_sp_dyn "dynamic boost pressure setpoint correction" SWORD _CNV_A_R_LINEAR_____142_CM 1 0. -2717.04 2716.96 DISPLAY_IDENTIFIER MAP_SP_DYN ECU_ADDRESS 0x7fa758 BYTE_ORDER MSB_LAST FORMAT "%6.2" /end MEASUREMENT
/begin MEASUREMENT map_sp_gen "general boost pressure setpoint" UWORD _CNV_A_R_LINEAR_____45_CM 1 0. 0. 5434. DISPLAY_IDENTIFIER MAP_SP_GEN ECU_ADDRESS 0x7fa75a BYTE_ORDER MSB_LAST FORMAT "%6.2" /end MEASUREMENT
/begin MEASUREMENT map_sp_trig "manifold pressure setpoint" UWORD _CNV_A_R_LINEAR_____45_CM 1 0. 0. 5434. DISPLAY_IDENTIFIER MAP_SP_TRIG ECU_ADDRESS 0x7fa75c BYTE_ORDER MSB_LAST FORMAT "%6.2" /end MEASUREMENT
/begin MEASUREMENT lv_map_sp_trig_fil "Activation flag for active filtering of MAP_SP_TRIG" UBYTE _CNV_S_2_RANGE______11_CM 1 0. 0. 1. DISPLAY_IDENTIFIER LV_MAP_SP_TRIG_FIL ECU_ADDRESS 0x7fbe5f /end MEASUREMENT
/begin MEASUREMENT lv_map_sp_trig "Activation flag for frozen MAP_SP_TRIG" UBYTE _CNV_S_2_RANGE______11_CM 1 0. 0. 1. DISPLAY_IDENTIFIER LV_MAP_SP_TRIG ECU_ADDRESS 0x7fbe60 /end MEASUREMENT
/begin MEASUREMENT map_sp_clc "unlimited setpoint of the manifold pressure" UWORD _CNV_A_R_LINEAR_____45_CM 1 0. 0. 5434. DISPLAY_IDENTIFIER MAP_SP_CLC ECU_ADDRESS 0x7f98e8 BYTE_ORDER MSB_LAST FORMAT "%6.2" /end MEASUREMENT
/begin MEASUREMENT map_sp_mmv_sub "filtered manifold pressure setpoint" UWORD _CNV_A_R_LINEAR_____45_CM 1 0. 0. 5434. DISPLAY_IDENTIFIER MAP_SP_MMV_SUB ECU_ADDRESS 0x7f98ea BYTE_ORDER MSB_LAST FORMAT "%6.2" /end MEASUREMENT
/begin MEASUREMENT map_sp_sub "boost pressure setpoint before filter" UWORD _CNV_A_R_LINEAR_____45_CM 1 0. 0. 5434. DISPLAY_IDENTIFIER MAP_SP_SUB ECU_ADDRESS 0x7f98ec BYTE_ORDER MSB_LAST FORMAT "%6.2" /end MEASUREMENT
/begin CHARACTERISTIC c_map_sp_min "min. MAP setpoint" VALUE 0x84fdd2 _REC_VAL_20_u2 5434. _CNV_A_R_LINEAR_____45_CM 0. 5434. DISPLAY_IDENTIFIER C_MAP_SP_MIN FORMAT "%6.2" /end CHARACTERISTIC
/begin CHARACTERISTIC c_map_sp_max_prot_maf_err "substitude value for the maximum boost pressure setpoint (turbo protection) in case of an MAF sensor error" VALUE 0x84fdd0 _REC_VAL_20_u2 5434. _CNV_A_R_LINEAR_____45_CM 0. 5434. DISPLAY_IDENTIFIER C_MAP_SP_MAX_PROT_MAF_ERR FORMAT "%6.2" /end CHARACTERISTIC
/begin CHARACTERISTIC c_tia_sub_maf_stnd_cmp "substitude temperature for the standardization of the air mass flow through the compressor" VALUE 0x850042 _REC_VAL_20_u1 255. _CNV_A_R_LINEAR_____18_CM -50. 205. DISPLAY_IDENTIFIER C_TIA_SUB_MAF_STND_CMP FORMAT "%3.0" /end CHARACTERISTIC
/begin CHARACTERISTIC c_amp_sub_maf_stnd_cmp "substitude ambient pressure for the standardization of the air mass flow through the compressor" VALUE 0x84fb94 _REC_VAL_20_u2 5434. _CNV_A_R_LINEAR_____45_CM 0. 5434. DISPLAY_IDENTIFIER C_AMP_SUB_MAF_STND_CMP FORMAT "%6.2" /end CHARACTERISTIC
/begin CHARACTERISTIC lc_map_sp_dev "activation button for manifold pressure during development" VALUE 0x850156 _REC_VAL_20_u1 1. _CNV_A_R_LINEAR_____0_CM 0. 1. DISPLAY_IDENTIFIER LC_MAP_SP_DEV FORMAT "%1.0" /end CHARACTERISTIC
/begin CHARACTERISTIC c_fac_map_sp_dev "basic boost pressure setpoint: factor for development" VALUE 0x84fd38 _REC_VAL_20_u2 1.99996948242188 _CNV_A_R_LINEAR_____102_CM 0. 1.99996948242188 DISPLAY_IDENTIFIER C_FAC_MAP_SP_DEV FORMAT "%6.5" /end CHARACTERISTIC
/begin CHARACTERISTIC c_map_sp_dev "manifold pressure during development" VALUE 0x84fdc6 _REC_VAL_20_s2 10867.834 _CNV_A_R_LINEAR_____143_CM -5434. 5433.834 DISPLAY_IDENTIFIER C_MAP_SP_DEV FORMAT "%5.1" /end CHARACTERISTIC
/begin CHARACTERISTIC lc_map_sp_dyn_on "button for dynamic MAP_SP" VALUE 0x850158 _REC_VAL_20_u1 1. _CNV_A_R_LINEAR_____0_CM 0. 1. DISPLAY_IDENTIFIER LC_MAP_SP_DYN_ON FORMAT "%1.0" /end CHARACTERISTIC
/begin CHARACTERISTIC c_t2_dt1_map_sp "(T1) time value for dynamic MAP_SP increasing" VALUE 0x84ff1a _REC_VAL_20_u2 4.19424 _CNV_A_R_LINEAR_____64_CM 0. 4.19424 DISPLAY_IDENTIFIER C_T2_DT1_MAP_SP FORMAT "%6.5" /end CHARACTERISTIC
/begin CHARACTERISTIC c_map_sp_dyn_max "maximum of the dynamic MAP setpoint" VALUE 0x84fdc8 _REC_VAL_20_s2 5434. _CNV_A_R_LINEAR_____142_CM -2717.04 2716.96 DISPLAY_IDENTIFIER C_MAP_SP_DYN_MAX FORMAT "%6.2" /end CHARACTERISTIC
/begin CHARACTERISTIC c_map_sp_dyn_min "minimum of the dynamic MAP setpoint" VALUE 0x84fdca _REC_VAL_20_s2 5434. _CNV_A_R_LINEAR_____142_CM -2717.04 2716.96 DISPLAY_IDENTIFIER C_MAP_SP_DYN_MIN FORMAT "%6.2" /end CHARACTERISTIC
/begin CHARACTERISTIC lc_map_sp_dyn_map_sp "dynamic MAP_SP from MAP_SP_LIM" VALUE 0x850157 _REC_VAL_20_u1 1. _CNV_A_R_LINEAR_____0_CM 0. 1. DISPLAY_IDENTIFIER LC_MAP_SP_DYN_MAP_SP FORMAT "%1.0" /end CHARACTERISTIC
/begin CHARACTERISTIC c_map_sp_dyn_thd_min "threshold for dynamic setpoint" VALUE 0x84fdcc _REC_VAL_20_u2 5434. _CNV_A_R_LINEAR_____45_CM 0. 5434. DISPLAY_IDENTIFIER C_MAP_SP_DYN_THD_MIN FORMAT "%6.2" /end CHARACTERISTIC
/begin CHARACTERISTIC c_fac_map_sp_fil_trig "filter factor for MAP_SP" VALUE 0x84fd3e _REC_VAL_20_u2 0.9999847412109381 _CNV_A_R_LINEAR_____14_CM 0. 0.9999847412109381 DISPLAY_IDENTIFIER C_FAC_MAP_SP_FIL_TRIG FORMAT "%6.5" /end CHARACTERISTIC
/begin CHARACTERISTIC c_map_sp_thd_trig "setpoint threshold for MAP_SP trigger" VALUE 0x84fdd4 _REC_VAL_20_u2 5434. _CNV_A_R_LINEAR_____45_CM 0. 5434. DISPLAY_IDENTIFIER C_MAP_SP_THD_TRIG FORMAT "%6.2" /end CHARACTERISTIC
/begin CHARACTERISTIC c_t_map_sp_trig "max. time for manifold pressure setpoint freeze" VALUE 0x84ffb4 _REC_VAL_20_u2 4.19424 _CNV_A_R_LINEAR_____64_CM 0. 4.19424 DISPLAY_IDENTIFIER C_T_MAP_SP_TRIG FORMAT "%6.5" /end CHARACTERISTIC
/begin CHARACTERISTIC c_map_sp_man "manual setpoint" VALUE 0x84fdce _REC_VAL_20_u2 5434. _CNV_A_R_LINEAR_____45_CM 0. 5434. DISPLAY_IDENTIFIER C_MAP_SP_MAN FORMAT "%6.2" /end CHARACTERISTIC
/begin CHARACTERISTIC lc_map_sp_man "manual setpoint enable" VALUE 0x850159 _REC_VAL_20_u1 1. _CNV_A_R_LINEAR_____0_CM 0. 1. DISPLAY_IDENTIFIER LC_MAP_SP_MAN FORMAT "%1.0" /end CHARACTERISTIC
/begin CHARACTERISTIC c_fac_map_sp_fil "filter factor for manifold pressure setpoint" VALUE 0x84fd3a _REC_VAL_20_u2 0.9999847412109381 _CNV_A_R_LINEAR_____14_CM 0. 0.9999847412109381 DISPLAY_IDENTIFIER C_FAC_MAP_SP_FIL FORMAT "%6.5" /end CHARACTERISTIC
/begin CHARACTERISTIC c_fac_map_sp_fil_ini "initial filter factor for manifold pressure setpoint" VALUE 0x84fd3c _REC_VAL_20_u2 0.9999847412109381 _CNV_A_R_LINEAR_____14_CM 0. 0.9999847412109381 DISPLAY_IDENTIFIER C_FAC_MAP_SP_FIL_INI FORMAT "%6.5" /end CHARACTERISTIC
/begin CHARACTERISTIC ip_pq_cmp_prot0 "GE_BSP: maximum pressure ratio of the compressor without surge" CURVE 0x84d564 _REC_CUR_20_u2_u2 6.5535 _CNV_A_R_LINEAR_____144_CM 0. 6.5535 DISPLAY_IDENTIFIER IP_PQ_CMP_PROT0 FORMAT "%5.4"
 /begin AXIS_DESCR COM_AXIS maf_kgh _CNV_A_R_LINEAR_____110_CM 12 0. 1023.984375 FORMAT "%6.2" AXIS_PTS_REF ldpm_maf_kgh_ip_pq_cmp_prot /end AXIS_DESCR
/end CHARACTERISTIC
/begin AXIS_PTS ldpm_maf_kgh_ip_pq_cmp_prot "" 0x842bf0 maf_kgh _REC_AXS_20_u2 1023.984375 _CNV_A_R_LINEAR_____110_CM 12 0. 1023.984375 FORMAT "%6.2" /end AXIS_PTS
/begin CHARACTERISTIC ip_pq_cmp_prot1 "GE_BSP: maximum pressure ratio of the compressure without overspeed" CURVE 0x84d57c _REC_CUR_20_u2_u2 6.5535 _CNV_A_R_LINEAR_____144_CM 0. 6.5535 DISPLAY_IDENTIFIER IP_PQ_CMP_PROT1 FORMAT "%5.4"
 /begin AXIS_DESCR COM_AXIS maf_kgh _CNV_A_R_LINEAR_____110_CM 12 0. 1023.984375 FORMAT "%6.2" AXIS_PTS_REF ldpm_maf_kgh_ip_pq_cmp_prot /end AXIS_DESCR
/end CHARACTERISTIC
/begin CHARACTERISTIC ip_fac_tran_map_sp_0 "GE_BSP: transition factor for the basic manifold pressure setpoints (inj. region 0)" CURVE 0x848494 _REC_CUR_20_u2_u1 1.99996948242188 _CNV_A_R_LINEAR_____102_CM 0. 1.99996948242188 DISPLAY_IDENTIFIER IP_FAC_TRAN_MAP_SP_0 FORMAT "%6.5"
 /begin AXIS_DESCR COM_AXIS tco _CNV_A_R_LINEAR_____18_CM 8 -50. 205. FORMAT "%3.0" AXIS_PTS_REF ldp_tco_ip_fac_tran_map_sp_0 /end AXIS_DESCR
/end CHARACTERISTIC
/begin AXIS_PTS ldp_tco_ip_fac_tran_map_sp_0 "" 0x842365 tco _REC_AXS_20_u1 255. _CNV_A_R_LINEAR_____18_CM 8 -50. 205. FORMAT "%3.0" /end AXIS_PTS
/begin CHARACTERISTIC ip_fac_map_sp_cor_amp_0 "GE_BSP: manifold pressure correction factor for ambient pressure (inj. region GES = 0)" CURVE 0x8481c2 _REC_CUR_20_u2_u2 0.9999847412109381 _CNV_A_R_LINEAR_____14_CM 0. 0.9999847412109381 DISPLAY_IDENTIFIER IP_FAC_MAP_SP_COR_AMP_0 FORMAT "%6.5"
 /begin AXIS_DESCR COM_AXIS amp _CNV_A_R_LINEAR_____45_CM 8 0. 5434. FORMAT "%6.2" AXIS_PTS_REF ldp_amp_ip_fac_map_sp_cor_0 /end AXIS_DESCR
/end CHARACTERISTIC
/begin AXIS_PTS ldp_amp_ip_fac_map_sp_cor_0 "" 0x841176 amp _REC_AXS_20_u2 5434. _CNV_A_R_LINEAR_____45_CM 8 0. 5434. FORMAT "%6.2" /end AXIS_PTS
/begin CHARACTERISTIC ip_fac_map_sp_cor_tgas_0 "GE_BSP: manifold pressure correction factor for temperature of the intake gas (inj. region GES = 0)" CURVE 0x8481ea _REC_CUR_20_u2_u1 0.9999847412109381 _CNV_A_R_LINEAR_____14_CM 0. 0.9999847412109381 DISPLAY_IDENTIFIER IP_FAC_MAP_SP_COR_TGAS_0 FORMAT "%6.5"
 /begin AXIS_DESCR COM_AXIS tgas _CNV_A_R_LINEAR_____18_CM 8 -50. 205. FORMAT "%3.0" AXIS_PTS_REF ldp_tgas_ip_fac_map_sp_cor_0 /end AXIS_DESCR
/end CHARACTERISTIC
/begin AXIS_PTS ldp_tgas_ip_fac_map_sp_cor_0 "" 0x8424e2 tgas _REC_AXS_20_u1 255. _CNV_A_R_LINEAR_____18_CM 8 -50. 205. FORMAT "%3.0" /end AXIS_PTS
/begin CHARACTERISTIC ip_fac_tran_map_sp_1 "GE_BSP: transition factor for the basic manifold pressure setpoints (inj. region 1)" CURVE 0x8484a4 _REC_CUR_20_u2_u1 1.99996948242188 _CNV_A_R_LINEAR_____102_CM 0. 1.99996948242188 DISPLAY_IDENTIFIER IP_FAC_TRAN_MAP_SP_1 FORMAT "%6.5"
 /begin AXIS_DESCR COM_AXIS tco _CNV_A_R_LINEAR_____18_CM 8 -50. 205. FORMAT "%3.0" AXIS_PTS_REF ldp_tco_ip_fac_tran_map_sp_1 /end AXIS_DESCR
/end CHARACTERISTIC
/begin AXIS_PTS ldp_tco_ip_fac_tran_map_sp_1 "" 0x84236e tco _REC_AXS_20_u1 255. _CNV_A_R_LINEAR_____18_CM 8 -50. 205. FORMAT "%3.0" /end AXIS_PTS
/begin CHARACTERISTIC ip_fac_map_sp_cor_amp_1 "GE_BSP: manifold pressure correction factor for ambient pressure (inj. region GES = 1)" CURVE 0x8481d2 _REC_CUR_20_u2_u2 0.9999847412109381 _CNV_A_R_LINEAR_____14_CM 0. 0.9999847412109381 DISPLAY_IDENTIFIER IP_FAC_MAP_SP_COR_AMP_1 FORMAT "%6.5"
 /begin AXIS_DESCR COM_AXIS amp _CNV_A_R_LINEAR_____45_CM 8 0. 5434. FORMAT "%6.2" AXIS_PTS_REF ldp_amp_ip_fac_map_sp_cor_1 /end AXIS_DESCR
/end CHARACTERISTIC
/begin AXIS_PTS ldp_amp_ip_fac_map_sp_cor_1 "" 0x841188 amp _REC_AXS_20_u2 5434. _CNV_A_R_LINEAR_____45_CM 8 0. 5434. FORMAT "%6.2" /end AXIS_PTS
/begin CHARACTERISTIC ip_fac_map_sp_cor_tgas_1 "GE_BSP: manifold pressure correction factor for temperature of the intake gas (inj. region GES = 1)" CURVE 0x8481fa _REC_CUR_20_u2_u1 0.9999847412109381 _CNV_A_R_LINEAR_____14_CM 0. 0.9999847412109381 DISPLAY_IDENTIFIER IP_FAC_MAP_SP_COR_TGAS_1 FORMAT "%6.5"
 /begin AXIS_DESCR COM_AXIS tgas _CNV_A_R_LINEAR_____18_CM 8 -50. 205. FORMAT "%3.0" AXIS_PTS_REF ldp_tgas_ip_fac_map_sp_cor_1 /end AXIS_DESCR
/end CHARACTERISTIC
/begin AXIS_PTS ldp_tgas_ip_fac_map_sp_cor_1 "" 0x8424eb tgas _REC_AXS_20_u1 255. _CNV_A_R_LINEAR_____18_CM 8 -50. 205. FORMAT "%3.0" /end AXIS_PTS
/begin CHARACTERISTIC ip_fac_map_sp_cor_amp_rgn_1 "GE_BSP: Amp correction factor during rgn 1" CURVE 0x8481e2 _REC_CUR_20_u2_u2 0.9999847412109381 _CNV_A_R_LINEAR_____14_CM 0. 0.9999847412109381 DISPLAY_IDENTIFIER IP_FAC_MAP_SP_COR_AMP_RGN_1 FORMAT "%6.5"
 /begin AXIS_DESCR COM_AXIS amp _CNV_A_R_LINEAR_____45_CM 2 0. 5434. FORMAT "%6.2" AXIS_PTS_REF ldp_amp_ip_fac_map_sp_cor_rgn_1 /end AXIS_DESCR
/end CHARACTERISTIC
/begin AXIS_PTS ldp_amp_ip_fac_map_sp_cor_rgn_1 "" 0x84119a amp _REC_AXS_20_u2 5434. _CNV_A_R_LINEAR_____45_CM 2 0. 5434. FORMAT "%6.2" /end AXIS_PTS
/begin CHARACTERISTIC ip_fac_map_sp_cor_amp_rgn_2 "GE_BSP: Amp correction factor during rgn 2" CURVE 0x8481e6 _REC_CUR_20_u2_u2 0.9999847412109381 _CNV_A_R_LINEAR_____14_CM 0. 0.9999847412109381 DISPLAY_IDENTIFIER IP_FAC_MAP_SP_COR_AMP_RGN_2 FORMAT "%6.5"
 /begin AXIS_DESCR COM_AXIS amp _CNV_A_R_LINEAR_____45_CM 2 0. 5434. FORMAT "%6.2" AXIS_PTS_REF ldp_amp_ip_fac_map_sp_cor_rgn_2 /end AXIS_DESCR
/end CHARACTERISTIC
/begin AXIS_PTS ldp_amp_ip_fac_map_sp_cor_rgn_2 "" 0x8411a0 amp _REC_AXS_20_u2 5434. _CNV_A_R_LINEAR_____45_CM 2 0. 5434. FORMAT "%6.2" /end AXIS_PTS
/begin CHARACTERISTIC ip_kr_dt1_map__map_sp_grd "GE_BSP: gain value for dynamic MAP_SP calculation" CURVE 0x8484ec _REC_CUR_20_u2_u2 2147.48365 _CNV_A_R_LINEAR_____145_CM -1073.75821 1073.72544 DISPLAY_IDENTIFIER IP_KR_DT1_MAP__MAP_SP_GRD FORMAT "%6.2"
 /begin AXIS_DESCR COM_AXIS map _CNV_A_R_LINEAR_____146_CM 6 -2717.041459 2716.958541 FORMAT "%6.2" AXIS_PTS_REF ldp_map_sp_grd_ip_kr_dt1_map /end AXIS_DESCR
/end CHARACTERISTIC
/begin AXIS_PTS ldp_map_sp_grd_ip_kr_dt1_map "" 0x841860 map _REC_AXS_20_u2 5434. _CNV_A_R_LINEAR_____146_CM 6 -2717.041459 2716.958541 FORMAT "%6.2" /end AXIS_PTS
/begin CHARACTERISTIC ip_kr_dt1_map_sp_tqi "GE_BSP: gain value for dynamic MAP_SP calculation_a" CURVE 0x8484f8 _REC_CUR_20_u2_u2 13107. _CNV_A_R_LINEAR_____147_CM -6553.6 6553.4 DISPLAY_IDENTIFIER IP_KR_DT1_MAP_SP_TQI FORMAT "%5.1"
 /begin AXIS_DESCR COM_AXIS tqi_grd_bpa _CNV_A_R_LINEAR_____139_CM 6 -32768. 32767. FORMAT "%5.0" AXIS_PTS_REF ldp_tqi_grd_ip_kr_dt1_map_sp /end AXIS_DESCR
/end CHARACTERISTIC
/begin AXIS_PTS ldp_tqi_grd_ip_kr_dt1_map_sp "" 0x8425f2 tqi_grd_bpa _REC_AXS_20_u2 65535. _CNV_A_R_LINEAR_____139_CM 6 -32768. 32767. FORMAT "%5.0" /end AXIS_PTS
/begin CHARACTERISTIC ip_fac_map_sp_fil_tra__n "GE_BSP: transition filter factor for manifold pressure setpoint" CURVE 0x84820a _REC_CUR_20_u2_u2 0.9999847412109381 _CNV_A_R_LINEAR_____14_CM 0. 0.9999847412109381 DISPLAY_IDENTIFIER IP_FAC_MAP_SP_FIL_TRA__N FORMAT "%6.5"
 /begin AXIS_DESCR COM_AXIS n _CNV_A_R_LINEAR_____5_CM 6 0. 6375. FORMAT "%4.0" AXIS_PTS_REF ldpm_n_ip_bpa_egr_sp_fil /end AXIS_DESCR
/end CHARACTERISTIC
/begin AXIS_PTS ldpm_n_ip_bpa_egr_sp_fil "" 0x842efe n _REC_AXS_20_u2 6375. _CNV_A_R_LINEAR_____5_CM 6 0. 6375. FORMAT "%4.0" /end AXIS_PTS
/begin CHARACTERISTIC ip_map_sp_max__n__amp "GE_BSP: manifold pressure setpoint limitation" MAP 0x84b5e4 _REC_MAP_20_u2_u2_u2 5434. _CNV_A_R_LINEAR_____45_CM 0. 5434. DISPLAY_IDENTIFIER IP_MAP_SP_MAX__N__AMP FORMAT "%6.2"
 /begin AXIS_DESCR COM_AXIS n _CNV_A_R_LINEAR_____5_CM 16 0. 6375. FORMAT "%4.0" AXIS_PTS_REF ldpm_n_ip_map /end AXIS_DESCR
 /begin AXIS_DESCR COM_AXIS amp _CNV_A_R_LINEAR_____45_CM 8 0. 5434. FORMAT "%6.2" AXIS_PTS_REF ldpm_amp_ip_map /end AXIS_DESCR
/end CHARACTERISTIC
/begin AXIS_PTS ldpm_n_ip_map "" 0x8431fa n _REC_AXS_20_u2 6375. _CNV_A_R_LINEAR_____5_CM 16 0. 6375. FORMAT "%4.0" /end AXIS_PTS
/begin AXIS_PTS ldpm_amp_ip_map "" 0x842b1a amp _REC_AXS_20_u2 5434. _CNV_A_R_LINEAR_____45_CM 8 0. 5434. FORMAT "%6.2" /end AXIS_PTS
/begin CHARACTERISTIC ip_map_sp_max__n__tia "GE_BSP: manifold pressure setpoint limitation_a" MAP 0x84b6e4 _REC_MAP_20_u2_u2_u1 5434. _CNV_A_R_LINEAR_____45_CM 0. 5434. DISPLAY_IDENTIFIER IP_MAP_SP_MAX__N__TIA FORMAT "%6.2"
 /begin AXIS_DESCR COM_AXIS n _CNV_A_R_LINEAR_____5_CM 16 0. 6375. FORMAT "%4.0" AXIS_PTS_REF ldpm_n_ip_map /end AXIS_DESCR
 /begin AXIS_DESCR COM_AXIS tia _CNV_A_R_LINEAR_____18_CM 8 -50. 205. FORMAT "%3.0" AXIS_PTS_REF ldpm_tia_ip_map /end AXIS_DESCR
/end CHARACTERISTIC
/begin AXIS_PTS ldpm_tia_ip_map "" 0x843812 tia _REC_AXS_20_u1 255. _CNV_A_R_LINEAR_____18_CM 8 -50. 205. FORMAT "%3.0" /end AXIS_PTS
/begin CHARACTERISTIC ip_fac_maf_stnd_cmp "GE_BSP: standardization factor for the mass air flow through the compressor; map output" MAP 0x848142 _REC_MAP_20_u2_u1_u2 1.99996948242188 _CNV_A_R_LINEAR_____102_CM 0. 1.99996948242188 DISPLAY_IDENTIFIER IP_FAC_MAF_STND_CMP FORMAT "%6.5"
 /begin AXIS_DESCR COM_AXIS tia _CNV_A_R_LINEAR_____18_CM 8 -50. 205. FORMAT "%3.0" AXIS_PTS_REF ldp_tia_ip_fac_maf_stnd_cmp /end AXIS_DESCR
 /begin AXIS_DESCR COM_AXIS amp _CNV_A_R_LINEAR_____45_CM 8 0. 5434. FORMAT "%6.2" AXIS_PTS_REF ldp_amp_ip_fac_maf_stnd_cmp /end AXIS_DESCR
/end CHARACTERISTIC
/begin AXIS_PTS ldp_tia_ip_fac_maf_stnd_cmp "" 0x842583 tia _REC_AXS_20_u1 255. _CNV_A_R_LINEAR_____18_CM 8 -50. 205. FORMAT "%3.0" /end AXIS_PTS
/begin AXIS_PTS ldp_amp_ip_fac_maf_stnd_cmp "" 0x841136 amp _REC_AXS_20_u2 5434. _CNV_A_R_LINEAR_____45_CM 8 0. 5434. FORMAT "%6.2" /end AXIS_PTS
/begin CHARACTERISTIC ip_map_sp_bas_0_0 "GE_BSP: basic manifold pressure setpoint for hot engine (inj. region GES = 0)" MAP 0x84a7e4 _REC_MAP_20_u2_u2_u2 5434. _CNV_A_R_LINEAR_____45_CM 0. 5434. DISPLAY_IDENTIFIER IP_MAP_SP_BAS_0_0 FORMAT "%6.2"
 /begin AXIS_DESCR COM_AXIS n _CNV_A_R_LINEAR_____5_CM 16 0. 6375. FORMAT "%4.0" AXIS_PTS_REF ldpm_n_ip_map_sp_bas_0 /end AXIS_DESCR
 /begin AXIS_DESCR COM_AXIS tqi_bpa _CNV_A_R_LINEAR_____52_CM 16 0. 1023.96875 FORMAT "%6.2" AXIS_PTS_REF ldpm_tqi_ip_map_sp_bas_0 /end AXIS_DESCR
/end CHARACTERISTIC
/begin AXIS_PTS ldpm_n_ip_map_sp_bas_0 "" 0x843272 n _REC_AXS_20_u2 6375. _CNV_A_R_LINEAR_____5_CM 16 0. 6375. FORMAT "%4.0" /end AXIS_PTS
/begin AXIS_PTS ldpm_tqi_ip_map_sp_bas_0 "" 0x843a80 tqi_bpa _REC_AXS_20_u2 1023.96875 _CNV_A_R_LINEAR_____52_CM 16 0. 1023.96875 FORMAT "%6.2" /end AXIS_PTS
/begin CHARACTERISTIC ip_map_sp_bas_0_1 "GE_BSP: basic manifold pressure setpoint for warm engine (inj. region GES = 0)" MAP 0x84a9e4 _REC_MAP_20_u2_u2_u2 5434. _CNV_A_R_LINEAR_____45_CM 0. 5434. DISPLAY_IDENTIFIER IP_MAP_SP_BAS_0_1 FORMAT "%6.2"
 /begin AXIS_DESCR COM_AXIS n _CNV_A_R_LINEAR_____5_CM 16 0. 6375. FORMAT "%4.0" AXIS_PTS_REF ldpm_n_ip_map_sp_bas_0 /end AXIS_DESCR
 /begin AXIS_DESCR COM_AXIS tqi_bpa _CNV_A_R_LINEAR_____52_CM 16 0. 1023.96875 FORMAT "%6.2" AXIS_PTS_REF ldpm_tqi_ip_map_sp_bas_0 /end AXIS_DESCR
/end CHARACTERISTIC
/begin CHARACTERISTIC ip_map_sp_bas_0_2 "GE_BSP: basic manifold pressure setpoint for cold engine (inj. region GES = 0)" MAP 0x84abe4 _REC_MAP_20_u2_u2_u2 5434. _CNV_A_R_LINEAR_____45_CM 0. 5434. DISPLAY_IDENTIFIER IP_MAP_SP_BAS_0_2 FORMAT "%6.2"
 /begin AXIS_DESCR COM_AXIS n _CNV_A_R_LINEAR_____5_CM 16 0. 6375. FORMAT "%4.0" AXIS_PTS_REF ldpm_n_ip_map_sp_bas_0 /end AXIS_DESCR
 /begin AXIS_DESCR COM_AXIS tqi_bpa _CNV_A_R_LINEAR_____52_CM 16 0. 1023.96875 FORMAT "%6.2" AXIS_PTS_REF ldpm_tqi_ip_map_sp_bas_0 /end AXIS_DESCR
/end CHARACTERISTIC
/begin CHARACTERISTIC ip_map_sp_cor_tgas_0 "GE_BSP: basic manifold pressure setpoint correction map for temperature of the intake gas (inj. region GES = 0)" MAP 0x84b4e4 _REC_MAP_20_u2_u2_u2 5434. _CNV_A_R_LINEAR_____146_CM -2717.041459 2716.958541 DISPLAY_IDENTIFIER IP_MAP_SP_COR_TGAS_0 FORMAT "%6.2"
 /begin AXIS_DESCR COM_AXIS n _CNV_A_R_LINEAR_____5_CM 8 0. 6375. FORMAT "%4.0" AXIS_PTS_REF ldp_n_ip_map_sp_cor_tgas_0 /end AXIS_DESCR
 /begin AXIS_DESCR COM_AXIS tqi_bpa _CNV_A_R_LINEAR_____52_CM 8 0. 1023.96875 FORMAT "%6.2" AXIS_PTS_REF ldp_tqi_ip_map_sp_cor_tgas_0 /end AXIS_DESCR
/end CHARACTERISTIC
/begin AXIS_PTS ldp_n_ip_map_sp_cor_tgas_0 "" 0x841bcc n _REC_AXS_20_u2 6375. _CNV_A_R_LINEAR_____5_CM 8 0. 6375. FORMAT "%4.0" /end AXIS_PTS
/begin AXIS_PTS ldp_tqi_ip_map_sp_cor_tgas_0 "" 0x842768 tqi_bpa _REC_AXS_20_u2 1023.96875 _CNV_A_R_LINEAR_____52_CM 8 0. 1023.96875 FORMAT "%6.2" /end AXIS_PTS
/begin CHARACTERISTIC ip_map_sp_cor_amp_0 "GE_BSP: basic manifold pressure setpoint correction map for ambient pressure (inj. region GES = 0)" MAP 0x84b3e4 _REC_MAP_20_u2_u2_u2 5434. _CNV_A_R_LINEAR_____146_CM -2717.041459 2716.958541 DISPLAY_IDENTIFIER IP_MAP_SP_COR_AMP_0 FORMAT "%6.2"
 /begin AXIS_DESCR COM_AXIS n _CNV_A_R_LINEAR_____5_CM 8 0. 6375. FORMAT "%4.0" AXIS_PTS_REF ldp_n_ip_map_sp_cor_amp_0 /end AXIS_DESCR
 /begin AXIS_DESCR COM_AXIS tqi_bpa _CNV_A_R_LINEAR_____52_CM 8 0. 1023.96875 FORMAT "%6.2" AXIS_PTS_REF ldp_tqi_ip_map_sp_cor_amp_0 /end AXIS_DESCR
/end CHARACTERISTIC
/begin AXIS_PTS ldp_n_ip_map_sp_cor_amp_0 "" 0x841ba8 n _REC_AXS_20_u2 6375. _CNV_A_R_LINEAR_____5_CM 8 0. 6375. FORMAT "%4.0" /end AXIS_PTS
/begin AXIS_PTS ldp_tqi_ip_map_sp_cor_amp_0 "" 0x842744 tqi_bpa _REC_AXS_20_u2 1023.96875 _CNV_A_R_LINEAR_____52_CM 8 0. 1023.96875 FORMAT "%6.2" /end AXIS_PTS
/begin CHARACTERISTIC ip_map_sp_bas_1_2 "GE_BSP: basic manifold pressure setpoint for cold engine (inj. region GES = 1)" MAP 0x84b1e4 _REC_MAP_20_u2_u2_u2 5434. _CNV_A_R_LINEAR_____45_CM 0. 5434. DISPLAY_IDENTIFIER IP_MAP_SP_BAS_1_2 FORMAT "%6.2"
 /begin AXIS_DESCR COM_AXIS n _CNV_A_R_LINEAR_____5_CM 16 0. 6375. FORMAT "%4.0" AXIS_PTS_REF ldpm_n_ip_map_sp_bas_1 /end AXIS_DESCR
 /begin AXIS_DESCR COM_AXIS tqi_bpa _CNV_A_R_LINEAR_____52_CM 16 0. 1023.96875 FORMAT "%6.2" AXIS_PTS_REF ldpm_tqi_ip_map_sp_bas_1 /end AXIS_DESCR
/end CHARACTERISTIC
/begin AXIS_PTS ldpm_n_ip_map_sp_bas_1 "" 0x843294 n _REC_AXS_20_u2 6375. _CNV_A_R_LINEAR_____5_CM 16 0. 6375. FORMAT "%4.0" /end AXIS_PTS
/begin AXIS_PTS ldpm_tqi_ip_map_sp_bas_1 "" 0x843aa2 tqi_bpa _REC_AXS_20_u2 1023.96875 _CNV_A_R_LINEAR_____52_CM 16 0. 1023.96875 FORMAT "%6.2" /end AXIS_PTS
/begin CHARACTERISTIC ip_map_sp_bas_1_1 "GE_BSP: basic manifold pressure setpoint for warm engine (inj. region GES = 1)" MAP 0x84afe4 _REC_MAP_20_u2_u2_u2 5434. _CNV_A_R_LINEAR_____45_CM 0. 5434. DISPLAY_IDENTIFIER IP_MAP_SP_BAS_1_1 FORMAT "%6.2"
 /begin AXIS_DESCR COM_AXIS n _CNV_A_R_LINEAR_____5_CM 16 0. 6375. FORMAT "%4.0" AXIS_PTS_REF ldpm_n_ip_map_sp_bas_1 /end AXIS_DESCR
 /begin AXIS_DESCR COM_AXIS tqi_bpa _CNV_A_R_LINEAR_____52_CM 16 0. 1023.96875 FORMAT "%6.2" AXIS_PTS_REF ldpm_tqi_ip_map_sp_bas_1 /end AXIS_DESCR
/end CHARACTERISTIC
/begin CHARACTERISTIC ip_map_sp_bas_1_0 "GE_BSP: basic manifold pressure setpoint for hot engine (inj. region GES = 1)" MAP 0x84ade4 _REC_MAP_20_u2_u2_u2 5434. _CNV_A_R_LINEAR_____45_CM 0. 5434. DISPLAY_IDENTIFIER IP_MAP_SP_BAS_1_0 FORMAT "%6.2"
 /begin AXIS_DESCR COM_AXIS n _CNV_A_R_LINEAR_____5_CM 16 0. 6375. FORMAT "%4.0" AXIS_PTS_REF ldpm_n_ip_map_sp_bas_1 /end AXIS_DESCR
 /begin AXIS_DESCR COM_AXIS tqi_bpa _CNV_A_R_LINEAR_____52_CM 16 0. 1023.96875 FORMAT "%6.2" AXIS_PTS_REF ldpm_tqi_ip_map_sp_bas_1 /end AXIS_DESCR
/end CHARACTERISTIC
/begin CHARACTERISTIC ip_map_sp_cor_tgas_1 "GE_BSP: basic manifold pressure setpoint correction map for temperature of the intake gas (inj. region GES = 1)" MAP 0x84b564 _REC_MAP_20_u2_u2_u2 5434. _CNV_A_R_LINEAR_____146_CM -2717.041459 2716.958541 DISPLAY_IDENTIFIER IP_MAP_SP_COR_TGAS_1 FORMAT "%6.2"
 /begin AXIS_DESCR COM_AXIS n _CNV_A_R_LINEAR_____5_CM 8 0. 6375. FORMAT "%4.0" AXIS_PTS_REF ldp_n_ip_map_sp_cor_tgas_1 /end AXIS_DESCR
 /begin AXIS_DESCR COM_AXIS tqi_bpa _CNV_A_R_LINEAR_____52_CM 8 0. 1023.96875 FORMAT "%6.2" AXIS_PTS_REF ldp_tqi_ip_map_sp_cor_tgas_1 /end AXIS_DESCR
/end CHARACTERISTIC
/begin AXIS_PTS ldp_n_ip_map_sp_cor_tgas_1 "" 0x841bde n _REC_AXS_20_u2 6375. _CNV_A_R_LINEAR_____5_CM 8 0. 6375. FORMAT "%4.0" /end AXIS_PTS
/begin AXIS_PTS ldp_tqi_ip_map_sp_cor_tgas_1 "" 0x84277a tqi_bpa _REC_AXS_20_u2 1023.96875 _CNV_A_R_LINEAR_____52_CM 8 0. 1023.96875 FORMAT "%6.2" /end AXIS_PTS
/begin CHARACTERISTIC ip_map_sp_cor_amp_1 "GE_BSP: basic manifold pressure setpoint correction map for ambient pressure (inj. region GES = 1)" MAP 0x84b464 _REC_MAP_20_u2_u2_u2 5434. _CNV_A_R_LINEAR_____146_CM -2717.041459 2716.958541 DISPLAY_IDENTIFIER IP_MAP_SP_COR_AMP_1 FORMAT "%6.2"
 /begin AXIS_DESCR COM_AXIS n _CNV_A_R_LINEAR_____5_CM 8 0. 6375. FORMAT "%4.0" AXIS_PTS_REF ldp_n_ip_map_sp_cor_amp_1 /end AXIS_DESCR
 /begin AXIS_DESCR COM_AXIS tqi_bpa _CNV_A_R_LINEAR_____52_CM 8 0. 1023.96875 FORMAT "%6.2" AXIS_PTS_REF ldp_tqi_ip_map_sp_cor_amp_1 /end AXIS_DESCR
/end CHARACTERISTIC
/begin AXIS_PTS ldp_n_ip_map_sp_cor_amp_1 "" 0x841bba n _REC_AXS_20_u2 6375. _CNV_A_R_LINEAR_____5_CM 8 0. 6375. FORMAT "%4.0" /end AXIS_PTS
/begin AXIS_PTS ldp_tqi_ip_map_sp_cor_amp_1 "" 0x842756 tqi_bpa _REC_AXS_20_u2 1023.96875 _CNV_A_R_LINEAR_____52_CM 8 0. 1023.96875 FORMAT "%6.2" /end AXIS_PTS
/begin CHARACTERISTIC ip_map_sp_amp_h_rgn_1 "GE_BSP: pressure setpoint for dpf rgn mode 1, high amp" MAP 0x849fe4 _REC_MAP_20_u2_u2_u2 5434. _CNV_A_R_LINEAR_____45_CM 0. 5434. DISPLAY_IDENTIFIER IP_MAP_SP_AMP_H_RGN_1 FORMAT "%6.2"
 /begin AXIS_DESCR COM_AXIS n _CNV_A_R_LINEAR_____5_CM 16 0. 6375. FORMAT "%4.0" AXIS_PTS_REF ldpm_n_ip_map_sp_amp_rgn_1 /end AXIS_DESCR
 /begin AXIS_DESCR COM_AXIS tqi_bpa _CNV_A_R_LINEAR_____148_CM 16 0. 1023.984375 FORMAT "%6.2" AXIS_PTS_REF ldpm_tqi_ip_map_sp_amp_rgn_1 /end AXIS_DESCR
/end CHARACTERISTIC
/begin AXIS_PTS ldpm_n_ip_map_sp_amp_rgn_1 "" 0x84322e n _REC_AXS_20_u2 6375. _CNV_A_R_LINEAR_____5_CM 16 0. 6375. FORMAT "%4.0" /end AXIS_PTS
/begin AXIS_PTS ldpm_tqi_ip_map_sp_amp_rgn_1 "" 0x843a3c tqi_bpa _REC_AXS_20_u2 1023.984375 _CNV_A_R_LINEAR_____148_CM 16 0. 1023.984375 FORMAT "%6.2" /end AXIS_PTS
/begin CHARACTERISTIC ip_map_sp_amp_l_rgn_1 "GE_BSP: pressure setpoint for dpf rgn mode 1, low amp" MAP 0x84a3e4 _REC_MAP_20_u2_u2_u2 5434. _CNV_A_R_LINEAR_____45_CM 0. 5434. DISPLAY_IDENTIFIER IP_MAP_SP_AMP_L_RGN_1 FORMAT "%6.2"
 /begin AXIS_DESCR COM_AXIS n _CNV_A_R_LINEAR_____5_CM 16 0. 6375. FORMAT "%4.0" AXIS_PTS_REF ldpm_n_ip_map_sp_amp_rgn_1 /end AXIS_DESCR
 /begin AXIS_DESCR COM_AXIS tqi_bpa _CNV_A_R_LINEAR_____148_CM 16 0. 1023.984375 FORMAT "%6.2" AXIS_PTS_REF ldpm_tqi_ip_map_sp_amp_rgn_1 /end AXIS_DESCR
/end CHARACTERISTIC
/begin CHARACTERISTIC ip_map_sp_amp_h_rgn_2 "GE_BSP: pressure setpoint for dpf rgn mode 2, high amp" MAP 0x84a1e4 _REC_MAP_20_u2_u2_u2 5434. _CNV_A_R_LINEAR_____45_CM 0. 5434. DISPLAY_IDENTIFIER IP_MAP_SP_AMP_H_RGN_2 FORMAT "%6.2"
 /begin AXIS_DESCR COM_AXIS n _CNV_A_R_LINEAR_____5_CM 16 0. 6375. FORMAT "%4.0" AXIS_PTS_REF ldpm_n_ip_map_sp_amp_rgn_2 /end AXIS_DESCR
 /begin AXIS_DESCR COM_AXIS tqi_bpa _CNV_A_R_LINEAR_____148_CM 16 0. 1023.984375 FORMAT "%6.2" AXIS_PTS_REF ldpm_tqi_ip_map_sp_amp_rgn_2 /end AXIS_DESCR
/end CHARACTERISTIC
/begin AXIS_PTS ldpm_n_ip_map_sp_amp_rgn_2 "" 0x843250 n _REC_AXS_20_u2 6375. _CNV_A_R_LINEAR_____5_CM 16 0. 6375. FORMAT "%4.0" /end AXIS_PTS
/begin AXIS_PTS ldpm_tqi_ip_map_sp_amp_rgn_2 "" 0x843a5e tqi_bpa _REC_AXS_20_u2 1023.984375 _CNV_A_R_LINEAR_____148_CM 16 0. 1023.984375 FORMAT "%6.2" /end AXIS_PTS
/begin CHARACTERISTIC ip_map_sp_amp_l_rgn_2 "GE_BSP: pressure setpoint for dpf rgn mode 2, low amp" MAP 0x84a5e4 _REC_MAP_20_u2_u2_u2 5434. _CNV_A_R_LINEAR_____45_CM 0. 5434. DISPLAY_IDENTIFIER IP_MAP_SP_AMP_L_RGN_2 FORMAT "%6.2"
 /begin AXIS_DESCR COM_AXIS n _CNV_A_R_LINEAR_____5_CM 16 0. 6375. FORMAT "%4.0" AXIS_PTS_REF ldpm_n_ip_map_sp_amp_rgn_2 /end AXIS_DESCR
 /begin AXIS_DESCR COM_AXIS tqi_bpa _CNV_A_R_LINEAR_____148_CM 16 0. 1023.984375 FORMAT "%6.2" AXIS_PTS_REF ldpm_tqi_ip_map_sp_amp_rgn_2 /end AXIS_DESCR
/end CHARACTERISTIC
/begin MEASUREMENT state_rgn_pf "regeneration status (bit0=regular regeneration, bit1=increased regeneration, bit15=\"fast bit\")" UWORD _CNV_A_R_LINEAR_____0_CM 1 0. 0. 65535. DISPLAY_IDENTIFIER STATE_RGN_PF ECU_ADDRESS 0x7f9de2 BYTE_ORDER MSB_LAST FORMAT "%5.0" /end MEASUREMENT
/begin MEASUREMENT sf_level_rgn_pf "Regeneration Level" UBYTE _CNV_A_R_LINEAR_____0_CM 1 0. 0. 3. DISPLAY_IDENTIFIER SF_LEVEL_RGN_PF ECU_ADDRESS 0x7fbac3 FORMAT "%1.0" /end MEASUREMENT
/begin MEASUREMENT lv_inj_post1_dece_on_rgn "enable specific POST1 activation during deceleration" UBYTE _CNV_S_2_RANGE______11_CM 1 0. 0. 1. DISPLAY_IDENTIFIER LV_INJ_POST1_DECE_ON_RGN ECU_ADDRESS 0x7fbac4 /end MEASUREMENT
/begin MEASUREMENT lv_inj_post1_on_rgn "enable specific POST1 activation in regeneration mode" UBYTE _CNV_S_2_RANGE______11_CM 1 0. 0. 1. DISPLAY_IDENTIFIER LV_INJ_POST1_ON_RGN ECU_ADDRESS 0x7fbac5 /end MEASUREMENT
/begin CHARACTERISTIC lc_state_rgn_pf_man "switch to manual value for the regeneration status" VALUE 0x850163 _REC_VAL_20_u1 1. _CNV_A_R_LINEAR_____0_CM 0. 1. DISPLAY_IDENTIFIER LC_STATE_RGN_PF_MAN FORMAT "%1.0" /end CHARACTERISTIC
/begin CHARACTERISTIC lc_fast_bit_rgn_pf_man "\"fast bit\" manual value" VALUE 0x85012d _REC_VAL_20_u1 1. _CNV_A_R_LINEAR_____0_CM 0. 1. DISPLAY_IDENTIFIER LC_FAST_BIT_RGN_PF_MAN FORMAT "%1.0" /end CHARACTERISTIC
/begin CHARACTERISTIC c_state_rgn_pf_man "manual value for the regeneration status (currently equal to the level: 0 = no regeneration, 1 = level 1, 2 = level 2)" VALUE 0x84ff00 _REC_VAL_20_u1 2. _CNV_A_R_LINEAR_____0_CM 0. 2. DISPLAY_IDENTIFIER C_STATE_RGN_PF_MAN FORMAT "%1.0" /end CHARACTERISTIC
/begin CHARACTERISTIC c_level_rgn_pf "Regeneration Level switch" VALUE 0x84fd82 _REC_VAL_20_u1 3. _CNV_A_R_LINEAR_____0_CM 0. 3. DISPLAY_IDENTIFIER C_LEVEL_RGN_PF FORMAT "%1.0" /end CHARACTERISTIC
/begin CHARACTERISTIC lc_inj_post1_dece_on_rgn "enable specific POST1 activation during deceleration" VALUE 0x850130 _REC_VAL_20_u1 1. _CNV_A_R_LINEAR_____0_CM 0. 1. DISPLAY_IDENTIFIER LC_INJ_POST1_DECE_ON_RGN FORMAT "%1.0" /end CHARACTERISTIC
/begin CHARACTERISTIC lc_inj_post1_on_rgn "enable specific POST1 activation in regeneration mode" VALUE 0x850131 _REC_VAL_20_u1 1. _CNV_A_R_LINEAR_____0_CM 0. 1. DISPLAY_IDENTIFIER LC_INJ_POST1_ON_RGN FORMAT "%1.0" /end CHARACTERISTIC
/begin MEASUREMENT cru_req "Ausgeführte Aktion der CRU" UBYTE _CNV_S_9_STATE_CRU__320_CM 1 0. 0. 8. DISPLAY_IDENTIFIER CRU_REQ ECU_ADDRESS 0x7fb7ee /end MEASUREMENT
/begin MEASUREMENT lv_cru_soft_off "Flag fuer Komfortabschaltung" UBYTE _CNV_S_2_RANGE__0___85_CM 1 0. 0. 1. DISPLAY_IDENTIFIER LV_CRU_SOFT_OFF ECU_ADDRESS 0x7fb7ef BIT_MASK 0x1 /end MEASUREMENT
/begin MEASUREMENT lv_cru_hard_off "Flag fuer harte Abschaltung" UBYTE _CNV_S_2_RANGE__0___85_CM 1 0. 0. 1. DISPLAY_IDENTIFIER LV_CRU_HARD_OFF ECU_ADDRESS 0x7fb7f0 BIT_MASK 0x1 /end MEASUREMENT
/begin MEASUREMENT lv_cru_off_dc "Flag fuer irreversible Abschaltung der CRU" UBYTE _CNV_S_2_RANGE__0___85_CM 1 0. 0. 1. DISPLAY_IDENTIFIER LV_CRU_OFF_DC ECU_ADDRESS 0x7fbdce BIT_MASK 0x1 /end MEASUREMENT
/begin MEASUREMENT lv_cru_del_vs_sp "Flag fuer Loeschen des Geschwindigkeitsspeichers" UBYTE _CNV_S_2_RANGE__0___85_CM 1 0. 0. 1. DISPLAY_IDENTIFIER LV_CRU_DEL_VS_SP ECU_ADDRESS 0x7fb7f1 BIT_MASK 0x1 /end MEASUREMENT
/begin CHARACTERISTIC c_t_max_abs "Zeitschwelle zum Abwerfen der CRU bei ABS-Eingriff" VALUE 0x84ffb6 _REC_VAL_20_u1 0.4 _CNV_A_R_LINEAR_____226_CM 0. 0.4 DISPLAY_IDENTIFIER C_T_MAX_ABS FORMAT "%4.2" /end CHARACTERISTIC
/begin CHARACTERISTIC c_t_max_asr "Zeitschwelle zum Abwerfen der CRU bei ASR-Eingriff" VALUE 0x84ffba _REC_VAL_20_u1 2.55 _CNV_A_R_LINEAR_____226_CM 0. 2.55 DISPLAY_IDENTIFIER C_T_MAX_ASR FORMAT "%4.2" /end CHARACTERISTIC
/begin CHARACTERISTIC c_t_max_msr "Zeitschwelle zum Abwerfen der CRU bei MSR-Eingriff" VALUE 0x84ffbe _REC_VAL_20_u1 2.55 _CNV_A_R_LINEAR_____226_CM 0. 2.55 DISPLAY_IDENTIFIER C_T_MAX_MSR FORMAT "%4.2" /end CHARACTERISTIC
/begin CHARACTERISTIC c_t_max_esp "Zeitschwelle zum Abwerfen der CRU bei ESP-Eingriff" VALUE 0x84ffbd _REC_VAL_20_u1 2.55 _CNV_A_R_LINEAR_____226_CM 0. 2.55 DISPLAY_IDENTIFIER C_T_MAX_ESP FORMAT "%4.2" /end CHARACTERISTIC
/begin CHARACTERISTIC c_t_max_eds "Zeitschwelle zum Abwerfen der CRU bei EDS-Eingriff" VALUE 0x84ffbc _REC_VAL_20_u1 2.55 _CNV_A_R_LINEAR_____226_CM 0. 2.55 DISPLAY_IDENTIFIER C_T_MAX_EDS FORMAT "%4.2" /end CHARACTERISTIC
/begin CHARACTERISTIC c_vb_min_cru "Bordspannungsschwelle zum Abwerfen der CRU" VALUE 0x8500f0 _REC_VAL_20_u1 26. _CNV_A_R_LINEAR_____250_CM 0. 26. DISPLAY_IDENTIFIER C_VB_MIN_CRU FORMAT "%4.1" /end CHARACTERISTIC
/begin CHARACTERISTIC c_vs_min_cru_off "Geschwindigkeitschwelle zum Ausschalten der CRU" VALUE 0x8500fa _REC_VAL_20_u2 511.9921875 _CNV_A_R_LINEAR_____321_CM 0. 511.9921875 DISPLAY_IDENTIFIER C_VS_MIN_CRU_OFF FORMAT "%7.3" /end CHARACTERISTIC
/begin CHARACTERISTIC c_vs_min_cru_on "Geschwindigkeitschwelle zum Einschalten der CRU" VALUE 0x8500fc _REC_VAL_20_u2 511.9921875 _CNV_A_R_LINEAR_____321_CM 0. 511.9921875 DISPLAY_IDENTIFIER C_VS_MIN_CRU_ON FORMAT "%7.3" /end CHARACTERISTIC
/begin CHARACTERISTIC c_ac_max_cru "Verzoegerungsschwelle zum Abwerfen der CRU" VALUE 0x84fb84 _REC_VAL_20_s2 27.77088 _CNV_A_R_LINEAR_____322_CM -27.77088 0. DISPLAY_IDENTIFIER C_AC_MAX_CRU FORMAT "%7.4" /end CHARACTERISTIC
/begin CHARACTERISTIC c_t_ac_max_cru "Zeitschwelle zum Abwerfen der CRU bei Überschreiten der Verzoegerungsschwelle" VALUE 0x84ff1c _REC_VAL_20_u1 2.55 _CNV_A_R_LINEAR_____226_CM 0. 2.55 DISPLAY_IDENTIFIER C_T_AC_MAX_CRU FORMAT "%4.2" /end CHARACTERISTIC
/begin MEASUREMENT n_vs_cru "N/VS-Verhaeltnis" UWORD _CNV_A_R_LINEAR_____323_CM 1 0. 0. 16320. DISPLAY_IDENTIFIER N_VS_CRU ECU_ADDRESS 0x7fa5f2 BYTE_ORDER MSB_LAST FORMAT "%5.0" /end MEASUREMENT
/begin CHARACTERISTIC c_n_vs_max_cru "Toleranzbandbreite zur Plausibilisierung des N/VS-Verhaeltnisses" VALUE 0x84fe3a _REC_VAL_20_u1 99.609375 _CNV_A_R_LINEAR_____79_CM 0. 99.609375 DISPLAY_IDENTIFIER C_N_VS_MAX_CRU FORMAT "%4.1" /end CHARACTERISTIC
/begin MEASUREMENT lv_cru_plus_off "Flag fuer reversible Abschaltung der CRU-PLUS (Bremseneingriff)" UBYTE _CNV_S_2_RANGE__0___85_CM 1 0. 0. 1. DISPLAY_IDENTIFIER LV_CRU_PLUS_OFF ECU_ADDRESS 0x7fb7f2 BIT_MASK 0x1 /end MEASUREMENT
/begin MEASUREMENT lv_cru_plus_off_dc "Flag fuer irreversible Abschaltung der CRU-PLUS (Bremseneingriff)" UBYTE _CNV_S_2_RANGE__0___85_CM 1 0. 0. 1. DISPLAY_IDENTIFIER LV_CRU_PLUS_OFF_DC ECU_ADDRESS 0x7fb7f3 BIT_MASK 0x1 /end MEASUREMENT
/begin MEASUREMENT cru_ctl_state "CRU-Betriebszustand" UBYTE _CNV_S_3_STATE_CRU__324_CM 1 0. 0. 2. DISPLAY_IDENTIFIER CRU_CTL_STATE ECU_ADDRESS 0x7fb7f4 /end MEASUREMENT
/begin MEASUREMENT lv_cru_act "Flag für CRU im Regelbetrieb" UBYTE _CNV_S_2_RANGE__0___85_CM 1 0. 0. 1. DISPLAY_IDENTIFIER LV_CRU_ACT ECU_ADDRESS 0x7fb7f5 BIT_MASK 0x1 /end MEASUREMENT
/begin AXIS_PTS ldp_n_32__ip_fac_tq_dec_cru "" 0x844056 n_32 _REC_AXS_20_u1 8160. _CNV_A_R_LINEAR_____81_CM 5 0. 8160. FORMAT "%4.0" /end AXIS_PTS
/begin MEASUREMENT ac_veh_loss "minimal mögliche Beschleunigung bedingt durch Motorverluste und Fahrwiderstände" SWORD _CNV_A_R_LINEAR_____322_CM 1 0. -27.77088 27.7700325 DISPLAY_IDENTIFIER AC_VEH_LOSS ECU_ADDRESS 0x7f9826 BYTE_ORDER MSB_LAST FORMAT "%7.4" /end MEASUREMENT
/begin MEASUREMENT lv_ena_cru_plus_intv "Flag für \"Bremseingriff durch CRU+ ist freigegeben\"" UBYTE _CNV_S_2_RANGE__0___85_CM 1 0. 0. 1. DISPLAY_IDENTIFIER LV_ENA_CRU_PLUS_INTV ECU_ADDRESS 0x7fb7f6 BIT_MASK 0x1 /end MEASUREMENT
/begin MEASUREMENT ac_cru_req_ext "nach extern (zu ESP, CVT und sonstigen) auszugebende Verzögerungsanforderung" SWORD _CNV_A_R_LINEAR_____322_CM 1 0. -27.77088 27.7700325 DISPLAY_IDENTIFIER AC_CRU_REQ_EXT ECU_ADDRESS 0x7f9828 BYTE_ORDER MSB_LAST FORMAT "%7.4" /end MEASUREMENT
/begin AXIS_PTS ldpm_vs_dif_cru__cru_plus "" 0x844458 vs_dif_cru _REC_AXS_20_u2 511.9921875 _CNV_A_R_LINEAR_____325_CM 8 -256. 255.9921875 FORMAT "%7.3" /end AXIS_PTS
/begin AXIS_PTS ldp_vs_fil__cru_plus "" 0x8443a2 vs_fil _REC_AXS_20_u2 511.9921875 _CNV_A_R_LINEAR_____321_CM 8 0. 511.9921875 FORMAT "%7.3" /end AXIS_PTS
/begin CHARACTERISTIC ip_ac_cru_req_ext_const "nach extern auszugebende Verzögerungsanforderung bei Konstantfahrt" CURVE 0x844ea2 _REC_CUR_20_u2_u2 55.5409125 _CNV_A_R_LINEAR_____326_CM -27.77088 27.7700325 DISPLAY_IDENTIFIER IP_AC_CRU_REQ_EXT_CONST FORMAT "%7.4"
 /begin AXIS_DESCR COM_AXIS vs_dif_cru _CNV_A_R_LINEAR_____325_CM 8 -256. 255.9921875 FORMAT "%7.3" AXIS_PTS_REF ldpm_vs_dif_cru__cru_plus /end AXIS_DESCR
/end CHARACTERISTIC
/begin CHARACTERISTIC ip_ac_cru_req_ext_dece "nach extern auszugebende Verzögerungsanforderung bei Verzögern" CURVE 0x844eb2 _REC_CUR_20_u2_u2 55.5409125 _CNV_A_R_LINEAR_____326_CM -27.77088 27.7700325 DISPLAY_IDENTIFIER IP_AC_CRU_REQ_EXT_DECE FORMAT "%7.4"
 /begin AXIS_DESCR COM_AXIS vs_fil _CNV_A_R_LINEAR_____321_CM 8 0. 511.9921875 FORMAT "%7.3" AXIS_PTS_REF ldp_vs_fil__cru_plus /end AXIS_DESCR
/end CHARACTERISTIC
/begin CHARACTERISTIC ip_ac_cru_req_ext_res "nach extern auszugebende Verzögerungsanforderung bei Wiederaufnahme" CURVE 0x844ec2 _REC_CUR_20_u2_u2 55.5409125 _CNV_A_R_LINEAR_____326_CM -27.77088 27.7700325 DISPLAY_IDENTIFIER IP_AC_CRU_REQ_EXT_RES FORMAT "%7.4"
 /begin AXIS_DESCR COM_AXIS vs_dif_cru _CNV_A_R_LINEAR_____325_CM 8 -256. 255.9921875 FORMAT "%7.3" AXIS_PTS_REF ldpm_vs_dif_cru__cru_plus /end AXIS_DESCR
/end CHARACTERISTIC
/begin CHARACTERISTIC c_mass_veh "Fahrzeugmasse" VALUE 0x84fdd8 _REC_VAL_20_u2 2999. _CNV_A_R_LINEAR_____327_CM 1. 3000. DISPLAY_IDENTIFIER C_MASS_VEH FORMAT "%5.0" /end CHARACTERISTIC
/begin CHARACTERISTIC c_vs_dif_min_cru_plus_intv "VS_DIF-Schwelle für Berechnungsfreigabe von AC_CRU_REQ_EXT während Konstantfahrt" VALUE 0x8500f4 _REC_VAL_20_s2 511.9921875 _CNV_A_R_LINEAR_____321_CM -256. 255.9921875 DISPLAY_IDENTIFIER C_VS_DIF_MIN_CRU_PLUS_INTV FORMAT "%7.3" /end CHARACTERISTIC
/begin CHARACTERISTIC lc_swi_ena_cru_plus "Ein- / Ausschalter der CRU+" VALUE 0x850165 _REC_VAL_20_u1 1. _CNV_A_R_LINEAR_____1_CM 0. 1. DISPLAY_IDENTIFIER LC_SWI_ENA_CRU_PLUS FORMAT "%1.0" /end CHARACTERISTIC
/begin CHARACTERISTIC ip_fac_tq_dec_cru "FAC_TQ_REQ_CRU-Dekrement bei \"SOFT_OFF\"" CURVE 0x84843a _REC_CUR_20_u2_u1 0.999969 _CNV_A_R_LINEAR_____328_CM 0. 0.999969 DISPLAY_IDENTIFIER IP_FAC_TQ_DEC_CRU FORMAT "%7.5"
 /begin AXIS_DESCR COM_AXIS n_32 _CNV_A_R_LINEAR_____81_CM 5 0. 8160. FORMAT "%4.0" AXIS_PTS_REF ldp_n_32__ip_fac_tq_dec_cru /end AXIS_DESCR
/end CHARACTERISTIC
/begin MEASUREMENT n_vs "Gear Step MT" UBYTE _CNV_A_R_LINEAR_____329_CM 1 0. 0. 255. DISPLAY_IDENTIFIER N_VS ECU_ADDRESS 0x7fbb71 FORMAT "%3.0" /end MEASUREMENT
/begin MEASUREMENT lv_intv_cru "Boolean signals intervention of cruise control" UBYTE _CNV_S_2_RANGE__0___85_CM 1 0. 0. 1. DISPLAY_IDENTIFIER LV_INTV_CRU ECU_ADDRESS 0x7fbb73 BIT_MASK 0x1 /end MEASUREMENT
/begin MEASUREMENT ac_veh "" SWORD _CNV_A_R_LINEAR_____322_CM 1 0. -27.77088 27.7700325 DISPLAY_IDENTIFIER AC_VEH ECU_ADDRESS 0x7fa166 BYTE_ORDER MSB_LAST FORMAT "%7.4" /end MEASUREMENT
/begin MEASUREMENT lv_etc_lih "Torque Limp Home limitation" UBYTE _CNV_S_2_RANGE__0___85_CM 1 0. 0. 1. DISPLAY_IDENTIFIER LV_ETC_LIH ECU_ADDRESS 0x7fbb74 BIT_MASK 0x1 /end MEASUREMENT
/begin MEASUREMENT lv_pin_dcc_swi " Flag indicating whether DCC is switched ON or OFF " UBYTE _CNV_S_2_RANGE__0___85_CM 1 0. 0. 1. DISPLAY_IDENTIFIER LV_PIN_DCC_SWI ECU_ADDRESS 0x7fbb7c BIT_MASK 0x1 /end MEASUREMENT
/begin MEASUREMENT lv_err_trl_msg_ood "Fehlerbit Anhaengerbotschoft nicht aktuell" UBYTE _CNV_S_2_RANGE__0___85_CM 1 0. 0. 1. DISPLAY_IDENTIFIER LV_ERR_TRL_MSG_OOD ECU_ADDRESS 0x7fbb76 BIT_MASK 0x1 /end MEASUREMENT
/begin MEASUREMENT lv_err_state_ctl_dece "Fehlerbit " UBYTE _CNV_S_2_RANGE__0___85_CM 1 0. 0. 1. DISPLAY_IDENTIFIER LV_ERR_STATE_CTL_DECE ECU_ADDRESS 0x7fbb77 BIT_MASK 0x1 /end MEASUREMENT
/begin MEASUREMENT lv_err_brake_lamp "Fehlerbit Lichtbotschoft nicht aktuell" UBYTE _CNV_S_2_RANGE__0___85_CM 1 0. 0. 1. DISPLAY_IDENTIFIER LV_ERR_BRAKE_LAMP ECU_ADDRESS 0x7fbb79 BIT_MASK 0x1 /end MEASUREMENT
/begin MEASUREMENT lv_err_state_ctl_dece_trlcu "Fehlerbit AAG red. ECD Bremslichtanst" UBYTE _CNV_S_2_RANGE__0___85_CM 1 0. 0. 1. DISPLAY_IDENTIFIER LV_ERR_STATE_CTL_DECE_TRLCU ECU_ADDRESS 0x7fbb7a BIT_MASK 0x1 /end MEASUREMENT
/begin MEASUREMENT lv_err_brake_lamp_trl "Fehlerbit Bremslicht-Aenhaenger" UBYTE _CNV_S_2_RANGE__0___85_CM 1 0. 0. 1. DISPLAY_IDENTIFIER LV_ERR_BRAKE_LAMP_TRL ECU_ADDRESS 0x7fbb7b BIT_MASK 0x1 /end MEASUREMENT
/begin MEASUREMENT lv_err_lamp_re_msg_ood "Fehlerbit " UBYTE _CNV_S_2_RANGE__0___85_CM 1 0. 0. 1. DISPLAY_IDENTIFIER LV_ERR_LAMP_RE_MSG_OOD ECU_ADDRESS 0x7fbb78 BIT_MASK 0x1 /end MEASUREMENT
/begin MEASUREMENT fac_tq_cru_p_i "Momentenanforderung des PI-Reglers" UWORD _CNV_A_R_LINEAR_____330_CM 1 0. 0. 0.999969 DISPLAY_IDENTIFIER FAC_TQ_CRU_P_I ECU_ADDRESS 0x7f982a BYTE_ORDER MSB_LAST FORMAT "%7.5" /end MEASUREMENT
/begin MEASUREMENT vs_dif_cru "Regelabweichung" SWORD _CNV_A_R_LINEAR_____321_CM 1 0. -256. 255.9921875 DISPLAY_IDENTIFIER VS_DIF_CRU ECU_ADDRESS 0x7f982c BYTE_ORDER MSB_LAST FORMAT "%7.3" /end MEASUREMENT
/begin MEASUREMENT cru_p "P-Anteil des PI-Reglers" SWORD _CNV_A_R_LINEAR_____331_CM 1 0. -1. 0.999969 DISPLAY_IDENTIFIER CRU_P ECU_ADDRESS 0x7fa5f8 BYTE_ORDER MSB_LAST FORMAT "%8.5" /end MEASUREMENT
/begin MEASUREMENT cru_i "I - Anteil des PI-Reglers" UWORD _CNV_A_R_LINEAR_____330_CM 1 0. 0. 0.999969 DISPLAY_IDENTIFIER CRU_I ECU_ADDRESS 0x7fa5f6 BYTE_ORDER MSB_LAST FORMAT "%7.5" /end MEASUREMENT
/begin MEASUREMENT cru_i_dif "Differenz zwischen tatsaechlichen und theoretischen Fahrwiderstaenden" SWORD _CNV_A_R_LINEAR_____331_CM 1 0. -1. 0.999969 DISPLAY_IDENTIFIER CRU_I_DIF ECU_ADDRESS 0x7fa5fa BYTE_ORDER MSB_LAST FORMAT "%8.5" /end MEASUREMENT
/begin MEASUREMENT t_cru_ini "Ansteuerzeit der CRU" UBYTE _CNV_A_R_LINEAR_____240_CM 1 0. 0. 25.5 DISPLAY_IDENTIFIER T_CRU_INI ECU_ADDRESS 0x7fbdcf FORMAT "%4.1" /end MEASUREMENT
/begin MEASUREMENT fac_t_cru_ini "Ansteuerfaktor des Reglers" UBYTE _CNV_A_R_LINEAR_____254_CM 1 0. 0. 0.99609375 DISPLAY_IDENTIFIER FAC_T_CRU_INI ECU_ADDRESS 0x7fbdd0 FORMAT "%5.3" /end MEASUREMENT
/begin MEASUREMENT lv_tq_req_cru_lim "Flag fuer Aenderungsbegrenzung des Reglers aktiv" UBYTE _CNV_S_2_RANGE__0___85_CM 1 0. 0. 1. DISPLAY_IDENTIFIER LV_TQ_REQ_CRU_LIM ECU_ADDRESS 0x7fbdd3 BIT_MASK 0x1 /end MEASUREMENT
/begin MEASUREMENT lv_lim_ac_veh "Flag fuer Beschleunigungsbegrenzung des Reglers aktiv" UBYTE _CNV_S_2_RANGE__0___85_CM 1 0. 0. 1. DISPLAY_IDENTIFIER LV_LIM_AC_VEH ECU_ADDRESS 0x7fb7f7 BIT_MASK 0x1 /end MEASUREMENT
/begin AXIS_PTS ldp_vs_dif_cru__ip_ac_cru_req "" 0x84437a vs_dif_cru _REC_AXS_20_u2 511.9921875 _CNV_A_R_LINEAR_____325_CM 9 -256. 255.9921875 FORMAT "%7.3" /end AXIS_PTS
/begin AXIS_PTS ldp_vs_fil__ip_ac_cru_req "" 0x8443b4 vs_fil _REC_AXS_20_u2 511.9921875 _CNV_A_R_LINEAR_____321_CM 9 0. 511.9921875 FORMAT "%7.3" /end AXIS_PTS
/begin CHARACTERISTIC ip_ac_cru_req "Beschleunigungsanforderung des Reglers" MAP 0x844e00 _REC_MAP_20_u2_u2_u2 55.5409125 _CNV_A_R_LINEAR_____326_CM -27.77088 27.7700325 DISPLAY_IDENTIFIER IP_AC_CRU_REQ FORMAT "%7.4"
 /begin AXIS_DESCR COM_AXIS vs_dif_cru _CNV_A_R_LINEAR_____325_CM 9 -256. 255.9921875 FORMAT "%7.3" AXIS_PTS_REF ldp_vs_dif_cru__ip_ac_cru_req /end AXIS_DESCR
 /begin AXIS_DESCR COM_AXIS vs_fil _CNV_A_R_LINEAR_____321_CM 9 0. 511.9921875 FORMAT "%7.3" AXIS_PTS_REF ldp_vs_fil__ip_ac_cru_req /end AXIS_DESCR
/end CHARACTERISTIC
/begin AXIS_PTS ldp_n_32__ip_ac_veh_ref "" 0x84404c n_32 _REC_AXS_20_u1 8160. _CNV_A_R_LINEAR_____81_CM 9 0. 8160. FORMAT "%4.0" /end AXIS_PTS
/begin AXIS_PTS ldp_n_vs__ip_ac_veh_ref "" 0x8440d8 n_vs _REC_AXS_20_u1 255. _CNV_A_R_LINEAR_____1_CM 9 0. 255. FORMAT "%3.0" /end AXIS_PTS
/begin AXIS_PTS ldp_vs_dif_cru__ip_cru_i "" 0x84438e vs_dif_cru _REC_AXS_20_u2 511.9921875 _CNV_A_R_LINEAR_____325_CM 9 -256. 255.9921875 FORMAT "%7.3" /end AXIS_PTS
/begin AXIS_PTS ldp_ac_veh__ip_cru_i "" 0x843f48 ac_veh _REC_AXS_20_u2 55.5409125 _CNV_A_R_LINEAR_____326_CM 9 -27.77088 27.7700325 FORMAT "%7.4" /end AXIS_PTS
/begin AXIS_PTS ldp_n_vs__ip_cru_i_ini "" 0x8440e2 n_vs _REC_AXS_20_u1 255. _CNV_A_R_LINEAR_____1_CM 9 0. 255. FORMAT "%3.0" /end AXIS_PTS
/begin AXIS_PTS ldp_vs_fil__ip_cru_i_ini "" 0x8443d6 vs_fil _REC_AXS_20_u2 511.9921875 _CNV_A_R_LINEAR_____321_CM 9 0. 511.9921875 FORMAT "%7.3" /end AXIS_PTS
/begin AXIS_PTS ldpm_t_cru_ini__ip_cru_fac_1 "" 0x844413 t_cru_ini _REC_AXS_20_u1 5. _CNV_A_R_LINEAR_____240_CM 6 0. 5. FORMAT "%4.1" /end AXIS_PTS
/begin AXIS_PTS ldpm_t_cru_ini__ip_cru_fac_2 "" 0x84441a t_cru_ini _REC_AXS_20_u1 5. _CNV_A_R_LINEAR_____240_CM 6 0. 5. FORMAT "%4.1" /end AXIS_PTS
/begin AXIS_PTS ldpm_t_cru_ini__ip_cru_fac_3 "" 0x844421 t_cru_ini _REC_AXS_20_u1 5. _CNV_A_R_LINEAR_____240_CM 6 0. 5. FORMAT "%4.1" /end AXIS_PTS
/begin AXIS_PTS ldpm_t_cru_ini__ip_cru_fac_4 "" 0x844428 t_cru_ini _REC_AXS_20_u1 5. _CNV_A_R_LINEAR_____240_CM 6 0. 5. FORMAT "%4.1" /end AXIS_PTS
/begin CHARACTERISTIC ip_cru_fac_1_at "Ansteuerfaktor bei \"AC\" fuer AT" CURVE 0x84515c _REC_CUR_20_u1_u1 0.99609375 _CNV_A_R_LINEAR_____254_CM 0. 0.99609375 DISPLAY_IDENTIFIER IP_CRU_FAC_1_AT FORMAT "%5.3"
 /begin AXIS_DESCR COM_AXIS t_cru_ini _CNV_A_R_LINEAR_____240_CM 6 0. 5. FORMAT "%4.1" AXIS_PTS_REF ldpm_t_cru_ini__ip_cru_fac_1 /end AXIS_DESCR
/end CHARACTERISTIC
/begin CHARACTERISTIC ip_cru_fac_2_at "Ansteuerfaktor bei \"DEC\" fuer AT" CURVE 0x845168 _REC_CUR_20_u1_u1 0.99609375 _CNV_A_R_LINEAR_____254_CM 0. 0.99609375 DISPLAY_IDENTIFIER IP_CRU_FAC_2_AT FORMAT "%5.3"
 /begin AXIS_DESCR COM_AXIS t_cru_ini _CNV_A_R_LINEAR_____240_CM 6 0. 5. FORMAT "%4.1" AXIS_PTS_REF ldpm_t_cru_ini__ip_cru_fac_2 /end AXIS_DESCR
/end CHARACTERISTIC
/begin CHARACTERISTIC ip_cru_fac_2_mt "Ansteuerfaktor bei \"DEC\" fuer MT" CURVE 0x84516e _REC_CUR_20_u1_u1 0.99609375 _CNV_A_R_LINEAR_____254_CM 0. 0.99609375 DISPLAY_IDENTIFIER IP_CRU_FAC_2_MT FORMAT "%5.3"
 /begin AXIS_DESCR COM_AXIS t_cru_ini _CNV_A_R_LINEAR_____240_CM 6 0. 5. FORMAT "%4.1" AXIS_PTS_REF ldpm_t_cru_ini__ip_cru_fac_2 /end AXIS_DESCR
/end CHARACTERISTIC
/begin CHARACTERISTIC ip_cru_fac_3_at "Ansteuerfaktor bei \"RES\" fuer AT" CURVE 0x845174 _REC_CUR_20_u1_u1 0.99609375 _CNV_A_R_LINEAR_____254_CM 0. 0.99609375 DISPLAY_IDENTIFIER IP_CRU_FAC_3_AT FORMAT "%5.3"
 /begin AXIS_DESCR COM_AXIS t_cru_ini _CNV_A_R_LINEAR_____240_CM 6 0. 5. FORMAT "%4.1" AXIS_PTS_REF ldpm_t_cru_ini__ip_cru_fac_3 /end AXIS_DESCR
/end CHARACTERISTIC
/begin CHARACTERISTIC ip_cru_fac_3_mt "Ansteuerfaktor bei \"RES\" fuer MT" CURVE 0x84517a _REC_CUR_20_u1_u1 0.99609375 _CNV_A_R_LINEAR_____254_CM 0. 0.99609375 DISPLAY_IDENTIFIER IP_CRU_FAC_3_MT FORMAT "%5.3"
 /begin AXIS_DESCR COM_AXIS t_cru_ini _CNV_A_R_LINEAR_____240_CM 6 0. 5. FORMAT "%4.1" AXIS_PTS_REF ldpm_t_cru_ini__ip_cru_fac_3 /end AXIS_DESCR
/end CHARACTERISTIC
/begin CHARACTERISTIC ip_cru_fac_4_mt "Ansteuerfaktor bei \"TIP-UP/-DOWN\" fuer MT" CURVE 0x845186 _REC_CUR_20_u1_u1 0.99609375 _CNV_A_R_LINEAR_____254_CM 0. 0.99609375 DISPLAY_IDENTIFIER IP_CRU_FAC_4_MT FORMAT "%5.3"
 /begin AXIS_DESCR COM_AXIS t_cru_ini _CNV_A_R_LINEAR_____240_CM 6 0. 5. FORMAT "%4.1" AXIS_PTS_REF ldpm_t_cru_ini__ip_cru_fac_4 /end AXIS_DESCR
/end CHARACTERISTIC
/begin CHARACTERISTIC ip_cru_fac_4_at "Ansteuerfaktor bei \"TIP-UP/-DOWN\" fuer AT" CURVE 0x845180 _REC_CUR_20_u1_u1 0.99609375 _CNV_A_R_LINEAR_____254_CM 0. 0.99609375 DISPLAY_IDENTIFIER IP_CRU_FAC_4_AT FORMAT "%5.3"
 /begin AXIS_DESCR COM_AXIS t_cru_ini _CNV_A_R_LINEAR_____240_CM 6 0. 5. FORMAT "%4.1" AXIS_PTS_REF ldpm_t_cru_ini__ip_cru_fac_4 /end AXIS_DESCR
/end CHARACTERISTIC
/begin AXIS_PTS ldp_vs_fil__ip_ac_veh_lim "" 0x8443c8 vs_fil _REC_AXS_20_u2 511.9921875 _CNV_A_R_LINEAR_____321_CM 6 0. 511.9921875 FORMAT "%7.3" /end AXIS_PTS
/begin CHARACTERISTIC c_t_max_ac_veh_lim "Zeitschwelle fuer Aktivierung der Beschleunigungsbegrenzung" VALUE 0x84ffb7 _REC_VAL_20_u1 5. _CNV_A_R_LINEAR_____240_CM 0. 5. DISPLAY_IDENTIFIER C_T_MAX_AC_VEH_LIM FORMAT "%4.1" /end CHARACTERISTIC
/begin CHARACTERISTIC c_fac_tq_lgrd_pos_cru "Aenderungsbegrenzung des Reglers in positive Richtung" VALUE 0x84fd52 _REC_VAL_20_u2 0.999969 _CNV_A_R_LINEAR_____330_CM 0. 0.999969 DISPLAY_IDENTIFIER C_FAC_TQ_LGRD_POS_CRU FORMAT "%7.5" /end CHARACTERISTIC
/begin CHARACTERISTIC c_tq_req_cru_lim "FAC_TQ_CRU_P_I-Schwellwert fuer Berechnungsunterbrechung des I-Anteils" VALUE 0x850066 _REC_VAL_20_u2 0.999969 _CNV_A_R_LINEAR_____330_CM 0. 0.999969 DISPLAY_IDENTIFIER C_TQ_REQ_CRU_LIM FORMAT "%7.5" /end CHARACTERISTIC
/begin CHARACTERISTIC c_fac_tq_lgrd_neg_cru "Aenderungsbegrenzung des Reglers in negative Richtung" VALUE 0x84fd50 _REC_VAL_20_u2 0.999969 _CNV_A_R_LINEAR_____330_CM 0. 0.999969 DISPLAY_IDENTIFIER C_FAC_TQ_LGRD_NEG_CRU FORMAT "%7.5" /end CHARACTERISTIC
/begin MEASUREMENT ac_cru_req "Beschleunigungsanforderung der CRU" SWORD _CNV_A_R_LINEAR_____322_CM 1 0. -27.77088 27.7700325 DISPLAY_IDENTIFIER AC_CRU_REQ ECU_ADDRESS 0x7f982e BYTE_ORDER MSB_LAST FORMAT "%7.4" /end MEASUREMENT
/begin AXIS_PTS ldp_amp_ad__ip_fac_ac_cru_req "" 0x843f76 amp_ad _REC_AXS_20_u2 5434. _CNV_A_R_LINEAR_____247_CM 5 0. 5434. FORMAT "%7.2" /end AXIS_PTS
/begin AXIS_PTS ldp_drg_tcu__ip_fac_ac_cru_req "" 0x843fb6 drg_tcu _REC_AXS_20_u1 63.49500000000001 _CNV_A_R_LINEAR_____332_CM 5 -31.623 31.872 FORMAT "%5.1" /end AXIS_PTS
/begin CHARACTERISTIC ip_ac_veh_ref "Maximal moegliche Fahrzeugbeschleunigung (Referenzbeschleunigung)" MAP 0x844ede _REC_MAP_20_u2_u1_u1 27.7683125268555 _CNV_A_R_LINEAR_____333_CM 8.4e-004 27.7691525268555 DISPLAY_IDENTIFIER IP_AC_VEH_REF FORMAT "%6.4"
 /begin AXIS_DESCR COM_AXIS n_32 _CNV_A_R_LINEAR_____81_CM 9 0. 8160. FORMAT "%4.0" AXIS_PTS_REF ldp_n_32__ip_ac_veh_ref /end AXIS_DESCR
 /begin AXIS_DESCR COM_AXIS n_vs _CNV_A_R_LINEAR_____1_CM 9 0. 255. FORMAT "%3.0" AXIS_PTS_REF ldp_n_vs__ip_ac_veh_ref /end AXIS_DESCR
/end CHARACTERISTIC
/begin CHARACTERISTIC ip_cru_i "Integral-Anteil des PI-Reglers" MAP 0x84518c _REC_MAP_20_u2_u2_u2 1.99996948 _CNV_A_R_LINEAR_____334_CM -1. 0.99996948 DISPLAY_IDENTIFIER IP_CRU_I FORMAT "%7.5"
 /begin AXIS_DESCR COM_AXIS vs_dif_cru _CNV_A_R_LINEAR_____325_CM 9 -256. 255.9921875 FORMAT "%7.3" AXIS_PTS_REF ldp_vs_dif_cru__ip_cru_i /end AXIS_DESCR
 /begin AXIS_DESCR COM_AXIS ac_veh _CNV_A_R_LINEAR_____326_CM 9 -27.77088 27.7700325 FORMAT "%7.4" AXIS_PTS_REF ldp_ac_veh__ip_cru_i /end AXIS_DESCR
/end CHARACTERISTIC
/begin CHARACTERISTIC ip_cru_i_ini "Initialisierungswert des I-Anteils (Fahrwiderstandskennfeld)" MAP 0x84522e _REC_MAP_20_u2_u1_u2 0.999969 _CNV_A_R_LINEAR_____330_CM 0. 0.999969 DISPLAY_IDENTIFIER IP_CRU_I_INI FORMAT "%7.5"
 /begin AXIS_DESCR COM_AXIS n_vs _CNV_A_R_LINEAR_____1_CM 9 0. 255. FORMAT "%3.0" AXIS_PTS_REF ldp_n_vs__ip_cru_i_ini /end AXIS_DESCR
 /begin AXIS_DESCR COM_AXIS vs_fil _CNV_A_R_LINEAR_____321_CM 9 0. 511.9921875 FORMAT "%7.3" AXIS_PTS_REF ldp_vs_fil__ip_cru_i_ini /end AXIS_DESCR
/end CHARACTERISTIC
/begin CHARACTERISTIC ip_cru_fac_1_mt "Ansteuerfaktor bei \"AC\" fuer MT" CURVE 0x845162 _REC_CUR_20_u1_u1 0.99609375 _CNV_A_R_LINEAR_____254_CM 0. 0.99609375 DISPLAY_IDENTIFIER IP_CRU_FAC_1_MT FORMAT "%5.3"
 /begin AXIS_DESCR COM_AXIS t_cru_ini _CNV_A_R_LINEAR_____240_CM 6 0. 5. FORMAT "%4.1" AXIS_PTS_REF ldpm_t_cru_ini__ip_cru_fac_1 /end AXIS_DESCR
/end CHARACTERISTIC
/begin CHARACTERISTIC ip_ac_veh_lim "Maximal zulaessige Beschleunigung mit CRU" CURVE 0x844ed2 _REC_CUR_20_u2_u2 27.7691525268555 _CNV_A_R_LINEAR_____333_CM 0. 27.7691525268555 DISPLAY_IDENTIFIER IP_AC_VEH_LIM FORMAT "%6.4"
 /begin AXIS_DESCR COM_AXIS vs_fil _CNV_A_R_LINEAR_____321_CM 6 0. 511.9921875 FORMAT "%7.3" AXIS_PTS_REF ldp_vs_fil__ip_ac_veh_lim /end AXIS_DESCR
/end CHARACTERISTIC
/begin CHARACTERISTIC ip_fac_ac_cru_req "Faktor zur Korrektur der Beschleunigungsanforderung ueber Hoehe und Fahrwiderstandsindex" MAP 0x847f06 _REC_MAP_20_u1_u2_u1 1.9921875 _CNV_A_R_LINEAR_____246_CM 0. 1.9921875 DISPLAY_IDENTIFIER IP_FAC_AC_CRU_REQ FORMAT "%8.6"
 /begin AXIS_DESCR COM_AXIS amp_ad _CNV_A_R_LINEAR_____247_CM 5 0. 5434. FORMAT "%7.2" AXIS_PTS_REF ldp_amp_ad__ip_fac_ac_cru_req /end AXIS_DESCR
 /begin AXIS_DESCR COM_AXIS drg_tcu _CNV_A_R_LINEAR_____332_CM 5 -31.623 31.872 FORMAT "%5.1" AXIS_PTS_REF ldp_drg_tcu__ip_fac_ac_cru_req /end AXIS_DESCR
/end CHARACTERISTIC
/begin CHARACTERISTIC ip_fac_cru_i "Faktor zur Korrektur des I-Anteils in Abhaengigkeit der Sollgeschwindigkeit" CURVE 0x847f27 _REC_CUR_20_u1_u2 0.99609375 _CNV_A_R_LINEAR_____254_CM 0. 0.99609375 DISPLAY_IDENTIFIER IP_FAC_CRU_I FORMAT "%5.3"
 /begin AXIS_DESCR COM_AXIS vs_sp_cru _CNV_A_R_LINEAR_____321_CM 9 0. 511.9921875 FORMAT "%7.3" AXIS_PTS_REF ldp_vs_sp_cru__ip_fac_cru_i /end AXIS_DESCR
/end CHARACTERISTIC
/begin AXIS_PTS ldp_vs_sp_cru__ip_fac_cru_i "" 0x8443ea vs_sp_cru _REC_AXS_20_u2 511.9921875 _CNV_A_R_LINEAR_____321_CM 9 0. 511.9921875 FORMAT "%7.3" /end AXIS_PTS
/begin CHARACTERISTIC c_vs_i_ac_max_cru "Maximalschwelle zur Uebernahme des Fahrerwunsches in den I-Anteil" VALUE 0x8500f6 _REC_VAL_20_s2 55.5409125 _CNV_A_R_LINEAR_____322_CM -27.77088 27.7700325 DISPLAY_IDENTIFIER C_VS_I_AC_MAX_CRU FORMAT "%7.4" /end CHARACTERISTIC
/begin MEASUREMENT vs_sp_cru "Fahrzeugsollgeschwindigkeit" UWORD _CNV_A_R_LINEAR_____321_CM 1 0. 0. 511.9921875 DISPLAY_IDENTIFIER VS_SP_CRU ECU_ADDRESS 0x7f9830 BYTE_ORDER MSB_LAST /end MEASUREMENT
/begin MEASUREMENT vs_sp_cru_old "zuletzt gespeicherte Fahrzeugsollgeschwindigkeit" UWORD _CNV_A_R_LINEAR_____321_CM 1 0. 0. 511.9921875 DISPLAY_IDENTIFIER VS_SP_CRU_OLD ECU_ADDRESS 0x7fa5fc BYTE_ORDER MSB_LAST /end MEASUREMENT
/begin MEASUREMENT cru_sp_state "Ansteuer- / Regelzustand von VS_SP_CRU" UBYTE _CNV_S_8_STATE_CRU__335_CM 1 0. 0. 7. DISPLAY_IDENTIFIER CRU_SP_STATE ECU_ADDRESS 0x7fb7f8 /end MEASUREMENT
/begin MEASUREMENT vs_fil_st "Fahrzeuggeschwindigkeit bei Funktionsaufnahme " UWORD _CNV_A_R_LINEAR_____321_CM 1 0. 0. 511.9921875 DISPLAY_IDENTIFIER VS_FIL_ST ECU_ADDRESS 0x7fa5fe BYTE_ORDER MSB_LAST /end MEASUREMENT
/begin CHARACTERISTIC c_vs_inc_cru "Inkrement / Dekrement für TIP-UP- / TIP-DOWN-Funktion" VALUE 0x8500f8 _REC_VAL_20_u2 2. _CNV_A_R_LINEAR_____321_CM 1. 3. DISPLAY_IDENTIFIER C_VS_INC_CRU FORMAT "%7.3" /end CHARACTERISTIC
/begin CHARACTERISTIC c_vs_sp_inc_ac "Increment der Fahrzeugsollgeschwindigkeit bei \"AC\"" VALUE 0x850100 _REC_VAL_20_u2 511.9921875 _CNV_A_R_LINEAR_____321_CM 0. 511.9921875 DISPLAY_IDENTIFIER C_VS_SP_INC_AC FORMAT "%7.3" /end CHARACTERISTIC
/begin CHARACTERISTIC c_vs_sp_inc_dece "Increment der Fahrzeugsollgeschwindigkeit bei \"DECE\"" VALUE 0x850102 _REC_VAL_20_u2 511.9921875 _CNV_A_R_LINEAR_____321_CM 0. 511.9921875 DISPLAY_IDENTIFIER C_VS_SP_INC_DECE FORMAT "%7.3" /end CHARACTERISTIC
/begin AXIS_PTS ldpm_vs_fil__ip_vs_sp_cru_inc "" 0x84446a vs_fil _REC_AXS_20_u2 511.9921875 _CNV_A_R_LINEAR_____321_CM 6 0. 511.9921875 FORMAT "%7.3" /end AXIS_PTS
/begin CHARACTERISTIC ip_vs_sp_cru_hys "Hysterese um VS_SP_CRU" CURVE 0x84f974 _REC_CUR_20_u2_u2 511.99218 _CNV_A_R_LINEAR_____336_CM 0. 511.99218 DISPLAY_IDENTIFIER IP_VS_SP_CRU_HYS FORMAT "%7.3"
 /begin AXIS_DESCR COM_AXIS vs_fil _CNV_A_R_LINEAR_____321_CM 6 0. 511.9921875 FORMAT "%7.3" AXIS_PTS_REF ldpm_vs_fil__ip_vs_sp_cru_inc /end AXIS_DESCR
/end CHARACTERISTIC
/begin CHARACTERISTIC ip_vs_sp_cru_inc_dece "Increment der Fahrzeugsollgeschwindigkeit bei \"DECE\"" CURVE 0x84f98c _REC_CUR_20_u2_u2 511.99218 _CNV_A_R_LINEAR_____336_CM 0. 511.99218 DISPLAY_IDENTIFIER IP_VS_SP_CRU_INC_DECE FORMAT "%7.3"
 /begin AXIS_DESCR COM_AXIS vs_fil _CNV_A_R_LINEAR_____321_CM 6 0. 511.9921875 FORMAT "%7.3" AXIS_PTS_REF ldpm_vs_fil__ip_vs_sp_cru_inc /end AXIS_DESCR
/end CHARACTERISTIC
/begin CHARACTERISTIC ip_vs_sp_cru_inc_ac "Increment der Fahrzeugsollgeschwindigkeit bei \"AC\"" CURVE 0x84f980 _REC_CUR_20_u2_u2 511.99218 _CNV_A_R_LINEAR_____336_CM 0. 511.99218 DISPLAY_IDENTIFIER IP_VS_SP_CRU_INC_AC FORMAT "%7.3"
 /begin AXIS_DESCR COM_AXIS vs_fil _CNV_A_R_LINEAR_____321_CM 6 0. 511.9921875 FORMAT "%7.3" AXIS_PTS_REF ldpm_vs_fil__ip_vs_sp_cru_inc /end AXIS_DESCR
/end CHARACTERISTIC
/begin CHARACTERISTIC ip_vs_sp_cru_inc_resu "Increment der Fahrzeugsollgeschwindigkeit bei \"RESU\"" CURVE 0x84f998 _REC_CUR_20_u2_u2 511.99218 _CNV_A_R_LINEAR_____336_CM 0. 511.99218 DISPLAY_IDENTIFIER IP_VS_SP_CRU_INC_RESU FORMAT "%7.3"
 /begin AXIS_DESCR COM_AXIS vs_fil _CNV_A_R_LINEAR_____321_CM 6 0. 511.9921875 FORMAT "%7.3" AXIS_PTS_REF ldpm_vs_fil__ip_vs_sp_cru_inc /end AXIS_DESCR
/end CHARACTERISTIC
/begin MEASUREMENT lv_resu_up "Bit fuer Wiederaufnahme zu hoeherer Geschwindigkeit" UBYTE _CNV_S_2_RANGE__0___85_CM 1 0. 0. 1. DISPLAY_IDENTIFIER LV_RESU_UP ECU_ADDRESS 0x7fb7f9 BIT_MASK 0x1 /end MEASUREMENT
/begin MEASUREMENT cru_swi_req "Vom Fahrer gewuenschte Aktion (aus Schalterzuständen)" UBYTE _CNV_S_9_STATE_CRU__320_CM 1 0. 0. 8. DISPLAY_IDENTIFIER CRU_SWI_REQ ECU_ADDRESS 0x7fb7fa /end MEASUREMENT
/begin CHARACTERISTIC c_t_min_hld_cru_swi "Mindestbetaetigungszeit der GRA-Bedientaste" VALUE 0x84ffd3 _REC_VAL_20_u1 2.55 _CNV_A_R_LINEAR_____226_CM 0. 2.55 DISPLAY_IDENTIFIER C_T_MIN_HLD_CRU_SWI FORMAT "%4.2" /end CHARACTERISTIC
/begin MEASUREMENT lv_pin_cru_swi "Flag fuer diskreter Hauptschalter auf \"ON\"" UBYTE _CNV_S_2_RANGE__0___85_CM 1 0. 0. 1. DISPLAY_IDENTIFIER LV_PIN_CRU_SWI ECU_ADDRESS 0x7fb7fd BIT_MASK 0x1 /end MEASUREMENT
/begin MEASUREMENT lv_pin_cru_off "flag fuer schieber nicht in \"getastet off\"-stellung bei diskretem cru-signal" UBYTE _CNV_S_2_RANGE__0___85_CM 1 0. 0. 1. DISPLAY_IDENTIFIER LV_PIN_CRU_OFF ECU_ADDRESS 0x7fb7fe BIT_MASK 0x1 /end MEASUREMENT
/begin MEASUREMENT lv_pin_cru_reac "flag fuer schieber in \"resu/ac/tip-up\"-stellung bei diskretem cru-signal" UBYTE _CNV_S_2_RANGE__0___85_CM 1 0. 0. 1. DISPLAY_IDENTIFIER LV_PIN_CRU_REAC ECU_ADDRESS 0x7fb7ff BIT_MASK 0x1 /end MEASUREMENT
/begin MEASUREMENT lv_pin_cru_set "flag fuer betaetigten \"set/deacc/tip-down\"-taster bei diskretem cru-signal" UBYTE _CNV_S_2_RANGE__0___85_CM 1 0. 0. 1. DISPLAY_IDENTIFIER LV_PIN_CRU_SET ECU_ADDRESS 0x7fb800 BIT_MASK 0x1 /end MEASUREMENT
/begin MEASUREMENT t_acc "Timer for duration of transient TQ_LOSS_ACC correction " UWORD _CNV_A_R_LINEAR_____226_CM 1 0. 0. 655.35 DISPLAY_IDENTIFIER T_ACC ECU_ADDRESS 0x7fb4a0 BYTE_ORDER MSB_LAST FORMAT "%6.2" /end MEASUREMENT
/begin MEASUREMENT tq_add_acc "Torque reserve for switching on air conditioning compressor" SWORD _CNV_A_R_LINEAR_____52_CM 1 0. 0. 1023.96875 DISPLAY_IDENTIFIER TQ_ADD_ACC ECU_ADDRESS 0x7fa2ac BYTE_ORDER MSB_LAST FORMAT "%7.2" /end MEASUREMENT
/begin MEASUREMENT tq_loss_acc "Engine torque losses air conditioning compressor" SWORD _CNV_A_R_LINEAR_____52_CM 1 0. -1024. 0. DISPLAY_IDENTIFIER TQ_LOSS_ACC ECU_ADDRESS 0x7fa2ae BYTE_ORDER MSB_LAST FORMAT "%8.2" /end MEASUREMENT
/begin CHARACTERISTIC c_tq_loss_acc_sub "Substitute value in case of error CAN_ACP or CAN_TQ_LOSS_ACC_INP" VALUE 0x85005c _REC_VAL_20_s2 40.96 _CNV_A_R_LINEAR_____52_CM -1024. 0. DISPLAY_IDENTIFIER C_TQ_LOSS_ACC_SUB FORMAT "%8.2" /end CHARACTERISTIC
/begin CHARACTERISTIC ip_fac_tq_loss_acc_on "TQ_LOSS_ACC weighting factor at ACC activation" CURVE 0x84844c _REC_CUR_20_u1_u2 1.9921875 _CNV_A_R_LINEAR_____246_CM 0. 1.9921875 DISPLAY_IDENTIFIER IP_FAC_TQ_LOSS_ACC_ON FORMAT "%5.3"
 /begin AXIS_DESCR COM_AXIS t_acc _CNV_A_R_LINEAR_____226_CM 8 0. 655.35 FORMAT "%6.2" AXIS_PTS_REF ldp_t_acc__fac_tq_loss_acc_on /end AXIS_DESCR
/end CHARACTERISTIC
/begin CHARACTERISTIC ip_fac_tq_loss_acc_off "TQ_LOSS_ACC weighting factor at ACC deactivation" CURVE 0x848444 _REC_CUR_20_u1_u2 1.9921875 _CNV_A_R_LINEAR_____246_CM 0. 1.9921875 DISPLAY_IDENTIFIER IP_FAC_TQ_LOSS_ACC_OFF FORMAT "%5.3"
 /begin AXIS_DESCR COM_AXIS t_acc _CNV_A_R_LINEAR_____226_CM 8 0. 655.35 FORMAT "%6.2" AXIS_PTS_REF ldp_t_acc__fac_tq_loss_acc_off /end AXIS_DESCR
/end CHARACTERISTIC
/begin AXIS_PTS ldp_n__tq_loss_acc "" 0x8440a8 n_32 _REC_AXS_20_u1 8160. _CNV_A_R_LINEAR_____81_CM 6 0. 8160. FORMAT "%4.0" /end AXIS_PTS
/begin AXIS_PTS ldp_acp__tq_loss_acc "" 0x843f5c acp _REC_AXS_20_u1 127.5 _CNV_A_R_LINEAR_____256_CM 6 0. 127.5 FORMAT "%5.1" /end AXIS_PTS
/begin AXIS_PTS ldp_t_acc__fac_tq_loss_acc_on "" 0x844156 t_acc _REC_AXS_20_u2 655.35 _CNV_A_R_LINEAR_____226_CM 8 0. 655.35 FORMAT "%6.2" /end AXIS_PTS
/begin AXIS_PTS ldp_t_acc__fac_tq_loss_acc_off "" 0x844144 t_acc _REC_AXS_20_u2 655.35 _CNV_A_R_LINEAR_____226_CM 8 0. 655.35 FORMAT "%6.2" /end AXIS_PTS
/begin CHARACTERISTIC ip_tq_loss_acc "ACC torque loss due to engine-speed and ACC fluid-pressure" MAP 0x84f7fa _REC_MAP_20_u2_u1_u1 2047.97875 _CNV_A_R_LINEAR_____80_CM -1024. 1023.97875 DISPLAY_IDENTIFIER IP_TQ_LOSS_ACC FORMAT "%8.2"
 /begin AXIS_DESCR COM_AXIS n_32 _CNV_A_R_LINEAR_____81_CM 6 0. 8160. FORMAT "%4.0" AXIS_PTS_REF ldp_n__tq_loss_acc /end AXIS_DESCR
 /begin AXIS_DESCR COM_AXIS acp _CNV_A_R_LINEAR_____256_CM 6 0. 127.5 FORMAT "%5.1" AXIS_PTS_REF ldp_acp__tq_loss_acc /end AXIS_DESCR
/end CHARACTERISTIC
/begin MEASUREMENT lv_can_mon "v o" UBYTE _CNV_S_2_RANGE__0___85_CM 1 0. 0. 1. DISPLAY_IDENTIFIER LV_CAN_MON ECU_ADDRESS 0x7fbc2c /end MEASUREMENT
/begin MEASUREMENT lv_can_inh_mon "v o" UBYTE _CNV_S_2_RANGE__0___85_CM 1 0. 0. 1. DISPLAY_IDENTIFIER LV_CAN_INH_MON ECU_ADDRESS 0x7fbc2d /end MEASUREMENT
/begin MEASUREMENT lv_can_tcs_mon "v" UBYTE _CNV_S_2_RANGE__0___85_CM 1 0. 0. 1. DISPLAY_IDENTIFIER LV_CAN_TCS_MON ECU_ADDRESS 0x7fc03e /end MEASUREMENT
/begin MEASUREMENT lv_can_tcs_inh_mon "v" UBYTE _CNV_S_2_RANGE__0___85_CM 1 0. 0. 1. DISPLAY_IDENTIFIER LV_CAN_TCS_INH_MON ECU_ADDRESS 0x7fc03f /end MEASUREMENT
/begin MEASUREMENT t_can_tcs_inh_mon "v" UBYTE _CNV_A_R_LINEAR_____360_CM 1 0. 0. 10.2 DISPLAY_IDENTIFIER T_CAN_TCS_INH_MON ECU_ADDRESS 0x7fc035 FORMAT "%4.2" /end MEASUREMENT
/begin MEASUREMENT lv_can_tcs_tout_det_mon "v" UBYTE _CNV_S_2_RANGE__0___85_CM 1 0. 0. 1. DISPLAY_IDENTIFIER LV_CAN_TCS_TOUT_DET_MON ECU_ADDRESS 0x7fc03d /end MEASUREMENT
/begin MEASUREMENT abc_can_tcs_mon "v" UBYTE _CNV_A_R_LINEAR_____1_CM 1 0. 0. 255. DISPLAY_IDENTIFIER ABC_CAN_TCS_MON ECU_ADDRESS 0x7fc037 FORMAT "%3.0" /end MEASUREMENT
/begin CHARACTERISTIC c_abc_inc_can_tcs_mon "" VALUE 0x85c83b _REC_VAL_20_u1 255. _CNV_A_R_LINEAR_____1_CM 0. 255. DISPLAY_IDENTIFIER C_ABC_INC_CAN_TCS_MON FORMAT "%3.0" /end CHARACTERISTIC
/begin CHARACTERISTIC c_abc_max_can_tcs_mon "" VALUE 0x85c850 _REC_VAL_20_u1 254. _CNV_A_R_LINEAR_____1_CM 1. 255. DISPLAY_IDENTIFIER C_ABC_MAX_CAN_TCS_MON FORMAT "%3.0" /end CHARACTERISTIC
/begin CHARACTERISTIC c_vb_min_can_mon "" VALUE 0x85ce13 _REC_VAL_20_u1 28.8 _CNV_A_R_LINEAR_____43_CM 0. 28.8 DISPLAY_IDENTIFIER C_VB_MIN_CAN_MON FORMAT "%3.1" /end CHARACTERISTIC
/begin CHARACTERISTIC c_t_max_tcs1_miss_mon "" VALUE 0x85cc60 _REC_VAL_20_u1 10.2 _CNV_A_R_LINEAR_____360_CM 0. 10.2 DISPLAY_IDENTIFIER C_T_MAX_TCS1_MISS_MON FORMAT "%4.2" /end CHARACTERISTIC
/begin CHARACTERISTIC c_t_can_tcs_inh_mon "" VALUE 0x85cc12 _REC_VAL_20_u1 10.2 _CNV_A_R_LINEAR_____360_CM 0. 10.2 DISPLAY_IDENTIFIER C_T_CAN_TCS_INH_MON FORMAT "%4.2" /end CHARACTERISTIC
/begin MEASUREMENT n_32_mon2 "v" UBYTE _CNV_A_R_LINEAR_____55_CM 1 0. 0. 8160. DISPLAY_IDENTIFIER N_32_MON2 ECU_ADDRESS 0x7fc042 FORMAT "%4.0" /end MEASUREMENT
/begin CHARACTERISTIC id_abc_fcut_mon2 "SAFETY: Table of starting values for anti bounce counter of fuel cut off condition" CURVE 0x850236 _REC_CUR_20_u1_u1 255. _CNV_A_R_LINEAR_____1_CM 0. 255. DISPLAY_IDENTIFIER ID_ABC_FCUT_MON2 FORMAT "%3.0"
 /begin AXIS_DESCR COM_AXIS test_rec_idx_mon2 _CNV_A_R_LINEAR_____0_CM 12 0. 15. FORMAT "%2.0" AXIS_PTS_REF ldpm_test_rec_idx_mon2 /end AXIS_DESCR
/end CHARACTERISTIC
/begin CHARACTERISTIC id_abc_n_32_mon2 "SAFETY: Table of starting values for anti bounce counter N_32_MON2 ratio error" CURVE 0x850242 _REC_CUR_20_u1_u1 255. _CNV_A_R_LINEAR_____1_CM 0. 255. DISPLAY_IDENTIFIER ID_ABC_N_32_MON2 FORMAT "%3.0"
 /begin AXIS_DESCR COM_AXIS test_rec_idx_mon2 _CNV_A_R_LINEAR_____0_CM 12 0. 15. FORMAT "%2.0" AXIS_PTS_REF ldpm_test_rec_idx_mon2 /end AXIS_DESCR
/end CHARACTERISTIC
/begin CHARACTERISTIC id_abc_pvs_ratio_mon2 "SAFETY: Table of starting values for anti bounce counter PVS ratio error" CURVE 0x85024e _REC_CUR_20_u1_u1 255. _CNV_A_R_LINEAR_____1_CM 0. 255. DISPLAY_IDENTIFIER ID_ABC_PVS_RATIO_MON2 FORMAT "%3.0"
 /begin AXIS_DESCR COM_AXIS test_rec_idx_mon2 _CNV_A_R_LINEAR_____0_CM 12 0. 15. FORMAT "%2.0" AXIS_PTS_REF ldpm_test_rec_idx_mon2 /end AXIS_DESCR
/end CHARACTERISTIC
/begin CHARACTERISTIC id_abc_tqi_n_max_mon2 "SAFETY: Table of starting values for anti bounce counter for fault in engine speed limitation" CURVE 0x85025a _REC_CUR_20_u1_u1 255. _CNV_A_R_LINEAR_____1_CM 0. 255. DISPLAY_IDENTIFIER ID_ABC_TQI_N_MAX_MON2 FORMAT "%3.0"
 /begin AXIS_DESCR COM_AXIS test_rec_idx_mon2 _CNV_A_R_LINEAR_____0_CM 12 0. 15. FORMAT "%2.0" AXIS_PTS_REF ldpm_test_rec_idx_mon2 /end AXIS_DESCR
/end CHARACTERISTIC
/begin CHARACTERISTIC id_n_32_mon2 "SAFETY: Table of starting values for engine speed" CURVE 0x850736 _REC_CUR_20_u1_u1 8160. _CNV_A_R_LINEAR_____55_CM 0. 8160. DISPLAY_IDENTIFIER ID_N_32_MON2 FORMAT "%4.0"
 /begin AXIS_DESCR COM_AXIS test_rec_idx_mon2 _CNV_A_R_LINEAR_____0_CM 12 0. 15. FORMAT "%2.0" AXIS_PTS_REF ldpm_test_rec_idx_mon2 /end AXIS_DESCR
/end CHARACTERISTIC
/begin CHARACTERISTIC id_v_pvs_1_bas_mon2 "SAFETY2: pedal sensor channel 1 raw acquisition" CURVE 0x85088c _REC_CUR_20_u2_u1 5. _CNV_A_R_LINEAR_____361_CM 0. 5. DISPLAY_IDENTIFIER ID_V_PVS_1_BAS_MON2 FORMAT "%4.2"
 /begin AXIS_DESCR COM_AXIS test_rec_idx_mon2 _CNV_A_R_LINEAR_____0_CM 12 0. 15. FORMAT "%2.0" AXIS_PTS_REF ldpm_test_rec_idx_mon2 /end AXIS_DESCR
/end CHARACTERISTIC
/begin CHARACTERISTIC id_v_pvs_2_bas_mon2 "SAFETY2: pedal sensor channel 2 raw acquisition" CURVE 0x8508a4 _REC_CUR_20_u2_u1 5. _CNV_A_R_LINEAR_____361_CM 0. 5. DISPLAY_IDENTIFIER ID_V_PVS_2_BAS_MON2 FORMAT "%4.2"
 /begin AXIS_DESCR COM_AXIS test_rec_idx_mon2 _CNV_A_R_LINEAR_____0_CM 12 0. 15. FORMAT "%2.0" AXIS_PTS_REF ldpm_test_rec_idx_mon2 /end AXIS_DESCR
/end CHARACTERISTIC
/begin CHARACTERISTIC id_t_seg_sw_mon2 "SAFETY2: segment timing information" CURVE 0x85085c _REC_CUR_20_u4_u1 268435455. _CNV_A_R_LINEAR_____362_CM 0. 268435455. DISPLAY_IDENTIFIER ID_T_SEG_SW_MON2 FORMAT "%9.0"
 /begin AXIS_DESCR COM_AXIS test_rec_idx_mon2 _CNV_A_R_LINEAR_____0_CM 12 0. 15. FORMAT "%2.0" AXIS_PTS_REF ldpm_test_rec_idx_mon2 /end AXIS_DESCR
/end CHARACTERISTIC
/begin CHARACTERISTIC id_sf_1_mon2 "SAFETY2: logical starting values 1" CURVE 0x850770 _REC_CUR_20_u2_u1 65535. _CNV_A_R_LINEAR_____0_CM 0. 65535. DISPLAY_IDENTIFIER ID_SF_1_MON2 FORMAT "%5.0"
 /begin AXIS_DESCR COM_AXIS test_rec_idx_mon2 _CNV_A_R_LINEAR_____0_CM 12 0. 15. FORMAT "%2.0" AXIS_PTS_REF ldpm_test_rec_idx_mon2 /end AXIS_DESCR
/end CHARACTERISTIC
/begin CHARACTERISTIC id_sf_2_mon2 "SAFETY2: logical starting values 2" CURVE 0x850788 _REC_CUR_20_u2_u1 65535. _CNV_A_R_LINEAR_____0_CM 0. 65535. DISPLAY_IDENTIFIER ID_SF_2_MON2 FORMAT "%5.0"
 /begin AXIS_DESCR COM_AXIS test_rec_idx_mon2 _CNV_A_R_LINEAR_____0_CM 12 0. 15. FORMAT "%2.0" AXIS_PTS_REF ldpm_test_rec_idx_mon2 /end AXIS_DESCR
/end CHARACTERISTIC
/begin CHARACTERISTIC id_state_iv_mon2 "SAFETY2: state of injection valves at previous cycle" CURVE 0x8507a0 _REC_CUR_20_u1_u1 255. _CNV_A_R_LINEAR_____1_CM 0. 255. DISPLAY_IDENTIFIER ID_STATE_IV_MON2 FORMAT "%3.0"
 /begin AXIS_DESCR COM_AXIS test_rec_idx_mon2 _CNV_A_R_LINEAR_____0_CM 12 0. 15. FORMAT "%2.0" AXIS_PTS_REF ldpm_test_rec_idx_mon2 /end AXIS_DESCR
/end CHARACTERISTIC
/begin CHARACTERISTIC id_t_fcut_inh_mon2 "SAFETY: Table of starting values for dead time fuel cut off condition inhibit" CURVE 0x8507ac _REC_CUR_20_u1_u1 10.2 _CNV_A_R_LINEAR_____360_CM 0. 10.2 DISPLAY_IDENTIFIER ID_T_FCUT_INH_MON2 FORMAT "%4.2"
 /begin AXIS_DESCR COM_AXIS test_rec_idx_mon2 _CNV_A_R_LINEAR_____0_CM 12 0. 15. FORMAT "%2.0" AXIS_PTS_REF ldpm_test_rec_idx_mon2 /end AXIS_DESCR
/end CHARACTERISTIC
/begin CHARACTERISTIC id_t_i_diag_prev1_mon2 "SAFETY2: time betw. charging and end discharging of inj." CURVE 0x850818 _REC_CUR_20_u2_u1 26.2136 _CNV_A_R_LINEAR_____363_CM 0. 26.2136 DISPLAY_IDENTIFIER ID_T_I_DIAG_PREV1_MON2 FORMAT "%6.4"
 /begin AXIS_DESCR COM_AXIS test_rec_idx_mon2 _CNV_A_R_LINEAR_____0_CM 12 0. 15. FORMAT "%2.0" AXIS_PTS_REF ldpm_test_rec_idx_mon2 /end AXIS_DESCR
/end CHARACTERISTIC
/begin CHARACTERISTIC id_t_i_diag_prev2_mon2 "SAFETY2: time betw. charging and end discharging of preinj_2" CURVE 0x850830 _REC_CUR_20_u2_u1 26.2136 _CNV_A_R_LINEAR_____363_CM 0. 26.2136 DISPLAY_IDENTIFIER ID_T_I_DIAG_PREV2_MON2 FORMAT "%6.4"
 /begin AXIS_DESCR COM_AXIS test_rec_idx_mon2 _CNV_A_R_LINEAR_____0_CM 12 0. 15. FORMAT "%2.0" AXIS_PTS_REF ldpm_test_rec_idx_mon2 /end AXIS_DESCR
/end CHARACTERISTIC
/begin CHARACTERISTIC id_t_i_diag_main1_mon2 "SAFETY2: time betw charging and end discharging of maininj" CURVE 0x8507b8 _REC_CUR_20_u2_u1 26.2136 _CNV_A_R_LINEAR_____363_CM 0. 26.2136 DISPLAY_IDENTIFIER ID_T_I_DIAG_MAIN1_MON2 FORMAT "%6.4"
 /begin AXIS_DESCR COM_AXIS test_rec_idx_mon2 _CNV_A_R_LINEAR_____0_CM 12 0. 15. FORMAT "%2.0" AXIS_PTS_REF ldpm_test_rec_idx_mon2 /end AXIS_DESCR
/end CHARACTERISTIC
/begin CHARACTERISTIC id_t_i_diag_main2_mon2 "SAFETY2: time betw charging and end discharging of maininj_2" CURVE 0x8507d0 _REC_CUR_20_u2_u1 26.2136 _CNV_A_R_LINEAR_____363_CM 0. 26.2136 DISPLAY_IDENTIFIER ID_T_I_DIAG_MAIN2_MON2 FORMAT "%6.4"
 /begin AXIS_DESCR COM_AXIS test_rec_idx_mon2 _CNV_A_R_LINEAR_____0_CM 12 0. 15. FORMAT "%2.0" AXIS_PTS_REF ldpm_test_rec_idx_mon2 /end AXIS_DESCR
/end CHARACTERISTIC
/begin CHARACTERISTIC id_t_i_diag_post1_mon2 "SAFETY2: time betw charging and end discharging of postinj" CURVE 0x8507e8 _REC_CUR_20_u2_u1 26.2136 _CNV_A_R_LINEAR_____363_CM 0. 26.2136 DISPLAY_IDENTIFIER ID_T_I_DIAG_POST1_MON2 FORMAT "%6.4"
 /begin AXIS_DESCR COM_AXIS test_rec_idx_mon2 _CNV_A_R_LINEAR_____0_CM 12 0. 15. FORMAT "%2.0" AXIS_PTS_REF ldpm_test_rec_idx_mon2 /end AXIS_DESCR
/end CHARACTERISTIC
/begin CHARACTERISTIC id_t_i_diag_post2_mon2 "SAFETY2: time betw charging and end discharging of postinj_2" CURVE 0x850800 _REC_CUR_20_u2_u1 26.2136 _CNV_A_R_LINEAR_____363_CM 0. 26.2136 DISPLAY_IDENTIFIER ID_T_I_DIAG_POST2_MON2 FORMAT "%6.4"
 /begin AXIS_DESCR COM_AXIS test_rec_idx_mon2 _CNV_A_R_LINEAR_____0_CM 12 0. 15. FORMAT "%2.0" AXIS_PTS_REF ldpm_test_rec_idx_mon2 /end AXIS_DESCR
/end CHARACTERISTIC
/begin MEASUREMENT lv_pps_fcut_mon2 "v" UBYTE _CNV_S_2_RANGE__0___85_CM 1 0. 0. 1. DISPLAY_IDENTIFIER LV_PPS_FCUT_MON2 ECU_ADDRESS 0x7fc05c /end MEASUREMENT
/begin CHARACTERISTIC c_t_i_diag_main1_max_mon2 "" VALUE 0x85cc4c _REC_VAL_20_u2 26.2136 _CNV_A_R_LINEAR_____363_CM 0. 26.2136 DISPLAY_IDENTIFIER C_T_I_DIAG_MAIN1_MAX_MON2 FORMAT "%6.4" /end CHARACTERISTIC
/begin MEASUREMENT abc_n_32_mon2 "v" UBYTE _CNV_A_R_LINEAR_____1_CM 1 0. 0. 255. DISPLAY_IDENTIFIER ABC_N_32_MON2 ECU_ADDRESS 0x7fc044 FORMAT "%3.0" /end MEASUREMENT
/begin MEASUREMENT lv_err_n_32_mon2 "Logical variable for ratio error between N_32_MON2 and N_32_SUB_MON2" UBYTE _CNV_S_2_RANGE______11_CM 1 0. 0. 1. DISPLAY_IDENTIFIER LV_ERR_N_32_MON2 ECU_ADDRESS 0x7fc05d /end MEASUREMENT
/begin MEASUREMENT n_32_dif_rel_mon2 "Relative engine speed deviation monitoring level" UWORD _CNV_A_R_LINEAR_____364_CM 1 0. 0. 255. DISPLAY_IDENTIFIER N_32_DIF_REL_MON2 ECU_ADDRESS 0x7fb558 BYTE_ORDER MSB_LAST /end MEASUREMENT
/begin MEASUREMENT n_32_mon_mon2 "v" UBYTE _CNV_A_R_LINEAR_____55_CM 1 0. 0. 8160. DISPLAY_IDENTIFIER N_32_MON_MON2 ECU_ADDRESS 0x7fc045 FORMAT "%4.0" /end MEASUREMENT
/begin MEASUREMENT n_32_sub_mon2 "v" UBYTE _CNV_A_R_LINEAR_____55_CM 1 0. 0. 8160. DISPLAY_IDENTIFIER N_32_SUB_MON2 ECU_ADDRESS 0x7fc046 FORMAT "%4.0" /end MEASUREMENT
/begin CHARACTERISTIC c_abc_inc_n_32_mon2 "" VALUE 0x85c842 _REC_VAL_20_u1 255. _CNV_A_R_LINEAR_____1_CM 0. 255. DISPLAY_IDENTIFIER C_ABC_INC_N_32_MON2 FORMAT "%3.0" /end CHARACTERISTIC
/begin CHARACTERISTIC c_abc_max_n_32_mon2 "" VALUE 0x85c857 _REC_VAL_20_u1 254. _CNV_A_R_LINEAR_____1_CM 1. 255. DISPLAY_IDENTIFIER C_ABC_MAX_N_32_MON2 FORMAT "%3.0" /end CHARACTERISTIC
/begin CHARACTERISTIC c_n_32_dif_rel_max_mon2 "" VALUE 0x85caf4 _REC_VAL_20_u2 255. _CNV_A_R_LINEAR_____365_CM 0. 255. DISPLAY_IDENTIFIER C_N_32_DIF_REL_MAX_MON2 /end CHARACTERISTIC
/begin CHARACTERISTIC c_n_32_lim_mon2 "" VALUE 0x85caf7 _REC_VAL_20_u1 8160. _CNV_A_R_LINEAR_____55_CM 0. 8160. DISPLAY_IDENTIFIER C_N_32_LIM_MON2 FORMAT "%4.0" /end CHARACTERISTIC
/begin CHARACTERISTIC c_n_32_min_mon2 "" VALUE 0x85cafe _REC_VAL_20_u1 8160. _CNV_A_R_LINEAR_____55_CM 0. 8160. DISPLAY_IDENTIFIER C_N_32_MIN_MON2 FORMAT "%4.0" /end CHARACTERISTIC
/begin MEASUREMENT abc_pvs_ratio_mon2 "v" UBYTE _CNV_A_R_LINEAR_____1_CM 1 0. 0. 255. DISPLAY_IDENTIFIER ABC_PVS_RATIO_MON2 ECU_ADDRESS 0x7fc047 FORMAT "%3.0" /end MEASUREMENT
/begin MEASUREMENT pv_av_1_mon2 "v" UBYTE _CNV_A_R_LINEAR_____79_CM 1 0. 0. 99.609375 DISPLAY_IDENTIFIER PV_AV_1_MON2 ECU_ADDRESS 0x7fc048 FORMAT "%3.1" /end MEASUREMENT
/begin MEASUREMENT pv_av_2_mon2 "v" UBYTE _CNV_A_R_LINEAR_____79_CM 1 0. 0. 99.609375 DISPLAY_IDENTIFIER PV_AV_2_MON2 ECU_ADDRESS 0x7fc049 FORMAT "%3.1" /end MEASUREMENT
/begin MEASUREMENT lv_err_pvs_mon2 "v" UBYTE _CNV_S_2_RANGE__0___85_CM 1 0. 0. 1. DISPLAY_IDENTIFIER LV_ERR_PVS_MON2 ECU_ADDRESS 0x7fc05f /end MEASUREMENT
/begin MEASUREMENT pv_av_mon2 "v" UBYTE _CNV_A_R_LINEAR_____79_CM 1 0. 0. 99.609375 DISPLAY_IDENTIFIER PV_AV_MON2 ECU_ADDRESS 0x7fc04a FORMAT "%3.1" /end MEASUREMENT
/begin CHARACTERISTIC c_abc_inc_pvs_ratio_mon2 "" VALUE 0x85c848 _REC_VAL_20_u1 255. _CNV_A_R_LINEAR_____1_CM 0. 255. DISPLAY_IDENTIFIER C_ABC_INC_PVS_RATIO_MON2 FORMAT "%3.0" /end CHARACTERISTIC
/begin CHARACTERISTIC c_abc_max_pvs_ratio_mon2 "" VALUE 0x85c85d _REC_VAL_20_u1 254. _CNV_A_R_LINEAR_____1_CM 1. 255. DISPLAY_IDENTIFIER C_ABC_MAX_PVS_RATIO_MON2 FORMAT "%3.0" /end CHARACTERISTIC
/begin CHARACTERISTIC c_v_pvs_is_thd_1_mon2 "" VALUE 0x85cda2 _REC_VAL_20_u2 4.9951171875 _CNV_A_R_LINEAR_____28_CM 0. 4.9951171875 DISPLAY_IDENTIFIER C_V_PVS_IS_THD_1_MON2 FORMAT "%4.3" /end CHARACTERISTIC
/begin CHARACTERISTIC c_v_pvs_is_thd_2_mon2 "" VALUE 0x85cda6 _REC_VAL_20_u2 4.9951171875 _CNV_A_R_LINEAR_____28_CM 0. 4.9951171875 DISPLAY_IDENTIFIER C_V_PVS_IS_THD_2_MON2 FORMAT "%4.3" /end CHARACTERISTIC
/begin CHARACTERISTIC c_v_pvs_slop_1_mon2 "" VALUE 0x85cdbd _REC_VAL_20_u1 79.6875 _CNV_A_R_LINEAR_____366_CM 0. 79.6875 DISPLAY_IDENTIFIER C_V_PVS_SLOP_1_MON2 FORMAT "%3.1" /end CHARACTERISTIC
/begin CHARACTERISTIC c_v_pvs_slop_2_mon2 "" VALUE 0x85cdbf _REC_VAL_20_u1 159.375 _CNV_A_R_LINEAR_____367_CM 0. 159.375 DISPLAY_IDENTIFIER C_V_PVS_SLOP_2_MON2 FORMAT "%4.1" /end CHARACTERISTIC
/begin CHARACTERISTIC c_v_pv_lih_max_mon2 "" VALUE 0x85cd9c _REC_VAL_20_u1 159.375 _CNV_A_R_LINEAR_____367_CM 0. 159.375 DISPLAY_IDENTIFIER C_V_PV_LIH_MAX_MON2 FORMAT "%4.1" /end CHARACTERISTIC
/begin CHARACTERISTIC ip_pv_ratio_hys_mon2 "SAFETY2: Maximum PV ratio error allowed" CURVE 0x8581ea _REC_CUR_20_u1_u1 99.609375 _CNV_A_R_LINEAR_____79_CM 0. 99.609375 DISPLAY_IDENTIFIER IP_PV_RATIO_HYS_MON2 FORMAT "%3.1"
 /begin AXIS_DESCR COM_AXIS pv_av_1_mon2 _CNV_A_R_LINEAR_____79_CM 6 0. 99.609375 FORMAT "%3.1" AXIS_PTS_REF ldp_pv_av_min_mon_ip_pv_mon2 /end AXIS_DESCR
/end CHARACTERISTIC
/begin AXIS_PTS ldp_pv_av_min_mon_ip_pv_mon2 "" 0x8420e5 pv_av_1_mon2 _REC_AXS_20_u1 99.609375 _CNV_A_R_LINEAR_____79_CM 6 0. 99.609375 FORMAT "%3.1" /end AXIS_PTS
/begin MEASUREMENT t_fcut_inh_mon2 "v" UBYTE _CNV_A_R_LINEAR_____360_CM 1 0. 0. 10.2 DISPLAY_IDENTIFIER T_FCUT_INH_MON2 ECU_ADDRESS 0x7fc04b FORMAT "%4.2" /end MEASUREMENT
/begin MEASUREMENT lv_err_fcut_mon2 "v" UBYTE _CNV_S_2_RANGE__0___85_CM 1 0. 0. 1. DISPLAY_IDENTIFIER LV_ERR_FCUT_MON2 ECU_ADDRESS 0x7fc060 /end MEASUREMENT
/begin MEASUREMENT abc_fcut_mon2 "v" UBYTE _CNV_A_R_LINEAR_____1_CM 1 0. 0. 255. DISPLAY_IDENTIFIER ABC_FCUT_MON2 ECU_ADDRESS 0x7fc04c FORMAT "%3.0" /end MEASUREMENT
/begin CHARACTERISTIC c_abc_inc_fcut_mon2 "" VALUE 0x85c83f _REC_VAL_20_u1 255. _CNV_A_R_LINEAR_____1_CM 0. 255. DISPLAY_IDENTIFIER C_ABC_INC_FCUT_MON2 FORMAT "%3.0" /end CHARACTERISTIC
/begin CHARACTERISTIC c_abc_max_fcut_mon2 "" VALUE 0x85c854 _REC_VAL_20_u1 254. _CNV_A_R_LINEAR_____1_CM 1. 255. DISPLAY_IDENTIFIER C_ABC_MAX_FCUT_MON2 FORMAT "%3.0" /end CHARACTERISTIC
/begin CHARACTERISTIC c_t_fcut_inh_mon2 "" VALUE 0x85cc40 _REC_VAL_20_u1 10.2 _CNV_A_R_LINEAR_____360_CM 0. 10.2 DISPLAY_IDENTIFIER C_T_FCUT_INH_MON2 FORMAT "%4.2" /end CHARACTERISTIC
/begin MEASUREMENT lv_err_tqi_n_max_mon2 "v" UBYTE _CNV_S_2_RANGE__0___85_CM 1 0. 0. 1. DISPLAY_IDENTIFIER LV_ERR_TQI_N_MAX_MON2 ECU_ADDRESS 0x7fc061 /end MEASUREMENT
/begin MEASUREMENT abc_tqi_n_max_mon2 "v" UBYTE _CNV_A_R_LINEAR_____1_CM 1 0. 0. 255. DISPLAY_IDENTIFIER ABC_TQI_N_MAX_MON2 ECU_ADDRESS 0x7fc04d FORMAT "%3.0" /end MEASUREMENT
/begin CHARACTERISTIC c_n_max_mtc_lih_thd_mon2 "" VALUE 0x85cb2b _REC_VAL_20_u1 8160. _CNV_A_R_LINEAR_____55_CM 0. 8160. DISPLAY_IDENTIFIER C_N_MAX_MTC_LIH_THD_MON2 FORMAT "%4.0" /end CHARACTERISTIC
/begin CHARACTERISTIC c_abc_inc_tqi_n_max_mon2 "" VALUE 0x85c84a _REC_VAL_20_u1 255. _CNV_A_R_LINEAR_____1_CM 0. 255. DISPLAY_IDENTIFIER C_ABC_INC_TQI_N_MAX_MON2 FORMAT "%3.0" /end CHARACTERISTIC
/begin CHARACTERISTIC c_abc_max_tqi_n_max_mon2 "" VALUE 0x85c85f _REC_VAL_20_u1 254. _CNV_A_R_LINEAR_____1_CM 1. 255. DISPLAY_IDENTIFIER C_ABC_MAX_TQI_N_MAX_MON2 FORMAT "%3.0" /end CHARACTERISTIC
/begin MEASUREMENT lv_n_lim_req_mon2 "v" UBYTE _CNV_S_2_RANGE__0___85_CM 1 0. 0. 1. DISPLAY_IDENTIFIER LV_N_LIM_REQ_MON2 ECU_ADDRESS 0x7fc062 /end MEASUREMENT
/begin MEASUREMENT lv_off_iv_mon2 "v" UBYTE _CNV_S_2_RANGE__0___85_CM 1 0. 0. 1. DISPLAY_IDENTIFIER LV_OFF_IV_MON2 ECU_ADDRESS 0x7fc063 /end MEASUREMENT
/begin MEASUREMENT lv_dr_off_mu_mon2 "Request for wrong answers by the instruction set test to the monitoring unit in order to disable power stages" UBYTE _CNV_S_2_RANGE______11_CM 1 0. 0. 1. DISPLAY_IDENTIFIER LV_DR_OFF_MU_MON2 ECU_ADDRESS 0x7fc064 /end MEASUREMENT
/begin MEASUREMENT lv_off_mtc_mon2 "v" UBYTE _CNV_S_2_RANGE__0___85_CM 1 0. 0. 1. DISPLAY_IDENTIFIER LV_OFF_MTC_MON2 ECU_ADDRESS 0x7fc065 /end MEASUREMENT
/begin AXIS_PTS ldpm_test_rec_idx_mon2 "" 0x8437f4 test_rec_idx_mon2 _REC_AXS_20_u1 15. _CNV_A_R_LINEAR_____0_CM 12 0. 15. FORMAT "%2.0" /end AXIS_PTS
/begin MEASUREMENT resp_mon2 "v o" UWORD _CNV_A_R_LINEAR_____1_CM 1 0. 0. 65535. DISPLAY_IDENTIFIER RESP_MON2 ECU_ADDRESS 0x7fa340 BYTE_ORDER MSB_LAST FORMAT "%5.0" /end MEASUREMENT
/begin CHARACTERISTIC id_resp_mon2 "SAFETY2: answer decoder of copy of process mon" CURVE 0x850758 _REC_CUR_20_u2_u1 65535. _CNV_A_R_LINEAR_____1_CM 0. 65535. DISPLAY_IDENTIFIER ID_RESP_MON2 FORMAT "%5.0"
 /begin AXIS_DESCR COM_AXIS test_rec_idx_mon2 _CNV_A_R_LINEAR_____0_CM 12 0. 15. FORMAT "%2.0" AXIS_PTS_REF ldpm_test_rec_idx_mon2 /end AXIS_DESCR
/end CHARACTERISTIC
/begin MEASUREMENT lv_brake_mon2 "v" UBYTE _CNV_S_2_RANGE__0___85_CM 1 0. 0. 1. DISPLAY_IDENTIFIER LV_BRAKE_MON2 ECU_ADDRESS 0x7fc04e /end MEASUREMENT
/begin MEASUREMENT lv_err_conv_mon2 "-v" UBYTE _CNV_S_2_RANGE______23_CM 1 0. 0. 1. DISPLAY_IDENTIFIER LV_ERR_CONV_MON2 ECU_ADDRESS 0x7fc04f /end MEASUREMENT
/begin MEASUREMENT lv_err_mc_mon2 "-v" UBYTE _CNV_S_2_RANGE__0___85_CM 1 0. 0. 1. DISPLAY_IDENTIFIER LV_ERR_MC_MON2 ECU_ADDRESS 0x7fc050 BIT_MASK 0x1 /end MEASUREMENT
/begin MEASUREMENT lv_err_pvs_ratio_mon_mon2 "v" UBYTE _CNV_S_2_RANGE__0___85_CM 1 0. 0. 1. DISPLAY_IDENTIFIER LV_ERR_PVS_RATIO_MON_MON2 ECU_ADDRESS 0x7fc05e /end MEASUREMENT
/begin MEASUREMENT lv_err_pvs_ratio_mon2 "v" UBYTE _CNV_S_2_RANGE__0___85_CM 1 0. 0. 1. DISPLAY_IDENTIFIER LV_ERR_PVS_RATIO_MON2 ECU_ADDRESS 0x7fc051 /end MEASUREMENT
/begin MEASUREMENT lv_err_pvs_1_mon2 "v" UBYTE _CNV_S_2_RANGE______11_CM 1 0. 0. 1. DISPLAY_IDENTIFIER LV_ERR_PVS_1_MON2 ECU_ADDRESS 0x7fc052 /end MEASUREMENT
/begin MEASUREMENT lv_err_pvs_2_mon2 "v" UBYTE _CNV_S_2_RANGE______11_CM 1 0. 0. 1. DISPLAY_IDENTIFIER LV_ERR_PVS_2_MON2 ECU_ADDRESS 0x7fc053 /end MEASUREMENT
/begin MEASUREMENT lv_err_tmp_mc_mon2 "v" UBYTE _CNV_S_2_RANGE__0___85_CM 1 0. 0. 1. DISPLAY_IDENTIFIER LV_ERR_TMP_MC_MON2 ECU_ADDRESS 0x7fc054 BIT_MASK 0x1 /end MEASUREMENT
/begin MEASUREMENT lv_err_vcc_pvs_1_mon2 "temporary request for disabled power stages by processor monitoring on MC" UBYTE _CNV_S_2_RANGE__0___85_CM 1 0. 0. 1. DISPLAY_IDENTIFIER LV_ERR_VCC_PVS_1_MON2 ECU_ADDRESS 0x7fc056 BIT_MASK 0x1 /end MEASUREMENT
/begin MEASUREMENT lv_err_vcc_pvs_2_mon2 "v" UBYTE _CNV_S_2_RANGE__0___85_CM 1 0. 0. 1. DISPLAY_IDENTIFIER LV_ERR_VCC_PVS_2_MON2 ECU_ADDRESS 0x7fc057 BIT_MASK 0x1 /end MEASUREMENT
/begin MEASUREMENT lv_can_mon2 "Var for activation for TCS and ETCU" UBYTE _CNV_S_2_RANGE__0___85_CM 1 0. 0. 1. DISPLAY_IDENTIFIER LV_CAN_MON2 ECU_ADDRESS 0x7fc058 BIT_MASK 0x1 /end MEASUREMENT
/begin MEASUREMENT lv_err_vcc_pvs_mon2 "v" UBYTE _CNV_S_2_RANGE__0___85_CM 1 0. 0. 1. DISPLAY_IDENTIFIER LV_ERR_VCC_PVS_MON2 ECU_ADDRESS 0x7fc055 BIT_MASK 0x1 /end MEASUREMENT
/begin MEASUREMENT lv_n_lim_etc_mon2 "logical var. for activation of engine speed limitation mon" UBYTE _CNV_S_2_RANGE__0___85_CM 1 0. 0. 1. DISPLAY_IDENTIFIER LV_N_LIM_ETC_MON2 ECU_ADDRESS 0x7fc05a BIT_MASK 0x1 /end MEASUREMENT
/begin MEASUREMENT lv_post_act_mon2 "logical var. for activation of post injection" UBYTE _CNV_S_2_RANGE__0___85_CM 1 0. 0. 1. DISPLAY_IDENTIFIER LV_POST_ACT_MON2 ECU_ADDRESS 0x7fc059 BIT_MASK 0x1 /end MEASUREMENT
/begin MEASUREMENT lv_tq_cru_act_mon2 "logical var. for activation of cruise control" UBYTE _CNV_S_2_RANGE__0___85_CM 1 0. 0. 1. DISPLAY_IDENTIFIER LV_TQ_CRU_ACT_MON2 ECU_ADDRESS 0x7fc05b BIT_MASK 0x1 /end MEASUREMENT
/begin MEASUREMENT v_pvs_1_bas_mon2 "pedal sensor channel 1 raw acquisition" UWORD _CNV_A_R_LINEAR_____361_CM 1 0. 0. 5. DISPLAY_IDENTIFIER V_PVS_1_BAS_MON2 ECU_ADDRESS 0x7fb524 BYTE_ORDER MSB_LAST FORMAT "%5.4" BIT_MASK 0x1 /end MEASUREMENT
/begin MEASUREMENT t_seg_sw_mon2 "segment timing information" ULONG _CNV_A_R_LINEAR_____230_CM 1 0. 0. 268435455. DISPLAY_IDENTIFIER T_SEG_SW_MON2 ECU_ADDRESS 0x7f907c BYTE_ORDER MSB_LAST FORMAT "%9.0" BIT_MASK 0x1 /end MEASUREMENT
/begin MEASUREMENT v_pvs_2_bas_mon2 "pedal sensor channel 1 raw acquisition" UWORD _CNV_A_R_LINEAR_____361_CM 1 0. 0. 5. DISPLAY_IDENTIFIER V_PVS_2_BAS_MON2 ECU_ADDRESS 0x7fb526 BYTE_ORDER MSB_LAST FORMAT "%5.4" BIT_MASK 0x1 /end MEASUREMENT
/begin MEASUREMENT t_i_diag_prev1_mon2[0] "time betw. charging and end of discharging of previnj" UWORD _CNV_A_R_LINEAR_____363_CM 1 0. 0. 26.2136 DISPLAY_IDENTIFIER T_I_DIAG_PREV1_MON2_0_ ECU_ADDRESS 0x7fb528 BYTE_ORDER MSB_LAST FORMAT "%5.4" BIT_MASK 0x1 /end MEASUREMENT
/begin MEASUREMENT t_i_diag_prev1_mon2[1] "time betw. charging and end of discharging of previnj" UWORD _CNV_A_R_LINEAR_____363_CM 1 0. 0. 26.2136 DISPLAY_IDENTIFIER T_I_DIAG_PREV1_MON2_1_ ECU_ADDRESS 0x7fb52a BYTE_ORDER MSB_LAST FORMAT "%5.4" BIT_MASK 0x1 /end MEASUREMENT
/begin MEASUREMENT t_i_diag_prev1_mon2[2] "time betw. charging and end of discharging of previnj" UWORD _CNV_A_R_LINEAR_____363_CM 1 0. 0. 26.2136 DISPLAY_IDENTIFIER T_I_DIAG_PREV1_MON2_2_ ECU_ADDRESS 0x7fb52c BYTE_ORDER MSB_LAST FORMAT "%5.4" BIT_MASK 0x1 /end MEASUREMENT
/begin MEASUREMENT t_i_diag_prev1_mon2[3] "time betw. charging and end of discharging of previnj" UWORD _CNV_A_R_LINEAR_____363_CM 1 0. 0. 26.2136 DISPLAY_IDENTIFIER T_I_DIAG_PREV1_MON2_3_ ECU_ADDRESS 0x7fb52e BYTE_ORDER MSB_LAST FORMAT "%5.4" BIT_MASK 0x1 /end MEASUREMENT
/begin MEASUREMENT t_i_diag_main1_mon2[0] "time betw. charging and end of discharging of maininj" UWORD _CNV_A_R_LINEAR_____363_CM 1 0. 0. 26.2136 DISPLAY_IDENTIFIER T_I_DIAG_MAIN1_MON2_0_ ECU_ADDRESS 0x7fb538 BYTE_ORDER MSB_LAST FORMAT "%5.4" BIT_MASK 0x1 /end MEASUREMENT
/begin MEASUREMENT t_i_diag_main1_mon2[1] "time betw. charging and end of discharging of maininj" UWORD _CNV_A_R_LINEAR_____363_CM 1 0. 0. 26.2136 DISPLAY_IDENTIFIER T_I_DIAG_MAIN1_MON2_1_ ECU_ADDRESS 0x7fb53a BYTE_ORDER MSB_LAST FORMAT "%5.4" BIT_MASK 0x1 /end MEASUREMENT
/begin MEASUREMENT t_i_diag_main1_mon2[2] "time betw. charging and end of discharging of maininj" UWORD _CNV_A_R_LINEAR_____363_CM 1 0. 0. 26.2136 DISPLAY_IDENTIFIER T_I_DIAG_MAIN1_MON2_2_ ECU_ADDRESS 0x7fb53c BYTE_ORDER MSB_LAST FORMAT "%5.4" BIT_MASK 0x1 /end MEASUREMENT
/begin MEASUREMENT t_i_diag_main1_mon2[3] "time betw. charging and end of discharging of maininj" UWORD _CNV_A_R_LINEAR_____363_CM 1 0. 0. 26.2136 DISPLAY_IDENTIFIER T_I_DIAG_MAIN1_MON2_3_ ECU_ADDRESS 0x7fb53e BYTE_ORDER MSB_LAST FORMAT "%5.4" BIT_MASK 0x1 /end MEASUREMENT
/begin MEASUREMENT t_i_diag_main2_mon2[0] "time betw. charging and end of discharging of maininj_2" UWORD _CNV_A_R_LINEAR_____363_CM 1 0. 0. 26.2136 DISPLAY_IDENTIFIER T_I_DIAG_MAIN2_MON2_0_ ECU_ADDRESS 0x7fb540 BYTE_ORDER MSB_LAST FORMAT "%5.4" BIT_MASK 0x1 /end MEASUREMENT
/begin MEASUREMENT t_i_diag_main2_mon2[1] "time betw. charging and end of discharging of maininj_2" UWORD _CNV_A_R_LINEAR_____363_CM 1 0. 0. 26.2136 DISPLAY_IDENTIFIER T_I_DIAG_MAIN2_MON2_1_ ECU_ADDRESS 0x7fb542 BYTE_ORDER MSB_LAST FORMAT "%5.4" BIT_MASK 0x1 /end MEASUREMENT
/begin MEASUREMENT t_i_diag_main2_mon2[2] "time betw. charging and end of discharging of maininj_2" UWORD _CNV_A_R_LINEAR_____363_CM 1 0. 0. 26.2136 DISPLAY_IDENTIFIER T_I_DIAG_MAIN2_MON2_2_ ECU_ADDRESS 0x7fb544 BYTE_ORDER MSB_LAST FORMAT "%5.4" BIT_MASK 0x1 /end MEASUREMENT
/begin MEASUREMENT t_i_diag_main2_mon2[3] "time betw. charging and end of discharging of maininj_2" UWORD _CNV_A_R_LINEAR_____363_CM 1 0. 0. 26.2136 DISPLAY_IDENTIFIER T_I_DIAG_MAIN2_MON2_3_ ECU_ADDRESS 0x7fb546 BYTE_ORDER MSB_LAST FORMAT "%5.4" BIT_MASK 0x1 /end MEASUREMENT
/begin MEASUREMENT t_i_diag_post1_mon2[0] "time betw. charging and end of discharging of postinj" UWORD _CNV_A_R_LINEAR_____363_CM 1 0. 0. 26.2136 DISPLAY_IDENTIFIER T_I_DIAG_POST1_MON2_0_ ECU_ADDRESS 0x7fb548 BYTE_ORDER MSB_LAST FORMAT "%5.4" BIT_MASK 0x1 /end MEASUREMENT
/begin MEASUREMENT t_i_diag_post1_mon2[1] "time betw. charging and end of discharging of postinj" UWORD _CNV_A_R_LINEAR_____363_CM 1 0. 0. 26.2136 DISPLAY_IDENTIFIER T_I_DIAG_POST1_MON2_1_ ECU_ADDRESS 0x7fb54a BYTE_ORDER MSB_LAST FORMAT "%5.4" BIT_MASK 0x1 /end MEASUREMENT
/begin MEASUREMENT t_i_diag_post1_mon2[2] "time betw. charging and end of discharging of postinj" UWORD _CNV_A_R_LINEAR_____363_CM 1 0. 0. 26.2136 DISPLAY_IDENTIFIER T_I_DIAG_POST1_MON2_2_ ECU_ADDRESS 0x7fb54c BYTE_ORDER MSB_LAST FORMAT "%5.4" BIT_MASK 0x1 /end MEASUREMENT
/begin MEASUREMENT t_i_diag_post1_mon2[3] "time betw. charging and end of discharging of postinj" UWORD _CNV_A_R_LINEAR_____363_CM 1 0. 0. 26.2136 DISPLAY_IDENTIFIER T_I_DIAG_POST1_MON2_3_ ECU_ADDRESS 0x7fb54e BYTE_ORDER MSB_LAST FORMAT "%5.4" BIT_MASK 0x1 /end MEASUREMENT
/begin MEASUREMENT t_i_diag_prev2_mon2[0] "time betw. charging and end of discharging of previnj_2" UWORD _CNV_A_R_LINEAR_____363_CM 1 0. 0. 26.2136 DISPLAY_IDENTIFIER T_I_DIAG_PREV2_MON2_0_ ECU_ADDRESS 0x7fb530 BYTE_ORDER MSB_LAST FORMAT "%5.4" BIT_MASK 0x1 /end MEASUREMENT
/begin MEASUREMENT t_i_diag_prev2_mon2[1] "time betw. charging and end of discharging of previnj_2" UWORD _CNV_A_R_LINEAR_____363_CM 1 0. 0. 26.2136 DISPLAY_IDENTIFIER T_I_DIAG_PREV2_MON2_1_ ECU_ADDRESS 0x7fb532 BYTE_ORDER MSB_LAST FORMAT "%5.4" BIT_MASK 0x1 /end MEASUREMENT
/begin MEASUREMENT t_i_diag_prev2_mon2[2] "time betw. charging and end of discharging of previnj_2" UWORD _CNV_A_R_LINEAR_____363_CM 1 0. 0. 26.2136 DISPLAY_IDENTIFIER T_I_DIAG_PREV2_MON2_2_ ECU_ADDRESS 0x7fb534 BYTE_ORDER MSB_LAST FORMAT "%5.4" BIT_MASK 0x1 /end MEASUREMENT
/begin MEASUREMENT t_i_diag_prev2_mon2[3] "time betw. charging and end of discharging of previnj_2" UWORD _CNV_A_R_LINEAR_____363_CM 1 0. 0. 26.2136 DISPLAY_IDENTIFIER T_I_DIAG_PREV2_MON2_3_ ECU_ADDRESS 0x7fb536 BYTE_ORDER MSB_LAST FORMAT "%5.4" BIT_MASK 0x1 /end MEASUREMENT
/begin MEASUREMENT t_i_diag_post2_mon2[0] "time betw. charging and end of discharging of postinj_2" UWORD _CNV_A_R_LINEAR_____363_CM 1 0. 0. 26.2136 DISPLAY_IDENTIFIER T_I_DIAG_POST2_MON2_0_ ECU_ADDRESS 0x7fb550 BYTE_ORDER MSB_LAST FORMAT "%5.4" BIT_MASK 0x1 /end MEASUREMENT
/begin MEASUREMENT t_i_diag_post2_mon2[1] "time betw. charging and end of discharging of postinj_2" UWORD _CNV_A_R_LINEAR_____363_CM 1 0. 0. 26.2136 DISPLAY_IDENTIFIER T_I_DIAG_POST2_MON2_1_ ECU_ADDRESS 0x7fb552 BYTE_ORDER MSB_LAST FORMAT "%5.4" BIT_MASK 0x1 /end MEASUREMENT
/begin MEASUREMENT t_i_diag_post2_mon2[2] "time betw. charging and end of discharging of postinj_2" UWORD _CNV_A_R_LINEAR_____363_CM 1 0. 0. 26.2136 DISPLAY_IDENTIFIER T_I_DIAG_POST2_MON2_2_ ECU_ADDRESS 0x7fb554 BYTE_ORDER MSB_LAST FORMAT "%5.4" BIT_MASK 0x1 /end MEASUREMENT
/begin MEASUREMENT t_i_diag_post2_mon2[3] "time betw. charging and end of discharging of postinj_2" UWORD _CNV_A_R_LINEAR_____363_CM 1 0. 0. 26.2136 DISPLAY_IDENTIFIER T_I_DIAG_POST2_MON2_3_ ECU_ADDRESS 0x7fb556 BYTE_ORDER MSB_LAST FORMAT "%5.4" BIT_MASK 0x1 /end MEASUREMENT
/begin MEASUREMENT state_iv_mon2 "v" UBYTE _CNV_A_R_LINEAR_____1_CM 1 0. 0. 255. DISPLAY_IDENTIFIER STATE_IV_MON2 ECU_ADDRESS 0x7fc043 FORMAT "%3.0" /end MEASUREMENT
/begin MEASUREMENT lv_tq_cru_act_mon "logical variable for activation of cruise control" UBYTE _CNV_S_2_RANGE______11_CM 1 0. 0. 1. DISPLAY_IDENTIFIER LV_TQ_CRU_ACT_MON ECU_ADDRESS 0x7fbc31 /end MEASUREMENT
/begin MEASUREMENT lv_cru_inh_mon "logical variable for inhibition of cruise control" UBYTE _CNV_S_2_RANGE______11_CM 1 0. 0. 1. DISPLAY_IDENTIFIER LV_CRU_INH_MON ECU_ADDRESS 0x7fbc30 /end MEASUREMENT
/begin MEASUREMENT t_cru_inh_mon "timer for inhibit of cruise control demand in monitoring level" UBYTE _CNV_A_R_LINEAR_____360_CM 1 0. 0. 10.2 DISPLAY_IDENTIFIER T_CRU_INH_MON ECU_ADDRESS 0x7fc06f FORMAT "%4.2" /end MEASUREMENT
/begin MEASUREMENT abc_cru_mon "anti bounce counter for fault in cruise control conditions present" UBYTE _CNV_A_R_LINEAR_____0_CM 1 0. 0. 255. DISPLAY_IDENTIFIER ABC_CRU_MON ECU_ADDRESS 0x7fc071 FORMAT "%3.0" /end MEASUREMENT
/begin CHARACTERISTIC c_abc_inc_cru_mon "anti bounce counter increment" VALUE 0x85c83d _REC_VAL_20_u1 255. _CNV_A_R_LINEAR_____0_CM 0. 255. DISPLAY_IDENTIFIER C_ABC_INC_CRU_MON FORMAT "%3.0" /end CHARACTERISTIC
/begin CHARACTERISTIC c_abc_max_cru_mon "maximum value of anti bounce counter" VALUE 0x85c852 _REC_VAL_20_u1 254. _CNV_A_R_LINEAR_____0_CM 1. 255. DISPLAY_IDENTIFIER C_ABC_MAX_CRU_MON FORMAT "%3.0" /end CHARACTERISTIC
/begin CHARACTERISTIC c_t_cru_inh_mon "delay time for disable of cruise control in monitoring level" VALUE 0x85cc13 _REC_VAL_20_u1 10.2 _CNV_A_R_LINEAR_____360_CM 0. 10.2 DISPLAY_IDENTIFIER C_T_CRU_INH_MON FORMAT "%4.2" /end CHARACTERISTIC
/begin CHARACTERISTIC c_vs_min_cru_mon "minimum threshold for vehicle speed control active" VALUE 0x85ce3a _REC_VAL_20_u2 655.35 _CNV_A_R_LINEAR_____71_CM 0. 655.35 DISPLAY_IDENTIFIER C_VS_MIN_CRU_MON FORMAT "%5.2" /end CHARACTERISTIC
/begin CHARACTERISTIC c_abc_inc_conv_mon_1 "anti bounce counter increment for diagnosis instance CONV_MON_1" VALUE 0x84fa87 _REC_VAL_20_u1 255. _CNV_A_R_LINEAR_____0_CM 0. 255. DISPLAY_IDENTIFIER C_ABC_INC_CONV_MON_1 FORMAT "%3.0" /end CHARACTERISTIC
/begin CHARACTERISTIC c_abc_max_conv_mon_1 "maximum value of anti bounce counter for diagnosis instance CONV_MON_1" VALUE 0x84fb13 _REC_VAL_20_u1 255. _CNV_A_R_LINEAR_____0_CM 0. 255. DISPLAY_IDENTIFIER C_ABC_MAX_CONV_MON_1 FORMAT "%3.0" /end CHARACTERISTIC
/begin CHARACTERISTIC c_abc_inc_n_32_mon_1 "anti bounce counter increment for diagnosis instance N_32_MON_1" VALUE 0x84faad _REC_VAL_20_u1 255. _CNV_A_R_LINEAR_____0_CM 0. 255. DISPLAY_IDENTIFIER C_ABC_INC_N_32_MON_1 FORMAT "%3.0" /end CHARACTERISTIC
/begin CHARACTERISTIC c_abc_max_n_32_mon_1 "maximum value of anti bounce counter for diagnosis instance N_32_MON_1" VALUE 0x84fb39 _REC_VAL_20_u1 255. _CNV_A_R_LINEAR_____0_CM 0. 255. DISPLAY_IDENTIFIER C_ABC_MAX_N_32_MON_1 FORMAT "%3.0" /end CHARACTERISTIC
/begin CHARACTERISTIC c_abc_inc_pvs_mon_1 "anti bounce counter increment for diagnosis instance PVS_MON_1" VALUE 0x84fac5 _REC_VAL_20_u1 255. _CNV_A_R_LINEAR_____0_CM 0. 255. DISPLAY_IDENTIFIER C_ABC_INC_PVS_MON_1 FORMAT "%3.0" /end CHARACTERISTIC
/begin CHARACTERISTIC c_abc_max_pvs_mon_1 "maximum value of anti bounce counter for diagnosis instance PVS_MON_1" VALUE 0x84fb51 _REC_VAL_20_u1 255. _CNV_A_R_LINEAR_____0_CM 0. 255. DISPLAY_IDENTIFIER C_ABC_MAX_PVS_MON_1 FORMAT "%3.0" /end CHARACTERISTIC
/begin CHARACTERISTIC c_abc_inc_fcut_mon_1 "anti bounce counter increment for diagnosis instance FCUT_MON_1" VALUE 0x84fa9d _REC_VAL_20_u1 255. _CNV_A_R_LINEAR_____0_CM 0. 255. DISPLAY_IDENTIFIER C_ABC_INC_FCUT_MON_1 FORMAT "%3.0" /end CHARACTERISTIC
/begin CHARACTERISTIC c_abc_max_fcut_mon_1 "maximum value of anti bounce counter for diagnosis instance FCUT_MON_1" VALUE 0x84fb29 _REC_VAL_20_u1 255. _CNV_A_R_LINEAR_____0_CM 0. 255. DISPLAY_IDENTIFIER C_ABC_MAX_FCUT_MON_1 FORMAT "%3.0" /end CHARACTERISTIC
/begin CHARACTERISTIC c_abc_inc_tqi_n_max_mon_1 "anti bounce counter increment for diagnosis instance TQI_N_MAX_MON_1" VALUE 0x84fadc _REC_VAL_20_u1 255. _CNV_A_R_LINEAR_____0_CM 0. 255. DISPLAY_IDENTIFIER C_ABC_INC_TQI_N_MAX_MON_1 FORMAT "%3.0" /end CHARACTERISTIC
/begin CHARACTERISTIC c_abc_max_tqi_n_max_mon_1 "maximum value of anti bounce counter for diagnosis instance TQI_N_MAX_MON_1" VALUE 0x84fb68 _REC_VAL_20_u1 255. _CNV_A_R_LINEAR_____0_CM 0. 255. DISPLAY_IDENTIFIER C_ABC_MAX_TQI_N_MAX_MON_1 FORMAT "%3.0" /end CHARACTERISTIC
/begin CHARACTERISTIC c_abc_inc_can_inh_mon "anti bounce counter increment for diagnosis instance CAN_INH_MON" VALUE 0x84fa7d _REC_VAL_20_u1 255. _CNV_A_R_LINEAR_____0_CM 0. 255. DISPLAY_IDENTIFIER C_ABC_INC_CAN_INH_MON FORMAT "%3.0" /end CHARACTERISTIC
/begin CHARACTERISTIC c_abc_max_can_inh_mon "maximum value of anti bounce counter for diagnosis instance CAN_INH_MON" VALUE 0x84fb09 _REC_VAL_20_u1 254. _CNV_A_R_LINEAR_____0_CM 1. 255. DISPLAY_IDENTIFIER C_ABC_MAX_CAN_INH_MON FORMAT "%3.0" /end CHARACTERISTIC
/begin CHARACTERISTIC c_abc_inc_post_inh_mon "anti bounce counter increment for diagnosis instance POST_INH_MON" VALUE 0x84faae _REC_VAL_20_u1 255. _CNV_A_R_LINEAR_____0_CM 0. 255. DISPLAY_IDENTIFIER C_ABC_INC_POST_INH_MON FORMAT "%3.0" /end CHARACTERISTIC
/begin CHARACTERISTIC c_abc_max_post_inh_mon "maximum value of anti bounce counter for diagnosis instance POST_INH_MON" VALUE 0x84fb3a _REC_VAL_20_u1 254. _CNV_A_R_LINEAR_____0_CM 1. 255. DISPLAY_IDENTIFIER C_ABC_MAX_POST_INH_MON FORMAT "%3.0" /end CHARACTERISTIC
/begin CHARACTERISTIC c_abc_inc_cru_inh_mon "anti bounce counter increment for diagnosis instance CRU_INH_MON" VALUE 0x84fa88 _REC_VAL_20_u1 255. _CNV_A_R_LINEAR_____0_CM 0. 255. DISPLAY_IDENTIFIER C_ABC_INC_CRU_INH_MON FORMAT "%3.0" /end CHARACTERISTIC
/begin CHARACTERISTIC c_abc_max_cru_inh_mon "maximum value of anti bounce counter for diagnosis instance CRU_INH_MON" VALUE 0x84fb14 _REC_VAL_20_u1 254. _CNV_A_R_LINEAR_____0_CM 1. 255. DISPLAY_IDENTIFIER C_ABC_MAX_CRU_INH_MON FORMAT "%3.0" /end CHARACTERISTIC
/begin CHARACTERISTIC c_abc_inc_serv_mon_1 "anti bounce counter increment for diagnosis instance SERV_MON_1" VALUE 0x84faca _REC_VAL_20_u1 255. _CNV_A_R_LINEAR_____0_CM 0. 255. DISPLAY_IDENTIFIER C_ABC_INC_SERV_MON_1 FORMAT "%3.0" /end CHARACTERISTIC
/begin CHARACTERISTIC c_abc_max_serv_mon_1 "maximum value of anti bounce counter for diagnosis instance SERV_MON_1" VALUE 0x84fb56 _REC_VAL_20_u1 255. _CNV_A_R_LINEAR_____0_CM 0. 255. DISPLAY_IDENTIFIER C_ABC_MAX_SERV_MON_1 FORMAT "%3.0" /end CHARACTERISTIC
/begin MEASUREMENT lv_n_lim_req_mon "v" UBYTE _CNV_S_2_RANGE__0___85_CM 1 0. 0. 1. DISPLAY_IDENTIFIER LV_N_LIM_REQ_MON ECU_ADDRESS 0x7fbc32 /end MEASUREMENT
/begin MEASUREMENT lv_off_mtc_mon "v" UBYTE _CNV_S_2_RANGE__0___85_CM 1 0. 0. 1. DISPLAY_IDENTIFIER LV_OFF_MTC_MON ECU_ADDRESS 0x7fbc33 /end MEASUREMENT
/begin MEASUREMENT lv_off_iv_mon "v" UBYTE _CNV_S_2_RANGE__0___85_CM 1 0. 0. 1. DISPLAY_IDENTIFIER LV_OFF_IV_MON ECU_ADDRESS 0x7fbc34 /end MEASUREMENT
/begin MEASUREMENT t_fcut_inh_mon "" UBYTE _CNV_A_R_LINEAR_____360_CM 1 0. 0. 10.2 DISPLAY_IDENTIFIER T_FCUT_INH_MON ECU_ADDRESS 0x7fbc36 FORMAT "%4.2" /end MEASUREMENT
/begin MEASUREMENT abc_fcut_mon "" UBYTE _CNV_A_R_LINEAR_____0_CM 1 0. 0. 255. DISPLAY_IDENTIFIER ABC_FCUT_MON ECU_ADDRESS 0x7fc07a FORMAT "%3.0" /end MEASUREMENT
/begin CHARACTERISTIC c_t_fcut_inh_mon "" VALUE 0x85cc3f _REC_VAL_20_u1 10.2 _CNV_A_R_LINEAR_____360_CM 0. 10.2 DISPLAY_IDENTIFIER C_T_FCUT_INH_MON FORMAT "%4.2" /end CHARACTERISTIC
/begin CHARACTERISTIC c_abc_inc_fcut_mon "" VALUE 0x85c83e _REC_VAL_20_u1 255. _CNV_A_R_LINEAR_____0_CM 0. 255. DISPLAY_IDENTIFIER C_ABC_INC_FCUT_MON FORMAT "%3.0" /end CHARACTERISTIC
/begin CHARACTERISTIC c_abc_max_fcut_mon "" VALUE 0x85c853 _REC_VAL_20_u1 254. _CNV_A_R_LINEAR_____0_CM 1. 255. DISPLAY_IDENTIFIER C_ABC_MAX_FCUT_MON FORMAT "%3.0" /end CHARACTERISTIC
/begin MEASUREMENT lv_err_fcut_mon "" UBYTE _CNV_S_2_RANGE______11_CM 1 0. 0. 1. DISPLAY_IDENTIFIER LV_ERR_FCUT_MON ECU_ADDRESS 0x7fbc35 /end MEASUREMENT
/begin MEASUREMENT lv_brake_mon "brake active or brake fault present" UBYTE _CNV_S_2_RANGE______11_CM 1 0. 0. 1. DISPLAY_IDENTIFIER LV_BRAKE_MON ECU_ADDRESS 0x7fbc37 /end MEASUREMENT
/begin MEASUREMENT lv_err_vcc_pvs_1_mon "fault in power supply for PVS_1 present" UBYTE _CNV_S_2_RANGE______11_CM 1 0. 0. 1. DISPLAY_IDENTIFIER LV_ERR_VCC_PVS_1_MON ECU_ADDRESS 0x7fbc38 /end MEASUREMENT
/begin MEASUREMENT lv_err_vcc_pvs_2_mon "fault in power supply for PVS_2 present" UBYTE _CNV_S_2_RANGE______11_CM 1 0. 0. 1. DISPLAY_IDENTIFIER LV_ERR_VCC_PVS_2_MON ECU_ADDRESS 0x7fbc39 /end MEASUREMENT
/begin MEASUREMENT lv_err_vcc_pvs_mon "fault in power supply for PVS present" UBYTE _CNV_S_2_RANGE______11_CM 1 0. 0. 1. DISPLAY_IDENTIFIER LV_ERR_VCC_PVS_MON ECU_ADDRESS 0x7fbc3a /end MEASUREMENT
/begin MEASUREMENT vcc_pvs_mon "supply voltage pedal value" UWORD _CNV_A_R_LINEAR_____35_CM 1 0. 0. 9.99023 DISPLAY_IDENTIFIER VCC_PVS_MON ECU_ADDRESS 0x7fb55a BYTE_ORDER MSB_LAST FORMAT "%3.2" /end MEASUREMENT
/begin MEASUREMENT abc_vcc_pvs_mon "anti bounce counter VCC error" UBYTE _CNV_A_R_LINEAR_____0_CM 1 0. 0. 255. DISPLAY_IDENTIFIER ABC_VCC_PVS_MON ECU_ADDRESS 0x7fc07f FORMAT "%3.0" /end MEASUREMENT
/begin CHARACTERISTIC c_vcc_pvs_max_mon "upper  threshold for monitoring supply voltage" VALUE 0x85ce20 _REC_VAL_20_u2 9.99023 _CNV_A_R_LINEAR_____35_CM 0. 9.99023 DISPLAY_IDENTIFIER C_VCC_PVS_MAX_MON FORMAT "%4.3" /end CHARACTERISTIC
/begin CHARACTERISTIC c_vcc_pvs_min_mon "lower threshold for monitoring supply voltage" VALUE 0x85ce22 _REC_VAL_20_u2 9.99023 _CNV_A_R_LINEAR_____35_CM 0. 9.99023 DISPLAY_IDENTIFIER C_VCC_PVS_MIN_MON FORMAT "%4.3" /end CHARACTERISTIC
/begin CHARACTERISTIC c_v_pvs_max_mon "upper threshold for monitoring pedal voltage" VALUE 0x85cdac _REC_VAL_20_u2 4.9951171875 _CNV_A_R_LINEAR_____28_CM 0. 4.9951171875 DISPLAY_IDENTIFIER C_V_PVS_MAX_MON FORMAT "%4.3" /end CHARACTERISTIC
/begin CHARACTERISTIC c_abc_inc_vcc_pvs_mon "anti bounce counter increment monitoring referents voltage" VALUE 0x85c84b _REC_VAL_20_u1 255. _CNV_A_R_LINEAR_____0_CM 0. 255. DISPLAY_IDENTIFIER C_ABC_INC_VCC_PVS_MON FORMAT "%3.0" /end CHARACTERISTIC
/begin CHARACTERISTIC c_abc_max_vcc_pvs_mon "value at which VCC error is recognizef, when reached" VALUE 0x85c861 _REC_VAL_20_u1 254. _CNV_A_R_LINEAR_____0_CM 1. 255. DISPLAY_IDENTIFIER C_ABC_MAX_VCC_PVS_MON FORMAT "%3.0" /end CHARACTERISTIC
/begin MEASUREMENT lv_fcut_mon_act_mon "logical variable for process monitoring" UBYTE _CNV_S_2_RANGE______11_CM 1 0. 0. 1. DISPLAY_IDENTIFIER LV_FCUT_MON_ACT_MON ECU_ADDRESS 0x7fbc3b /end MEASUREMENT
/begin MEASUREMENT lv_tqi_mon_act_mon "logical variable for process monitoring" UBYTE _CNV_S_2_RANGE______11_CM 1 0. 0. 1. DISPLAY_IDENTIFIER LV_TQI_MON_ACT_MON ECU_ADDRESS 0x7fbc3c /end MEASUREMENT
/begin MEASUREMENT lv_n_lim_etc_mon "Logical variable for activation of engine speed limitation monitoring" UBYTE _CNV_S_2_RANGE______11_CM 1 0. 0. 1. DISPLAY_IDENTIFIER LV_N_LIM_ETC_MON ECU_ADDRESS 0x7fbc3d /end MEASUREMENT
/begin MEASUREMENT lv_igk_mon "logical variable for ignition key on" UBYTE _CNV_S_2_RANGE______11_CM 1 0. 0. 1. DISPLAY_IDENTIFIER LV_IGK_MON ECU_ADDRESS 0x7fbc3e /end MEASUREMENT
/begin MEASUREMENT lv_igk_act_n_lim_mon "Logical variable for of engine speed limitation monitoring during key off" UBYTE _CNV_S_2_RANGE______11_CM 1 0. 0. 1. DISPLAY_IDENTIFIER LV_IGK_ACT_N_LIM_MON ECU_ADDRESS 0x7fbc3f /end MEASUREMENT
/begin MEASUREMENT t_prep_es_mon "Timer for engine speed limitation monitoring activation after key off" UBYTE _CNV_A_R_LINEAR_____360_CM 1 0. 0. 10.2 DISPLAY_IDENTIFIER T_PREP_ES_MON ECU_ADDRESS 0x7fbc40 FORMAT "%4.2" /end MEASUREMENT
/begin CHARACTERISTIC c_n_min_fcut_mon "minimal engine speed monitoring fuel cut off condition" VALUE 0x85cb36 _REC_VAL_20_u1 8160. _CNV_A_R_LINEAR_____55_CM 0. 8160. DISPLAY_IDENTIFIER C_N_MIN_FCUT_MON FORMAT "%4.0" /end CHARACTERISTIC
/begin CHARACTERISTIC c_t_prep_es_mon "Minimal time for engine stop after key off" VALUE 0x85cc6c _REC_VAL_20_u1 10.2 _CNV_A_R_LINEAR_____360_CM 0. 10.2 DISPLAY_IDENTIFIER C_T_PREP_ES_MON FORMAT "%4.2" /end CHARACTERISTIC
/begin MEASUREMENT state_iv "status word disable injectors" UBYTE _CNV_A_R_LINEAR_____0_CM 1 0. 0. 255. DISPLAY_IDENTIFIER STATE_IV ECU_ADDRESS 0x7fbc41 FORMAT "%3.0" /end MEASUREMENT
/begin MEASUREMENT prev_state_iv "status word disable injectors" UBYTE _CNV_A_R_LINEAR_____0_CM 1 0. 0. 255. DISPLAY_IDENTIFIER PREV_STATE_IV ECU_ADDRESS 0x7fbc42 FORMAT "%3.0" /end MEASUREMENT
/begin MEASUREMENT lv_err_tqi_n_max_mon "" UBYTE _CNV_S_2_RANGE______23_CM 1 0. 0. 1. DISPLAY_IDENTIFIER LV_ERR_TQI_N_MAX_MON ECU_ADDRESS 0x7fbc43 /end MEASUREMENT
/begin MEASUREMENT abc_tqi_n_max_mon "" UBYTE _CNV_A_R_LINEAR_____0_CM 1 0. 0. 255. DISPLAY_IDENTIFIER ABC_TQI_N_MAX_MON ECU_ADDRESS 0x7fc08d FORMAT "%3.0" /end MEASUREMENT
/begin CHARACTERISTIC c_n_max_mtc_lih_thd_mon "" VALUE 0x85cb2a _REC_VAL_20_u1 8160. _CNV_A_R_LINEAR_____55_CM 0. 8160. DISPLAY_IDENTIFIER C_N_MAX_MTC_LIH_THD_MON FORMAT "%4.0" /end CHARACTERISTIC
/begin CHARACTERISTIC c_abc_inc_tqi_n_max_mon "" VALUE 0x85c849 _REC_VAL_20_u1 255. _CNV_A_R_LINEAR_____0_CM 0. 255. DISPLAY_IDENTIFIER C_ABC_INC_TQI_N_MAX_MON FORMAT "%3.0" /end CHARACTERISTIC
/begin CHARACTERISTIC c_abc_max_tqi_n_max_mon "" VALUE 0x85c85e _REC_VAL_20_u1 254. _CNV_A_R_LINEAR_____0_CM 1. 255. DISPLAY_IDENTIFIER C_ABC_MAX_TQI_N_MAX_MON FORMAT "%3.0" /end CHARACTERISTIC
/begin MEASUREMENT abc_n_32_mon "" UBYTE _CNV_A_R_LINEAR_____0_CM 1 0. 0. 255. DISPLAY_IDENTIFIER ABC_N_32_MON ECU_ADDRESS 0x7fc091 FORMAT "%3.0" /end MEASUREMENT
/begin MEASUREMENT lv_err_n_32_mon "" UBYTE _CNV_S_2_RANGE______23_CM 1 0. 0. 1. DISPLAY_IDENTIFIER LV_ERR_N_32_MON ECU_ADDRESS 0x7fbc44 /end MEASUREMENT
/begin MEASUREMENT n_32_sub_mon "" UBYTE _CNV_A_R_LINEAR_____55_CM 1 0. 0. 8160. DISPLAY_IDENTIFIER N_32_SUB_MON ECU_ADDRESS 0x7fc093 FORMAT "%4.0" /end MEASUREMENT
/begin MEASUREMENT n_32_dif_rel_mon "v" UWORD _CNV_A_R_LINEAR_____365_CM 1 0. 0. 255. DISPLAY_IDENTIFIER N_32_DIF_REL_MON ECU_ADDRESS 0x7fb55c BYTE_ORDER MSB_LAST /end MEASUREMENT
/begin MEASUREMENT n_32_mon "" UBYTE _CNV_A_R_LINEAR_____55_CM 1 0. 0. 8160. DISPLAY_IDENTIFIER N_32_MON ECU_ADDRESS 0x7fbc45 FORMAT "%4.0" /end MEASUREMENT
/begin CHARACTERISTIC c_abc_inc_n_32_mon "" VALUE 0x85c841 _REC_VAL_20_u1 255. _CNV_A_R_LINEAR_____0_CM 0. 255. DISPLAY_IDENTIFIER C_ABC_INC_N_32_MON FORMAT "%3.0" /end CHARACTERISTIC
/begin CHARACTERISTIC c_abc_max_n_32_mon "" VALUE 0x85c856 _REC_VAL_20_u1 254. _CNV_A_R_LINEAR_____0_CM 1. 255. DISPLAY_IDENTIFIER C_ABC_MAX_N_32_MON FORMAT "%3.0" /end CHARACTERISTIC
/begin CHARACTERISTIC c_n_32_dif_rel_max_mon "" VALUE 0x85caf2 _REC_VAL_20_u2 255. _CNV_A_R_LINEAR_____365_CM 0. 255. DISPLAY_IDENTIFIER C_N_32_DIF_REL_MAX_MON /end CHARACTERISTIC
/begin CHARACTERISTIC c_n_32_lim_mon "" VALUE 0x85caf6 _REC_VAL_20_u1 8128. _CNV_A_R_LINEAR_____55_CM 32. 8160. DISPLAY_IDENTIFIER C_N_32_LIM_MON FORMAT "%4.0" /end CHARACTERISTIC
/begin CHARACTERISTIC c_n_32_min_mon "" VALUE 0x85cafd _REC_VAL_20_u1 8160. _CNV_A_R_LINEAR_____55_CM 0. 8160. DISPLAY_IDENTIFIER C_N_32_MIN_MON FORMAT "%4.0" /end CHARACTERISTIC
/begin MEASUREMENT lv_post_act_mon "Logical variable for activation of post injection" UBYTE _CNV_S_2_RANGE______11_CM 1 0. 0. 1. DISPLAY_IDENTIFIER LV_POST_ACT_MON ECU_ADDRESS 0x7fbc2e /end MEASUREMENT
/begin MEASUREMENT lv_post_inh_mon "Logical variable for inhibition of post injection" UBYTE _CNV_S_2_RANGE______11_CM 1 0. 0. 1. DISPLAY_IDENTIFIER LV_POST_INH_MON ECU_ADDRESS 0x7fbc2f /end MEASUREMENT
/begin MEASUREMENT t_post_inh_mon "Timer for inhibit of post injection demand in monitoring level" UBYTE _CNV_A_R_LINEAR_____360_CM 1 0. 0. 10.2 DISPLAY_IDENTIFIER T_POST_INH_MON ECU_ADDRESS 0x7fc067 FORMAT "%4.2" /end MEASUREMENT
/begin MEASUREMENT lv_post_loc_mon "Local  variable for activation of post injection" UBYTE _CNV_S_2_RANGE______11_CM 1 0. 0. 1. DISPLAY_IDENTIFIER LV_POST_LOC_MON ECU_ADDRESS 0x7fc06c /end MEASUREMENT
/begin MEASUREMENT abc_post_act_mon "Anti bounce counter" UBYTE _CNV_A_R_LINEAR_____0_CM 1 0. 0. 255. DISPLAY_IDENTIFIER ABC_POST_ACT_MON ECU_ADDRESS 0x7fc069 FORMAT "%3.0" /end MEASUREMENT
/begin CHARACTERISTIC c_soi_max_mon "c_soi_max_mon" VALUE 0x85cbb6 _REC_VAL_20_u2 360. _CNV_A_R_LINEAR_____118_CM -120. 240. DISPLAY_IDENTIFIER C_SOI_MAX_MON FORMAT "%5.2" /end CHARACTERISTIC
/begin CHARACTERISTIC c_abc_inc_post_act_mon "Anti bounce counter increment." VALUE 0x85c846 _REC_VAL_20_u1 255. _CNV_A_R_LINEAR_____0_CM 0. 255. DISPLAY_IDENTIFIER C_ABC_INC_POST_ACT_MON FORMAT "%3.0" /end CHARACTERISTIC
/begin CHARACTERISTIC c_abc_max_post_act_mon "Anti bounce counter maximun." VALUE 0x85c85b _REC_VAL_20_u1 254. _CNV_A_R_LINEAR_____0_CM 1. 255. DISPLAY_IDENTIFIER C_ABC_MAX_POST_ACT_MON FORMAT "%3.0" /end CHARACTERISTIC
/begin CHARACTERISTIC c_t_post_inh_mon "Delay time for disable of post injection in monitoring level." VALUE 0x85cc6b _REC_VAL_20_u1 10.2 _CNV_A_R_LINEAR_____360_CM 0. 10.2 DISPLAY_IDENTIFIER C_T_POST_INH_MON FORMAT "%4.2" /end CHARACTERISTIC
/begin CHARACTERISTIC ip_soi_post_min_mon "SAFETY_LEVEL2: Min phase for post injection" CURVE 0x85a780 _REC_CUR_20_u2_u1 360. _CNV_A_R_LINEAR_____118_CM -120. 240. DISPLAY_IDENTIFIER IP_SOI_POST_MIN_MON FORMAT "%5.2"
 /begin AXIS_DESCR COM_AXIS n_32_mon _CNV_A_R_LINEAR_____55_CM 6 0. 8160. FORMAT "%4.0" AXIS_PTS_REF ldp_n_32_mon_ip_post_mon /end AXIS_DESCR
/end CHARACTERISTIC
/begin AXIS_PTS ldp_n_32_mon_ip_post_mon "" 0x841916 n_32_mon _REC_AXS_20_u1 8160. _CNV_A_R_LINEAR_____55_CM 6 0. 8160. FORMAT "%4.0" /end AXIS_PTS
/begin MEASUREMENT lv_pps_fcut_mon " " UBYTE _CNV_S_2_RANGE__0___85_CM 1 0. 0. 1. DISPLAY_IDENTIFIER LV_PPS_FCUT_MON ECU_ADDRESS 0x7fbc46 /end MEASUREMENT
/begin MEASUREMENT lv_err_pvs_ratio_mon "v" UBYTE _CNV_S_2_RANGE__0___85_CM 1 0. 0. 1. DISPLAY_IDENTIFIER LV_ERR_PVS_RATIO_MON ECU_ADDRESS 0x7fc09e /end MEASUREMENT
/begin MEASUREMENT abc_pvs_ratio_mon "" UBYTE _CNV_A_R_LINEAR_____0_CM 1 0. 0. 255. DISPLAY_IDENTIFIER ABC_PVS_RATIO_MON ECU_ADDRESS 0x7fc097 FORMAT "%3.0" /end MEASUREMENT
/begin MEASUREMENT pv_av_2_mon "" UBYTE _CNV_A_R_LINEAR_____79_CM 1 0. 0. 99.609375 DISPLAY_IDENTIFIER PV_AV_2_MON ECU_ADDRESS 0x7fc09b FORMAT "%3.1" /end MEASUREMENT
/begin MEASUREMENT lv_err_pvs_mon "" UBYTE _CNV_S_2_RANGE______23_CM 1 0. 0. 1. DISPLAY_IDENTIFIER LV_ERR_PVS_MON ECU_ADDRESS 0x7fbc48 /end MEASUREMENT
/begin MEASUREMENT pv_av_mon "" UBYTE _CNV_A_R_LINEAR_____79_CM 1 0. 0. 99.609375 DISPLAY_IDENTIFIER PV_AV_MON ECU_ADDRESS 0x7fbc47 FORMAT "%3.1" /end MEASUREMENT
/begin CHARACTERISTIC c_n_min_pvs_diag_mon "" VALUE 0x85cb3e _REC_VAL_20_u1 8160. _CNV_A_R_LINEAR_____55_CM 0. 8160. DISPLAY_IDENTIFIER C_N_MIN_PVS_DIAG_MON FORMAT "%4.0" /end CHARACTERISTIC
/begin CHARACTERISTIC c_abc_inc_pvs_ratio_mon "" VALUE 0x85c847 _REC_VAL_20_u1 255. _CNV_A_R_LINEAR_____0_CM 0. 255. DISPLAY_IDENTIFIER C_ABC_INC_PVS_RATIO_MON FORMAT "%3.0" /end CHARACTERISTIC
/begin CHARACTERISTIC c_abc_max_pvs_ratio_mon "" VALUE 0x85c85c _REC_VAL_20_u1 254. _CNV_A_R_LINEAR_____0_CM 1. 255. DISPLAY_IDENTIFIER C_ABC_MAX_PVS_RATIO_MON FORMAT "%3.0" /end CHARACTERISTIC
/begin CHARACTERISTIC c_v_pvs_is_thd_1_mon "" VALUE 0x85cda0 _REC_VAL_20_u2 4.9951171875 _CNV_A_R_LINEAR_____28_CM 0. 4.9951171875 DISPLAY_IDENTIFIER C_V_PVS_IS_THD_1_MON FORMAT "%3.2" /end CHARACTERISTIC
/begin CHARACTERISTIC c_v_pvs_is_thd_2_mon "" VALUE 0x85cda4 _REC_VAL_20_u2 4.9951171875 _CNV_A_R_LINEAR_____28_CM 0. 4.9951171875 DISPLAY_IDENTIFIER C_V_PVS_IS_THD_2_MON FORMAT "%3.2" /end CHARACTERISTIC
/begin CHARACTERISTIC c_v_pvs_slop_1_mon "" VALUE 0x85cdbc _REC_VAL_20_u1 79.6875 _CNV_A_R_LINEAR_____366_CM 0. 79.6875 DISPLAY_IDENTIFIER C_V_PVS_SLOP_1_MON FORMAT "%4.2" /end CHARACTERISTIC
/begin CHARACTERISTIC c_v_pvs_slop_2_mon "" VALUE 0x85cdbe _REC_VAL_20_u1 159.375 _CNV_A_R_LINEAR_____367_CM 0. 159.375 DISPLAY_IDENTIFIER C_V_PVS_SLOP_2_MON FORMAT "%5.2" /end CHARACTERISTIC
/begin CHARACTERISTIC c_pv_lih_max_mon "" VALUE 0x85cb72 _REC_VAL_20_u1 99.609375 _CNV_A_R_LINEAR_____79_CM 0. 99.609375 DISPLAY_IDENTIFIER C_PV_LIH_MAX_MON FORMAT "%3.1" /end CHARACTERISTIC
/begin MEASUREMENT pv_av_1_mon "" UBYTE _CNV_A_R_LINEAR_____79_CM 1 0. 0. 99.609375 DISPLAY_IDENTIFIER PV_AV_1_MON ECU_ADDRESS 0x7fc099 FORMAT "%3.1" /end MEASUREMENT
/begin CHARACTERISTIC ip_pv_ratio_hys_mon "SAFETY: PVS ratio hysteresis" CURVE 0x8581e4 _REC_CUR_20_u1_u1 99.609375 _CNV_A_R_LINEAR_____79_CM 0. 99.609375 DISPLAY_IDENTIFIER IP_PV_RATIO_HYS_MON FORMAT "%3.1"
 /begin AXIS_DESCR COM_AXIS pv_av_1_mon _CNV_A_R_LINEAR_____79_CM 6 0. 99.609375 FORMAT "%3.1" AXIS_PTS_REF ldp_pv_av_min_mon_ip_pv_mon /end AXIS_DESCR
/end CHARACTERISTIC
/begin AXIS_PTS ldp_pv_av_min_mon_ip_pv_mon "" 0x8420de pv_av_1_mon _REC_AXS_20_u1 99.609375 _CNV_A_R_LINEAR_____79_CM 6 0. 99.609375 FORMAT "%3.1" /end AXIS_PTS
/begin MEASUREMENT lv_serv_act_mon "logical variable for activation of diagnostic demand" UBYTE _CNV_S_2_RANGE______11_CM 1 0. 0. 1. DISPLAY_IDENTIFIER LV_SERV_ACT_MON ECU_ADDRESS 0x7fbc49 /end MEASUREMENT
/begin MEASUREMENT lv_err_serv_mon "Error flag for inhibition of diagnostic demand" UBYTE _CNV_S_2_RANGE______11_CM 1 0. 0. 1. DISPLAY_IDENTIFIER LV_ERR_SERV_MON ECU_ADDRESS 0x7fbc4a /end MEASUREMENT
/begin CHARACTERISTIC c_acq_conv_hys_mon "" VALUE 0x85c869 _REC_VAL_20_u1 4.98046875 _CNV_A_R_LINEAR_____368_CM 0. 4.98046875 DISPLAY_IDENTIFIER C_ACQ_CONV_HYS_MON FORMAT "%3.2" /end CHARACTERISTIC
/begin CHARACTERISTIC c_abc_inc_conv_mon "" VALUE 0x85c83c _REC_VAL_20_u1 255. _CNV_A_R_LINEAR_____0_CM 0. 255. DISPLAY_IDENTIFIER C_ABC_INC_CONV_MON FORMAT "%3.0" /end CHARACTERISTIC
/begin CHARACTERISTIC c_abc_max_conv_mon "" VALUE 0x85c851 _REC_VAL_20_u1 254. _CNV_A_R_LINEAR_____0_CM 1. 255. DISPLAY_IDENTIFIER C_ABC_MAX_CONV_MON FORMAT "%3.0" /end CHARACTERISTIC
/begin MEASUREMENT abc_conv_mon "" UBYTE _CNV_A_R_LINEAR_____0_CM 1 0. 0. 255. DISPLAY_IDENTIFIER ABC_CONV_MON ECU_ADDRESS 0x7fc032 FORMAT "%3.0" /end MEASUREMENT
/begin MEASUREMENT lv_err_conv_mon "" UBYTE _CNV_S_2_RANGE______23_CM 1 0. 0. 1. DISPLAY_IDENTIFIER LV_ERR_CONV_MON ECU_ADDRESS 0x7fbc2b /end MEASUREMENT
/begin CHARACTERISTIC id_mv_block_conf "Table of measured values" MAP 0x84454e _REC_MAP_20_u2_u1_u1 65535. _CNV_S_65_MV_ID_RANG_401_CM 0. 65535. DISPLAY_IDENTIFIER ID_MV_BLOCK_CONF
 /begin AXIS_DESCR FIX_AXIS online_dummy _CNV_A_R_LINEAR_____1_CM 256 0. 255. READ_ONLY FORMAT "%3.0" FIX_AXIS_PAR_DIST 0 1 256 /end AXIS_DESCR
 /begin AXIS_DESCR FIX_AXIS online_dummy _CNV_A_R_LINEAR_____1_CM 4 0. 255. READ_ONLY FORMAT "%3.0" FIX_AXIS_PAR_DIST 1 1 4 /end AXIS_DESCR
/end CHARACTERISTIC
/begin CHARACTERISTIC c_cal_dummy_u8_2 "For Development only" VALUE 0x84fbdd _REC_VAL_20_u1 255. _CNV_A_R_LINEAR_____1_CM 0. 255. DISPLAY_IDENTIFIER C_CAL_DUMMY_U8_2 FORMAT "%3.0" /end CHARACTERISTIC
/begin CHARACTERISTIC c_cal_dummy_u8_3 "For Development Only" VALUE 0x84fbde _REC_VAL_20_u1 255. _CNV_A_R_LINEAR_____1_CM 0. 255. DISPLAY_IDENTIFIER C_CAL_DUMMY_U8_3 FORMAT "%3.0" /end CHARACTERISTIC
/begin CHARACTERISTIC c_cal_dummy_s16_1 "For Development only" VALUE 0x84fbd8 _REC_VAL_20_s2 65535. _CNV_A_R_LINEAR_____1_CM -32768. 32767. DISPLAY_IDENTIFIER C_CAL_DUMMY_S16_1 FORMAT "%5.4" /end CHARACTERISTIC
/begin CHARACTERISTIC c_cal_dummy_u8_1 "For Development only" VALUE 0x84fbdc _REC_VAL_20_u1 255. _CNV_A_R_LINEAR_____1_CM 0. 255. DISPLAY_IDENTIFIER C_CAL_DUMMY_U8_1 FORMAT "%3.0" /end CHARACTERISTIC
/begin CHARACTERISTIC c_cal_dummy_u16_1 "For Development only" VALUE 0x84fbda _REC_VAL_20_u2 65535. _CNV_A_R_LINEAR_____1_CM 0. 65535. DISPLAY_IDENTIFIER C_CAL_DUMMY_U16_1 FORMAT "%5.0" /end CHARACTERISTIC
/begin MEASUREMENT thrpwm_es_clc "pulse width for the throttle after \"close\" input during ES" UWORD _CNV_A_R_LINEAR_____8_CM 1 0. 0. 99.99847412109381 DISPLAY_IDENTIFIER THRPWM_ES_CLC ECU_ADDRESS 0x7fa90e BYTE_ORDER MSB_LAST FORMAT "%5.3" /end MEASUREMENT
/begin MEASUREMENT lv_cdn_es_thr_bas "conditions for engine throttling at ES" UBYTE _CNV_S_2_RANGE______11_CM 1 0. 0. 1. DISPLAY_IDENTIFIER LV_CDN_ES_THR_BAS ECU_ADDRESS 0x7fb876 /end MEASUREMENT
/begin MEASUREMENT lv_cdn_es_thr "conditions for timer start: engine throttling at ES" UBYTE _CNV_S_2_RANGE______11_CM 1 0. 0. 1. DISPLAY_IDENTIFIER LV_CDN_ES_THR ECU_ADDRESS 0x7fbe6c /end MEASUREMENT
/begin MEASUREMENT t_thr_es "timer for engine throttling during ES" UBYTE _CNV_A_R_LINEAR_____19_CM 1 0. 0. 25.5 DISPLAY_IDENTIFIER T_THR_ES ECU_ADDRESS 0x7fbe6b FORMAT "%3.1" /end MEASUREMENT
/begin MEASUREMENT lv_cdn_es_thr_end "opening of the throttle" UBYTE _CNV_S_2_RANGE______11_CM 1 0. 0. 1. DISPLAY_IDENTIFIER LV_CDN_ES_THR_END ECU_ADDRESS 0x7fb877 /end MEASUREMENT
/begin MEASUREMENT thrpwm "basic pulse width for the EGR- throttle(s)" UWORD _CNV_A_R_LINEAR_____8_CM 1 0. 0. 99.99847412109381 DISPLAY_IDENTIFIER THRPWM ECU_ADDRESS 0x7f99ae BYTE_ORDER MSB_LAST FORMAT "%5.3" /end MEASUREMENT
/begin MEASUREMENT thrpwm_egr "pulse width for the EGR- throttle(s) coming from the EGR- function" UWORD _CNV_A_R_LINEAR_____8_CM 1 0. 0. 99.99847412109381 DISPLAY_IDENTIFIER THRPWM_EGR ECU_ADDRESS 0x7fa90a BYTE_ORDER MSB_LAST FORMAT "%5.3" /end MEASUREMENT
/begin MEASUREMENT mafpwm_thr "MAFPWM for EGR throttle" UWORD _CNV_A_R_LINEAR_____136_CM 1 0. 0. 99.9969482421875 DISPLAY_IDENTIFIER MAFPWM_THR ECU_ADDRESS 0x7fa90c BYTE_ORDER MSB_LAST FORMAT "%5.3" /end MEASUREMENT
/begin MEASUREMENT thr_pwm[0] "output for EGR-throttle (j=0..NC_THR_NR-1)" UWORD _CNV_A_R_LINEAR_____8_CM 1 0. 0. 99.99847412109381 DISPLAY_IDENTIFIER THR_PWM_0_ ECU_ADDRESS 0x7f99ac BYTE_ORDER MSB_LAST FORMAT "%5.3" /end MEASUREMENT
/begin MEASUREMENT lv_pwm_thr_lim_diag "flag for a limited THRPWM" UBYTE _CNV_S_2_RANGE______11_CM 1 0. 0. 1. DISPLAY_IDENTIFIER LV_PWM_THR_LIM_DIAG ECU_ADDRESS 0x7fbe6d /end MEASUREMENT
/begin MEASUREMENT lv_pwm_thr_max_diag "max. throttle output flag" UBYTE _CNV_S_2_RANGE______11_CM 1 0. 0. 1. DISPLAY_IDENTIFIER LV_PWM_THR_MAX_DIAG ECU_ADDRESS 0x7fb879 /end MEASUREMENT
/begin MEASUREMENT lv_pwm_thr_min_diag "min. throttle output flag" UBYTE _CNV_S_2_RANGE______11_CM 1 0. 0. 1. DISPLAY_IDENTIFIER LV_PWM_THR_MIN_DIAG ECU_ADDRESS 0x7fb87a /end MEASUREMENT
/begin MEASUREMENT lv_req_iah_sub "LV_REQ_IAH_SUB" UBYTE _CNV_S_2_RANGE______11_CM 1 0. 0. 1. DISPLAY_IDENTIFIER LV_REQ_IAH_SUB ECU_ADDRESS 0x7fb878 /end MEASUREMENT
/begin MEASUREMENT fac_thr_byp_iah "factor to switch between EGR- or PF- function controlled pulse width" UWORD _CNV_A_R_LINEAR_____14_CM 1 0. 0. 0.9999847412109381 DISPLAY_IDENTIFIER FAC_THR_BYP_IAH ECU_ADDRESS 0x7f99b0 BYTE_ORDER MSB_LAST FORMAT "%6.5" /end MEASUREMENT
/begin MEASUREMENT thrpwm_bas "pulse width for the EGR- throttle(s) after PF- intervention" UWORD _CNV_A_R_LINEAR_____8_CM 1 0. 0. 99.99847412109381 DISPLAY_IDENTIFIER THRPWM_BAS ECU_ADDRESS 0x7fa904 BYTE_ORDER MSB_LAST FORMAT "%5.3" /end MEASUREMENT
/begin CHARACTERISTIC c_n_thd_max_es_thr "max. threshold for throttling at engine shutoff" VALUE 0x85cb4e _REC_VAL_20_u2 6375. _CNV_A_R_LINEAR_____5_CM 0. 6375. DISPLAY_IDENTIFIER C_N_THD_MAX_ES_THR FORMAT "%4.0" /end CHARACTERISTIC
/begin CHARACTERISTIC c_map_thd_max_es_thr "max. threshold for throttling at engine shutoff" VALUE 0x85caca _REC_VAL_20_u2 5434. _CNV_A_R_LINEAR_____45_CM 0. 5434. DISPLAY_IDENTIFIER C_MAP_THD_MAX_ES_THR FORMAT "%6.2" /end CHARACTERISTIC
/begin CHARACTERISTIC c_t_es_thr_close "time for closed throttle at engine shutoff" VALUE 0x85cc3e _REC_VAL_20_u1 25.5 _CNV_A_R_LINEAR_____19_CM 0. 25.5 DISPLAY_IDENTIFIER C_T_ES_THR_CLOSE FORMAT "%3.1" /end CHARACTERISTIC
/begin CHARACTERISTIC c_thrpwm_es_close "close position at throttled engine shutoff" VALUE 0x85cd12 _REC_VAL_20_u2 99.99847412109381 _CNV_A_R_LINEAR_____8_CM 0. 99.99847412109381 DISPLAY_IDENTIFIER C_THRPWM_ES_CLOSE FORMAT "%5.3" /end CHARACTERISTIC
/begin CHARACTERISTIC c_thrpwm_es_open "open position at throttled engine shutoff" VALUE 0x85cd14 _REC_VAL_20_u2 99.99847412109381 _CNV_A_R_LINEAR_____8_CM 0. 99.99847412109381 DISPLAY_IDENTIFIER C_THRPWM_ES_OPEN FORMAT "%5.3" /end CHARACTERISTIC
/begin CHARACTERISTIC c_n_thd_es_thr "threshold for throttling at engine shutoff" VALUE 0x85cb4c _REC_VAL_20_u2 6375. _CNV_A_R_LINEAR_____5_CM 0. 6375. DISPLAY_IDENTIFIER C_N_THD_ES_THR FORMAT "%4.0" /end CHARACTERISTIC
/begin CHARACTERISTIC c_fac_thrpwm_es_close "filter-factor for throttle during engine shutdown" VALUE 0x85ca14 _REC_VAL_20_u2 0.9999847412109381 _CNV_A_R_LINEAR_____14_CM 0. 0.9999847412109381 DISPLAY_IDENTIFIER C_FAC_THRPWM_ES_CLOSE FORMAT "%6.5" /end CHARACTERISTIC
/begin CHARACTERISTIC c_fac_thrpwm_es_open "filter-factor for throttle during engine shutdown" VALUE 0x85ca16 _REC_VAL_20_u2 0.9999847412109381 _CNV_A_R_LINEAR_____14_CM 0. 0.9999847412109381 DISPLAY_IDENTIFIER C_FAC_THRPWM_ES_OPEN FORMAT "%6.5" /end CHARACTERISTIC
/begin CHARACTERISTIC lc_thr_es_on "button for engine throttling during ES" VALUE 0x85ceb4 _REC_VAL_20_u1 1. _CNV_A_R_LINEAR_____0_CM 0. 1. DISPLAY_IDENTIFIER LC_THR_ES_ON FORMAT "%1.0" /end CHARACTERISTIC
/begin CHARACTERISTIC c_thr_pwm_man[0] "" VALUE 0x85cd0a _REC_VAL_20_u2 99.99847412109381 _CNV_A_R_LINEAR_____8_CM 0. 99.99847412109381 DISPLAY_IDENTIFIER C_THR_PWM_MAN_0_ FORMAT "%5.3" /end CHARACTERISTIC
/begin CHARACTERISTIC lc_thr_psn_ctl "actuation of the throttle via position controller" VALUE 0x85ceb6 _REC_VAL_20_u1 1. _CNV_A_R_LINEAR_____0_CM 0. 1. DISPLAY_IDENTIFIER LC_THR_PSN_CTL FORMAT "%1.0" /end CHARACTERISTIC
/begin CHARACTERISTIC lc_act_iah "activation of intake air heater strategy" VALUE 0x85ce48 _REC_VAL_20_u1 1. _CNV_A_R_LINEAR_____0_CM 0. 1. DISPLAY_IDENTIFIER LC_ACT_IAH FORMAT "%1.0" /end CHARACTERISTIC
/begin CHARACTERISTIC c_t_ramp_thr_byp_iah "time to change to the actor signal during regeneration" VALUE 0x85cc70 _REC_VAL_20_u2 65.535 _CNV_A_R_LINEAR_____73_CM 0. 65.535 DISPLAY_IDENTIFIER C_T_RAMP_THR_BYP_IAH FORMAT "%5.3" /end CHARACTERISTIC
/begin CHARACTERISTIC ip_thrpwm__ar_thr "GE_TOUT: throttle output as function of the cross section" CURVE 0x85b1d4 _REC_CUR_20_u2_u2 99.99847412109381 _CNV_A_R_LINEAR_____8_CM 0. 99.99847412109381 DISPLAY_IDENTIFIER IP_THRPWM__AR_THR FORMAT "%5.3"
 /begin AXIS_DESCR COM_AXIS online_dummy _CNV_A_R_LINEAR_____7_CM 12 0. 78.08 FORMAT "%5.3" AXIS_PTS_REF ldp_ar_thr_ip_thrpwm /end AXIS_DESCR
/end CHARACTERISTIC
/begin AXIS_PTS ldp_ar_thr_ip_thrpwm "" 0x841408 online_dummy _REC_AXS_20_u2 78.08 _CNV_A_R_LINEAR_____7_CM 12 0. 78.08 FORMAT "%5.3" /end AXIS_PTS
/begin CHARACTERISTIC ip_thrpwm_pf__n__mafpwm "GE_TOUT: EGR-throttle output during regeneration" MAP 0x85b32c _REC_MAP_20_u2_u2_u2 99.99847412109381 _CNV_A_R_LINEAR_____8_CM 0. 99.99847412109381 DISPLAY_IDENTIFIER IP_THRPWM_PF__N__MAFPWM FORMAT "%5.3"
 /begin AXIS_DESCR COM_AXIS n _CNV_A_R_LINEAR_____5_CM 10 0. 6375. FORMAT "%4.0" AXIS_PTS_REF ldp_n_ip_thrpwm_pf /end AXIS_DESCR
 /begin AXIS_DESCR COM_AXIS online_dummy _CNV_A_R_LINEAR_____136_CM 16 0. 99.9969482421875 FORMAT "%5.3" AXIS_PTS_REF ldp_mafpwm_ip_thrpwm_pf /end AXIS_DESCR
/end CHARACTERISTIC
/begin AXIS_PTS ldp_n_ip_thrpwm_pf "" 0x841ed6 n _REC_AXS_20_u2 6375. _CNV_A_R_LINEAR_____5_CM 10 0. 6375. FORMAT "%4.0" /end AXIS_PTS
/begin AXIS_PTS ldp_mafpwm_ip_thrpwm_pf "" 0x841828 online_dummy _REC_AXS_20_u2 99.9969482421875 _CNV_A_R_LINEAR_____136_CM 16 0. 99.9969482421875 FORMAT "%5.3" /end AXIS_PTS
/begin CHARACTERISTIC ip_thrpwm__n__mafpwm "GE_TOUT: EGR-throttle output" MAP 0x85b1ec _REC_MAP_20_u2_u2_u2 99.99847412109381 _CNV_A_R_LINEAR_____8_CM 0. 99.99847412109381 DISPLAY_IDENTIFIER IP_THRPWM__N__MAFPWM FORMAT "%5.3"
 /begin AXIS_DESCR COM_AXIS n _CNV_A_R_LINEAR_____5_CM 10 0. 6375. FORMAT "%4.0" AXIS_PTS_REF ldp_n_ip_thrpwm /end AXIS_DESCR
 /begin AXIS_DESCR COM_AXIS online_dummy _CNV_A_R_LINEAR_____136_CM 16 0. 99.9969482421875 FORMAT "%5.3" AXIS_PTS_REF ldp_mafpwm_ip_thrpwm /end AXIS_DESCR
/end CHARACTERISTIC
/begin AXIS_PTS ldp_n_ip_thrpwm "" 0x841ec0 n _REC_AXS_20_u2 6375. _CNV_A_R_LINEAR_____5_CM 10 0. 6375. FORMAT "%4.0" /end AXIS_PTS
/begin AXIS_PTS ldp_mafpwm_ip_thrpwm "" 0x841806 online_dummy _REC_AXS_20_u2 99.9969482421875 _CNV_A_R_LINEAR_____136_CM 16 0. 99.9969482421875 FORMAT "%5.3" /end AXIS_PTS
/begin AXIS_PTS ldp_fac_tq_req_cru__ip_pv_cru "" 0x843fdc fac_tq_req_cru _REC_AXS_20_u2 0.999969 _CNV_A_R_LINEAR_____330_CM 9 0. 0.999969 FORMAT "%7.5" /end AXIS_PTS
/begin AXIS_PTS ldp_n_32__ip_pv_cru "" 0x84405c n_32 _REC_AXS_20_u1 8160. _CNV_A_R_LINEAR_____536_CM 9 0. 8160. FORMAT "%4.0" /end AXIS_PTS
/begin MEASUREMENT pv_cru "" UBYTE _CNV_A_R_LINEAR_____79_CM 1 0. 0. 99.609375 DISPLAY_IDENTIFIER PV_CRU ECU_ADDRESS 0x7fb801 FORMAT "%4.1" /end MEASUREMENT
/begin MEASUREMENT fac_tq_req_cru "Torque-Anforderung durch CRU" UWORD _CNV_A_R_LINEAR_____537_CM 1 0. 0. 0.99997 DISPLAY_IDENTIFIER FAC_TQ_REQ_CRU ECU_ADDRESS 0x7f9832 BYTE_ORDER MSB_LAST FORMAT "%8.6" /end MEASUREMENT
/begin MEASUREMENT fac_tq_req_cru_tmp "Torque-Anforderung durch CRU" UWORD _CNV_A_R_LINEAR_____537_CM 1 0. 0. 0.99997 DISPLAY_IDENTIFIER FAC_TQ_REQ_CRU_TMP ECU_ADDRESS 0x7f9824 BYTE_ORDER MSB_LAST FORMAT "%8.6" /end MEASUREMENT
/begin CHARACTERISTIC ip_pv_cru "PV-Ersatzwert bei CRU-Betrieb" MAP 0x84d594 _REC_MAP_20_u1_u2_u1 99.609375 _CNV_A_R_LINEAR_____79_CM 0. 99.609375 DISPLAY_IDENTIFIER IP_PV_CRU FORMAT "%4.1"
 /begin AXIS_DESCR COM_AXIS fac_tq_req_cru _CNV_A_R_LINEAR_____330_CM 9 0. 0.999969 FORMAT "%7.5" AXIS_PTS_REF ldp_fac_tq_req_cru__ip_pv_cru /end AXIS_DESCR
 /begin AXIS_DESCR COM_AXIS n_32 _CNV_A_R_LINEAR_____536_CM 9 0. 8160. FORMAT "%4.0" AXIS_PTS_REF ldp_n_32__ip_pv_cru /end AXIS_DESCR
/end CHARACTERISTIC
/begin MEASUREMENT lv_dcc_off_dc "Flag for switching off DCC" UBYTE _CNV_S_2_RANGE__0___85_CM 1 0. 0. 1. DISPLAY_IDENTIFIER LV_DCC_OFF_DC ECU_ADDRESS 0x7fb802 BIT_MASK 0x1 /end MEASUREMENT
/begin MEASUREMENT lv_ems_err_dcc_di "Flag für  ems fehler zur abschaltung" UBYTE _CNV_S_2_RANGE__0___85_CM 1 0. 0. 1. DISPLAY_IDENTIFIER LV_EMS_ERR_DCC_DI ECU_ADDRESS 0x7fb803 BIT_MASK 0x1 /end MEASUREMENT
/begin CHARACTERISTIC c_t_plaus_max_cru_swi_dcc "zeitschwelle zum abwerfen der acc bei unplaus. acc hauptschalter (default = 250ms)" VALUE 0x84ffe0 _REC_VAL_20_u1 2.55 _CNV_A_R_LINEAR_____226_CM 0. 2.55 DISPLAY_IDENTIFIER C_T_PLAUS_MAX_CRU_SWI_DCC FORMAT "%4.2" /end CHARACTERISTIC
/begin CHARACTERISTIC c_t_plaus_max_bls_dcc "zeitschwelle zum abwerfen der dcc bei dcc akt . trotz bls  (default = 500 ms)" VALUE 0x84ffdf _REC_VAL_20_u1 2.55 _CNV_A_R_LINEAR_____226_CM 0. 2.55 DISPLAY_IDENTIFIER C_T_PLAUS_MAX_BLS_DCC FORMAT "%4.2" /end CHARACTERISTIC
/begin COMPU_METHOD _CNV_A_R_LINEAR_____0_CM "" RAT_FUNC "%6.3" "[-]" COEFFS 0 1. 0. 0 0 1 /end COMPU_METHOD
/begin COMPU_METHOD _CNV_A_R_LINEAR_____1_CM "" RAT_FUNC "%6.3" "-" COEFFS 0 1. 0. 0 0 1 /end COMPU_METHOD
/begin COMPU_METHOD _CNV_A_R_LINEAR_____5_CM "" RAT_FUNC "%6.3" "[rpm]" COEFFS 0 1. 0. 0 0 1 /end COMPU_METHOD
/begin COMPU_METHOD _CNV_A_R_LINEAR_____7_CM "" RAT_FUNC "%6.3" "[cm^2]" COEFFS 0 839.3314549180328 0. 0 0 1 /end COMPU_METHOD
/begin COMPU_METHOD _CNV_A_R_LINEAR_____8_CM "" RAT_FUNC "%6.3" "[%]" COEFFS 0 655.3599999999997 0. 0 0 1 /end COMPU_METHOD
/begin COMPU_METHOD _CNV_S_2_RANGE______11_CM "" TAB_VERB "%6.3" "[-]" COMPU_TAB_REF _CNV_S_2_RANGE______11 /end COMPU_METHOD
/begin COMPU_VTAB _CNV_S_2_RANGE______11 "" TAB_VERB 2 0 "0" 1 "1" /end COMPU_VTAB
/begin COMPU_METHOD _CNV_A_R_LINEAR_____14_CM "" RAT_FUNC "%6.3" "[-]" COEFFS 0 65535.99999999996 0. 0 0 1 /end COMPU_METHOD
/begin COMPU_METHOD _CNV_A_R_LINEAR_____18_CM "" RAT_FUNC "%6.3" "[°C]" COEFFS 0 1. 50. 0 0 1 /end COMPU_METHOD
/begin COMPU_METHOD _CNV_A_R_LINEAR_____19_CM "" RAT_FUNC "%6.3" "[s]" COEFFS 0 10. 0. 0 0 1 /end COMPU_METHOD
/begin COMPU_METHOD _CNV_S_2_RANGE______23_CM "" TAB_VERB "%6.3" "[-]" COMPU_TAB_REF _CNV_S_2_RANGE______23 /end COMPU_METHOD
/begin COMPU_VTAB _CNV_S_2_RANGE______23 "" TAB_VERB 2 0 "passive" 1 "active" /end COMPU_VTAB
/begin COMPU_METHOD _CNV_A_R_LINEAR_____28_CM "" RAT_FUNC "%6.3" "[V]" COEFFS 0 204.8 0. 0 0 1 /end COMPU_METHOD
/begin COMPU_METHOD _CNV_A_R_LINEAR_____35_CM "" RAT_FUNC "%6.3" "[V]" COEFFS 0 102.4000448438124 0. 0 0 1 /end COMPU_METHOD
/begin COMPU_METHOD _CNV_A_R_LINEAR_____43_CM "" RAT_FUNC "%6.3" "[V]" COEFFS 0 8.854166666666666 0. 0 0 1 /end COMPU_METHOD
/begin COMPU_METHOD _CNV_A_R_LINEAR_____45_CM "" RAT_FUNC "%6.3" "[hPa]" COEFFS 0 12.06017666543982 0. 0 0 1 /end COMPU_METHOD
/begin COMPU_METHOD _CNV_A_R_LINEAR_____52_CM "" RAT_FUNC "%6.3" "[Nm]" COEFFS 0 32. 0. 0 0 1 /end COMPU_METHOD
/begin COMPU_METHOD _CNV_A_R_LINEAR_____55_CM "" RAT_FUNC "%6.3" "[rpm]" COEFFS 0 3.125e-002 0. 0 0 1 /end COMPU_METHOD
/begin COMPU_METHOD _CNV_A_R_LINEAR_____60_CM "" RAT_FUNC "%6.3" "[mg/stk]" COEFFS 0 47.18142548596112 0. 0 0 1 /end COMPU_METHOD
/begin COMPU_METHOD _CNV_A_R_LINEAR_____64_CM "" RAT_FUNC "%6.3" "[s]" COEFFS 0 15625. 0. 0 0 1 /end COMPU_METHOD
/begin COMPU_METHOD _CNV_A_R_LINEAR_____71_CM "" RAT_FUNC "%6.3" "[km/h]" COEFFS 0 100. 0. 0 0 1 /end COMPU_METHOD
/begin COMPU_METHOD _CNV_A_R_LINEAR_____73_CM "" RAT_FUNC "%6.3" "[s]" COEFFS 0 1000. 0. 0 0 1 /end COMPU_METHOD
/begin COMPU_METHOD _CNV_A_R_LINEAR_____79_CM "" RAT_FUNC "%6.3" "[%]" COEFFS 0 2.56 0. 0 0 1 /end COMPU_METHOD
/begin COMPU_METHOD _CNV_A_R_LINEAR_____80_CM "" RAT_FUNC "%6.3" "[Nm]" COEFFS 0 31.99984374837874 32767.83999833983 0 0 1 /end COMPU_METHOD
/begin COMPU_METHOD _CNV_A_R_LINEAR_____81_CM "" RAT_FUNC "%6.3" "rpm" COEFFS 0 3.125e-002 0. 0 0 1 /end COMPU_METHOD
/begin COMPU_METHOD _CNV_A_R_LINEAR_____82_CM "" RAT_FUNC "%6.3" "Nm" COEFFS 0 32. 0. 0 0 1 /end COMPU_METHOD
/begin COMPU_METHOD _CNV_A_R_LINEAR_____83_CM "" RAT_FUNC "%6.3" "Nm/10ms" COEFFS 0 32. 0. 0 0 1 /end COMPU_METHOD
/begin COMPU_METHOD _CNV_A_R_LINEAR_____84_CM "" RAT_FUNC "%6.3" "Nm" COEFFS 0 32. 32768. 0 0 1 /end COMPU_METHOD
/begin COMPU_METHOD _CNV_S_2_RANGE__0___85_CM "" TAB_VERB "%6.3" "-" COMPU_TAB_REF _CNV_S_2_RANGE__0___85 /end COMPU_METHOD
/begin COMPU_VTAB _CNV_S_2_RANGE__0___85 "" TAB_VERB 2 0 "0" 1 "1" /end COMPU_VTAB
/begin COMPU_METHOD _CNV_A_R_LINEAR_____96_CM "" RAT_FUNC "%6.3" "[%]" COEFFS 0 655.3599999999997 -1.455191522836685e-011 0 0 1 /end COMPU_METHOD
/begin COMPU_METHOD _CNV_A_R_LINEAR_____102_CM "" RAT_FUNC "%6.3" "[-]" COEFFS 0 32767.99999999992 0. 0 0 1 /end COMPU_METHOD
/begin COMPU_METHOD _CNV_A_R_LINEAR_____110_CM "" RAT_FUNC "%6.3" "[kg/h]" COEFFS 0 64. 0. 0 0 1 /end COMPU_METHOD
/begin COMPU_METHOD _CNV_A_R_LINEAR_____118_CM "" RAT_FUNC "%6.3" "[°CRK]" COEFFS 0 42.66666666666666 5120. 0 0 1 /end COMPU_METHOD
/begin COMPU_METHOD _CNV_A_R_LINEAR_____136_CM "" RAT_FUNC "%6.3" "[%]" COEFFS 0 327.68 0. 0 0 1 /end COMPU_METHOD
/begin COMPU_METHOD _CNV_A_R_LINEAR_____137_CM "" RAT_FUNC "%6.3" "-" COEFFS 0 65535.99999999996 0. 0 0 1 /end COMPU_METHOD
/begin COMPU_METHOD _CNV_A_R_LINEAR_____138_CM "" RAT_FUNC "%6.3" "[(%*s)/(N*m)]" COEFFS 0 10000. 32768. 0 0 1 /end COMPU_METHOD
/begin COMPU_METHOD _CNV_A_R_LINEAR_____139_CM "" RAT_FUNC "%6.3" "[Nm/s]" COEFFS 0 1. 32768. 0 0 1 /end COMPU_METHOD
/begin COMPU_METHOD _CNV_A_R_LINEAR_____140_CM "" RAT_FUNC "%6.3" "[%]" COEFFS 0 655.3600000071681 32768.00000035841 0 0 1 /end COMPU_METHOD
/begin COMPU_METHOD _CNV_A_R_LINEAR_____141_CM "" RAT_FUNC "%6.3" "[mg/stk]" COEFFS 0 655.3600000071681 32768.00000035841 0 0 1 /end COMPU_METHOD
/begin COMPU_METHOD _CNV_A_R_LINEAR_____142_CM "" RAT_FUNC "%6.3" "[hPa]" COEFFS 0 12.06017666543982 -1.759293338545831e-002 0 0 1 /end COMPU_METHOD
/begin COMPU_METHOD _CNV_A_R_LINEAR_____143_CM "" RAT_FUNC "%6.3" "[hPa]" COEFFS 0 6.030180438898865 5.049764295108616e-004 0 0 1 /end COMPU_METHOD
/begin COMPU_METHOD _CNV_A_R_LINEAR_____144_CM "" RAT_FUNC "%6.3" "[-]" COEFFS 0 10000. 0. 0 0 1 /end COMPU_METHOD
/begin COMPU_METHOD _CNV_A_R_LINEAR_____145_CM "" RAT_FUNC "%6.3" "[s]" COEFFS 0 30.51711243529142 32768.00002288725 0 0 1 /end COMPU_METHOD
/begin COMPU_METHOD _CNV_A_R_LINEAR_____146_CM "" RAT_FUNC "%6.3" "[hPa]" COEFFS 0 12.06017666543982 32768.00000286437 0 0 1 /end COMPU_METHOD
/begin COMPU_METHOD _CNV_A_R_LINEAR_____147_CM "" RAT_FUNC "%6.3" "[hPa*s/(N*m)]" COEFFS 0 5. 32768. 0 0 1 /end COMPU_METHOD
/begin COMPU_METHOD _CNV_A_R_LINEAR_____148_CM "" RAT_FUNC "%6.3" "[Nm]" COEFFS 0 64. 0. 0 0 1 /end COMPU_METHOD
/begin COMPU_METHOD _CNV_A_R_LINEAR_____226_CM "" RAT_FUNC "%6.3" "s" COEFFS 0 100. 0. 0 0 1 /end COMPU_METHOD
/begin COMPU_METHOD _CNV_A_R_LINEAR_____230_CM "" RAT_FUNC "%6.3" "µs" COEFFS 0 1. 0. 0 0 1 /end COMPU_METHOD
/begin COMPU_METHOD _CNV_A_R_LINEAR_____240_CM "" RAT_FUNC "%6.3" "s" COEFFS 0 10. 0. 0 0 1 /end COMPU_METHOD
/begin COMPU_METHOD _CNV_A_R_LINEAR_____246_CM "" RAT_FUNC "%6.3" "-" COEFFS 0 128. 0. 0 0 1 /end COMPU_METHOD
/begin COMPU_METHOD _CNV_A_R_LINEAR_____247_CM "" RAT_FUNC "%6.3" "hPa" COEFFS 0 12.06017666543982 0. 0 0 1 /end COMPU_METHOD
/begin COMPU_METHOD _CNV_A_R_LINEAR_____250_CM "" RAT_FUNC "%6.3" "[V]" COEFFS 0 9.807692307692308 0. 0 0 1 /end COMPU_METHOD
/begin COMPU_METHOD _CNV_A_R_LINEAR_____254_CM "" RAT_FUNC "%6.3" "-" COEFFS 0 256. 0. 0 0 1 /end COMPU_METHOD
/begin COMPU_METHOD _CNV_A_R_LINEAR_____256_CM "" RAT_FUNC "%6.3" "[bar]" COEFFS 0 2. 0. 0 0 1 /end COMPU_METHOD
/begin COMPU_METHOD _CNV_S_9_STATE_CRU__320_CM "" TAB_VERB "%6.3" "[-]" COMPU_TAB_REF _CNV_S_9_STATE_CRU__320 /end COMPU_METHOD
/begin COMPU_VTAB _CNV_S_9_STATE_CRU__320 "" TAB_VERB 9 0 "IDLE" 1 "HARD_OFF" 2 "SOFT_OFF" 3 "TIP_UP" 4 "TIP_DOWN" 5 "RESU" 6 "AC" 7 "SET" 8 "DECE" /end COMPU_VTAB
/begin COMPU_METHOD _CNV_A_R_LINEAR_____321_CM "" RAT_FUNC "%6.3" "km/h" COEFFS 0 128. 0. 0 0 1 /end COMPU_METHOD
/begin COMPU_METHOD _CNV_A_R_LINEAR_____322_CM "" RAT_FUNC "%6.3" "m/s²" COEFFS 0 1179.941002949853 0. 0 0 1 /end COMPU_METHOD
/begin COMPU_METHOD _CNV_A_R_LINEAR_____323_CM "" RAT_FUNC "%6.3" "-" COEFFS 0 0.5 0. 0 0 1 /end COMPU_METHOD
/begin COMPU_METHOD _CNV_S_3_STATE_CRU__324_CM "" TAB_VERB "%6.3" "[-]" COMPU_TAB_REF _CNV_S_3_STATE_CRU__324 /end COMPU_METHOD
/begin COMPU_VTAB _CNV_S_3_STATE_CRU__324 "" TAB_VERB 3 0 "OFF" 1 "SOFT_OFF" 2 "ON" /end COMPU_VTAB
/begin COMPU_METHOD _CNV_A_R_LINEAR_____325_CM "" RAT_FUNC "%6.3" "km/h" COEFFS 0 128. 32768. 0 0 1 /end COMPU_METHOD
/begin COMPU_METHOD _CNV_A_R_LINEAR_____326_CM "" RAT_FUNC "%6.3" "m/s²" COEFFS 0 1179.941002949853 32768. 0 0 1 /end COMPU_METHOD
/begin COMPU_METHOD _CNV_A_R_LINEAR_____327_CM "" RAT_FUNC "%6.3" "kg" COEFFS 0 1. 0. 0 0 1 /end COMPU_METHOD
/begin COMPU_METHOD _CNV_A_R_LINEAR_____328_CM "" RAT_FUNC "%6.3" "1/100ms" COEFFS 0 32768.01580849006 0. 0 0 1 /end COMPU_METHOD
/begin COMPU_METHOD _CNV_A_R_LINEAR_____329_CM "" RAT_FUNC "%6.3" "h/(km*min)" COEFFS 0 1. 0. 0 0 1 /end COMPU_METHOD
/begin COMPU_METHOD _CNV_A_R_LINEAR_____330_CM "" RAT_FUNC "%6.3" "-" COEFFS 0 32768.01580849006 0. 0 0 1 /end COMPU_METHOD
/begin COMPU_METHOD _CNV_A_R_LINEAR_____331_CM "" RAT_FUNC "%6.3" "-" COEFFS 0 32768.00790412251 7.90412251080852e-003 0 0 1 /end COMPU_METHOD
/begin COMPU_METHOD _CNV_A_R_LINEAR_____332_CM "" RAT_FUNC "%6.3" "%" COEFFS 0 4.016064257028112 127. 0 0 1 /end COMPU_METHOD
/begin COMPU_METHOD _CNV_A_R_LINEAR_____333_CM "" RAT_FUNC "%6.3" "m/s²" COEFFS 0 1179.978393950305 0. 0 0 1 /end COMPU_METHOD
/begin COMPU_METHOD _CNV_A_R_LINEAR_____334_CM "" RAT_FUNC "%6.3" "-" COEFFS 0 32768.00003968061 32768.00003968061 0 0 1 /end COMPU_METHOD
/begin COMPU_METHOD _CNV_S_8_STATE_CRU__335_CM "" TAB_VERB "%6.3" "[-]" COMPU_TAB_REF _CNV_S_8_STATE_CRU__335 /end COMPU_METHOD
/begin COMPU_VTAB _CNV_S_8_STATE_CRU__335 "" TAB_VERB 8 0 "PASSIVE" 1 "CONST" 2 "TIP_UP" 3 "TIP_DOWN" 4 "AC" 5 "RESU" 6 "DECE" 7 "SOFT_OFF" /end COMPU_VTAB
/begin COMPU_METHOD _CNV_A_R_LINEAR_____336_CM "" RAT_FUNC "%6.3" "km/h" COEFFS 0 128.0000018750286 0. 0 0 1 /end COMPU_METHOD
/begin COMPU_METHOD _CNV_A_R_LINEAR_____360_CM "" RAT_FUNC "%6.3" "[s]" COEFFS 0 25. 0. 0 0 1 /end COMPU_METHOD
/begin COMPU_METHOD _CNV_A_R_LINEAR_____361_CM "" RAT_FUNC "%6.3" "[V]" COEFFS 0 204.6 0. 0 0 1 /end COMPU_METHOD
/begin COMPU_METHOD _CNV_A_R_LINEAR_____362_CM "" RAT_FUNC "%6.3" "[us]" COEFFS 0 1. 0. 0 0 1 /end COMPU_METHOD
/begin COMPU_METHOD _CNV_A_R_LINEAR_____363_CM "" RAT_FUNC "%6.3" "[ms]" COEFFS 0 1250. 0. 0 0 1 /end COMPU_METHOD
/begin COMPU_METHOD _CNV_A_R_LINEAR_____364_CM "" RAT_FUNC "%6.3" "[-]" COEFFS 0 257. 0. 0 0 1 /end COMPU_METHOD
/begin COMPU_METHOD _CNV_A_R_LINEAR_____365_CM "" RAT_FUNC "%6.3" "-" COEFFS 0 257. 0. 0 0 1 /end COMPU_METHOD
/begin COMPU_METHOD _CNV_A_R_LINEAR_____366_CM "" RAT_FUNC "%6.3" "[%/V]" COEFFS 0 3.2 0. 0 0 1 /end COMPU_METHOD
/begin COMPU_METHOD _CNV_A_R_LINEAR_____367_CM "" RAT_FUNC "%6.3" "[%/V]" COEFFS 0 1.6 0. 0 0 1 /end COMPU_METHOD
/begin COMPU_METHOD _CNV_A_R_LINEAR_____368_CM "" RAT_FUNC "%6.3" "[V]" COEFFS 0 51.2 0. 0 0 1 /end COMPU_METHOD
/begin COMPU_METHOD _CNV_S_65_MV_ID_RANG_401_CM "" TAB_VERB "%6.3" "[-]" COMPU_TAB_REF _CNV_S_65_MV_ID_RANG_401 /end COMPU_METHOD
/begin COMPU_VTAB _CNV_S_65_MV_ID_RANG_401 "" TAB_VERB 65 0 "blank" 1 "ACP_CAN" 2 "ALTPWM" 3 "AMP" 4 "CTL_LIM_BPA_X" 5 "CTL_LIM_EGRV_X" 6 "DRI" 7 "ECFPWM_1" 8 "ECFPWM_2" 9 "ECTPWM" 10 "ENGSTATE" 11 "FCO_SUM" 12 "KL50R_STATE" 13 "KL50_STATE" 14 "CAN_CCU_STATE" 15 "CAN_ACU_STATE" 16 "CAN_BEM_STATE" 17 "CAN_ICL_STATE" 18 "CAN_TCS_STATE" 19 "CAN_TCU_STATE" 20 "CAN_VECU_STATE" 21 "MAF_MMV" 22 "MAF_SP_MMV" 23 "MAP_MMV" 24 "MAP_SP_MMV" 25 "MF_TOT" 26 "N_32" 27 "OIL_LEVEL_COR_WIV" 28 "PV_AV" 29 "SF_HEAT" 30 "SOOT_WIV_VALUE" 31 "T_GL_ES" 32 "TAM" 33 "TCO" 34 "TCO_2" 35 "TCO_2_SP" 36 "TEMP_TCO_HEAT_TOL_ACT" 37 "TFU" 38 "TIA_WAST_GAS_TEMP" 39 "TIA_PIP_TEMP" 40 "TOIL" 41 "TQ_DRIV_SUB" 42 "TQ_LOSS_ACC" 43 "TQ_REQ_ETCU" 44 "TQI_ASR_SLOW" 45 "TQI_LIM_MIN" 46 "TQI_MAX" 47 "TQI_MSR_SLOW" 48 "TQI_SP" 49 "TQI_ST" 50 "TQI_SLM" 51 "VB" 52 "VS" 53 "V_PVS_1_BAS" 54 "V_PVS_2_BAS" 55 "WEAR_WIV_VALUE" 65527 "-9" 65528 "-8" 65529 "-7" 65530 "-6" 65531 "-5" 65532 "-4" 65533 "-3" 65534 "-2" 65535 "-1" /end COMPU_VTAB
/begin COMPU_METHOD _CNV_A_R_LINEAR_____536_CM "" RAT_FUNC "%6.3" "km/h" COEFFS 0 3.125e-002 0. 0 0 1 /end COMPU_METHOD
/begin COMPU_METHOD _CNV_A_R_LINEAR_____537_CM "" RAT_FUNC "%6.3" "-" COEFFS 0 32767.98303949118 0. 0 0 1 /end COMPU_METHOD
/begin RECORD_LAYOUT _REC_VAL_20_u1 FNC_VALUES 1 UBYTE COLUMN_DIR DIRECT /end RECORD_LAYOUT
/begin RECORD_LAYOUT _REC_AXS_20_u2 NO_AXIS_PTS_X 1 UWORD AXIS_PTS_X 2 UWORD INDEX_INCR DIRECT /end RECORD_LAYOUT
/begin RECORD_LAYOUT _REC_MAP_20_u2_u2_u2 FNC_VALUES 1 UWORD COLUMN_DIR DIRECT /end RECORD_LAYOUT
/begin RECORD_LAYOUT _REC_VAL_20_u2 FNC_VALUES 1 UWORD COLUMN_DIR DIRECT /end RECORD_LAYOUT
/begin RECORD_LAYOUT _REC_VAL_20_s2 FNC_VALUES 1 SWORD COLUMN_DIR DIRECT /end RECORD_LAYOUT
/begin RECORD_LAYOUT _REC_AXS_20_u1 NO_AXIS_PTS_X 1 UBYTE AXIS_PTS_X 2 UBYTE INDEX_INCR DIRECT /end RECORD_LAYOUT
/begin RECORD_LAYOUT _REC_CUR_20_u2_u2 FNC_VALUES 1 UWORD COLUMN_DIR DIRECT /end RECORD_LAYOUT
/begin RECORD_LAYOUT _REC_CUR_20_u2_u1 FNC_VALUES 1 UWORD COLUMN_DIR DIRECT /end RECORD_LAYOUT
/begin RECORD_LAYOUT _REC_MAP_20_u2_u1_u1 FNC_VALUES 1 UWORD COLUMN_DIR DIRECT /end RECORD_LAYOUT
/begin RECORD_LAYOUT _REC_MAP_20_u2_u2_u1 FNC_VALUES 1 UWORD COLUMN_DIR DIRECT /end RECORD_LAYOUT
/begin RECORD_LAYOUT _REC_CUR_20_u1_u2 FNC_VALUES 1 UBYTE COLUMN_DIR DIRECT /end RECORD_LAYOUT
/begin RECORD_LAYOUT _REC_CUR_20_u1_u1 FNC_VALUES 1 UBYTE COLUMN_DIR DIRECT /end RECORD_LAYOUT
/begin RECORD_LAYOUT _REC_MAP_20_u2_u1_u2 FNC_VALUES 1 UWORD COLUMN_DIR DIRECT /end RECORD_LAYOUT
/begin RECORD_LAYOUT _REC_MAP_20_u1_u2_u1 FNC_VALUES 1 UBYTE COLUMN_DIR DIRECT /end RECORD_LAYOUT
/begin RECORD_LAYOUT _REC_CUR_20_u4_u1 FNC_VALUES 1 ULONG COLUMN_DIR DIRECT /end RECORD_LAYOUT
/begin FUNCTION TQM_TQ_Loss_And_Reserve_ACC ""
 /begin DEF_CHARACTERISTIC c_tq_loss_acc_sub ip_fac_tq_loss_acc_on ip_fac_tq_loss_acc_off ldp_n__tq_loss_acc ldp_acp__tq_loss_acc ldp_t_acc__fac_tq_loss_acc_on ldp_t_acc__fac_tq_loss_acc_off ip_tq_loss_acc /end DEF_CHARACTERISTIC
 /begin OUT_MEASUREMENT t_acc tq_add_acc tq_loss_acc /end OUT_MEASUREMENT
/end FUNCTION
/begin FUNCTION TQM_TQ_Loss_Alternator ""
 /begin DEF_CHARACTERISTIC ldp_gen_load__tq_loss_alter ip_tq_loss_alter c_lgrd_tq_loss_alter c_tq_loss_alter_sub lc_use_tq_loss_alter_can ldp_n32_tq_loss_alter /end DEF_CHARACTERISTIC
 /begin OUT_MEASUREMENT tq_loss_alter /end OUT_MEASUREMENT
/end FUNCTION
/begin FUNCTION C_E_MON ""
 /begin SUB_FUNCTION MON_AERRMON MON_AMONINCI MON_AADCMON MON_ACANMON MON_ACRUMON MON_AFCUTMON MON_ANMON MON_ANMAXMON MON_APOINMON MON_APPSMON MON_APVSMON MON_ASERVMON MON_ACOPPRMON /end SUB_FUNCTION
/end FUNCTION
/begin FUNCTION MON_AERRMON ""
 /begin DEF_CHARACTERISTIC c_abc_inc_conv_mon_1 c_abc_max_conv_mon_1 c_abc_inc_n_32_mon_1 c_abc_max_n_32_mon_1 c_abc_inc_pvs_mon_1 c_abc_max_pvs_mon_1 c_abc_inc_fcut_mon_1 c_abc_max_fcut_mon_1 c_abc_inc_tqi_n_max_mon_1 c_abc_max_tqi_n_max_mon_1 c_abc_inc_can_inh_mon c_abc_max_can_inh_mon c_abc_inc_post_inh_mon c_abc_max_post_inh_mon c_abc_inc_cru_inh_mon c_abc_max_cru_inh_mon c_abc_inc_serv_mon_1 c_abc_max_serv_mon_1 /end DEF_CHARACTERISTIC
 /begin OUT_MEASUREMENT lv_n_lim_req_mon lv_off_mtc_mon lv_off_iv_mon /end OUT_MEASUREMENT
/end FUNCTION
/begin FUNCTION MON_AMONINCI ""
 /begin DEF_CHARACTERISTIC c_vcc_pvs_max_mon c_vcc_pvs_min_mon c_v_pvs_max_mon c_abc_inc_vcc_pvs_mon c_abc_max_vcc_pvs_mon c_n_min_fcut_mon c_t_prep_es_mon /end DEF_CHARACTERISTIC
 /begin OUT_MEASUREMENT lv_brake_mon lv_err_vcc_pvs_1_mon lv_err_vcc_pvs_2_mon lv_err_vcc_pvs_mon vcc_pvs_mon abc_vcc_pvs_mon lv_fcut_mon_act_mon lv_tqi_mon_act_mon lv_n_lim_etc_mon lv_igk_mon lv_igk_act_n_lim_mon t_prep_es_mon state_iv prev_state_iv /end OUT_MEASUREMENT
/end FUNCTION
/begin FUNCTION MON_AADCMON "" /begin DEF_CHARACTERISTIC c_acq_conv_hys_mon c_abc_inc_conv_mon c_abc_max_conv_mon /end DEF_CHARACTERISTIC /begin OUT_MEASUREMENT abc_conv_mon lv_err_conv_mon /end OUT_MEASUREMENT /end FUNCTION
/begin FUNCTION MON_ACANMON ""
 /begin DEF_CHARACTERISTIC c_abc_inc_can_tcs_mon c_abc_max_can_tcs_mon c_vb_min_can_mon c_t_max_tcs1_miss_mon c_t_can_tcs_inh_mon /end DEF_CHARACTERISTIC
 /begin OUT_MEASUREMENT lv_can_mon lv_can_inh_mon lv_can_tcs_mon lv_can_tcs_inh_mon t_can_tcs_inh_mon lv_can_tcs_tout_det_mon abc_can_tcs_mon /end OUT_MEASUREMENT
/end FUNCTION
/begin FUNCTION MON_ACRUMON ""
 /begin DEF_CHARACTERISTIC c_abc_inc_cru_mon c_abc_max_cru_mon c_t_cru_inh_mon c_vs_min_cru_mon /end DEF_CHARACTERISTIC
 /begin OUT_MEASUREMENT lv_tq_cru_act_mon lv_cru_inh_mon t_cru_inh_mon abc_cru_mon /end OUT_MEASUREMENT
/end FUNCTION
/begin FUNCTION MON_AFCUTMON "" /begin DEF_CHARACTERISTIC c_t_fcut_inh_mon c_abc_inc_fcut_mon c_abc_max_fcut_mon /end DEF_CHARACTERISTIC /begin OUT_MEASUREMENT t_fcut_inh_mon abc_fcut_mon lv_err_fcut_mon /end OUT_MEASUREMENT /end FUNCTION
/begin FUNCTION MON_ANMON ""
 /begin DEF_CHARACTERISTIC c_abc_inc_n_32_mon c_abc_max_n_32_mon c_n_32_dif_rel_max_mon c_n_32_lim_mon c_n_32_min_mon /end DEF_CHARACTERISTIC
 /begin OUT_MEASUREMENT abc_n_32_mon lv_err_n_32_mon n_32_sub_mon n_32_dif_rel_mon n_32_mon /end OUT_MEASUREMENT
/end FUNCTION
/begin FUNCTION MON_ANMAXMON ""
 /begin DEF_CHARACTERISTIC c_n_max_mtc_lih_thd_mon c_abc_inc_tqi_n_max_mon c_abc_max_tqi_n_max_mon /end DEF_CHARACTERISTIC
 /begin OUT_MEASUREMENT lv_err_tqi_n_max_mon abc_tqi_n_max_mon /end OUT_MEASUREMENT
/end FUNCTION
/begin FUNCTION MON_APOINMON ""
 /begin DEF_CHARACTERISTIC c_soi_max_mon c_abc_inc_post_act_mon c_abc_max_post_act_mon c_t_post_inh_mon ip_soi_post_min_mon ldp_n_32_mon_ip_post_mon /end DEF_CHARACTERISTIC
 /begin OUT_MEASUREMENT lv_post_act_mon lv_post_inh_mon t_post_inh_mon lv_post_loc_mon abc_post_act_mon /end OUT_MEASUREMENT
/end FUNCTION
/begin FUNCTION MON_APPSMON "" /begin OUT_MEASUREMENT lv_pps_fcut_mon /end OUT_MEASUREMENT /end FUNCTION
/begin FUNCTION MON_APVSMON ""
 /begin DEF_CHARACTERISTIC c_n_min_pvs_diag_mon c_abc_inc_pvs_ratio_mon c_abc_max_pvs_ratio_mon c_v_pvs_is_thd_1_mon c_v_pvs_is_thd_2_mon c_v_pvs_slop_1_mon c_v_pvs_slop_2_mon c_pv_lih_max_mon ip_pv_ratio_hys_mon ldp_pv_av_min_mon_ip_pv_mon /end DEF_CHARACTERISTIC
 /begin OUT_MEASUREMENT lv_err_pvs_ratio_mon abc_pvs_ratio_mon pv_av_2_mon lv_err_pvs_mon pv_av_mon pv_av_1_mon /end OUT_MEASUREMENT
/end FUNCTION
/begin FUNCTION MON_ASERVMON "" /begin OUT_MEASUREMENT lv_serv_act_mon lv_err_serv_mon /end OUT_MEASUREMENT /end FUNCTION
/begin FUNCTION MON_ACOPPRMON ""
 /begin DEF_CHARACTERISTIC id_abc_fcut_mon2 id_abc_n_32_mon2 id_abc_pvs_ratio_mon2 id_abc_tqi_n_max_mon2 id_n_32_mon2 id_v_pvs_1_bas_mon2 id_v_pvs_2_bas_mon2 id_t_seg_sw_mon2 id_sf_1_mon2 id_sf_2_mon2 id_state_iv_mon2 id_t_fcut_inh_mon2 id_t_i_diag_prev1_mon2 id_t_i_diag_prev2_mon2 id_t_i_diag_main1_mon2 id_t_i_diag_main2_mon2 id_t_i_diag_post1_mon2 id_t_i_diag_post2_mon2 c_t_i_diag_main1_max_mon2 c_abc_inc_n_32_mon2 c_abc_max_n_32_mon2 c_n_32_dif_rel_max_mon2 c_n_32_lim_mon2 c_n_32_min_mon2 c_abc_inc_pvs_ratio_mon2 c_abc_max_pvs_ratio_mon2 c_v_pvs_is_thd_1_mon2 c_v_pvs_is_thd_2_mon2 c_v_pvs_slop_1_mon2 c_v_pvs_slop_2_mon2 c_v_pv_lih_max_mon2 ip_pv_ratio_hys_mon2 ldp_pv_av_min_mon_ip_pv_mon2 c_abc_inc_fcut_mon2 c_abc_max_fcut_mon2 c_t_fcut_inh_mon2 c_n_max_mtc_lih_thd_mon2 c_abc_inc_tqi_n_max_mon2 c_abc_max_tqi_n_max_mon2 ldpm_test_rec_idx_mon2 id_resp_mon2 /end DEF_CHARACTERISTIC
 /begin OUT_MEASUREMENT n_32_mon2 lv_pps_fcut_mon2 abc_n_32_mon2 lv_err_n_32_mon2 n_32_dif_rel_mon2 n_32_mon_mon2 n_32_sub_mon2 abc_pvs_ratio_mon2 pv_av_1_mon2 pv_av_2_mon2 lv_err_pvs_mon2 pv_av_mon2 t_fcut_inh_mon2 lv_err_fcut_mon2 abc_fcut_mon2 lv_err_tqi_n_max_mon2 abc_tqi_n_max_mon2 lv_n_lim_req_mon2 lv_off_iv_mon2 lv_dr_off_mu_mon2 lv_off_mtc_mon2 resp_mon2 lv_brake_mon2 lv_err_conv_mon2 lv_err_mc_mon2 lv_err_pvs_ratio_mon_mon2 lv_err_pvs_ratio_mon2 lv_err_pvs_1_mon2 lv_err_pvs_2_mon2 lv_err_tmp_mc_mon2 lv_err_vcc_pvs_1_mon2 lv_err_vcc_pvs_2_mon2 lv_can_mon2 lv_err_vcc_pvs_mon2 lv_n_lim_etc_mon2 lv_post_act_mon2 lv_tq_cru_act_mon2 v_pvs_1_bas_mon2 t_seg_sw_mon2 v_pvs_2_bas_mon2 t_i_diag_prev1_mon2[0] t_i_diag_prev1_mon2[1] t_i_diag_prev1_mon2[2] t_i_diag_prev1_mon2[3] t_i_diag_main1_mon2[0] t_i_diag_main1_mon2[1] t_i_diag_main1_mon2[2] t_i_diag_main1_mon2[3] t_i_diag_main2_mon2[0] t_i_diag_main2_mon2[1] t_i_diag_main2_mon2[2] t_i_diag_main2_mon2[3] t_i_diag_post1_mon2[0] t_i_diag_post1_mon2[1] t_i_diag_post1_mon2[2] t_i_diag_post1_mon2[3] t_i_diag_prev2_mon2[0] t_i_diag_prev2_mon2[1] t_i_diag_prev2_mon2[2] t_i_diag_prev2_mon2[3] t_i_diag_post2_mon2[0] t_i_diag_post2_mon2[1] t_i_diag_post2_mon2[2] t_i_diag_post2_mon2[3] state_iv_mon2 /end OUT_MEASUREMENT
/end FUNCTION
/begin FUNCTION C_F_FTU "" /begin SUB_FUNCTION Measurement_value_blocks /end SUB_FUNCTION /end FUNCTION
/begin FUNCTION Measurement_value_blocks ""
 /begin DEF_CHARACTERISTIC id_mv_block_conf c_cal_dummy_u8_2 c_cal_dummy_u8_3 c_cal_dummy_s16_1 c_cal_dummy_u8_1 c_cal_dummy_u16_1 /end DEF_CHARACTERISTIC
/end FUNCTION
/begin FUNCTION C_G_CRU "C_G_CRU"
 /begin SUB_FUNCTION CRU_CRU_Input CRU_CRU_Basic_Functions CRU_CRU_Output CRU_CRU_Controller CRU_Appl_Cond_CRU CRU_DCC_Chk_off_conditions CRU_and_VVSL_torque_demand /end SUB_FUNCTION
/end FUNCTION
/begin FUNCTION CRU_CRU_Input "CRU_Input" /begin DEF_CHARACTERISTIC c_t_min_hld_cru_swi /end DEF_CHARACTERISTIC
 /begin OUT_MEASUREMENT cru_swi_req lv_pin_cru_swi lv_pin_cru_off lv_pin_cru_reac lv_pin_cru_set /end OUT_MEASUREMENT
/end FUNCTION
/begin FUNCTION CRU_CRU_Basic_Functions "CRU_Basic_Functions"
 /begin DEF_CHARACTERISTIC c_vs_inc_cru c_vs_sp_inc_ac c_vs_sp_inc_dece ldpm_vs_fil__ip_vs_sp_cru_inc ip_vs_sp_cru_hys ip_vs_sp_cru_inc_dece ip_vs_sp_cru_inc_ac ip_vs_sp_cru_inc_resu /end DEF_CHARACTERISTIC
 /begin OUT_MEASUREMENT vs_sp_cru vs_sp_cru_old cru_sp_state vs_fil_st lv_resu_up /end OUT_MEASUREMENT
/end FUNCTION
/begin FUNCTION CRU_CRU_Output "CRU_Output"
 /begin DEF_CHARACTERISTIC ldp_n_32__ip_fac_tq_dec_cru ldpm_vs_dif_cru__cru_plus ldp_vs_fil__cru_plus ip_ac_cru_req_ext_const ip_ac_cru_req_ext_dece ip_ac_cru_req_ext_res c_mass_veh c_vs_dif_min_cru_plus_intv lc_swi_ena_cru_plus ip_fac_tq_dec_cru /end DEF_CHARACTERISTIC
 /begin OUT_MEASUREMENT cru_ctl_state lv_cru_act ac_veh_loss lv_ena_cru_plus_intv ac_cru_req_ext /end OUT_MEASUREMENT
/end FUNCTION
/begin FUNCTION CRU_CRU_Controller "CRU_Controller"
 /begin DEF_CHARACTERISTIC ldp_vs_dif_cru__ip_ac_cru_req ldp_vs_fil__ip_ac_cru_req ip_ac_cru_req ldp_n_32__ip_ac_veh_ref ldp_n_vs__ip_ac_veh_ref ldp_vs_dif_cru__ip_cru_i ldp_ac_veh__ip_cru_i ldp_n_vs__ip_cru_i_ini ldp_vs_fil__ip_cru_i_ini ldpm_t_cru_ini__ip_cru_fac_1 ldpm_t_cru_ini__ip_cru_fac_2 ldpm_t_cru_ini__ip_cru_fac_3 ldpm_t_cru_ini__ip_cru_fac_4 ip_cru_fac_1_at ip_cru_fac_2_at ip_cru_fac_2_mt ip_cru_fac_3_at ip_cru_fac_3_mt ip_cru_fac_4_mt ip_cru_fac_4_at ldp_vs_fil__ip_ac_veh_lim c_t_max_ac_veh_lim c_fac_tq_lgrd_pos_cru c_tq_req_cru_lim c_fac_tq_lgrd_neg_cru ldp_amp_ad__ip_fac_ac_cru_req ldp_drg_tcu__ip_fac_ac_cru_req ip_ac_veh_ref ip_cru_i ip_cru_i_ini ip_cru_fac_1_mt ip_ac_veh_lim ip_fac_ac_cru_req ip_fac_cru_i ldp_vs_sp_cru__ip_fac_cru_i c_vs_i_ac_max_cru /end DEF_CHARACTERISTIC
 /begin OUT_MEASUREMENT ac_veh fac_tq_cru_p_i vs_dif_cru cru_p cru_i cru_i_dif t_cru_ini fac_t_cru_ini lv_tq_req_cru_lim lv_lim_ac_veh ac_cru_req /end OUT_MEASUREMENT
/end FUNCTION
/begin FUNCTION CRU_Appl_Cond_CRU "Appl_Cond_CRU"
 /begin DEF_CHARACTERISTIC c_t_max_abs c_t_max_asr c_t_max_msr c_t_max_esp c_t_max_eds c_vb_min_cru c_vs_min_cru_off c_vs_min_cru_on c_ac_max_cru c_t_ac_max_cru c_n_vs_max_cru /end DEF_CHARACTERISTIC
 /begin OUT_MEASUREMENT cru_req lv_cru_soft_off lv_cru_hard_off lv_cru_off_dc lv_cru_del_vs_sp n_vs_cru lv_cru_plus_off lv_cru_plus_off_dc n_vs lv_intv_cru lv_etc_lih lv_pin_dcc_swi lv_err_trl_msg_ood lv_err_state_ctl_dece lv_err_brake_lamp lv_err_state_ctl_dece_trlcu lv_err_brake_lamp_trl lv_err_lamp_re_msg_ood /end OUT_MEASUREMENT
/end FUNCTION
/begin FUNCTION CRU_DCC_Chk_off_conditions "CRU_DCC_Chk_off_conditions" /begin DEF_CHARACTERISTIC c_t_plaus_max_cru_swi_dcc c_t_plaus_max_bls_dcc /end DEF_CHARACTERISTIC /begin OUT_MEASUREMENT lv_dcc_off_dc lv_ems_err_dcc_di /end OUT_MEASUREMENT /end FUNCTION
/begin FUNCTION CRU_and_VVSL_torque_demand "CRU_and_VVSL_torque_demand"
 /begin DEF_CHARACTERISTIC ldp_fac_tq_req_cru__ip_pv_cru ldp_n_32__ip_pv_cru ip_pv_cru /end DEF_CHARACTERISTIC
 /begin OUT_MEASUREMENT pv_cru fac_tq_req_cru fac_tq_req_cru_tmp /end OUT_MEASUREMENT
/end FUNCTION
/begin FUNCTION C_I_SEC "" /end FUNCTION
/begin FUNCTION C_J_EOL "" /end FUNCTION
/begin FUNCTION C_T_LIH "" /end FUNCTION
/begin FUNCTION C_U_EXHAUST "" /begin SUB_FUNCTION EXHAUST_APF_RGNL /end SUB_FUNCTION /end FUNCTION
/begin FUNCTION EXHAUST_APF_RGNL "Control of Transition"
 /begin DEF_CHARACTERISTIC lc_state_rgn_pf_man lc_fast_bit_rgn_pf_man c_state_rgn_pf_man c_level_rgn_pf lc_inj_post1_dece_on_rgn lc_inj_post1_on_rgn /end DEF_CHARACTERISTIC
 /begin OUT_MEASUREMENT state_rgn_pf sf_level_rgn_pf lv_inj_post1_dece_on_rgn lv_inj_post1_on_rgn /end OUT_MEASUREMENT
/end FUNCTION
/begin FUNCTION C_V_FUP "" /end FUNCTION
/begin FUNCTION C_W_GES ""
 /begin DEF_CHARACTERISTIC c_n_thd_max_es_thr c_map_thd_max_es_thr c_t_es_thr_close c_thrpwm_es_close c_thrpwm_es_open c_n_thd_es_thr c_fac_thrpwm_es_close c_fac_thrpwm_es_open lc_thr_es_on c_thr_pwm_man[0] lc_thr_psn_ctl lc_act_iah c_t_ramp_thr_byp_iah ip_thrpwm__ar_thr ldp_ar_thr_ip_thrpwm ip_thrpwm_pf__n__mafpwm ldp_n_ip_thrpwm_pf ldp_mafpwm_ip_thrpwm_pf ip_thrpwm__n__mafpwm ldp_n_ip_thrpwm ldp_mafpwm_ip_thrpwm /end DEF_CHARACTERISTIC
 /begin OUT_MEASUREMENT thrpwm_es_clc lv_cdn_es_thr_bas lv_cdn_es_thr t_thr_es lv_cdn_es_thr_end thrpwm thrpwm_egr mafpwm_thr thr_pwm[0] lv_pwm_thr_lim_diag lv_pwm_thr_max_diag lv_pwm_thr_min_diag lv_req_iah_sub fac_thr_byp_iah thrpwm_bas /end OUT_MEASUREMENT
 /begin SUB_FUNCTION GES_AGE_SP GES_AGE_ESP GES_AGE_BSP GES_AGE_MSP GES_AGE_COOL GES_AGE_SYSV GES_EGPT GES_AGE_BACT GES_AGE_MPRE GES_AGE_EACT GES_AGE_VCLN GES_AGE_VCLP GES_AGE_BCOR GES_AGE_BCLP GES_AGE_TPRE GES_AGE_BCTL GES_AGE_AIRV GES_AGE_ECTL GES_AGE_TAD GES_AGE_TCLP GES_AGE_TAI GES_AGE_SWRL /end SUB_FUNCTION
/end FUNCTION
/begin FUNCTION GES_AGE_SP "" /begin DEF_CHARACTERISTIC c_conv_ges_sp /end DEF_CHARACTERISTIC /begin OUT_MEASUREMENT maf_sp map_sp egr_sp maf_sp_mmv map_sp_mmv egr_sp_mmv /end OUT_MEASUREMENT /end FUNCTION
/begin FUNCTION GES_AGE_ESP ""
 /begin DEF_CHARACTERISTIC lc_egr_sp_dev c_fac_egr_sp_dev c_egr_sp_cor_dev lc_egr_sp_dyn_on c_t2_dt1_egr_sp c_egr_sp_thd_egr_sp_dyn c_egr_sp_dyn_max c_egr_sp_dyn_min c_fac_egr_sp_is_fil c_t_egr_sp_is lc_egr_sp_man c_egr_sp_man c_fac_egr_sp_fil_ini c_fac_egr_sp_fil ip_fac_tran_egr_sp_0 ldp_tco_ip_fac_tran_egr_sp_0 ip_fac_egr_sp_cor_tgas_0 ldp_tgas_ip_fac_egr_sp_cor_0 ip_fac_egr_sp_cor_amp_0 ldp_amp_ip_fac_egr_sp_cor_0 ip_fac_tran_egr_sp_1 ldp_tco_ip_fac_tran_egr_sp_1 ip_fac_egr_sp_cor_tgas_1 ldp_tgas_ip_fac_egr_sp_cor_1 ip_fac_egr_sp_cor_amp_1 ldp_amp_ip_fac_egr_sp_cor_1 ip_fac_egr_sp_cor_amp_rgn_1 ldp_amp_ip_fac_egr_sp_cor_rgn_1 ip_fac_egr_sp_cor_amp_rgn_2 ldp_amp_ip_fac_egr_sp_cor_rgn_2 ip_kr_dt1_egr_sp_dyn ldp_tqi_grd_ip_kr_dt1_egr_sp ip_fac_egr_sp_fil_tra__n ip_t_dly_egr_on__n ldp_n_ip_t_dly_egr_on ip_egr_sp_bas_0_0 ldpm_n_ip_egr_sp_bas_0 ldpm_tqi_ip_egr_sp_bas_0 ip_egr_sp_bas_0_1 ip_egr_sp_bas_0_2 ip_egr_sp_cor_tgas_0 ldp_n_ip_egr_sp_cor_tgas_0 ldp_tqi_ip_egr_sp_cor_tgas_0 ip_egr_sp_cor_amp_0 ldp_n_ip_egr_sp_cor_amp_0 ldp_tqi_ip_egr_sp_cor_amp_0 ip_egr_sp_cor_lih_0 ip_egr_sp_bas_1_0 ldpm_n_ip_egr_sp_bas_1 ldpm_tqi_ip_egr_sp_bas_1 ip_egr_sp_bas_1_1 ip_egr_sp_bas_1_2 ip_egr_sp_cor_tgas_1 ldp_n_ip_egr_sp_cor_tgas_1 ldp_tqi_ip_egr_sp_cor_tgas_1 ip_egr_sp_cor_amp_1 ldp_n_ip_egr_sp_cor_amp_1 ldp_tqi_ip_egr_sp_cor_amp_1 ip_egr_sp_cor_lih_1 ip_egr_sp_amp_h_rgn_1 ldpm_n_ip_egr_sp_amp_rgn_1 ldpm_tqi_egr_sp_amp_rgn_1 ip_egr_sp_amp_l_rgn_1 ip_egr_sp_amp_h_rgn_2 ldpm_n_ip_egr_sp_amp_rgn_2 ldpm_tqi_egr_sp_amp_rgn_2 ip_egr_sp_amp_l_rgn_2 ip_egr_sp_is ldp_amp_ip_egr_sp_is ldp_tgas_ip_egr_sp_is /end DEF_CHARACTERISTIC
 /begin OUT_MEASUREMENT egr_sp_bas_sub egr_sp_bas egr_sp_bas_clc egr_sp_bas_tco_0 egr_sp_bas_0 egr_sp_bas_tco_1 egr_sp_bas_1 egr_sp_rgn egr_sp_rgn_1 egr_sp_rgn_2 egr_sp_gen egr_sp_dyn egr_sp_clc_sub lv_act_egr_sp_is egr_sp_sub egr_sp_mmv_sub lv_cdn_egr_on_dly /end OUT_MEASUREMENT
/end FUNCTION
/begin FUNCTION GES_AGE_BSP ""
 /begin DEF_CHARACTERISTIC c_map_sp_min c_map_sp_max_prot_maf_err c_tia_sub_maf_stnd_cmp c_amp_sub_maf_stnd_cmp lc_map_sp_dev c_fac_map_sp_dev c_map_sp_dev lc_map_sp_dyn_on c_t2_dt1_map_sp c_map_sp_dyn_max c_map_sp_dyn_min lc_map_sp_dyn_map_sp c_map_sp_dyn_thd_min c_fac_map_sp_fil_trig c_map_sp_thd_trig c_t_map_sp_trig c_map_sp_man lc_map_sp_man c_fac_map_sp_fil c_fac_map_sp_fil_ini ip_pq_cmp_prot0 ldpm_maf_kgh_ip_pq_cmp_prot ip_pq_cmp_prot1 ip_fac_tran_map_sp_0 ldp_tco_ip_fac_tran_map_sp_0 ip_fac_map_sp_cor_amp_0 ldp_amp_ip_fac_map_sp_cor_0 ip_fac_map_sp_cor_tgas_0 ldp_tgas_ip_fac_map_sp_cor_0 ip_fac_tran_map_sp_1 ldp_tco_ip_fac_tran_map_sp_1 ip_fac_map_sp_cor_amp_1 ldp_amp_ip_fac_map_sp_cor_1 ip_fac_map_sp_cor_tgas_1 ldp_tgas_ip_fac_map_sp_cor_1 ip_fac_map_sp_cor_amp_rgn_1 ldp_amp_ip_fac_map_sp_cor_rgn_1 ip_fac_map_sp_cor_amp_rgn_2 ldp_amp_ip_fac_map_sp_cor_rgn_2 ip_kr_dt1_map__map_sp_grd ldp_map_sp_grd_ip_kr_dt1_map ip_kr_dt1_map_sp_tqi ldp_tqi_grd_ip_kr_dt1_map_sp ip_fac_map_sp_fil_tra__n ldpm_n_ip_bpa_egr_sp_fil ip_map_sp_max__n__amp ldpm_n_ip_map ldpm_amp_ip_map ip_map_sp_max__n__tia ldpm_tia_ip_map ip_fac_maf_stnd_cmp ldp_tia_ip_fac_maf_stnd_cmp ldp_amp_ip_fac_maf_stnd_cmp ip_map_sp_bas_0_0 ldpm_n_ip_map_sp_bas_0 ldpm_tqi_ip_map_sp_bas_0 ip_map_sp_bas_0_1 ip_map_sp_bas_0_2 ip_map_sp_cor_tgas_0 ldp_n_ip_map_sp_cor_tgas_0 ldp_tqi_ip_map_sp_cor_tgas_0 ip_map_sp_cor_amp_0 ldp_n_ip_map_sp_cor_amp_0 ldp_tqi_ip_map_sp_cor_amp_0 ip_map_sp_bas_1_2 ldpm_n_ip_map_sp_bas_1 ldpm_tqi_ip_map_sp_bas_1 ip_map_sp_bas_1_1 ip_map_sp_bas_1_0 ip_map_sp_cor_tgas_1 ldp_n_ip_map_sp_cor_tgas_1 ldp_tqi_ip_map_sp_cor_tgas_1 ip_map_sp_cor_amp_1 ldp_n_ip_map_sp_cor_amp_1 ldp_tqi_ip_map_sp_cor_amp_1 ip_map_sp_amp_h_rgn_1 ldpm_n_ip_map_sp_amp_rgn_1 ldpm_tqi_ip_map_sp_amp_rgn_1 ip_map_sp_amp_l_rgn_1 ip_map_sp_amp_h_rgn_2 ldpm_n_ip_map_sp_amp_rgn_2 ldpm_tqi_ip_map_sp_amp_rgn_2 ip_map_sp_amp_l_rgn_2 /end DEF_CHARACTERISTIC
 /begin OUT_MEASUREMENT map_sp_lim map_sp_max_prot_0 map_sp_max_prot_1 map_sp_max_prot fac_maf_stnd_cmp map_sp_bas_sub map_sp_bas map_sp_bas_clc map_sp_bas_tco_0 map_sp_bas_0 map_sp_bas_tco_1 map_sp_bas_1 map_sp_rgn map_sp_rgn_1 map_sp_rgn_2 map_sp_dyn map_sp_gen map_sp_trig lv_map_sp_trig_fil lv_map_sp_trig map_sp_clc map_sp_mmv_sub map_sp_sub /end OUT_MEASUREMENT
/end FUNCTION
/end MODULE
/end PROJECT
