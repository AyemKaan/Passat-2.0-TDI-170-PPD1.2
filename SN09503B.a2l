ASAP2_VERSION 1 41
/begin PROJECT SN0 "SIMOS PPD"
/begin HEADER "_default_HeaderComment" PROJECT_NO PRJ_NUM /end HEADER
/begin MODULE _default_ModuleName "_default_ModuleLongIdentifier"
/begin MOD_COMMON "_default_ModCommonComment" DEPOSIT ABSOLUTE BYTE_ORDER MSB_FIRST ALIGNMENT_BYTE 1 ALIGNMENT_WORD 2 ALIGNMENT_LONG 4 ALIGNMENT_FLOAT32_IEEE 4 ALIGNMENT_FLOAT64_IEEE 8 /end MOD_COMMON
/begin MEASUREMENT pwm_cha_[0] "PPS charging PWM output (cylinder individual)" UWORD _CNV_A_R_LINEAR_____8_CM 1 0. 0. 99.99847412109381 DISPLAY_IDENTIFIER PWM_CHA__0_ ECU_ADDRESS 0x7f9f44 BYTE_ORDER MSB_LAST FORMAT "%5.3" /end MEASUREMENT
/begin MEASUREMENT pwm_cha_[1] "PPS charging PWM output (cylinder individual)" UWORD _CNV_A_R_LINEAR_____8_CM 1 0. 0. 99.99847412109381 DISPLAY_IDENTIFIER PWM_CHA__1_ ECU_ADDRESS 0x7f9f46 BYTE_ORDER MSB_LAST FORMAT "%5.3" /end MEASUREMENT
/begin MEASUREMENT pwm_cha_[2] "PPS charging PWM output (cylinder individual)" UWORD _CNV_A_R_LINEAR_____8_CM 1 0. 0. 99.99847412109381 DISPLAY_IDENTIFIER PWM_CHA__2_ ECU_ADDRESS 0x7f9f48 BYTE_ORDER MSB_LAST FORMAT "%5.3" /end MEASUREMENT
/begin MEASUREMENT pwm_cha_[3] "PPS charging PWM output (cylinder individual)" UWORD _CNV_A_R_LINEAR_____8_CM 1 0. 0. 99.99847412109381 DISPLAY_IDENTIFIER PWM_CHA__3_ ECU_ADDRESS 0x7f9f4a BYTE_ORDER MSB_LAST FORMAT "%5.3" /end MEASUREMENT
/begin MEASUREMENT pwm_dcha_[0] "PPS discharging PWM output (cylinder individual)" UWORD _CNV_A_R_LINEAR_____8_CM 1 0. 0. 99.99847412109381 DISPLAY_IDENTIFIER PWM_DCHA__0_ ECU_ADDRESS 0x7f9f4c BYTE_ORDER MSB_LAST FORMAT "%5.3" /end MEASUREMENT
/begin MEASUREMENT pwm_dcha_[1] "PPS discharging PWM output (cylinder individual)" UWORD _CNV_A_R_LINEAR_____8_CM 1 0. 0. 99.99847412109381 DISPLAY_IDENTIFIER PWM_DCHA__1_ ECU_ADDRESS 0x7f9f4e BYTE_ORDER MSB_LAST FORMAT "%5.3" /end MEASUREMENT
/begin MEASUREMENT pwm_dcha_[2] "PPS discharging PWM output (cylinder individual)" UWORD _CNV_A_R_LINEAR_____8_CM 1 0. 0. 99.99847412109381 DISPLAY_IDENTIFIER PWM_DCHA__2_ ECU_ADDRESS 0x7f9f50 BYTE_ORDER MSB_LAST FORMAT "%5.3" /end MEASUREMENT
/begin MEASUREMENT pwm_dcha_[3] "PPS discharging PWM output (cylinder individual)" UWORD _CNV_A_R_LINEAR_____8_CM 1 0. 0. 99.99847412109381 DISPLAY_IDENTIFIER PWM_DCHA__3_ ECU_ADDRESS 0x7f9f52 BYTE_ORDER MSB_LAST FORMAT "%5.3" /end MEASUREMENT
/begin MEASUREMENT t_eoi_ofs_ctl_[0] "cylinder individual EOI correction for all injections" SWORD _CNV_A_R_LINEAR_____540_CM 1 0. -32.768 32.767 DISPLAY_IDENTIFIER T_EOI_OFS_CTL__0_ ECU_ADDRESS 0x7f9f3c BYTE_ORDER MSB_LAST FORMAT "%5.3" /end MEASUREMENT
/begin MEASUREMENT t_eoi_ofs_ctl_[1] "cylinder individual EOI correction for all injections" SWORD _CNV_A_R_LINEAR_____540_CM 1 0. -32.768 32.767 DISPLAY_IDENTIFIER T_EOI_OFS_CTL__1_ ECU_ADDRESS 0x7f9f3e BYTE_ORDER MSB_LAST FORMAT "%5.3" /end MEASUREMENT
/begin MEASUREMENT t_eoi_ofs_ctl_[2] "cylinder individual EOI correction for all injections" SWORD _CNV_A_R_LINEAR_____540_CM 1 0. -32.768 32.767 DISPLAY_IDENTIFIER T_EOI_OFS_CTL__2_ ECU_ADDRESS 0x7f9f40 BYTE_ORDER MSB_LAST FORMAT "%5.3" /end MEASUREMENT
/begin MEASUREMENT t_eoi_ofs_ctl_[3] "cylinder individual EOI correction for all injections" SWORD _CNV_A_R_LINEAR_____540_CM 1 0. -32.768 32.767 DISPLAY_IDENTIFIER T_EOI_OFS_CTL__3_ ECU_ADDRESS 0x7f9f42 BYTE_ORDER MSB_LAST FORMAT "%5.3" /end MEASUREMENT
/begin MEASUREMENT sf_pi_ctl_egy_max "maximum limit of energy controller´s integrator reached" UWORD _CNV_A_R_LINEAR_____0_CM 1 0. 0. 65535. DISPLAY_IDENTIFIER SF_PI_CTL_EGY_MAX ECU_ADDRESS 0x7faae0 BYTE_ORDER MSB_LAST FORMAT "%5.0" /end MEASUREMENT
/begin MEASUREMENT egy_inj_sp_[0] "energy controller set point (cylinder individual)" UWORD _CNV_A_R_LINEAR_____541_CM 1 0. 0. 522.7750632 DISPLAY_IDENTIFIER EGY_INJ_SP__0_ ECU_ADDRESS 0x7faae2 BYTE_ORDER MSB_LAST /end MEASUREMENT
/begin MEASUREMENT egy_inj_sp_[1] "energy controller set point (cylinder individual)" UWORD _CNV_A_R_LINEAR_____541_CM 1 0. 0. 522.7750632 DISPLAY_IDENTIFIER EGY_INJ_SP__1_ ECU_ADDRESS 0x7faae4 BYTE_ORDER MSB_LAST /end MEASUREMENT
/begin MEASUREMENT egy_inj_sp_[2] "energy controller set point (cylinder individual)" UWORD _CNV_A_R_LINEAR_____541_CM 1 0. 0. 522.7750632 DISPLAY_IDENTIFIER EGY_INJ_SP__2_ ECU_ADDRESS 0x7faae6 BYTE_ORDER MSB_LAST /end MEASUREMENT
/begin MEASUREMENT egy_inj_sp_[3] "energy controller set point (cylinder individual)" UWORD _CNV_A_R_LINEAR_____541_CM 1 0. 0. 522.7750632 DISPLAY_IDENTIFIER EGY_INJ_SP__3_ ECU_ADDRESS 0x7faae8 BYTE_ORDER MSB_LAST /end MEASUREMENT
/begin MEASUREMENT lv_egy_ctl_act "energy closed loop controller active" UBYTE _CNV_S_2_RANGE______11_CM 1 0. 0. 1. DISPLAY_IDENTIFIER LV_EGY_CTL_ACT ECU_ADDRESS 0x7fbf0d /end MEASUREMENT
/begin MEASUREMENT lv_egy_ctl_ini "energy controller initialising or manual mode" UBYTE _CNV_S_2_RANGE______11_CM 1 0. 0. 1. DISPLAY_IDENTIFIER LV_EGY_CTL_INI ECU_ADDRESS 0x7fbf0e /end MEASUREMENT
/begin MEASUREMENT lv_dcha_ctl_on "discharge control off (0) / on (1)" UBYTE _CNV_S_2_RANGE______11_CM 1 0. 0. 1. DISPLAY_IDENTIFIER LV_DCHA_CTL_ON ECU_ADDRESS 0x7fbf0f /end MEASUREMENT
/begin MEASUREMENT egy_step_sp_[0] "energy controller set point divided by number of CC PPS steps (cylinder individual)" UWORD _CNV_A_R_LINEAR_____541_CM 1 0. 0. 522.7750632 DISPLAY_IDENTIFIER EGY_STEP_SP__0_ ECU_ADDRESS 0x7faaea BYTE_ORDER MSB_LAST /end MEASUREMENT
/begin MEASUREMENT egy_step_sp_[1] "energy controller set point divided by number of CC PPS steps (cylinder individual)" UWORD _CNV_A_R_LINEAR_____541_CM 1 0. 0. 522.7750632 DISPLAY_IDENTIFIER EGY_STEP_SP__1_ ECU_ADDRESS 0x7faaec BYTE_ORDER MSB_LAST /end MEASUREMENT
/begin MEASUREMENT egy_step_sp_[2] "energy controller set point divided by number of CC PPS steps (cylinder individual)" UWORD _CNV_A_R_LINEAR_____541_CM 1 0. 0. 522.7750632 DISPLAY_IDENTIFIER EGY_STEP_SP__2_ ECU_ADDRESS 0x7faaee BYTE_ORDER MSB_LAST /end MEASUREMENT
/begin MEASUREMENT egy_step_sp_[3] "energy controller set point divided by number of CC PPS steps (cylinder individual)" UWORD _CNV_A_R_LINEAR_____541_CM 1 0. 0. 522.7750632 DISPLAY_IDENTIFIER EGY_STEP_SP__3_ ECU_ADDRESS 0x7faaf0 BYTE_ORDER MSB_LAST /end MEASUREMENT
/begin MEASUREMENT egy_inj_sp_pctl_[0] "energy controller set point for energy pre control (cylinder individual)" UWORD _CNV_A_R_LINEAR_____541_CM 1 0. 0. 522.7750632 DISPLAY_IDENTIFIER EGY_INJ_SP_PCTL__0_ ECU_ADDRESS 0x7faaf2 BYTE_ORDER MSB_LAST /end MEASUREMENT
/begin MEASUREMENT egy_inj_sp_pctl_[1] "energy controller set point for energy pre control (cylinder individual)" UWORD _CNV_A_R_LINEAR_____541_CM 1 0. 0. 522.7750632 DISPLAY_IDENTIFIER EGY_INJ_SP_PCTL__1_ ECU_ADDRESS 0x7faaf4 BYTE_ORDER MSB_LAST /end MEASUREMENT
/begin MEASUREMENT egy_inj_sp_pctl_[2] "energy controller set point for energy pre control (cylinder individual)" UWORD _CNV_A_R_LINEAR_____541_CM 1 0. 0. 522.7750632 DISPLAY_IDENTIFIER EGY_INJ_SP_PCTL__2_ ECU_ADDRESS 0x7faaf6 BYTE_ORDER MSB_LAST /end MEASUREMENT
/begin MEASUREMENT egy_inj_sp_pctl_[3] "energy controller set point for energy pre control (cylinder individual)" UWORD _CNV_A_R_LINEAR_____541_CM 1 0. 0. 522.7750632 DISPLAY_IDENTIFIER EGY_INJ_SP_PCTL__3_ ECU_ADDRESS 0x7faaf8 BYTE_ORDER MSB_LAST /end MEASUREMENT
/begin MEASUREMENT seg_nr_egy_ctl "actual segment number of energy control" UBYTE _CNV_A_R_LINEAR_____0_CM 1 0. 0. 15. DISPLAY_IDENTIFIER SEG_NR_EGY_CTL ECU_ADDRESS 0x7fbf0b FORMAT "%2.0" /end MEASUREMENT
/begin MEASUREMENT pwm_cha_ctl_[0] "energy controller output (cylinder individual)" UWORD _CNV_A_R_LINEAR_____8_CM 1 0. 0. 99.99847412109381 DISPLAY_IDENTIFIER PWM_CHA_CTL__0_ ECU_ADDRESS 0x7faafa BYTE_ORDER MSB_LAST FORMAT "%5.3" /end MEASUREMENT
/begin MEASUREMENT pwm_cha_ctl_[1] "energy controller output (cylinder individual)" UWORD _CNV_A_R_LINEAR_____8_CM 1 0. 0. 99.99847412109381 DISPLAY_IDENTIFIER PWM_CHA_CTL__1_ ECU_ADDRESS 0x7faafc BYTE_ORDER MSB_LAST FORMAT "%5.3" /end MEASUREMENT
/begin MEASUREMENT pwm_cha_ctl_[2] "energy controller output (cylinder individual)" UWORD _CNV_A_R_LINEAR_____8_CM 1 0. 0. 99.99847412109381 DISPLAY_IDENTIFIER PWM_CHA_CTL__2_ ECU_ADDRESS 0x7faafe BYTE_ORDER MSB_LAST FORMAT "%5.3" /end MEASUREMENT
/begin MEASUREMENT pwm_cha_ctl_[3] "energy controller output (cylinder individual)" UWORD _CNV_A_R_LINEAR_____8_CM 1 0. 0. 99.99847412109381 DISPLAY_IDENTIFIER PWM_CHA_CTL__3_ ECU_ADDRESS 0x7fab00 BYTE_ORDER MSB_LAST FORMAT "%5.3" /end MEASUREMENT
/begin MEASUREMENT pwm_cha_err_ctl_[0] "closed loop energy controller´s error correction/PI controller output (cylinder individual)" SWORD _CNV_A_R_LINEAR_____542_CM 1 0. -50. 49.99847412 DISPLAY_IDENTIFIER PWM_CHA_ERR_CTL__0_ ECU_ADDRESS 0x7fab02 BYTE_ORDER MSB_LAST FORMAT "%5.3" /end MEASUREMENT
/begin MEASUREMENT pwm_cha_err_ctl_[1] "closed loop energy controller´s error correction/PI controller output (cylinder individual)" SWORD _CNV_A_R_LINEAR_____542_CM 1 0. -50. 49.99847412 DISPLAY_IDENTIFIER PWM_CHA_ERR_CTL__1_ ECU_ADDRESS 0x7fab04 BYTE_ORDER MSB_LAST FORMAT "%5.3" /end MEASUREMENT
/begin MEASUREMENT pwm_cha_err_ctl_[2] "closed loop energy controller´s error correction/PI controller output (cylinder individual)" SWORD _CNV_A_R_LINEAR_____542_CM 1 0. -50. 49.99847412 DISPLAY_IDENTIFIER PWM_CHA_ERR_CTL__2_ ECU_ADDRESS 0x7fab06 BYTE_ORDER MSB_LAST FORMAT "%5.3" /end MEASUREMENT
/begin MEASUREMENT pwm_cha_err_ctl_[3] "closed loop energy controller´s error correction/PI controller output (cylinder individual)" SWORD _CNV_A_R_LINEAR_____542_CM 1 0. -50. 49.99847412 DISPLAY_IDENTIFIER PWM_CHA_ERR_CTL__3_ ECU_ADDRESS 0x7fab08 BYTE_ORDER MSB_LAST FORMAT "%5.3" /end MEASUREMENT
/begin MEASUREMENT p_ctl_egy_[0] "proportional part of closed loop energy controller (cylinder individual)" SWORD _CNV_A_R_LINEAR_____542_CM 1 0. -50. 49.99847412 DISPLAY_IDENTIFIER P_CTL_EGY__0_ ECU_ADDRESS 0x7fab0a BYTE_ORDER MSB_LAST FORMAT "%5.3" /end MEASUREMENT
/begin MEASUREMENT p_ctl_egy_[1] "proportional part of closed loop energy controller (cylinder individual)" SWORD _CNV_A_R_LINEAR_____542_CM 1 0. -50. 49.99847412 DISPLAY_IDENTIFIER P_CTL_EGY__1_ ECU_ADDRESS 0x7fab0c BYTE_ORDER MSB_LAST FORMAT "%5.3" /end MEASUREMENT
/begin MEASUREMENT p_ctl_egy_[2] "proportional part of closed loop energy controller (cylinder individual)" SWORD _CNV_A_R_LINEAR_____542_CM 1 0. -50. 49.99847412 DISPLAY_IDENTIFIER P_CTL_EGY__2_ ECU_ADDRESS 0x7fab0e BYTE_ORDER MSB_LAST FORMAT "%5.3" /end MEASUREMENT
/begin MEASUREMENT p_ctl_egy_[3] "proportional part of closed loop energy controller (cylinder individual)" SWORD _CNV_A_R_LINEAR_____542_CM 1 0. -50. 49.99847412 DISPLAY_IDENTIFIER P_CTL_EGY__3_ ECU_ADDRESS 0x7fab10 BYTE_ORDER MSB_LAST FORMAT "%5.3" /end MEASUREMENT
/begin MEASUREMENT i_ctl_egy_[0] "integral part of closed loop energy controller (cylinder individual)" SWORD _CNV_A_R_LINEAR_____542_CM 1 0. -50. 49.99847412 DISPLAY_IDENTIFIER I_CTL_EGY__0_ ECU_ADDRESS 0x7fab12 BYTE_ORDER MSB_LAST FORMAT "%5.3" /end MEASUREMENT
/begin MEASUREMENT i_ctl_egy_[1] "integral part of closed loop energy controller (cylinder individual)" SWORD _CNV_A_R_LINEAR_____542_CM 1 0. -50. 49.99847412 DISPLAY_IDENTIFIER I_CTL_EGY__1_ ECU_ADDRESS 0x7fab14 BYTE_ORDER MSB_LAST FORMAT "%5.3" /end MEASUREMENT
/begin MEASUREMENT i_ctl_egy_[2] "integral part of closed loop energy controller (cylinder individual)" SWORD _CNV_A_R_LINEAR_____542_CM 1 0. -50. 49.99847412 DISPLAY_IDENTIFIER I_CTL_EGY__2_ ECU_ADDRESS 0x7fab16 BYTE_ORDER MSB_LAST FORMAT "%5.3" /end MEASUREMENT
/begin MEASUREMENT i_ctl_egy_[3] "integral part of closed loop energy controller (cylinder individual)" SWORD _CNV_A_R_LINEAR_____542_CM 1 0. -50. 49.99847412 DISPLAY_IDENTIFIER I_CTL_EGY__3_ ECU_ADDRESS 0x7fab18 BYTE_ORDER MSB_LAST FORMAT "%5.3" /end MEASUREMENT
/begin MEASUREMENT sf_pi_ctl_egy_min "minimum limit of energy controller´s integrator reached" UWORD _CNV_A_R_LINEAR_____0_CM 1 0. 0. 65535. DISPLAY_IDENTIFIER SF_PI_CTL_EGY_MIN ECU_ADDRESS 0x7faade BYTE_ORDER MSB_LAST FORMAT "%5.0" /end MEASUREMENT
/begin MEASUREMENT egy_inj_dif_[0] "energy controller deviation = set point - controlled variable (cylinder individual)" SWORD _CNV_A_R_LINEAR_____543_CM 1 0. -261.3875315 261.3875315 DISPLAY_IDENTIFIER EGY_INJ_DIF__0_ ECU_ADDRESS 0x7fab1a BYTE_ORDER MSB_LAST /end MEASUREMENT
/begin MEASUREMENT egy_inj_dif_[1] "energy controller deviation = set point - controlled variable (cylinder individual)" SWORD _CNV_A_R_LINEAR_____543_CM 1 0. -261.3875315 261.3875315 DISPLAY_IDENTIFIER EGY_INJ_DIF__1_ ECU_ADDRESS 0x7fab1c BYTE_ORDER MSB_LAST /end MEASUREMENT
/begin MEASUREMENT egy_inj_dif_[2] "energy controller deviation = set point - controlled variable (cylinder individual)" SWORD _CNV_A_R_LINEAR_____543_CM 1 0. -261.3875315 261.3875315 DISPLAY_IDENTIFIER EGY_INJ_DIF__2_ ECU_ADDRESS 0x7fab1e BYTE_ORDER MSB_LAST /end MEASUREMENT
/begin MEASUREMENT egy_inj_dif_[3] "energy controller deviation = set point - controlled variable (cylinder individual)" SWORD _CNV_A_R_LINEAR_____543_CM 1 0. -261.3875315 261.3875315 DISPLAY_IDENTIFIER EGY_INJ_DIF__3_ ECU_ADDRESS 0x7fab20 BYTE_ORDER MSB_LAST /end MEASUREMENT
/begin CHARACTERISTIC c_egy_inj_sp_man_[0] "" VALUE 0x84fcda _REC_VAL_20_u2 522.7750632 _CNV_A_R_LINEAR_____541_CM 0. 522.7750632 DISPLAY_IDENTIFIER C_EGY_INJ_SP_MAN__0_ /end CHARACTERISTIC
/begin CHARACTERISTIC c_egy_inj_sp_man_[1] "" VALUE 0x84fcdc _REC_VAL_20_u2 522.7750632 _CNV_A_R_LINEAR_____541_CM 0. 522.7750632 DISPLAY_IDENTIFIER C_EGY_INJ_SP_MAN__1_ /end CHARACTERISTIC
/begin CHARACTERISTIC c_egy_inj_sp_man_[2] "" VALUE 0x84fcde _REC_VAL_20_u2 522.7750632 _CNV_A_R_LINEAR_____541_CM 0. 522.7750632 DISPLAY_IDENTIFIER C_EGY_INJ_SP_MAN__2_ /end CHARACTERISTIC
/begin CHARACTERISTIC c_egy_inj_sp_man_[3] "" VALUE 0x84fce0 _REC_VAL_20_u2 522.7750632 _CNV_A_R_LINEAR_____541_CM 0. 522.7750632 DISPLAY_IDENTIFIER C_EGY_INJ_SP_MAN__3_ /end CHARACTERISTIC
/begin CHARACTERISTIC c_egy_inj_sp_max "energy injection set point maximum" VALUE 0x84fce2 _REC_VAL_20_u2 522.7750632 _CNV_A_R_LINEAR_____541_CM 0. 522.7750632 DISPLAY_IDENTIFIER C_EGY_INJ_SP_MAX /end CHARACTERISTIC
/begin CHARACTERISTIC c_egy_inj_sp_min "energy injection set point minimum" VALUE 0x84fce4 _REC_VAL_20_u2 522.7750632 _CNV_A_R_LINEAR_____541_CM 0. 522.7750632 DISPLAY_IDENTIFIER C_EGY_INJ_SP_MIN /end CHARACTERISTIC
/begin CHARACTERISTIC c_fac_pwm_dcha_pwm_cha "amplification between PPS PWM_DCHA and PWM_CHA" VALUE 0x84fd44 _REC_VAL_20_s2 3.999939 _CNV_A_R_LINEAR_____408_CM -2. 1.999939 DISPLAY_IDENTIFIER C_FAC_PWM_DCHA_PWM_CHA FORMAT "%6.5" /end CHARACTERISTIC
/begin CHARACTERISTIC c_kr_pi_egy_ctl "PI energy controller amplification" VALUE 0x84fd7a _REC_VAL_20_s2 199.996948242 _CNV_A_R_LINEAR_____544_CM -100. 99.996948242 DISPLAY_IDENTIFIER C_KR_PI_EGY_CTL FORMAT "%5.3" /end CHARACTERISTIC
/begin CHARACTERISTIC c_lim_pi_egy_ctl_max "energy control error integrator max limit" VALUE 0x84fda4 _REC_VAL_20_u2 49.99847400000001 _CNV_A_R_LINEAR_____545_CM 0. 49.998474 DISPLAY_IDENTIFIER C_LIM_PI_EGY_CTL_MAX FORMAT "%5.3" /end CHARACTERISTIC
/begin CHARACTERISTIC c_lim_pi_egy_ctl_min "energy control error integrator min limit" VALUE 0x84fda6 _REC_VAL_20_s2 50. _CNV_A_R_LINEAR_____546_CM -50. 0. DISPLAY_IDENTIFIER C_LIM_PI_EGY_CTL_MIN FORMAT "%4.3" /end CHARACTERISTIC
/begin CHARACTERISTIC c_lim_pwm_cha_err_ctl_max "energy control error output max limit" VALUE 0x84fdb0 _REC_VAL_20_u2 49.99847400000001 _CNV_A_R_LINEAR_____545_CM 0. 49.998474 DISPLAY_IDENTIFIER C_LIM_PWM_CHA_ERR_CTL_MAX FORMAT "%5.3" /end CHARACTERISTIC
/begin CHARACTERISTIC c_lim_pwm_cha_err_ctl_min "energy control error output min limit" VALUE 0x84fdb2 _REC_VAL_20_s2 50. _CNV_A_R_LINEAR_____546_CM -50. 0. DISPLAY_IDENTIFIER C_LIM_PWM_CHA_ERR_CTL_MIN FORMAT "%4.3" /end CHARACTERISTIC
/begin CHARACTERISTIC c_pwm_cha_ini_[0] "" VALUE 0x84fec2 _REC_VAL_20_u2 99.99847412109381 _CNV_A_R_LINEAR_____8_CM 0. 99.99847412109381 DISPLAY_IDENTIFIER C_PWM_CHA_INI__0_ FORMAT "%5.3" /end CHARACTERISTIC
/begin CHARACTERISTIC c_pwm_cha_ini_[1] "" VALUE 0x84fec4 _REC_VAL_20_u2 99.99847412109381 _CNV_A_R_LINEAR_____8_CM 0. 99.99847412109381 DISPLAY_IDENTIFIER C_PWM_CHA_INI__1_ FORMAT "%5.3" /end CHARACTERISTIC
/begin CHARACTERISTIC c_pwm_cha_ini_[2] "" VALUE 0x84fec6 _REC_VAL_20_u2 99.99847412109381 _CNV_A_R_LINEAR_____8_CM 0. 99.99847412109381 DISPLAY_IDENTIFIER C_PWM_CHA_INI__2_ FORMAT "%5.3" /end CHARACTERISTIC
/begin CHARACTERISTIC c_pwm_cha_ini_[3] "" VALUE 0x84fec8 _REC_VAL_20_u2 99.99847412109381 _CNV_A_R_LINEAR_____8_CM 0. 99.99847412109381 DISPLAY_IDENTIFIER C_PWM_CHA_INI__3_ FORMAT "%5.3" /end CHARACTERISTIC
/begin CHARACTERISTIC c_pwm_cha_max "PPS charging PWM output maximum" VALUE 0x84feca _REC_VAL_20_u2 99.99847412109381 _CNV_A_R_LINEAR_____8_CM 0. 99.99847412109381 DISPLAY_IDENTIFIER C_PWM_CHA_MAX FORMAT "%5.3" /end CHARACTERISTIC
/begin CHARACTERISTIC c_pwm_cha_min "PPS charging PWM output minimum" VALUE 0x84fecc _REC_VAL_20_u2 99.99847412109381 _CNV_A_R_LINEAR_____8_CM 0. 99.99847412109381 DISPLAY_IDENTIFIER C_PWM_CHA_MIN FORMAT "%5.3" /end CHARACTERISTIC
/begin CHARACTERISTIC c_pwm_dcha_man_[0] "" VALUE 0x84fece _REC_VAL_20_u2 99.99847412109381 _CNV_A_R_LINEAR_____8_CM 0. 99.99847412109381 DISPLAY_IDENTIFIER C_PWM_DCHA_MAN__0_ FORMAT "%5.3" /end CHARACTERISTIC
/begin CHARACTERISTIC c_pwm_dcha_man_[1] "" VALUE 0x84fed0 _REC_VAL_20_u2 99.99847412109381 _CNV_A_R_LINEAR_____8_CM 0. 99.99847412109381 DISPLAY_IDENTIFIER C_PWM_DCHA_MAN__1_ FORMAT "%5.3" /end CHARACTERISTIC
/begin CHARACTERISTIC c_pwm_dcha_man_[2] "" VALUE 0x84fed2 _REC_VAL_20_u2 99.99847412109381 _CNV_A_R_LINEAR_____8_CM 0. 99.99847412109381 DISPLAY_IDENTIFIER C_PWM_DCHA_MAN__2_ FORMAT "%5.3" /end CHARACTERISTIC
/begin CHARACTERISTIC c_pwm_dcha_man_[3] "" VALUE 0x84fed4 _REC_VAL_20_u2 99.99847412109381 _CNV_A_R_LINEAR_____8_CM 0. 99.99847412109381 DISPLAY_IDENTIFIER C_PWM_DCHA_MAN__3_ FORMAT "%5.3" /end CHARACTERISTIC
/begin CHARACTERISTIC c_pwm_dcha_max "PPS discharging PWM output maximum" VALUE 0x84fed6 _REC_VAL_20_u2 99.99847412109381 _CNV_A_R_LINEAR_____8_CM 0. 99.99847412109381 DISPLAY_IDENTIFIER C_PWM_DCHA_MAX FORMAT "%5.3" /end CHARACTERISTIC
/begin CHARACTERISTIC c_pwm_dcha_min "PPS discharging PWM output minimum" VALUE 0x84fed8 _REC_VAL_20_u2 99.99847412109381 _CNV_A_R_LINEAR_____8_CM 0. 99.99847412109381 DISPLAY_IDENTIFIER C_PWM_DCHA_MIN FORMAT "%5.3" /end CHARACTERISTIC
/begin CHARACTERISTIC c_pwm_dcha_ofs "offset between PPS PWM_DCHA and PWM_CHA" VALUE 0x84feda _REC_VAL_20_s2 99.99847412 _CNV_A_R_LINEAR_____547_CM -50. 49.99847412 DISPLAY_IDENTIFIER C_PWM_DCHA_OFS FORMAT "%5.3" /end CHARACTERISTIC
/begin CHARACTERISTIC lc_dcha_ctl_on "switch PPS discharge control on" VALUE 0x850112 _REC_VAL_20_u1 1. _CNV_A_R_LINEAR_____0_CM 0. 1. DISPLAY_IDENTIFIER LC_DCHA_CTL_ON FORMAT "%1.0" /end CHARACTERISTIC
/begin CHARACTERISTIC lc_egy_ctl_on "switch PPS energy control on" VALUE 0x85011f _REC_VAL_20_u1 1. _CNV_A_R_LINEAR_____0_CM 0. 1. DISPLAY_IDENTIFIER LC_EGY_CTL_ON FORMAT "%1.0" /end CHARACTERISTIC
/begin CHARACTERISTIC lc_egy_inj_sp_man "force PPS energy control manual set point" VALUE 0x850120 _REC_VAL_20_u1 1. _CNV_A_R_LINEAR_____0_CM 0. 1. DISPLAY_IDENTIFIER LC_EGY_INJ_SP_MAN FORMAT "%1.0" /end CHARACTERISTIC
/begin CHARACTERISTIC id_fac_egy_inj_sp_cor__t_cha "PECO_ENCO: correction factor for energy setpoint" CURVE 0x8444e4 _REC_CUR_20_u2_u2 1.9999696 _CNV_A_R_LINEAR_____48_CM 0. 1.9999696 DISPLAY_IDENTIFIER ID_FAC_EGY_INJ_SP_COR__T_CHA FORMAT "%6.5"
 /begin AXIS_DESCR COM_AXIS dummy_peco _CNV_A_R_LINEAR_____211_CM 28 0. 32.767 FORMAT "%5.3" AXIS_PTS_REF ldp_t_cha_id_fac_egy_inj_sp_cor /end AXIS_DESCR
/end CHARACTERISTIC
/begin AXIS_PTS ldp_t_cha_id_fac_egy_inj_sp_cor "" 0x8421f8 dummy_peco _REC_AXS_20_u2 32.767 _CNV_A_R_LINEAR_____211_CM 28 0. 32.767 FORMAT "%5.3" /end AXIS_PTS
/begin CHARACTERISTIC ip_pwm_cha_pctl__egy "PECO_ENCO: amplification between PPS PWM_CHA and energy set point" CURVE 0x84d5e6 _REC_CUR_20_u2_u2 99.99847412109381 _CNV_A_R_LINEAR_____8_CM 0. 99.99847412109381 DISPLAY_IDENTIFIER IP_PWM_CHA_PCTL__EGY FORMAT "%6.5"
 /begin AXIS_DESCR COM_AXIS dummy_peco _CNV_A_R_LINEAR_____541_CM 6 0. 522.7750632 AXIS_PTS_REF ldp_egy_ip_pwm_cha_pctl /end AXIS_DESCR
/end CHARACTERISTIC
/begin AXIS_PTS ldp_egy_ip_pwm_cha_pctl "" 0x841684 dummy_peco _REC_AXS_20_u2 522.7750632 _CNV_A_R_LINEAR_____541_CM 6 0. 522.7750632 /end AXIS_PTS
/begin CHARACTERISTIC ip_tn_pi_neg_egy_ctl__n "PECO_ENCO: negative TN of energy PI controller" CURVE 0x84f5de _REC_CUR_20_u2_u2 3276.7 _CNV_A_R_LINEAR_____548_CM 0. 3276.7 DISPLAY_IDENTIFIER IP_TN_PI_NEG_EGY_CTL__N FORMAT "%5.1"
 /begin AXIS_DESCR COM_AXIS n _CNV_A_R_LINEAR_____5_CM 10 0. 6375. FORMAT "%4.0" AXIS_PTS_REF ldpm_n_ip_tn_pi_egy_ctl /end AXIS_DESCR
/end CHARACTERISTIC
/begin AXIS_PTS ldpm_n_ip_tn_pi_egy_ctl "" 0x843560 n _REC_AXS_20_u2 6375. _CNV_A_R_LINEAR_____5_CM 10 0. 6375. FORMAT "%4.0" /end AXIS_PTS
/begin CHARACTERISTIC ip_tn_pi_pos_egy_ctl__n "PECO_ENCO: positive TN of energy PI controller" CURVE 0x84f62e _REC_CUR_20_u2_u2 3276.7 _CNV_A_R_LINEAR_____548_CM 0. 3276.7 DISPLAY_IDENTIFIER IP_TN_PI_POS_EGY_CTL__N FORMAT "%5.1"
 /begin AXIS_DESCR COM_AXIS n _CNV_A_R_LINEAR_____5_CM 10 0. 6375. FORMAT "%4.0" AXIS_PTS_REF ldpm_n_ip_tn_pi_egy_ctl /end AXIS_DESCR
/end CHARACTERISTIC
/begin CHARACTERISTIC ip_t_eoi_ofs_ctl__pwm "PECO_ENCO: EOI correction depending on PWM_DCHA" CURVE 0x84ee06 _REC_CUR_20_u2_u2 65.535 _CNV_A_R_LINEAR_____549_CM -32.768 32.767 DISPLAY_IDENTIFIER IP_T_EOI_OFS_CTL__PWM FORMAT "%5.3"
 /begin AXIS_DESCR COM_AXIS dummy_peco _CNV_A_R_LINEAR_____8_CM 10 0. 99.99847412109381 FORMAT "%5.3" AXIS_PTS_REF ldp_pwm_ip_t_eoi_ofs_ctl /end AXIS_DESCR
/end CHARACTERISTIC
/begin AXIS_PTS ldp_pwm_ip_t_eoi_ofs_ctl "" 0x8420f8 dummy_peco _REC_AXS_20_u2 99.99847412109381 _CNV_A_R_LINEAR_____8_CM 10 0. 99.99847412109381 FORMAT "%5.3" /end AXIS_PTS
/begin CHARACTERISTIC c_fac_eoi_ofs_ctl_[0] "amplification of t_soi_ofs_ctl_ to calculate t_eoi_ofs_ctl" VALUE 0x84fd1e _REC_VAL_20_s2 7.96875 _CNV_A_R_LINEAR_____550_CM -4. 3.96875 DISPLAY_IDENTIFIER C_FAC_EOI_OFS_CTL__0_ FORMAT "%6.5" /end CHARACTERISTIC
/begin CHARACTERISTIC c_fac_eoi_ofs_ctl_[1] "amplification of t_soi_ofs_ctl_ to calculate t_eoi_ofs_ctl" VALUE 0x84fd20 _REC_VAL_20_s2 7.96875 _CNV_A_R_LINEAR_____550_CM -4. 3.96875 DISPLAY_IDENTIFIER C_FAC_EOI_OFS_CTL__1_ FORMAT "%6.5" /end CHARACTERISTIC
/begin CHARACTERISTIC c_fac_eoi_ofs_ctl_[2] "amplification of t_soi_ofs_ctl_ to calculate t_eoi_ofs_ctl" VALUE 0x84fd22 _REC_VAL_20_s2 7.96875 _CNV_A_R_LINEAR_____550_CM -4. 3.96875 DISPLAY_IDENTIFIER C_FAC_EOI_OFS_CTL__2_ FORMAT "%6.5" /end CHARACTERISTIC
/begin CHARACTERISTIC c_fac_eoi_ofs_ctl_[3] "amplification of t_soi_ofs_ctl_ to calculate t_eoi_ofs_ctl" VALUE 0x84fd24 _REC_VAL_20_s2 7.96875 _CNV_A_R_LINEAR_____550_CM -4. 3.96875 DISPLAY_IDENTIFIER C_FAC_EOI_OFS_CTL__3_ FORMAT "%6.5" /end CHARACTERISTIC
/begin CHARACTERISTIC lc_egy_sp_cor_on "switch on/off energy setpoint correction" VALUE 0x850121 _REC_VAL_20_u1 1. _CNV_A_R_LINEAR_____0_CM 0. 1. DISPLAY_IDENTIFIER LC_EGY_SP_COR_ON FORMAT "%1.0" /end CHARACTERISTIC
/begin MEASUREMENT v_inj_burst_act_max_[1] "injector voltage at last point (cylinder individual)" UWORD _CNV_A_R_LINEAR_____121_CM 1 0. 0. 255. DISPLAY_IDENTIFIER V_INJ_BURST_ACT_MAX__1_ ECU_ADDRESS 0x7fadf0 BYTE_ORDER MSB_LAST FORMAT "%4.1" /end MEASUREMENT
/begin MEASUREMENT v_inj_burst_act_max_[2] "injector voltage at last point (cylinder individual)" UWORD _CNV_A_R_LINEAR_____121_CM 1 0. 0. 255. DISPLAY_IDENTIFIER V_INJ_BURST_ACT_MAX__2_ ECU_ADDRESS 0x7fadf2 BYTE_ORDER MSB_LAST FORMAT "%4.1" /end MEASUREMENT
/begin MEASUREMENT v_inj_burst_act_max_[3] "injector voltage at last point (cylinder individual)" UWORD _CNV_A_R_LINEAR_____121_CM 1 0. 0. 255. DISPLAY_IDENTIFIER V_INJ_BURST_ACT_MAX__3_ ECU_ADDRESS 0x7fadf4 BYTE_ORDER MSB_LAST FORMAT "%4.1" /end MEASUREMENT
/begin MEASUREMENT v_inj_burst_act_[0] "voltage burst signal (choosen for detection)" UWORD _CNV_A_R_LINEAR_____121_CM 1 0. 0. 255. DISPLAY_IDENTIFIER V_INJ_BURST_ACT__0_ ECU_ADDRESS 0x7fadf6 BYTE_ORDER MSB_LAST FORMAT "%4.1" /end MEASUREMENT
/begin MEASUREMENT v_inj_burst_act_[1] "voltage burst signal (choosen for detection)" UWORD _CNV_A_R_LINEAR_____121_CM 1 0. 0. 255. DISPLAY_IDENTIFIER V_INJ_BURST_ACT__1_ ECU_ADDRESS 0x7fadf8 BYTE_ORDER MSB_LAST FORMAT "%4.1" /end MEASUREMENT
/begin MEASUREMENT v_inj_burst_act_[2] "voltage burst signal (choosen for detection)" UWORD _CNV_A_R_LINEAR_____121_CM 1 0. 0. 255. DISPLAY_IDENTIFIER V_INJ_BURST_ACT__2_ ECU_ADDRESS 0x7fadfa BYTE_ORDER MSB_LAST FORMAT "%4.1" /end MEASUREMENT
/begin MEASUREMENT v_inj_burst_act_[3] "voltage burst signal (choosen for detection)" UWORD _CNV_A_R_LINEAR_____121_CM 1 0. 0. 255. DISPLAY_IDENTIFIER V_INJ_BURST_ACT__3_ ECU_ADDRESS 0x7fadfc BYTE_ORDER MSB_LAST FORMAT "%4.1" /end MEASUREMENT
/begin MEASUREMENT v_inj_burst_act_[4] "voltage burst signal (choosen for detection)" UWORD _CNV_A_R_LINEAR_____121_CM 1 0. 0. 255. DISPLAY_IDENTIFIER V_INJ_BURST_ACT__4_ ECU_ADDRESS 0x7fadfe BYTE_ORDER MSB_LAST FORMAT "%4.1" /end MEASUREMENT
/begin MEASUREMENT v_inj_burst_act_[5] "voltage burst signal (choosen for detection)" UWORD _CNV_A_R_LINEAR_____121_CM 1 0. 0. 255. DISPLAY_IDENTIFIER V_INJ_BURST_ACT__5_ ECU_ADDRESS 0x7fae00 BYTE_ORDER MSB_LAST FORMAT "%4.1" /end MEASUREMENT
/begin MEASUREMENT v_inj_burst_act_[6] "voltage burst signal (choosen for detection)" UWORD _CNV_A_R_LINEAR_____121_CM 1 0. 0. 255. DISPLAY_IDENTIFIER V_INJ_BURST_ACT__6_ ECU_ADDRESS 0x7fae02 BYTE_ORDER MSB_LAST FORMAT "%4.1" /end MEASUREMENT
/begin MEASUREMENT v_inj_burst_act_[7] "voltage burst signal (choosen for detection)" UWORD _CNV_A_R_LINEAR_____121_CM 1 0. 0. 255. DISPLAY_IDENTIFIER V_INJ_BURST_ACT__7_ ECU_ADDRESS 0x7fae04 BYTE_ORDER MSB_LAST FORMAT "%4.1" /end MEASUREMENT
/begin MEASUREMENT v_inj_burst_act_[8] "voltage burst signal (choosen for detection)" UWORD _CNV_A_R_LINEAR_____121_CM 1 0. 0. 255. DISPLAY_IDENTIFIER V_INJ_BURST_ACT__8_ ECU_ADDRESS 0x7fae06 BYTE_ORDER MSB_LAST FORMAT "%4.1" /end MEASUREMENT
/begin MEASUREMENT v_inj_burst_act_[9] "voltage burst signal (choosen for detection)" UWORD _CNV_A_R_LINEAR_____121_CM 1 0. 0. 255. DISPLAY_IDENTIFIER V_INJ_BURST_ACT__9_ ECU_ADDRESS 0x7fae08 BYTE_ORDER MSB_LAST FORMAT "%4.1" /end MEASUREMENT
/begin MEASUREMENT v_inj_burst_act_[10] "voltage burst signal (choosen for detection)" UWORD _CNV_A_R_LINEAR_____121_CM 1 0. 0. 255. DISPLAY_IDENTIFIER V_INJ_BURST_ACT__10_ ECU_ADDRESS 0x7fae0a BYTE_ORDER MSB_LAST FORMAT "%4.1" /end MEASUREMENT
/begin MEASUREMENT v_inj_burst_act_[11] "voltage burst signal (choosen for detection)" UWORD _CNV_A_R_LINEAR_____121_CM 1 0. 0. 255. DISPLAY_IDENTIFIER V_INJ_BURST_ACT__11_ ECU_ADDRESS 0x7fae0c BYTE_ORDER MSB_LAST FORMAT "%4.1" /end MEASUREMENT
/begin MEASUREMENT v_inj_burst_act_[12] "voltage burst signal (choosen for detection)" UWORD _CNV_A_R_LINEAR_____121_CM 1 0. 0. 255. DISPLAY_IDENTIFIER V_INJ_BURST_ACT__12_ ECU_ADDRESS 0x7fae0e BYTE_ORDER MSB_LAST FORMAT "%4.1" /end MEASUREMENT
/begin MEASUREMENT v_inj_burst_act_[13] "voltage burst signal (choosen for detection)" UWORD _CNV_A_R_LINEAR_____121_CM 1 0. 0. 255. DISPLAY_IDENTIFIER V_INJ_BURST_ACT__13_ ECU_ADDRESS 0x7fae10 BYTE_ORDER MSB_LAST FORMAT "%4.1" /end MEASUREMENT
/begin MEASUREMENT v_inj_burst_act_[14] "voltage burst signal (choosen for detection)" UWORD _CNV_A_R_LINEAR_____121_CM 1 0. 0. 255. DISPLAY_IDENTIFIER V_INJ_BURST_ACT__14_ ECU_ADDRESS 0x7fae12 BYTE_ORDER MSB_LAST FORMAT "%4.1" /end MEASUREMENT
/begin MEASUREMENT v_inj_burst_act_[15] "voltage burst signal (choosen for detection)" UWORD _CNV_A_R_LINEAR_____121_CM 1 0. 0. 255. DISPLAY_IDENTIFIER V_INJ_BURST_ACT__15_ ECU_ADDRESS 0x7fae14 BYTE_ORDER MSB_LAST FORMAT "%4.1" /end MEASUREMENT
/begin MEASUREMENT v_inj_burst_act_[16] "voltage burst signal (choosen for detection)" UWORD _CNV_A_R_LINEAR_____121_CM 1 0. 0. 255. DISPLAY_IDENTIFIER V_INJ_BURST_ACT__16_ ECU_ADDRESS 0x7fae16 BYTE_ORDER MSB_LAST FORMAT "%4.1" /end MEASUREMENT
/begin MEASUREMENT v_inj_burst_act_[17] "voltage burst signal (choosen for detection)" UWORD _CNV_A_R_LINEAR_____121_CM 1 0. 0. 255. DISPLAY_IDENTIFIER V_INJ_BURST_ACT__17_ ECU_ADDRESS 0x7fae18 BYTE_ORDER MSB_LAST FORMAT "%4.1" /end MEASUREMENT
/begin MEASUREMENT v_inj_burst_act_[18] "voltage burst signal (choosen for detection)" UWORD _CNV_A_R_LINEAR_____121_CM 1 0. 0. 255. DISPLAY_IDENTIFIER V_INJ_BURST_ACT__18_ ECU_ADDRESS 0x7fae1a BYTE_ORDER MSB_LAST FORMAT "%4.1" /end MEASUREMENT
/begin MEASUREMENT v_inj_burst_act_[19] "voltage burst signal (choosen for detection)" UWORD _CNV_A_R_LINEAR_____121_CM 1 0. 0. 255. DISPLAY_IDENTIFIER V_INJ_BURST_ACT__19_ ECU_ADDRESS 0x7fae1c BYTE_ORDER MSB_LAST FORMAT "%4.1" /end MEASUREMENT
/begin MEASUREMENT v_inj_burst_act_[20] "voltage burst signal (choosen for detection)" UWORD _CNV_A_R_LINEAR_____121_CM 1 0. 0. 255. DISPLAY_IDENTIFIER V_INJ_BURST_ACT__20_ ECU_ADDRESS 0x7fae1e BYTE_ORDER MSB_LAST FORMAT "%4.1" /end MEASUREMENT
/begin MEASUREMENT v_inj_burst_act_[21] "voltage burst signal (choosen for detection)" UWORD _CNV_A_R_LINEAR_____121_CM 1 0. 0. 255. DISPLAY_IDENTIFIER V_INJ_BURST_ACT__21_ ECU_ADDRESS 0x7fae20 BYTE_ORDER MSB_LAST FORMAT "%4.1" /end MEASUREMENT
/begin MEASUREMENT v_inj_burst_act_[22] "voltage burst signal (choosen for detection)" UWORD _CNV_A_R_LINEAR_____121_CM 1 0. 0. 255. DISPLAY_IDENTIFIER V_INJ_BURST_ACT__22_ ECU_ADDRESS 0x7fae22 BYTE_ORDER MSB_LAST FORMAT "%4.1" /end MEASUREMENT
/begin MEASUREMENT v_inj_burst_act_[23] "voltage burst signal (choosen for detection)" UWORD _CNV_A_R_LINEAR_____121_CM 1 0. 0. 255. DISPLAY_IDENTIFIER V_INJ_BURST_ACT__23_ ECU_ADDRESS 0x7fae24 BYTE_ORDER MSB_LAST FORMAT "%4.1" /end MEASUREMENT
/begin MEASUREMENT v_inj_burst_act_[24] "voltage burst signal (choosen for detection)" UWORD _CNV_A_R_LINEAR_____121_CM 1 0. 0. 255. DISPLAY_IDENTIFIER V_INJ_BURST_ACT__24_ ECU_ADDRESS 0x7fae26 BYTE_ORDER MSB_LAST FORMAT "%4.1" /end MEASUREMENT
/begin MEASUREMENT v_inj_burst_act_[25] "voltage burst signal (choosen for detection)" UWORD _CNV_A_R_LINEAR_____121_CM 1 0. 0. 255. DISPLAY_IDENTIFIER V_INJ_BURST_ACT__25_ ECU_ADDRESS 0x7fae28 BYTE_ORDER MSB_LAST FORMAT "%4.1" /end MEASUREMENT
/begin MEASUREMENT v_inj_burst_act_[26] "voltage burst signal (choosen for detection)" UWORD _CNV_A_R_LINEAR_____121_CM 1 0. 0. 255. DISPLAY_IDENTIFIER V_INJ_BURST_ACT__26_ ECU_ADDRESS 0x7fae2a BYTE_ORDER MSB_LAST FORMAT "%4.1" /end MEASUREMENT
/begin MEASUREMENT v_inj_burst_act_[27] "voltage burst signal (choosen for detection)" UWORD _CNV_A_R_LINEAR_____121_CM 1 0. 0. 255. DISPLAY_IDENTIFIER V_INJ_BURST_ACT__27_ ECU_ADDRESS 0x7fae2c BYTE_ORDER MSB_LAST FORMAT "%4.1" /end MEASUREMENT
/begin MEASUREMENT v_inj_burst_act_[28] "voltage burst signal (choosen for detection)" UWORD _CNV_A_R_LINEAR_____121_CM 1 0. 0. 255. DISPLAY_IDENTIFIER V_INJ_BURST_ACT__28_ ECU_ADDRESS 0x7fae2e BYTE_ORDER MSB_LAST FORMAT "%4.1" /end MEASUREMENT
/begin MEASUREMENT v_inj_burst_act_[29] "voltage burst signal (choosen for detection)" UWORD _CNV_A_R_LINEAR_____121_CM 1 0. 0. 255. DISPLAY_IDENTIFIER V_INJ_BURST_ACT__29_ ECU_ADDRESS 0x7fae30 BYTE_ORDER MSB_LAST FORMAT "%4.1" /end MEASUREMENT
/begin MEASUREMENT v_inj_burst_act_[30] "voltage burst signal (choosen for detection)" UWORD _CNV_A_R_LINEAR_____121_CM 1 0. 0. 255. DISPLAY_IDENTIFIER V_INJ_BURST_ACT__30_ ECU_ADDRESS 0x7fae32 BYTE_ORDER MSB_LAST FORMAT "%4.1" /end MEASUREMENT
/begin MEASUREMENT v_inj_burst_act_[31] "voltage burst signal (choosen for detection)" UWORD _CNV_A_R_LINEAR_____121_CM 1 0. 0. 255. DISPLAY_IDENTIFIER V_INJ_BURST_ACT__31_ ECU_ADDRESS 0x7fae34 BYTE_ORDER MSB_LAST FORMAT "%4.1" /end MEASUREMENT
/begin MEASUREMENT v_inj_burst_act_[32] "voltage burst signal (choosen for detection)" UWORD _CNV_A_R_LINEAR_____121_CM 1 0. 0. 255. DISPLAY_IDENTIFIER V_INJ_BURST_ACT__32_ ECU_ADDRESS 0x7fae36 BYTE_ORDER MSB_LAST FORMAT "%4.1" /end MEASUREMENT
/begin MEASUREMENT v_inj_burst_act_[33] "voltage burst signal (choosen for detection)" UWORD _CNV_A_R_LINEAR_____121_CM 1 0. 0. 255. DISPLAY_IDENTIFIER V_INJ_BURST_ACT__33_ ECU_ADDRESS 0x7fae38 BYTE_ORDER MSB_LAST FORMAT "%4.1" /end MEASUREMENT
/begin MEASUREMENT v_inj_burst_act_[34] "voltage burst signal (choosen for detection)" UWORD _CNV_A_R_LINEAR_____121_CM 1 0. 0. 255. DISPLAY_IDENTIFIER V_INJ_BURST_ACT__34_ ECU_ADDRESS 0x7fae3a BYTE_ORDER MSB_LAST FORMAT "%4.1" /end MEASUREMENT
/begin MEASUREMENT v_inj_burst_act_[35] "voltage burst signal (choosen for detection)" UWORD _CNV_A_R_LINEAR_____121_CM 1 0. 0. 255. DISPLAY_IDENTIFIER V_INJ_BURST_ACT__35_ ECU_ADDRESS 0x7fae3c BYTE_ORDER MSB_LAST FORMAT "%4.1" /end MEASUREMENT
/begin MEASUREMENT v_inj_burst_act_[36] "voltage burst signal (choosen for detection)" UWORD _CNV_A_R_LINEAR_____121_CM 1 0. 0. 255. DISPLAY_IDENTIFIER V_INJ_BURST_ACT__36_ ECU_ADDRESS 0x7fae3e BYTE_ORDER MSB_LAST FORMAT "%4.1" /end MEASUREMENT
/begin MEASUREMENT v_inj_burst_act_[37] "voltage burst signal (choosen for detection)" UWORD _CNV_A_R_LINEAR_____121_CM 1 0. 0. 255. DISPLAY_IDENTIFIER V_INJ_BURST_ACT__37_ ECU_ADDRESS 0x7fae40 BYTE_ORDER MSB_LAST FORMAT "%4.1" /end MEASUREMENT
/begin MEASUREMENT v_inj_burst_act_[38] "voltage burst signal (choosen for detection)" UWORD _CNV_A_R_LINEAR_____121_CM 1 0. 0. 255. DISPLAY_IDENTIFIER V_INJ_BURST_ACT__38_ ECU_ADDRESS 0x7fae42 BYTE_ORDER MSB_LAST FORMAT "%4.1" /end MEASUREMENT
/begin MEASUREMENT v_inj_burst_act_[39] "voltage burst signal (choosen for detection)" UWORD _CNV_A_R_LINEAR_____121_CM 1 0. 0. 255. DISPLAY_IDENTIFIER V_INJ_BURST_ACT__39_ ECU_ADDRESS 0x7fae44 BYTE_ORDER MSB_LAST FORMAT "%4.1" /end MEASUREMENT
/begin MEASUREMENT v_inj_burst_act_[40] "voltage burst signal (choosen for detection)" UWORD _CNV_A_R_LINEAR_____121_CM 1 0. 0. 255. DISPLAY_IDENTIFIER V_INJ_BURST_ACT__40_ ECU_ADDRESS 0x7fae46 BYTE_ORDER MSB_LAST FORMAT "%4.1" /end MEASUREMENT
/begin MEASUREMENT v_inj_burst_act_[41] "voltage burst signal (choosen for detection)" UWORD _CNV_A_R_LINEAR_____121_CM 1 0. 0. 255. DISPLAY_IDENTIFIER V_INJ_BURST_ACT__41_ ECU_ADDRESS 0x7fae48 BYTE_ORDER MSB_LAST FORMAT "%4.1" /end MEASUREMENT
/begin MEASUREMENT v_inj_burst_act_[42] "voltage burst signal (choosen for detection)" UWORD _CNV_A_R_LINEAR_____121_CM 1 0. 0. 255. DISPLAY_IDENTIFIER V_INJ_BURST_ACT__42_ ECU_ADDRESS 0x7fae4a BYTE_ORDER MSB_LAST FORMAT "%4.1" /end MEASUREMENT
/begin MEASUREMENT v_inj_burst_act_[43] "voltage burst signal (choosen for detection)" UWORD _CNV_A_R_LINEAR_____121_CM 1 0. 0. 255. DISPLAY_IDENTIFIER V_INJ_BURST_ACT__43_ ECU_ADDRESS 0x7fae4c BYTE_ORDER MSB_LAST FORMAT "%4.1" /end MEASUREMENT
/begin MEASUREMENT v_inj_burst_act_[44] "voltage burst signal (choosen for detection)" UWORD _CNV_A_R_LINEAR_____121_CM 1 0. 0. 255. DISPLAY_IDENTIFIER V_INJ_BURST_ACT__44_ ECU_ADDRESS 0x7fae4e BYTE_ORDER MSB_LAST FORMAT "%4.1" /end MEASUREMENT
/begin MEASUREMENT v_inj_burst_act_[45] "voltage burst signal (choosen for detection)" UWORD _CNV_A_R_LINEAR_____121_CM 1 0. 0. 255. DISPLAY_IDENTIFIER V_INJ_BURST_ACT__45_ ECU_ADDRESS 0x7fae50 BYTE_ORDER MSB_LAST FORMAT "%4.1" /end MEASUREMENT
/begin MEASUREMENT v_inj_burst_act_[46] "voltage burst signal (choosen for detection)" UWORD _CNV_A_R_LINEAR_____121_CM 1 0. 0. 255. DISPLAY_IDENTIFIER V_INJ_BURST_ACT__46_ ECU_ADDRESS 0x7fae52 BYTE_ORDER MSB_LAST FORMAT "%4.1" /end MEASUREMENT
/begin MEASUREMENT v_inj_burst_act_[47] "voltage burst signal (choosen for detection)" UWORD _CNV_A_R_LINEAR_____121_CM 1 0. 0. 255. DISPLAY_IDENTIFIER V_INJ_BURST_ACT__47_ ECU_ADDRESS 0x7fae54 BYTE_ORDER MSB_LAST FORMAT "%4.1" /end MEASUREMENT
/begin MEASUREMENT v_inj_burst_act_[48] "voltage burst signal (choosen for detection)" UWORD _CNV_A_R_LINEAR_____121_CM 1 0. 0. 255. DISPLAY_IDENTIFIER V_INJ_BURST_ACT__48_ ECU_ADDRESS 0x7fae56 BYTE_ORDER MSB_LAST FORMAT "%4.1" /end MEASUREMENT
/begin MEASUREMENT v_inj_burst_act_[49] "voltage burst signal (choosen for detection)" UWORD _CNV_A_R_LINEAR_____121_CM 1 0. 0. 255. DISPLAY_IDENTIFIER V_INJ_BURST_ACT__49_ ECU_ADDRESS 0x7fae58 BYTE_ORDER MSB_LAST FORMAT "%4.1" /end MEASUREMENT
/begin MEASUREMENT v_inj_burst_act_[50] "voltage burst signal (choosen for detection)" UWORD _CNV_A_R_LINEAR_____121_CM 1 0. 0. 255. DISPLAY_IDENTIFIER V_INJ_BURST_ACT__50_ ECU_ADDRESS 0x7fae5a BYTE_ORDER MSB_LAST FORMAT "%4.1" /end MEASUREMENT
/begin MEASUREMENT v_inj_burst_act_[51] "voltage burst signal (choosen for detection)" UWORD _CNV_A_R_LINEAR_____121_CM 1 0. 0. 255. DISPLAY_IDENTIFIER V_INJ_BURST_ACT__51_ ECU_ADDRESS 0x7fae5c BYTE_ORDER MSB_LAST FORMAT "%4.1" /end MEASUREMENT
/begin MEASUREMENT v_inj_burst_act_[52] "voltage burst signal (choosen for detection)" UWORD _CNV_A_R_LINEAR_____121_CM 1 0. 0. 255. DISPLAY_IDENTIFIER V_INJ_BURST_ACT__52_ ECU_ADDRESS 0x7fae5e BYTE_ORDER MSB_LAST FORMAT "%4.1" /end MEASUREMENT
/begin MEASUREMENT v_inj_burst_act_[53] "voltage burst signal (choosen for detection)" UWORD _CNV_A_R_LINEAR_____121_CM 1 0. 0. 255. DISPLAY_IDENTIFIER V_INJ_BURST_ACT__53_ ECU_ADDRESS 0x7fae60 BYTE_ORDER MSB_LAST FORMAT "%4.1" /end MEASUREMENT
/begin MEASUREMENT v_inj_burst_act_[54] "voltage burst signal (choosen for detection)" UWORD _CNV_A_R_LINEAR_____121_CM 1 0. 0. 255. DISPLAY_IDENTIFIER V_INJ_BURST_ACT__54_ ECU_ADDRESS 0x7fae62 BYTE_ORDER MSB_LAST FORMAT "%4.1" /end MEASUREMENT
/begin MEASUREMENT v_inj_burst_act_[55] "voltage burst signal (choosen for detection)" UWORD _CNV_A_R_LINEAR_____121_CM 1 0. 0. 255. DISPLAY_IDENTIFIER V_INJ_BURST_ACT__55_ ECU_ADDRESS 0x7fae64 BYTE_ORDER MSB_LAST FORMAT "%4.1" /end MEASUREMENT
/begin MEASUREMENT v_inj_burst_act_[56] "voltage burst signal (choosen for detection)" UWORD _CNV_A_R_LINEAR_____121_CM 1 0. 0. 255. DISPLAY_IDENTIFIER V_INJ_BURST_ACT__56_ ECU_ADDRESS 0x7fae66 BYTE_ORDER MSB_LAST FORMAT "%4.1" /end MEASUREMENT
/begin MEASUREMENT v_inj_burst_act_[57] "voltage burst signal (choosen for detection)" UWORD _CNV_A_R_LINEAR_____121_CM 1 0. 0. 255. DISPLAY_IDENTIFIER V_INJ_BURST_ACT__57_ ECU_ADDRESS 0x7fae68 BYTE_ORDER MSB_LAST FORMAT "%4.1" /end MEASUREMENT
/begin MEASUREMENT v_inj_burst_act_[58] "voltage burst signal (choosen for detection)" UWORD _CNV_A_R_LINEAR_____121_CM 1 0. 0. 255. DISPLAY_IDENTIFIER V_INJ_BURST_ACT__58_ ECU_ADDRESS 0x7fae6a BYTE_ORDER MSB_LAST FORMAT "%4.1" /end MEASUREMENT
/begin MEASUREMENT v_inj_burst_act_[59] "voltage burst signal (choosen for detection)" UWORD _CNV_A_R_LINEAR_____121_CM 1 0. 0. 255. DISPLAY_IDENTIFIER V_INJ_BURST_ACT__59_ ECU_ADDRESS 0x7fae6c BYTE_ORDER MSB_LAST FORMAT "%4.1" /end MEASUREMENT
/begin MEASUREMENT v_inj_burst_act_[60] "voltage burst signal (choosen for detection)" UWORD _CNV_A_R_LINEAR_____121_CM 1 0. 0. 255. DISPLAY_IDENTIFIER V_INJ_BURST_ACT__60_ ECU_ADDRESS 0x7fae6e BYTE_ORDER MSB_LAST FORMAT "%4.1" /end MEASUREMENT
/begin MEASUREMENT v_inj_burst_act_[61] "voltage burst signal (choosen for detection)" UWORD _CNV_A_R_LINEAR_____121_CM 1 0. 0. 255. DISPLAY_IDENTIFIER V_INJ_BURST_ACT__61_ ECU_ADDRESS 0x7fae70 BYTE_ORDER MSB_LAST FORMAT "%4.1" /end MEASUREMENT
/begin MEASUREMENT v_inj_burst_act_[62] "voltage burst signal (choosen for detection)" UWORD _CNV_A_R_LINEAR_____121_CM 1 0. 0. 255. DISPLAY_IDENTIFIER V_INJ_BURST_ACT__62_ ECU_ADDRESS 0x7fae72 BYTE_ORDER MSB_LAST FORMAT "%4.1" /end MEASUREMENT
/begin MEASUREMENT v_inj_burst_act_[63] "voltage burst signal (choosen for detection)" UWORD _CNV_A_R_LINEAR_____121_CM 1 0. 0. 255. DISPLAY_IDENTIFIER V_INJ_BURST_ACT__63_ ECU_ADDRESS 0x7fae74 BYTE_ORDER MSB_LAST FORMAT "%4.1" /end MEASUREMENT
/begin MEASUREMENT v_inj_burst_act_[64] "voltage burst signal (choosen for detection)" UWORD _CNV_A_R_LINEAR_____121_CM 1 0. 0. 255. DISPLAY_IDENTIFIER V_INJ_BURST_ACT__64_ ECU_ADDRESS 0x7fae76 BYTE_ORDER MSB_LAST FORMAT "%4.1" /end MEASUREMENT
/begin MEASUREMENT v_inj_burst_act_[65] "voltage burst signal (choosen for detection)" UWORD _CNV_A_R_LINEAR_____121_CM 1 0. 0. 255. DISPLAY_IDENTIFIER V_INJ_BURST_ACT__65_ ECU_ADDRESS 0x7fae78 BYTE_ORDER MSB_LAST FORMAT "%4.1" /end MEASUREMENT
/begin MEASUREMENT v_inj_burst_act_[66] "voltage burst signal (choosen for detection)" UWORD _CNV_A_R_LINEAR_____121_CM 1 0. 0. 255. DISPLAY_IDENTIFIER V_INJ_BURST_ACT__66_ ECU_ADDRESS 0x7fae7a BYTE_ORDER MSB_LAST FORMAT "%4.1" /end MEASUREMENT
/begin MEASUREMENT v_inj_burst_act_[67] "voltage burst signal (choosen for detection)" UWORD _CNV_A_R_LINEAR_____121_CM 1 0. 0. 255. DISPLAY_IDENTIFIER V_INJ_BURST_ACT__67_ ECU_ADDRESS 0x7fae7c BYTE_ORDER MSB_LAST FORMAT "%4.1" /end MEASUREMENT
/begin MEASUREMENT v_inj_burst_act_[68] "voltage burst signal (choosen for detection)" UWORD _CNV_A_R_LINEAR_____121_CM 1 0. 0. 255. DISPLAY_IDENTIFIER V_INJ_BURST_ACT__68_ ECU_ADDRESS 0x7fae7e BYTE_ORDER MSB_LAST FORMAT "%4.1" /end MEASUREMENT
/begin MEASUREMENT v_inj_burst_act_[69] "voltage burst signal (choosen for detection)" UWORD _CNV_A_R_LINEAR_____121_CM 1 0. 0. 255. DISPLAY_IDENTIFIER V_INJ_BURST_ACT__69_ ECU_ADDRESS 0x7fae80 BYTE_ORDER MSB_LAST FORMAT "%4.1" /end MEASUREMENT
/begin MEASUREMENT v_inj_burst_act_[70] "voltage burst signal (choosen for detection)" UWORD _CNV_A_R_LINEAR_____121_CM 1 0. 0. 255. DISPLAY_IDENTIFIER V_INJ_BURST_ACT__70_ ECU_ADDRESS 0x7fae82 BYTE_ORDER MSB_LAST FORMAT "%4.1" /end MEASUREMENT
/begin MEASUREMENT v_inj_burst_act_[71] "voltage burst signal (choosen for detection)" UWORD _CNV_A_R_LINEAR_____121_CM 1 0. 0. 255. DISPLAY_IDENTIFIER V_INJ_BURST_ACT__71_ ECU_ADDRESS 0x7fae84 BYTE_ORDER MSB_LAST FORMAT "%4.1" /end MEASUREMENT
/begin MEASUREMENT v_inj_burst_act_[72] "voltage burst signal (choosen for detection)" UWORD _CNV_A_R_LINEAR_____121_CM 1 0. 0. 255. DISPLAY_IDENTIFIER V_INJ_BURST_ACT__72_ ECU_ADDRESS 0x7fae86 BYTE_ORDER MSB_LAST FORMAT "%4.1" /end MEASUREMENT
/begin MEASUREMENT v_inj_burst_act_[73] "voltage burst signal (choosen for detection)" UWORD _CNV_A_R_LINEAR_____121_CM 1 0. 0. 255. DISPLAY_IDENTIFIER V_INJ_BURST_ACT__73_ ECU_ADDRESS 0x7fae88 BYTE_ORDER MSB_LAST FORMAT "%4.1" /end MEASUREMENT
/begin MEASUREMENT v_inj_burst_act_[74] "voltage burst signal (choosen for detection)" UWORD _CNV_A_R_LINEAR_____121_CM 1 0. 0. 255. DISPLAY_IDENTIFIER V_INJ_BURST_ACT__74_ ECU_ADDRESS 0x7fae8a BYTE_ORDER MSB_LAST FORMAT "%4.1" /end MEASUREMENT
/begin MEASUREMENT v_inj_burst_act_[75] "voltage burst signal (choosen for detection)" UWORD _CNV_A_R_LINEAR_____121_CM 1 0. 0. 255. DISPLAY_IDENTIFIER V_INJ_BURST_ACT__75_ ECU_ADDRESS 0x7fae8c BYTE_ORDER MSB_LAST FORMAT "%4.1" /end MEASUREMENT
/begin MEASUREMENT v_inj_burst_act_[76] "voltage burst signal (choosen for detection)" UWORD _CNV_A_R_LINEAR_____121_CM 1 0. 0. 255. DISPLAY_IDENTIFIER V_INJ_BURST_ACT__76_ ECU_ADDRESS 0x7fae8e BYTE_ORDER MSB_LAST FORMAT "%4.1" /end MEASUREMENT
/begin MEASUREMENT v_inj_burst_act_[77] "voltage burst signal (choosen for detection)" UWORD _CNV_A_R_LINEAR_____121_CM 1 0. 0. 255. DISPLAY_IDENTIFIER V_INJ_BURST_ACT__77_ ECU_ADDRESS 0x7fae90 BYTE_ORDER MSB_LAST FORMAT "%4.1" /end MEASUREMENT
/begin MEASUREMENT v_inj_burst_act_[78] "voltage burst signal (choosen for detection)" UWORD _CNV_A_R_LINEAR_____121_CM 1 0. 0. 255. DISPLAY_IDENTIFIER V_INJ_BURST_ACT__78_ ECU_ADDRESS 0x7fae92 BYTE_ORDER MSB_LAST FORMAT "%4.1" /end MEASUREMENT
/begin MEASUREMENT v_inj_burst_act_[79] "voltage burst signal (choosen for detection)" UWORD _CNV_A_R_LINEAR_____121_CM 1 0. 0. 255. DISPLAY_IDENTIFIER V_INJ_BURST_ACT__79_ ECU_ADDRESS 0x7fae94 BYTE_ORDER MSB_LAST FORMAT "%4.1" /end MEASUREMENT
/begin MEASUREMENT v_inj_burst_act_[80] "voltage burst signal (choosen for detection)" UWORD _CNV_A_R_LINEAR_____121_CM 1 0. 0. 255. DISPLAY_IDENTIFIER V_INJ_BURST_ACT__80_ ECU_ADDRESS 0x7fae96 BYTE_ORDER MSB_LAST FORMAT "%4.1" /end MEASUREMENT
/begin MEASUREMENT v_inj_burst_act_[81] "voltage burst signal (choosen for detection)" UWORD _CNV_A_R_LINEAR_____121_CM 1 0. 0. 255. DISPLAY_IDENTIFIER V_INJ_BURST_ACT__81_ ECU_ADDRESS 0x7fae98 BYTE_ORDER MSB_LAST FORMAT "%4.1" /end MEASUREMENT
/begin MEASUREMENT v_inj_burst_act_[82] "voltage burst signal (choosen for detection)" UWORD _CNV_A_R_LINEAR_____121_CM 1 0. 0. 255. DISPLAY_IDENTIFIER V_INJ_BURST_ACT__82_ ECU_ADDRESS 0x7fae9a BYTE_ORDER MSB_LAST FORMAT "%4.1" /end MEASUREMENT
/begin MEASUREMENT v_inj_burst_act_[83] "voltage burst signal (choosen for detection)" UWORD _CNV_A_R_LINEAR_____121_CM 1 0. 0. 255. DISPLAY_IDENTIFIER V_INJ_BURST_ACT__83_ ECU_ADDRESS 0x7fae9c BYTE_ORDER MSB_LAST FORMAT "%4.1" /end MEASUREMENT
/begin MEASUREMENT v_inj_burst_act_[84] "voltage burst signal (choosen for detection)" UWORD _CNV_A_R_LINEAR_____121_CM 1 0. 0. 255. DISPLAY_IDENTIFIER V_INJ_BURST_ACT__84_ ECU_ADDRESS 0x7fae9e BYTE_ORDER MSB_LAST FORMAT "%4.1" /end MEASUREMENT
/begin MEASUREMENT v_inj_burst_act_[85] "voltage burst signal (choosen for detection)" UWORD _CNV_A_R_LINEAR_____121_CM 1 0. 0. 255. DISPLAY_IDENTIFIER V_INJ_BURST_ACT__85_ ECU_ADDRESS 0x7faea0 BYTE_ORDER MSB_LAST FORMAT "%4.1" /end MEASUREMENT
/begin MEASUREMENT v_inj_burst_act_[86] "voltage burst signal (choosen for detection)" UWORD _CNV_A_R_LINEAR_____121_CM 1 0. 0. 255. DISPLAY_IDENTIFIER V_INJ_BURST_ACT__86_ ECU_ADDRESS 0x7faea2 BYTE_ORDER MSB_LAST FORMAT "%4.1" /end MEASUREMENT
/begin MEASUREMENT v_inj_burst_act_[87] "voltage burst signal (choosen for detection)" UWORD _CNV_A_R_LINEAR_____121_CM 1 0. 0. 255. DISPLAY_IDENTIFIER V_INJ_BURST_ACT__87_ ECU_ADDRESS 0x7faea4 BYTE_ORDER MSB_LAST FORMAT "%4.1" /end MEASUREMENT
/begin MEASUREMENT v_inj_burst_dif1_[0] "first order derivation of voltage burst signal" SWORD _CNV_A_R_LINEAR_____558_CM 1 0. -256. 255. DISPLAY_IDENTIFIER V_INJ_BURST_DIF1__0_ ECU_ADDRESS 0x7faea6 BYTE_ORDER MSB_LAST FORMAT "%4.1" /end MEASUREMENT
/begin MEASUREMENT v_inj_burst_dif1_[1] "first order derivation of voltage burst signal" SWORD _CNV_A_R_LINEAR_____558_CM 1 0. -256. 255. DISPLAY_IDENTIFIER V_INJ_BURST_DIF1__1_ ECU_ADDRESS 0x7faea8 BYTE_ORDER MSB_LAST FORMAT "%4.1" /end MEASUREMENT
/begin MEASUREMENT v_inj_burst_dif1_[2] "first order derivation of voltage burst signal" SWORD _CNV_A_R_LINEAR_____558_CM 1 0. -256. 255. DISPLAY_IDENTIFIER V_INJ_BURST_DIF1__2_ ECU_ADDRESS 0x7faeaa BYTE_ORDER MSB_LAST FORMAT "%4.1" /end MEASUREMENT
/begin MEASUREMENT v_inj_burst_dif1_[3] "first order derivation of voltage burst signal" SWORD _CNV_A_R_LINEAR_____558_CM 1 0. -256. 255. DISPLAY_IDENTIFIER V_INJ_BURST_DIF1__3_ ECU_ADDRESS 0x7faeac BYTE_ORDER MSB_LAST FORMAT "%4.1" /end MEASUREMENT
/begin MEASUREMENT v_inj_burst_dif2_[0] "second order derivation of voltage burst signal" SWORD _CNV_A_R_LINEAR_____558_CM 1 0. -256. 255. DISPLAY_IDENTIFIER V_INJ_BURST_DIF2__0_ ECU_ADDRESS 0x7faeae BYTE_ORDER MSB_LAST FORMAT "%4.1" /end MEASUREMENT
/begin MEASUREMENT v_inj_burst_dif2_[1] "second order derivation of voltage burst signal" SWORD _CNV_A_R_LINEAR_____558_CM 1 0. -256. 255. DISPLAY_IDENTIFIER V_INJ_BURST_DIF2__1_ ECU_ADDRESS 0x7faeb0 BYTE_ORDER MSB_LAST FORMAT "%4.1" /end MEASUREMENT
/begin MEASUREMENT v_inj_burst_dif2_[2] "second order derivation of voltage burst signal" SWORD _CNV_A_R_LINEAR_____558_CM 1 0. -256. 255. DISPLAY_IDENTIFIER V_INJ_BURST_DIF2__2_ ECU_ADDRESS 0x7faeb2 BYTE_ORDER MSB_LAST FORMAT "%4.1" /end MEASUREMENT
/begin MEASUREMENT v_inj_burst_dif2_[3] "second order derivation of voltage burst signal" SWORD _CNV_A_R_LINEAR_____558_CM 1 0. -256. 255. DISPLAY_IDENTIFIER V_INJ_BURST_DIF2__3_ ECU_ADDRESS 0x7faeb4 BYTE_ORDER MSB_LAST FORMAT "%4.1" /end MEASUREMENT
/begin MEASUREMENT v_inj_burst_exp_[0] "voltage burst signal (expanded)" UWORD _CNV_A_R_LINEAR_____121_CM 1 0. 0. 255. DISPLAY_IDENTIFIER V_INJ_BURST_EXP__0_ ECU_ADDRESS 0x7faeb6 BYTE_ORDER MSB_LAST FORMAT "%4.1" /end MEASUREMENT
/begin MEASUREMENT v_inj_burst_exp_[1] "voltage burst signal (expanded)" UWORD _CNV_A_R_LINEAR_____121_CM 1 0. 0. 255. DISPLAY_IDENTIFIER V_INJ_BURST_EXP__1_ ECU_ADDRESS 0x7faeb8 BYTE_ORDER MSB_LAST FORMAT "%4.1" /end MEASUREMENT
/begin MEASUREMENT v_inj_burst_exp_[2] "voltage burst signal (expanded)" UWORD _CNV_A_R_LINEAR_____121_CM 1 0. 0. 255. DISPLAY_IDENTIFIER V_INJ_BURST_EXP__2_ ECU_ADDRESS 0x7faeba BYTE_ORDER MSB_LAST FORMAT "%4.1" /end MEASUREMENT
/begin MEASUREMENT v_inj_burst_exp_[3] "voltage burst signal (expanded)" UWORD _CNV_A_R_LINEAR_____121_CM 1 0. 0. 255. DISPLAY_IDENTIFIER V_INJ_BURST_EXP__3_ ECU_ADDRESS 0x7faebc BYTE_ORDER MSB_LAST FORMAT "%4.1" /end MEASUREMENT
/begin MEASUREMENT v_inj_burst_exp_[4] "voltage burst signal (expanded)" UWORD _CNV_A_R_LINEAR_____121_CM 1 0. 0. 255. DISPLAY_IDENTIFIER V_INJ_BURST_EXP__4_ ECU_ADDRESS 0x7faebe BYTE_ORDER MSB_LAST FORMAT "%4.1" /end MEASUREMENT
/begin MEASUREMENT v_inj_burst_exp_[5] "voltage burst signal (expanded)" UWORD _CNV_A_R_LINEAR_____121_CM 1 0. 0. 255. DISPLAY_IDENTIFIER V_INJ_BURST_EXP__5_ ECU_ADDRESS 0x7faec0 BYTE_ORDER MSB_LAST FORMAT "%4.1" /end MEASUREMENT
/begin MEASUREMENT v_inj_burst_exp_[6] "voltage burst signal (expanded)" UWORD _CNV_A_R_LINEAR_____121_CM 1 0. 0. 255. DISPLAY_IDENTIFIER V_INJ_BURST_EXP__6_ ECU_ADDRESS 0x7faec2 BYTE_ORDER MSB_LAST FORMAT "%4.1" /end MEASUREMENT
/begin MEASUREMENT v_inj_burst_exp_[7] "voltage burst signal (expanded)" UWORD _CNV_A_R_LINEAR_____121_CM 1 0. 0. 255. DISPLAY_IDENTIFIER V_INJ_BURST_EXP__7_ ECU_ADDRESS 0x7faec4 BYTE_ORDER MSB_LAST FORMAT "%4.1" /end MEASUREMENT
/begin MEASUREMENT v_inj_burst_exp_[8] "voltage burst signal (expanded)" UWORD _CNV_A_R_LINEAR_____121_CM 1 0. 0. 255. DISPLAY_IDENTIFIER V_INJ_BURST_EXP__8_ ECU_ADDRESS 0x7faec6 BYTE_ORDER MSB_LAST FORMAT "%4.1" /end MEASUREMENT
/begin MEASUREMENT v_inj_burst_exp_[9] "voltage burst signal (expanded)" UWORD _CNV_A_R_LINEAR_____121_CM 1 0. 0. 255. DISPLAY_IDENTIFIER V_INJ_BURST_EXP__9_ ECU_ADDRESS 0x7faec8 BYTE_ORDER MSB_LAST FORMAT "%4.1" /end MEASUREMENT
/begin MEASUREMENT v_inj_burst_exp_[10] "voltage burst signal (expanded)" UWORD _CNV_A_R_LINEAR_____121_CM 1 0. 0. 255. DISPLAY_IDENTIFIER V_INJ_BURST_EXP__10_ ECU_ADDRESS 0x7faeca BYTE_ORDER MSB_LAST FORMAT "%4.1" /end MEASUREMENT
/begin MEASUREMENT v_inj_burst_exp_[11] "voltage burst signal (expanded)" UWORD _CNV_A_R_LINEAR_____121_CM 1 0. 0. 255. DISPLAY_IDENTIFIER V_INJ_BURST_EXP__11_ ECU_ADDRESS 0x7faecc BYTE_ORDER MSB_LAST FORMAT "%4.1" /end MEASUREMENT
/begin MEASUREMENT v_inj_burst_exp_[12] "voltage burst signal (expanded)" UWORD _CNV_A_R_LINEAR_____121_CM 1 0. 0. 255. DISPLAY_IDENTIFIER V_INJ_BURST_EXP__12_ ECU_ADDRESS 0x7faece BYTE_ORDER MSB_LAST FORMAT "%4.1" /end MEASUREMENT
/begin MEASUREMENT v_inj_burst_exp_[13] "voltage burst signal (expanded)" UWORD _CNV_A_R_LINEAR_____121_CM 1 0. 0. 255. DISPLAY_IDENTIFIER V_INJ_BURST_EXP__13_ ECU_ADDRESS 0x7faed0 BYTE_ORDER MSB_LAST FORMAT "%4.1" /end MEASUREMENT
/begin MEASUREMENT v_inj_burst_exp_[14] "voltage burst signal (expanded)" UWORD _CNV_A_R_LINEAR_____121_CM 1 0. 0. 255. DISPLAY_IDENTIFIER V_INJ_BURST_EXP__14_ ECU_ADDRESS 0x7faed2 BYTE_ORDER MSB_LAST FORMAT "%4.1" /end MEASUREMENT
/begin MEASUREMENT v_inj_burst_exp_[15] "voltage burst signal (expanded)" UWORD _CNV_A_R_LINEAR_____121_CM 1 0. 0. 255. DISPLAY_IDENTIFIER V_INJ_BURST_EXP__15_ ECU_ADDRESS 0x7faed4 BYTE_ORDER MSB_LAST FORMAT "%4.1" /end MEASUREMENT
/begin MEASUREMENT v_inj_burst_exp_[16] "voltage burst signal (expanded)" UWORD _CNV_A_R_LINEAR_____121_CM 1 0. 0. 255. DISPLAY_IDENTIFIER V_INJ_BURST_EXP__16_ ECU_ADDRESS 0x7faed6 BYTE_ORDER MSB_LAST FORMAT "%4.1" /end MEASUREMENT
/begin MEASUREMENT v_inj_burst_exp_[17] "voltage burst signal (expanded)" UWORD _CNV_A_R_LINEAR_____121_CM 1 0. 0. 255. DISPLAY_IDENTIFIER V_INJ_BURST_EXP__17_ ECU_ADDRESS 0x7faed8 BYTE_ORDER MSB_LAST FORMAT "%4.1" /end MEASUREMENT
/begin MEASUREMENT v_inj_burst_exp_[18] "voltage burst signal (expanded)" UWORD _CNV_A_R_LINEAR_____121_CM 1 0. 0. 255. DISPLAY_IDENTIFIER V_INJ_BURST_EXP__18_ ECU_ADDRESS 0x7faeda BYTE_ORDER MSB_LAST FORMAT "%4.1" /end MEASUREMENT
/begin MEASUREMENT v_inj_burst_exp_[19] "voltage burst signal (expanded)" UWORD _CNV_A_R_LINEAR_____121_CM 1 0. 0. 255. DISPLAY_IDENTIFIER V_INJ_BURST_EXP__19_ ECU_ADDRESS 0x7faedc BYTE_ORDER MSB_LAST FORMAT "%4.1" /end MEASUREMENT
/begin MEASUREMENT v_inj_burst_exp_[20] "voltage burst signal (expanded)" UWORD _CNV_A_R_LINEAR_____121_CM 1 0. 0. 255. DISPLAY_IDENTIFIER V_INJ_BURST_EXP__20_ ECU_ADDRESS 0x7faede BYTE_ORDER MSB_LAST FORMAT "%4.1" /end MEASUREMENT
/begin MEASUREMENT v_inj_burst_exp_[21] "voltage burst signal (expanded)" UWORD _CNV_A_R_LINEAR_____121_CM 1 0. 0. 255. DISPLAY_IDENTIFIER V_INJ_BURST_EXP__21_ ECU_ADDRESS 0x7faee0 BYTE_ORDER MSB_LAST FORMAT "%4.1" /end MEASUREMENT
/begin MEASUREMENT v_inj_burst_exp_[22] "voltage burst signal (expanded)" UWORD _CNV_A_R_LINEAR_____121_CM 1 0. 0. 255. DISPLAY_IDENTIFIER V_INJ_BURST_EXP__22_ ECU_ADDRESS 0x7faee2 BYTE_ORDER MSB_LAST FORMAT "%4.1" /end MEASUREMENT
/begin MEASUREMENT v_inj_burst_exp_[23] "voltage burst signal (expanded)" UWORD _CNV_A_R_LINEAR_____121_CM 1 0. 0. 255. DISPLAY_IDENTIFIER V_INJ_BURST_EXP__23_ ECU_ADDRESS 0x7faee4 BYTE_ORDER MSB_LAST FORMAT "%4.1" /end MEASUREMENT
/begin MEASUREMENT v_inj_burst_exp_[24] "voltage burst signal (expanded)" UWORD _CNV_A_R_LINEAR_____121_CM 1 0. 0. 255. DISPLAY_IDENTIFIER V_INJ_BURST_EXP__24_ ECU_ADDRESS 0x7faee6 BYTE_ORDER MSB_LAST FORMAT "%4.1" /end MEASUREMENT
/begin MEASUREMENT v_inj_burst_exp_[25] "voltage burst signal (expanded)" UWORD _CNV_A_R_LINEAR_____121_CM 1 0. 0. 255. DISPLAY_IDENTIFIER V_INJ_BURST_EXP__25_ ECU_ADDRESS 0x7faee8 BYTE_ORDER MSB_LAST FORMAT "%4.1" /end MEASUREMENT
/begin MEASUREMENT v_inj_burst_exp_[26] "voltage burst signal (expanded)" UWORD _CNV_A_R_LINEAR_____121_CM 1 0. 0. 255. DISPLAY_IDENTIFIER V_INJ_BURST_EXP__26_ ECU_ADDRESS 0x7faeea BYTE_ORDER MSB_LAST FORMAT "%4.1" /end MEASUREMENT
/begin MEASUREMENT v_inj_burst_exp_[27] "voltage burst signal (expanded)" UWORD _CNV_A_R_LINEAR_____121_CM 1 0. 0. 255. DISPLAY_IDENTIFIER V_INJ_BURST_EXP__27_ ECU_ADDRESS 0x7faeec BYTE_ORDER MSB_LAST FORMAT "%4.1" /end MEASUREMENT
/begin MEASUREMENT v_inj_burst_exp_[28] "voltage burst signal (expanded)" UWORD _CNV_A_R_LINEAR_____121_CM 1 0. 0. 255. DISPLAY_IDENTIFIER V_INJ_BURST_EXP__28_ ECU_ADDRESS 0x7faeee BYTE_ORDER MSB_LAST FORMAT "%4.1" /end MEASUREMENT
/begin MEASUREMENT v_inj_burst_exp_[29] "voltage burst signal (expanded)" UWORD _CNV_A_R_LINEAR_____121_CM 1 0. 0. 255. DISPLAY_IDENTIFIER V_INJ_BURST_EXP__29_ ECU_ADDRESS 0x7faef0 BYTE_ORDER MSB_LAST FORMAT "%4.1" /end MEASUREMENT
/begin MEASUREMENT v_inj_burst_exp_[30] "voltage burst signal (expanded)" UWORD _CNV_A_R_LINEAR_____121_CM 1 0. 0. 255. DISPLAY_IDENTIFIER V_INJ_BURST_EXP__30_ ECU_ADDRESS 0x7faef2 BYTE_ORDER MSB_LAST FORMAT "%4.1" /end MEASUREMENT
/begin MEASUREMENT v_inj_burst_exp_[31] "voltage burst signal (expanded)" UWORD _CNV_A_R_LINEAR_____121_CM 1 0. 0. 255. DISPLAY_IDENTIFIER V_INJ_BURST_EXP__31_ ECU_ADDRESS 0x7faef4 BYTE_ORDER MSB_LAST FORMAT "%4.1" /end MEASUREMENT
/begin MEASUREMENT v_inj_burst_exp_[32] "voltage burst signal (expanded)" UWORD _CNV_A_R_LINEAR_____121_CM 1 0. 0. 255. DISPLAY_IDENTIFIER V_INJ_BURST_EXP__32_ ECU_ADDRESS 0x7faef6 BYTE_ORDER MSB_LAST FORMAT "%4.1" /end MEASUREMENT
/begin MEASUREMENT v_inj_burst_exp_[33] "voltage burst signal (expanded)" UWORD _CNV_A_R_LINEAR_____121_CM 1 0. 0. 255. DISPLAY_IDENTIFIER V_INJ_BURST_EXP__33_ ECU_ADDRESS 0x7faef8 BYTE_ORDER MSB_LAST FORMAT "%4.1" /end MEASUREMENT
/begin MEASUREMENT v_inj_burst_exp_[34] "voltage burst signal (expanded)" UWORD _CNV_A_R_LINEAR_____121_CM 1 0. 0. 255. DISPLAY_IDENTIFIER V_INJ_BURST_EXP__34_ ECU_ADDRESS 0x7faefa BYTE_ORDER MSB_LAST FORMAT "%4.1" /end MEASUREMENT
/begin MEASUREMENT v_inj_burst_exp_[35] "voltage burst signal (expanded)" UWORD _CNV_A_R_LINEAR_____121_CM 1 0. 0. 255. DISPLAY_IDENTIFIER V_INJ_BURST_EXP__35_ ECU_ADDRESS 0x7faefc BYTE_ORDER MSB_LAST FORMAT "%4.1" /end MEASUREMENT
/begin MEASUREMENT v_inj_burst_exp_[36] "voltage burst signal (expanded)" UWORD _CNV_A_R_LINEAR_____121_CM 1 0. 0. 255. DISPLAY_IDENTIFIER V_INJ_BURST_EXP__36_ ECU_ADDRESS 0x7faefe BYTE_ORDER MSB_LAST FORMAT "%4.1" /end MEASUREMENT
/begin MEASUREMENT v_inj_burst_exp_[37] "voltage burst signal (expanded)" UWORD _CNV_A_R_LINEAR_____121_CM 1 0. 0. 255. DISPLAY_IDENTIFIER V_INJ_BURST_EXP__37_ ECU_ADDRESS 0x7faf00 BYTE_ORDER MSB_LAST FORMAT "%4.1" /end MEASUREMENT
/begin MEASUREMENT v_inj_burst_exp_[38] "voltage burst signal (expanded)" UWORD _CNV_A_R_LINEAR_____121_CM 1 0. 0. 255. DISPLAY_IDENTIFIER V_INJ_BURST_EXP__38_ ECU_ADDRESS 0x7faf02 BYTE_ORDER MSB_LAST FORMAT "%4.1" /end MEASUREMENT
/begin MEASUREMENT v_inj_burst_exp_[39] "voltage burst signal (expanded)" UWORD _CNV_A_R_LINEAR_____121_CM 1 0. 0. 255. DISPLAY_IDENTIFIER V_INJ_BURST_EXP__39_ ECU_ADDRESS 0x7faf04 BYTE_ORDER MSB_LAST FORMAT "%4.1" /end MEASUREMENT
/begin MEASUREMENT v_inj_burst_exp_[40] "voltage burst signal (expanded)" UWORD _CNV_A_R_LINEAR_____121_CM 1 0. 0. 255. DISPLAY_IDENTIFIER V_INJ_BURST_EXP__40_ ECU_ADDRESS 0x7faf06 BYTE_ORDER MSB_LAST FORMAT "%4.1" /end MEASUREMENT
/begin MEASUREMENT v_inj_burst_exp_[41] "voltage burst signal (expanded)" UWORD _CNV_A_R_LINEAR_____121_CM 1 0. 0. 255. DISPLAY_IDENTIFIER V_INJ_BURST_EXP__41_ ECU_ADDRESS 0x7faf08 BYTE_ORDER MSB_LAST FORMAT "%4.1" /end MEASUREMENT
/begin MEASUREMENT v_inj_burst_exp_[42] "voltage burst signal (expanded)" UWORD _CNV_A_R_LINEAR_____121_CM 1 0. 0. 255. DISPLAY_IDENTIFIER V_INJ_BURST_EXP__42_ ECU_ADDRESS 0x7faf0a BYTE_ORDER MSB_LAST FORMAT "%4.1" /end MEASUREMENT
/begin MEASUREMENT v_inj_burst_exp_[43] "voltage burst signal (expanded)" UWORD _CNV_A_R_LINEAR_____121_CM 1 0. 0. 255. DISPLAY_IDENTIFIER V_INJ_BURST_EXP__43_ ECU_ADDRESS 0x7faf0c BYTE_ORDER MSB_LAST FORMAT "%4.1" /end MEASUREMENT
/begin MEASUREMENT v_inj_burst_exp_[44] "voltage burst signal (expanded)" UWORD _CNV_A_R_LINEAR_____121_CM 1 0. 0. 255. DISPLAY_IDENTIFIER V_INJ_BURST_EXP__44_ ECU_ADDRESS 0x7faf0e BYTE_ORDER MSB_LAST FORMAT "%4.1" /end MEASUREMENT
/begin MEASUREMENT v_inj_burst_exp_[45] "voltage burst signal (expanded)" UWORD _CNV_A_R_LINEAR_____121_CM 1 0. 0. 255. DISPLAY_IDENTIFIER V_INJ_BURST_EXP__45_ ECU_ADDRESS 0x7faf10 BYTE_ORDER MSB_LAST FORMAT "%4.1" /end MEASUREMENT
/begin MEASUREMENT v_inj_burst_exp_[46] "voltage burst signal (expanded)" UWORD _CNV_A_R_LINEAR_____121_CM 1 0. 0. 255. DISPLAY_IDENTIFIER V_INJ_BURST_EXP__46_ ECU_ADDRESS 0x7faf12 BYTE_ORDER MSB_LAST FORMAT "%4.1" /end MEASUREMENT
/begin MEASUREMENT v_inj_burst_exp_[47] "voltage burst signal (expanded)" UWORD _CNV_A_R_LINEAR_____121_CM 1 0. 0. 255. DISPLAY_IDENTIFIER V_INJ_BURST_EXP__47_ ECU_ADDRESS 0x7faf14 BYTE_ORDER MSB_LAST FORMAT "%4.1" /end MEASUREMENT
/begin MEASUREMENT v_inj_burst_exp_[48] "voltage burst signal (expanded)" UWORD _CNV_A_R_LINEAR_____121_CM 1 0. 0. 255. DISPLAY_IDENTIFIER V_INJ_BURST_EXP__48_ ECU_ADDRESS 0x7faf16 BYTE_ORDER MSB_LAST FORMAT "%4.1" /end MEASUREMENT
/begin MEASUREMENT v_inj_burst_exp_[49] "voltage burst signal (expanded)" UWORD _CNV_A_R_LINEAR_____121_CM 1 0. 0. 255. DISPLAY_IDENTIFIER V_INJ_BURST_EXP__49_ ECU_ADDRESS 0x7faf18 BYTE_ORDER MSB_LAST FORMAT "%4.1" /end MEASUREMENT
/begin MEASUREMENT v_inj_burst_exp_[50] "voltage burst signal (expanded)" UWORD _CNV_A_R_LINEAR_____121_CM 1 0. 0. 255. DISPLAY_IDENTIFIER V_INJ_BURST_EXP__50_ ECU_ADDRESS 0x7faf1a BYTE_ORDER MSB_LAST FORMAT "%4.1" /end MEASUREMENT
/begin MEASUREMENT v_inj_burst_exp_[51] "voltage burst signal (expanded)" UWORD _CNV_A_R_LINEAR_____121_CM 1 0. 0. 255. DISPLAY_IDENTIFIER V_INJ_BURST_EXP__51_ ECU_ADDRESS 0x7faf1c BYTE_ORDER MSB_LAST FORMAT "%4.1" /end MEASUREMENT
/begin MEASUREMENT v_inj_burst_exp_[52] "voltage burst signal (expanded)" UWORD _CNV_A_R_LINEAR_____121_CM 1 0. 0. 255. DISPLAY_IDENTIFIER V_INJ_BURST_EXP__52_ ECU_ADDRESS 0x7faf1e BYTE_ORDER MSB_LAST FORMAT "%4.1" /end MEASUREMENT
/begin MEASUREMENT v_inj_burst_exp_[53] "voltage burst signal (expanded)" UWORD _CNV_A_R_LINEAR_____121_CM 1 0. 0. 255. DISPLAY_IDENTIFIER V_INJ_BURST_EXP__53_ ECU_ADDRESS 0x7faf20 BYTE_ORDER MSB_LAST FORMAT "%4.1" /end MEASUREMENT
/begin MEASUREMENT v_inj_burst_exp_[54] "voltage burst signal (expanded)" UWORD _CNV_A_R_LINEAR_____121_CM 1 0. 0. 255. DISPLAY_IDENTIFIER V_INJ_BURST_EXP__54_ ECU_ADDRESS 0x7faf22 BYTE_ORDER MSB_LAST FORMAT "%4.1" /end MEASUREMENT
/begin MEASUREMENT v_inj_burst_exp_[55] "voltage burst signal (expanded)" UWORD _CNV_A_R_LINEAR_____121_CM 1 0. 0. 255. DISPLAY_IDENTIFIER V_INJ_BURST_EXP__55_ ECU_ADDRESS 0x7faf24 BYTE_ORDER MSB_LAST FORMAT "%4.1" /end MEASUREMENT
/begin MEASUREMENT v_inj_burst_exp_[56] "voltage burst signal (expanded)" UWORD _CNV_A_R_LINEAR_____121_CM 1 0. 0. 255. DISPLAY_IDENTIFIER V_INJ_BURST_EXP__56_ ECU_ADDRESS 0x7faf26 BYTE_ORDER MSB_LAST FORMAT "%4.1" /end MEASUREMENT
/begin MEASUREMENT v_inj_burst_exp_[57] "voltage burst signal (expanded)" UWORD _CNV_A_R_LINEAR_____121_CM 1 0. 0. 255. DISPLAY_IDENTIFIER V_INJ_BURST_EXP__57_ ECU_ADDRESS 0x7faf28 BYTE_ORDER MSB_LAST FORMAT "%4.1" /end MEASUREMENT
/begin MEASUREMENT v_inj_burst_exp_[58] "voltage burst signal (expanded)" UWORD _CNV_A_R_LINEAR_____121_CM 1 0. 0. 255. DISPLAY_IDENTIFIER V_INJ_BURST_EXP__58_ ECU_ADDRESS 0x7faf2a BYTE_ORDER MSB_LAST FORMAT "%4.1" /end MEASUREMENT
/begin MEASUREMENT v_inj_burst_exp_[59] "voltage burst signal (expanded)" UWORD _CNV_A_R_LINEAR_____121_CM 1 0. 0. 255. DISPLAY_IDENTIFIER V_INJ_BURST_EXP__59_ ECU_ADDRESS 0x7faf2c BYTE_ORDER MSB_LAST FORMAT "%4.1" /end MEASUREMENT
/begin MEASUREMENT v_inj_burst_exp_[60] "voltage burst signal (expanded)" UWORD _CNV_A_R_LINEAR_____121_CM 1 0. 0. 255. DISPLAY_IDENTIFIER V_INJ_BURST_EXP__60_ ECU_ADDRESS 0x7faf2e BYTE_ORDER MSB_LAST FORMAT "%4.1" /end MEASUREMENT
/begin MEASUREMENT v_inj_burst_exp_[61] "voltage burst signal (expanded)" UWORD _CNV_A_R_LINEAR_____121_CM 1 0. 0. 255. DISPLAY_IDENTIFIER V_INJ_BURST_EXP__61_ ECU_ADDRESS 0x7faf30 BYTE_ORDER MSB_LAST FORMAT "%4.1" /end MEASUREMENT
/begin MEASUREMENT v_inj_burst_exp_[62] "voltage burst signal (expanded)" UWORD _CNV_A_R_LINEAR_____121_CM 1 0. 0. 255. DISPLAY_IDENTIFIER V_INJ_BURST_EXP__62_ ECU_ADDRESS 0x7faf32 BYTE_ORDER MSB_LAST FORMAT "%4.1" /end MEASUREMENT
/begin MEASUREMENT v_inj_burst_exp_[63] "voltage burst signal (expanded)" UWORD _CNV_A_R_LINEAR_____121_CM 1 0. 0. 255. DISPLAY_IDENTIFIER V_INJ_BURST_EXP__63_ ECU_ADDRESS 0x7faf34 BYTE_ORDER MSB_LAST FORMAT "%4.1" /end MEASUREMENT
/begin MEASUREMENT v_inj_burst_exp_[64] "voltage burst signal (expanded)" UWORD _CNV_A_R_LINEAR_____121_CM 1 0. 0. 255. DISPLAY_IDENTIFIER V_INJ_BURST_EXP__64_ ECU_ADDRESS 0x7faf36 BYTE_ORDER MSB_LAST FORMAT "%4.1" /end MEASUREMENT
/begin MEASUREMENT v_inj_burst_exp_[65] "voltage burst signal (expanded)" UWORD _CNV_A_R_LINEAR_____121_CM 1 0. 0. 255. DISPLAY_IDENTIFIER V_INJ_BURST_EXP__65_ ECU_ADDRESS 0x7faf38 BYTE_ORDER MSB_LAST FORMAT "%4.1" /end MEASUREMENT
/begin MEASUREMENT v_inj_burst_exp_[66] "voltage burst signal (expanded)" UWORD _CNV_A_R_LINEAR_____121_CM 1 0. 0. 255. DISPLAY_IDENTIFIER V_INJ_BURST_EXP__66_ ECU_ADDRESS 0x7faf3a BYTE_ORDER MSB_LAST FORMAT "%4.1" /end MEASUREMENT
/begin MEASUREMENT v_inj_burst_exp_[67] "voltage burst signal (expanded)" UWORD _CNV_A_R_LINEAR_____121_CM 1 0. 0. 255. DISPLAY_IDENTIFIER V_INJ_BURST_EXP__67_ ECU_ADDRESS 0x7faf3c BYTE_ORDER MSB_LAST FORMAT "%4.1" /end MEASUREMENT
/begin MEASUREMENT v_inj_burst_exp_[68] "voltage burst signal (expanded)" UWORD _CNV_A_R_LINEAR_____121_CM 1 0. 0. 255. DISPLAY_IDENTIFIER V_INJ_BURST_EXP__68_ ECU_ADDRESS 0x7faf3e BYTE_ORDER MSB_LAST FORMAT "%4.1" /end MEASUREMENT
/begin MEASUREMENT v_inj_burst_exp_[69] "voltage burst signal (expanded)" UWORD _CNV_A_R_LINEAR_____121_CM 1 0. 0. 255. DISPLAY_IDENTIFIER V_INJ_BURST_EXP__69_ ECU_ADDRESS 0x7faf40 BYTE_ORDER MSB_LAST FORMAT "%4.1" /end MEASUREMENT
/begin MEASUREMENT v_inj_burst_exp_[70] "voltage burst signal (expanded)" UWORD _CNV_A_R_LINEAR_____121_CM 1 0. 0. 255. DISPLAY_IDENTIFIER V_INJ_BURST_EXP__70_ ECU_ADDRESS 0x7faf42 BYTE_ORDER MSB_LAST FORMAT "%4.1" /end MEASUREMENT
/begin MEASUREMENT v_inj_burst_exp_[71] "voltage burst signal (expanded)" UWORD _CNV_A_R_LINEAR_____121_CM 1 0. 0. 255. DISPLAY_IDENTIFIER V_INJ_BURST_EXP__71_ ECU_ADDRESS 0x7faf44 BYTE_ORDER MSB_LAST FORMAT "%4.1" /end MEASUREMENT
/begin MEASUREMENT v_inj_burst_exp_[72] "voltage burst signal (expanded)" UWORD _CNV_A_R_LINEAR_____121_CM 1 0. 0. 255. DISPLAY_IDENTIFIER V_INJ_BURST_EXP__72_ ECU_ADDRESS 0x7faf46 BYTE_ORDER MSB_LAST FORMAT "%4.1" /end MEASUREMENT
/begin MEASUREMENT v_inj_burst_exp_[73] "voltage burst signal (expanded)" UWORD _CNV_A_R_LINEAR_____121_CM 1 0. 0. 255. DISPLAY_IDENTIFIER V_INJ_BURST_EXP__73_ ECU_ADDRESS 0x7faf48 BYTE_ORDER MSB_LAST FORMAT "%4.1" /end MEASUREMENT
/begin MEASUREMENT v_inj_burst_exp_[74] "voltage burst signal (expanded)" UWORD _CNV_A_R_LINEAR_____121_CM 1 0. 0. 255. DISPLAY_IDENTIFIER V_INJ_BURST_EXP__74_ ECU_ADDRESS 0x7faf4a BYTE_ORDER MSB_LAST FORMAT "%4.1" /end MEASUREMENT
/begin MEASUREMENT v_inj_burst_exp_[75] "voltage burst signal (expanded)" UWORD _CNV_A_R_LINEAR_____121_CM 1 0. 0. 255. DISPLAY_IDENTIFIER V_INJ_BURST_EXP__75_ ECU_ADDRESS 0x7faf4c BYTE_ORDER MSB_LAST FORMAT "%4.1" /end MEASUREMENT
/begin MEASUREMENT v_inj_burst_exp_[76] "voltage burst signal (expanded)" UWORD _CNV_A_R_LINEAR_____121_CM 1 0. 0. 255. DISPLAY_IDENTIFIER V_INJ_BURST_EXP__76_ ECU_ADDRESS 0x7faf4e BYTE_ORDER MSB_LAST FORMAT "%4.1" /end MEASUREMENT
/begin MEASUREMENT v_inj_burst_exp_[77] "voltage burst signal (expanded)" UWORD _CNV_A_R_LINEAR_____121_CM 1 0. 0. 255. DISPLAY_IDENTIFIER V_INJ_BURST_EXP__77_ ECU_ADDRESS 0x7faf50 BYTE_ORDER MSB_LAST FORMAT "%4.1" /end MEASUREMENT
/begin MEASUREMENT v_inj_burst_exp_[78] "voltage burst signal (expanded)" UWORD _CNV_A_R_LINEAR_____121_CM 1 0. 0. 255. DISPLAY_IDENTIFIER V_INJ_BURST_EXP__78_ ECU_ADDRESS 0x7faf52 BYTE_ORDER MSB_LAST FORMAT "%4.1" /end MEASUREMENT
/begin MEASUREMENT v_inj_burst_exp_[79] "voltage burst signal (expanded)" UWORD _CNV_A_R_LINEAR_____121_CM 1 0. 0. 255. DISPLAY_IDENTIFIER V_INJ_BURST_EXP__79_ ECU_ADDRESS 0x7faf54 BYTE_ORDER MSB_LAST FORMAT "%4.1" /end MEASUREMENT
/begin MEASUREMENT v_inj_burst_exp_[80] "voltage burst signal (expanded)" UWORD _CNV_A_R_LINEAR_____121_CM 1 0. 0. 255. DISPLAY_IDENTIFIER V_INJ_BURST_EXP__80_ ECU_ADDRESS 0x7faf56 BYTE_ORDER MSB_LAST FORMAT "%4.1" /end MEASUREMENT
/begin MEASUREMENT v_inj_burst_exp_[81] "voltage burst signal (expanded)" UWORD _CNV_A_R_LINEAR_____121_CM 1 0. 0. 255. DISPLAY_IDENTIFIER V_INJ_BURST_EXP__81_ ECU_ADDRESS 0x7faf58 BYTE_ORDER MSB_LAST FORMAT "%4.1" /end MEASUREMENT
/begin MEASUREMENT v_inj_burst_exp_[82] "voltage burst signal (expanded)" UWORD _CNV_A_R_LINEAR_____121_CM 1 0. 0. 255. DISPLAY_IDENTIFIER V_INJ_BURST_EXP__82_ ECU_ADDRESS 0x7faf5a BYTE_ORDER MSB_LAST FORMAT "%4.1" /end MEASUREMENT
/begin MEASUREMENT v_inj_burst_exp_[83] "voltage burst signal (expanded)" UWORD _CNV_A_R_LINEAR_____121_CM 1 0. 0. 255. DISPLAY_IDENTIFIER V_INJ_BURST_EXP__83_ ECU_ADDRESS 0x7faf5c BYTE_ORDER MSB_LAST FORMAT "%4.1" /end MEASUREMENT
/begin MEASUREMENT v_inj_burst_exp_[84] "voltage burst signal (expanded)" UWORD _CNV_A_R_LINEAR_____121_CM 1 0. 0. 255. DISPLAY_IDENTIFIER V_INJ_BURST_EXP__84_ ECU_ADDRESS 0x7faf5e BYTE_ORDER MSB_LAST FORMAT "%4.1" /end MEASUREMENT
/begin MEASUREMENT v_inj_burst_exp_[85] "voltage burst signal (expanded)" UWORD _CNV_A_R_LINEAR_____121_CM 1 0. 0. 255. DISPLAY_IDENTIFIER V_INJ_BURST_EXP__85_ ECU_ADDRESS 0x7faf60 BYTE_ORDER MSB_LAST FORMAT "%4.1" /end MEASUREMENT
/begin MEASUREMENT v_inj_burst_exp_[86] "voltage burst signal (expanded)" UWORD _CNV_A_R_LINEAR_____121_CM 1 0. 0. 255. DISPLAY_IDENTIFIER V_INJ_BURST_EXP__86_ ECU_ADDRESS 0x7faf62 BYTE_ORDER MSB_LAST FORMAT "%4.1" /end MEASUREMENT
/begin MEASUREMENT v_inj_burst_exp_[87] "voltage burst signal (expanded)" UWORD _CNV_A_R_LINEAR_____121_CM 1 0. 0. 255. DISPLAY_IDENTIFIER V_INJ_BURST_EXP__87_ ECU_ADDRESS 0x7faf64 BYTE_ORDER MSB_LAST FORMAT "%4.1" /end MEASUREMENT
/begin MEASUREMENT v_inj_burst_fil_max_[0] "vector with maximal risings in voltage burst signal" SWORD _CNV_A_R_LINEAR_____558_CM 1 0. -256. 255. DISPLAY_IDENTIFIER V_INJ_BURST_FIL_MAX__0_ ECU_ADDRESS 0x7faf66 BYTE_ORDER MSB_LAST FORMAT "%4.1" /end MEASUREMENT
/begin MEASUREMENT v_inj_burst_fil_max_[1] "vector with maximal risings in voltage burst signal" SWORD _CNV_A_R_LINEAR_____558_CM 1 0. -256. 255. DISPLAY_IDENTIFIER V_INJ_BURST_FIL_MAX__1_ ECU_ADDRESS 0x7faf68 BYTE_ORDER MSB_LAST FORMAT "%4.1" /end MEASUREMENT
/begin MEASUREMENT v_inj_burst_fil_max_[2] "vector with maximal risings in voltage burst signal" SWORD _CNV_A_R_LINEAR_____558_CM 1 0. -256. 255. DISPLAY_IDENTIFIER V_INJ_BURST_FIL_MAX__2_ ECU_ADDRESS 0x7faf6a BYTE_ORDER MSB_LAST FORMAT "%4.1" /end MEASUREMENT
/begin MEASUREMENT v_inj_burst_fil_max_[3] "vector with maximal risings in voltage burst signal" SWORD _CNV_A_R_LINEAR_____558_CM 1 0. -256. 255. DISPLAY_IDENTIFIER V_INJ_BURST_FIL_MAX__3_ ECU_ADDRESS 0x7faf6c BYTE_ORDER MSB_LAST FORMAT "%4.1" /end MEASUREMENT
/begin MEASUREMENT v_inj_burst_fil_max_[4] "vector with maximal risings in voltage burst signal" SWORD _CNV_A_R_LINEAR_____558_CM 1 0. -256. 255. DISPLAY_IDENTIFIER V_INJ_BURST_FIL_MAX__4_ ECU_ADDRESS 0x7faf6e BYTE_ORDER MSB_LAST FORMAT "%4.1" /end MEASUREMENT
/begin MEASUREMENT v_inj_burst_fil_max_[5] "vector with maximal risings in voltage burst signal" SWORD _CNV_A_R_LINEAR_____558_CM 1 0. -256. 255. DISPLAY_IDENTIFIER V_INJ_BURST_FIL_MAX__5_ ECU_ADDRESS 0x7faf70 BYTE_ORDER MSB_LAST FORMAT "%4.1" /end MEASUREMENT
/begin MEASUREMENT v_inj_burst_intp_[0] "voltage burst signal (interpolated)" UWORD _CNV_A_R_LINEAR_____121_CM 1 0. 0. 255. DISPLAY_IDENTIFIER V_INJ_BURST_INTP__0_ ECU_ADDRESS 0x7faf72 BYTE_ORDER MSB_LAST FORMAT "%4.1" /end MEASUREMENT
/begin MEASUREMENT v_inj_burst_intp_[1] "voltage burst signal (interpolated)" UWORD _CNV_A_R_LINEAR_____121_CM 1 0. 0. 255. DISPLAY_IDENTIFIER V_INJ_BURST_INTP__1_ ECU_ADDRESS 0x7faf74 BYTE_ORDER MSB_LAST FORMAT "%4.1" /end MEASUREMENT
/begin MEASUREMENT v_inj_burst_intp_[2] "voltage burst signal (interpolated)" UWORD _CNV_A_R_LINEAR_____121_CM 1 0. 0. 255. DISPLAY_IDENTIFIER V_INJ_BURST_INTP__2_ ECU_ADDRESS 0x7faf76 BYTE_ORDER MSB_LAST FORMAT "%4.1" /end MEASUREMENT
/begin MEASUREMENT v_inj_burst_intp_[3] "voltage burst signal (interpolated)" UWORD _CNV_A_R_LINEAR_____121_CM 1 0. 0. 255. DISPLAY_IDENTIFIER V_INJ_BURST_INTP__3_ ECU_ADDRESS 0x7faf78 BYTE_ORDER MSB_LAST FORMAT "%4.1" /end MEASUREMENT
/begin MEASUREMENT v_inj_burst_intp_[4] "voltage burst signal (interpolated)" UWORD _CNV_A_R_LINEAR_____121_CM 1 0. 0. 255. DISPLAY_IDENTIFIER V_INJ_BURST_INTP__4_ ECU_ADDRESS 0x7faf7a BYTE_ORDER MSB_LAST FORMAT "%4.1" /end MEASUREMENT
/begin MEASUREMENT v_inj_burst_intp_[5] "voltage burst signal (interpolated)" UWORD _CNV_A_R_LINEAR_____121_CM 1 0. 0. 255. DISPLAY_IDENTIFIER V_INJ_BURST_INTP__5_ ECU_ADDRESS 0x7faf7c BYTE_ORDER MSB_LAST FORMAT "%4.1" /end MEASUREMENT
/begin MEASUREMENT v_inj_burst_intp_[6] "voltage burst signal (interpolated)" UWORD _CNV_A_R_LINEAR_____121_CM 1 0. 0. 255. DISPLAY_IDENTIFIER V_INJ_BURST_INTP__6_ ECU_ADDRESS 0x7faf7e BYTE_ORDER MSB_LAST FORMAT "%4.1" /end MEASUREMENT
/begin MEASUREMENT v_inj_burst_intp_[7] "voltage burst signal (interpolated)" UWORD _CNV_A_R_LINEAR_____121_CM 1 0. 0. 255. DISPLAY_IDENTIFIER V_INJ_BURST_INTP__7_ ECU_ADDRESS 0x7faf80 BYTE_ORDER MSB_LAST FORMAT "%4.1" /end MEASUREMENT
/begin MEASUREMENT v_inj_burst_intp_[8] "voltage burst signal (interpolated)" UWORD _CNV_A_R_LINEAR_____121_CM 1 0. 0. 255. DISPLAY_IDENTIFIER V_INJ_BURST_INTP__8_ ECU_ADDRESS 0x7faf82 BYTE_ORDER MSB_LAST FORMAT "%4.1" /end MEASUREMENT
/begin MEASUREMENT v_inj_burst_intp_[9] "voltage burst signal (interpolated)" UWORD _CNV_A_R_LINEAR_____121_CM 1 0. 0. 255. DISPLAY_IDENTIFIER V_INJ_BURST_INTP__9_ ECU_ADDRESS 0x7faf84 BYTE_ORDER MSB_LAST FORMAT "%4.1" /end MEASUREMENT
/begin MEASUREMENT v_inj_burst_intp_[10] "voltage burst signal (interpolated)" UWORD _CNV_A_R_LINEAR_____121_CM 1 0. 0. 255. DISPLAY_IDENTIFIER V_INJ_BURST_INTP__10_ ECU_ADDRESS 0x7faf86 BYTE_ORDER MSB_LAST FORMAT "%4.1" /end MEASUREMENT
/begin MEASUREMENT v_inj_burst_intp_[11] "voltage burst signal (interpolated)" UWORD _CNV_A_R_LINEAR_____121_CM 1 0. 0. 255. DISPLAY_IDENTIFIER V_INJ_BURST_INTP__11_ ECU_ADDRESS 0x7faf88 BYTE_ORDER MSB_LAST FORMAT "%4.1" /end MEASUREMENT
/begin MEASUREMENT v_inj_burst_intp_[12] "voltage burst signal (interpolated)" UWORD _CNV_A_R_LINEAR_____121_CM 1 0. 0. 255. DISPLAY_IDENTIFIER V_INJ_BURST_INTP__12_ ECU_ADDRESS 0x7faf8a BYTE_ORDER MSB_LAST FORMAT "%4.1" /end MEASUREMENT
/begin MEASUREMENT v_inj_burst_intp_[13] "voltage burst signal (interpolated)" UWORD _CNV_A_R_LINEAR_____121_CM 1 0. 0. 255. DISPLAY_IDENTIFIER V_INJ_BURST_INTP__13_ ECU_ADDRESS 0x7faf8c BYTE_ORDER MSB_LAST FORMAT "%4.1" /end MEASUREMENT
/begin MEASUREMENT v_inj_burst_intp_[14] "voltage burst signal (interpolated)" UWORD _CNV_A_R_LINEAR_____121_CM 1 0. 0. 255. DISPLAY_IDENTIFIER V_INJ_BURST_INTP__14_ ECU_ADDRESS 0x7faf8e BYTE_ORDER MSB_LAST FORMAT "%4.1" /end MEASUREMENT
/begin MEASUREMENT v_inj_burst_intp_[15] "voltage burst signal (interpolated)" UWORD _CNV_A_R_LINEAR_____121_CM 1 0. 0. 255. DISPLAY_IDENTIFIER V_INJ_BURST_INTP__15_ ECU_ADDRESS 0x7faf90 BYTE_ORDER MSB_LAST FORMAT "%4.1" /end MEASUREMENT
/begin MEASUREMENT v_inj_burst_intp_[16] "voltage burst signal (interpolated)" UWORD _CNV_A_R_LINEAR_____121_CM 1 0. 0. 255. DISPLAY_IDENTIFIER V_INJ_BURST_INTP__16_ ECU_ADDRESS 0x7faf92 BYTE_ORDER MSB_LAST FORMAT "%4.1" /end MEASUREMENT
/begin MEASUREMENT v_inj_burst_intp_[17] "voltage burst signal (interpolated)" UWORD _CNV_A_R_LINEAR_____121_CM 1 0. 0. 255. DISPLAY_IDENTIFIER V_INJ_BURST_INTP__17_ ECU_ADDRESS 0x7faf94 BYTE_ORDER MSB_LAST FORMAT "%4.1" /end MEASUREMENT
/begin MEASUREMENT v_inj_burst_intp_[18] "voltage burst signal (interpolated)" UWORD _CNV_A_R_LINEAR_____121_CM 1 0. 0. 255. DISPLAY_IDENTIFIER V_INJ_BURST_INTP__18_ ECU_ADDRESS 0x7faf96 BYTE_ORDER MSB_LAST FORMAT "%4.1" /end MEASUREMENT
/begin MEASUREMENT v_inj_burst_intp_[19] "voltage burst signal (interpolated)" UWORD _CNV_A_R_LINEAR_____121_CM 1 0. 0. 255. DISPLAY_IDENTIFIER V_INJ_BURST_INTP__19_ ECU_ADDRESS 0x7faf98 BYTE_ORDER MSB_LAST FORMAT "%4.1" /end MEASUREMENT
/begin MEASUREMENT v_inj_burst_intp_[20] "voltage burst signal (interpolated)" UWORD _CNV_A_R_LINEAR_____121_CM 1 0. 0. 255. DISPLAY_IDENTIFIER V_INJ_BURST_INTP__20_ ECU_ADDRESS 0x7faf9a BYTE_ORDER MSB_LAST FORMAT "%4.1" /end MEASUREMENT
/begin MEASUREMENT v_inj_burst_intp_[21] "voltage burst signal (interpolated)" UWORD _CNV_A_R_LINEAR_____121_CM 1 0. 0. 255. DISPLAY_IDENTIFIER V_INJ_BURST_INTP__21_ ECU_ADDRESS 0x7faf9c BYTE_ORDER MSB_LAST FORMAT "%4.1" /end MEASUREMENT
/begin MEASUREMENT v_inj_burst_intp_[22] "voltage burst signal (interpolated)" UWORD _CNV_A_R_LINEAR_____121_CM 1 0. 0. 255. DISPLAY_IDENTIFIER V_INJ_BURST_INTP__22_ ECU_ADDRESS 0x7faf9e BYTE_ORDER MSB_LAST FORMAT "%4.1" /end MEASUREMENT
/begin MEASUREMENT v_inj_burst_intp_[23] "voltage burst signal (interpolated)" UWORD _CNV_A_R_LINEAR_____121_CM 1 0. 0. 255. DISPLAY_IDENTIFIER V_INJ_BURST_INTP__23_ ECU_ADDRESS 0x7fafa0 BYTE_ORDER MSB_LAST FORMAT "%4.1" /end MEASUREMENT
/begin MEASUREMENT v_inj_burst_intp_[24] "voltage burst signal (interpolated)" UWORD _CNV_A_R_LINEAR_____121_CM 1 0. 0. 255. DISPLAY_IDENTIFIER V_INJ_BURST_INTP__24_ ECU_ADDRESS 0x7fafa2 BYTE_ORDER MSB_LAST FORMAT "%4.1" /end MEASUREMENT
/begin MEASUREMENT v_inj_burst_intp_[25] "voltage burst signal (interpolated)" UWORD _CNV_A_R_LINEAR_____121_CM 1 0. 0. 255. DISPLAY_IDENTIFIER V_INJ_BURST_INTP__25_ ECU_ADDRESS 0x7fafa4 BYTE_ORDER MSB_LAST FORMAT "%4.1" /end MEASUREMENT
/begin MEASUREMENT v_inj_burst_intp_[26] "voltage burst signal (interpolated)" UWORD _CNV_A_R_LINEAR_____121_CM 1 0. 0. 255. DISPLAY_IDENTIFIER V_INJ_BURST_INTP__26_ ECU_ADDRESS 0x7fafa6 BYTE_ORDER MSB_LAST FORMAT "%4.1" /end MEASUREMENT
/begin MEASUREMENT v_inj_burst_intp_[27] "voltage burst signal (interpolated)" UWORD _CNV_A_R_LINEAR_____121_CM 1 0. 0. 255. DISPLAY_IDENTIFIER V_INJ_BURST_INTP__27_ ECU_ADDRESS 0x7fafa8 BYTE_ORDER MSB_LAST FORMAT "%4.1" /end MEASUREMENT
/begin MEASUREMENT v_inj_burst_intp_[28] "voltage burst signal (interpolated)" UWORD _CNV_A_R_LINEAR_____121_CM 1 0. 0. 255. DISPLAY_IDENTIFIER V_INJ_BURST_INTP__28_ ECU_ADDRESS 0x7fafaa BYTE_ORDER MSB_LAST FORMAT "%4.1" /end MEASUREMENT
/begin MEASUREMENT v_inj_burst_intp_[29] "voltage burst signal (interpolated)" UWORD _CNV_A_R_LINEAR_____121_CM 1 0. 0. 255. DISPLAY_IDENTIFIER V_INJ_BURST_INTP__29_ ECU_ADDRESS 0x7fafac BYTE_ORDER MSB_LAST FORMAT "%4.1" /end MEASUREMENT
/begin MEASUREMENT v_inj_burst_intp_[30] "voltage burst signal (interpolated)" UWORD _CNV_A_R_LINEAR_____121_CM 1 0. 0. 255. DISPLAY_IDENTIFIER V_INJ_BURST_INTP__30_ ECU_ADDRESS 0x7fafae BYTE_ORDER MSB_LAST FORMAT "%4.1" /end MEASUREMENT
/begin MEASUREMENT v_inj_burst_intp_[31] "voltage burst signal (interpolated)" UWORD _CNV_A_R_LINEAR_____121_CM 1 0. 0. 255. DISPLAY_IDENTIFIER V_INJ_BURST_INTP__31_ ECU_ADDRESS 0x7fafb0 BYTE_ORDER MSB_LAST FORMAT "%4.1" /end MEASUREMENT
/begin MEASUREMENT v_inj_burst_intp_[32] "voltage burst signal (interpolated)" UWORD _CNV_A_R_LINEAR_____121_CM 1 0. 0. 255. DISPLAY_IDENTIFIER V_INJ_BURST_INTP__32_ ECU_ADDRESS 0x7fafb2 BYTE_ORDER MSB_LAST FORMAT "%4.1" /end MEASUREMENT
/begin MEASUREMENT v_inj_burst_intp_[33] "voltage burst signal (interpolated)" UWORD _CNV_A_R_LINEAR_____121_CM 1 0. 0. 255. DISPLAY_IDENTIFIER V_INJ_BURST_INTP__33_ ECU_ADDRESS 0x7fafb4 BYTE_ORDER MSB_LAST FORMAT "%4.1" /end MEASUREMENT
/begin MEASUREMENT v_inj_burst_intp_[34] "voltage burst signal (interpolated)" UWORD _CNV_A_R_LINEAR_____121_CM 1 0. 0. 255. DISPLAY_IDENTIFIER V_INJ_BURST_INTP__34_ ECU_ADDRESS 0x7fafb6 BYTE_ORDER MSB_LAST FORMAT "%4.1" /end MEASUREMENT
/begin MEASUREMENT v_inj_burst_intp_[35] "voltage burst signal (interpolated)" UWORD _CNV_A_R_LINEAR_____121_CM 1 0. 0. 255. DISPLAY_IDENTIFIER V_INJ_BURST_INTP__35_ ECU_ADDRESS 0x7fafb8 BYTE_ORDER MSB_LAST FORMAT "%4.1" /end MEASUREMENT
/begin MEASUREMENT v_inj_burst_intp_[36] "voltage burst signal (interpolated)" UWORD _CNV_A_R_LINEAR_____121_CM 1 0. 0. 255. DISPLAY_IDENTIFIER V_INJ_BURST_INTP__36_ ECU_ADDRESS 0x7fafba BYTE_ORDER MSB_LAST FORMAT "%4.1" /end MEASUREMENT
/begin MEASUREMENT v_inj_burst_intp_[37] "voltage burst signal (interpolated)" UWORD _CNV_A_R_LINEAR_____121_CM 1 0. 0. 255. DISPLAY_IDENTIFIER V_INJ_BURST_INTP__37_ ECU_ADDRESS 0x7fafbc BYTE_ORDER MSB_LAST FORMAT "%4.1" /end MEASUREMENT
/begin MEASUREMENT v_inj_burst_intp_[38] "voltage burst signal (interpolated)" UWORD _CNV_A_R_LINEAR_____121_CM 1 0. 0. 255. DISPLAY_IDENTIFIER V_INJ_BURST_INTP__38_ ECU_ADDRESS 0x7fafbe BYTE_ORDER MSB_LAST FORMAT "%4.1" /end MEASUREMENT
/begin MEASUREMENT v_inj_burst_intp_[39] "voltage burst signal (interpolated)" UWORD _CNV_A_R_LINEAR_____121_CM 1 0. 0. 255. DISPLAY_IDENTIFIER V_INJ_BURST_INTP__39_ ECU_ADDRESS 0x7fafc0 BYTE_ORDER MSB_LAST FORMAT "%4.1" /end MEASUREMENT
/begin MEASUREMENT v_inj_burst_intp_[40] "voltage burst signal (interpolated)" UWORD _CNV_A_R_LINEAR_____121_CM 1 0. 0. 255. DISPLAY_IDENTIFIER V_INJ_BURST_INTP__40_ ECU_ADDRESS 0x7fafc2 BYTE_ORDER MSB_LAST FORMAT "%4.1" /end MEASUREMENT
/begin MEASUREMENT v_inj_burst_intp_[41] "voltage burst signal (interpolated)" UWORD _CNV_A_R_LINEAR_____121_CM 1 0. 0. 255. DISPLAY_IDENTIFIER V_INJ_BURST_INTP__41_ ECU_ADDRESS 0x7fafc4 BYTE_ORDER MSB_LAST FORMAT "%4.1" /end MEASUREMENT
/begin MEASUREMENT v_inj_burst_intp_[42] "voltage burst signal (interpolated)" UWORD _CNV_A_R_LINEAR_____121_CM 1 0. 0. 255. DISPLAY_IDENTIFIER V_INJ_BURST_INTP__42_ ECU_ADDRESS 0x7fafc6 BYTE_ORDER MSB_LAST FORMAT "%4.1" /end MEASUREMENT
/begin MEASUREMENT v_inj_burst_intp_[43] "voltage burst signal (interpolated)" UWORD _CNV_A_R_LINEAR_____121_CM 1 0. 0. 255. DISPLAY_IDENTIFIER V_INJ_BURST_INTP__43_ ECU_ADDRESS 0x7fafc8 BYTE_ORDER MSB_LAST FORMAT "%4.1" /end MEASUREMENT
/begin MEASUREMENT v_inj_burst_intp_[44] "voltage burst signal (interpolated)" UWORD _CNV_A_R_LINEAR_____121_CM 1 0. 0. 255. DISPLAY_IDENTIFIER V_INJ_BURST_INTP__44_ ECU_ADDRESS 0x7fafca BYTE_ORDER MSB_LAST FORMAT "%4.1" /end MEASUREMENT
/begin MEASUREMENT v_inj_burst_intp_[45] "voltage burst signal (interpolated)" UWORD _CNV_A_R_LINEAR_____121_CM 1 0. 0. 255. DISPLAY_IDENTIFIER V_INJ_BURST_INTP__45_ ECU_ADDRESS 0x7fafcc BYTE_ORDER MSB_LAST FORMAT "%4.1" /end MEASUREMENT
/begin MEASUREMENT v_inj_burst_intp_[46] "voltage burst signal (interpolated)" UWORD _CNV_A_R_LINEAR_____121_CM 1 0. 0. 255. DISPLAY_IDENTIFIER V_INJ_BURST_INTP__46_ ECU_ADDRESS 0x7fafce BYTE_ORDER MSB_LAST FORMAT "%4.1" /end MEASUREMENT
/begin MEASUREMENT v_inj_burst_intp_[47] "voltage burst signal (interpolated)" UWORD _CNV_A_R_LINEAR_____121_CM 1 0. 0. 255. DISPLAY_IDENTIFIER V_INJ_BURST_INTP__47_ ECU_ADDRESS 0x7fafd0 BYTE_ORDER MSB_LAST FORMAT "%4.1" /end MEASUREMENT
/begin MEASUREMENT v_inj_burst_intp_[48] "voltage burst signal (interpolated)" UWORD _CNV_A_R_LINEAR_____121_CM 1 0. 0. 255. DISPLAY_IDENTIFIER V_INJ_BURST_INTP__48_ ECU_ADDRESS 0x7fafd2 BYTE_ORDER MSB_LAST FORMAT "%4.1" /end MEASUREMENT
/begin MEASUREMENT v_inj_burst_intp_[49] "voltage burst signal (interpolated)" UWORD _CNV_A_R_LINEAR_____121_CM 1 0. 0. 255. DISPLAY_IDENTIFIER V_INJ_BURST_INTP__49_ ECU_ADDRESS 0x7fafd4 BYTE_ORDER MSB_LAST FORMAT "%4.1" /end MEASUREMENT
/begin MEASUREMENT v_inj_burst_intp_[50] "voltage burst signal (interpolated)" UWORD _CNV_A_R_LINEAR_____121_CM 1 0. 0. 255. DISPLAY_IDENTIFIER V_INJ_BURST_INTP__50_ ECU_ADDRESS 0x7fafd6 BYTE_ORDER MSB_LAST FORMAT "%4.1" /end MEASUREMENT
/begin MEASUREMENT v_inj_burst_intp_[51] "voltage burst signal (interpolated)" UWORD _CNV_A_R_LINEAR_____121_CM 1 0. 0. 255. DISPLAY_IDENTIFIER V_INJ_BURST_INTP__51_ ECU_ADDRESS 0x7fafd8 BYTE_ORDER MSB_LAST FORMAT "%4.1" /end MEASUREMENT
/begin MEASUREMENT v_inj_burst_intp_[52] "voltage burst signal (interpolated)" UWORD _CNV_A_R_LINEAR_____121_CM 1 0. 0. 255. DISPLAY_IDENTIFIER V_INJ_BURST_INTP__52_ ECU_ADDRESS 0x7fafda BYTE_ORDER MSB_LAST FORMAT "%4.1" /end MEASUREMENT
/begin MEASUREMENT v_inj_burst_intp_[53] "voltage burst signal (interpolated)" UWORD _CNV_A_R_LINEAR_____121_CM 1 0. 0. 255. DISPLAY_IDENTIFIER V_INJ_BURST_INTP__53_ ECU_ADDRESS 0x7fafdc BYTE_ORDER MSB_LAST FORMAT "%4.1" /end MEASUREMENT
/begin MEASUREMENT v_inj_burst_intp_[54] "voltage burst signal (interpolated)" UWORD _CNV_A_R_LINEAR_____121_CM 1 0. 0. 255. DISPLAY_IDENTIFIER V_INJ_BURST_INTP__54_ ECU_ADDRESS 0x7fafde BYTE_ORDER MSB_LAST FORMAT "%4.1" /end MEASUREMENT
/begin MEASUREMENT v_inj_burst_intp_[55] "voltage burst signal (interpolated)" UWORD _CNV_A_R_LINEAR_____121_CM 1 0. 0. 255. DISPLAY_IDENTIFIER V_INJ_BURST_INTP__55_ ECU_ADDRESS 0x7fafe0 BYTE_ORDER MSB_LAST FORMAT "%4.1" /end MEASUREMENT
/begin MEASUREMENT v_inj_burst_intp_[56] "voltage burst signal (interpolated)" UWORD _CNV_A_R_LINEAR_____121_CM 1 0. 0. 255. DISPLAY_IDENTIFIER V_INJ_BURST_INTP__56_ ECU_ADDRESS 0x7fafe2 BYTE_ORDER MSB_LAST FORMAT "%4.1" /end MEASUREMENT
/begin MEASUREMENT v_inj_burst_intp_[57] "voltage burst signal (interpolated)" UWORD _CNV_A_R_LINEAR_____121_CM 1 0. 0. 255. DISPLAY_IDENTIFIER V_INJ_BURST_INTP__57_ ECU_ADDRESS 0x7fafe4 BYTE_ORDER MSB_LAST FORMAT "%4.1" /end MEASUREMENT
/begin MEASUREMENT v_inj_burst_intp_[58] "voltage burst signal (interpolated)" UWORD _CNV_A_R_LINEAR_____121_CM 1 0. 0. 255. DISPLAY_IDENTIFIER V_INJ_BURST_INTP__58_ ECU_ADDRESS 0x7fafe6 BYTE_ORDER MSB_LAST FORMAT "%4.1" /end MEASUREMENT
/begin MEASUREMENT v_inj_burst_intp_[59] "voltage burst signal (interpolated)" UWORD _CNV_A_R_LINEAR_____121_CM 1 0. 0. 255. DISPLAY_IDENTIFIER V_INJ_BURST_INTP__59_ ECU_ADDRESS 0x7fafe8 BYTE_ORDER MSB_LAST FORMAT "%4.1" /end MEASUREMENT
/begin MEASUREMENT v_inj_burst_intp_[60] "voltage burst signal (interpolated)" UWORD _CNV_A_R_LINEAR_____121_CM 1 0. 0. 255. DISPLAY_IDENTIFIER V_INJ_BURST_INTP__60_ ECU_ADDRESS 0x7fafea BYTE_ORDER MSB_LAST FORMAT "%4.1" /end MEASUREMENT
/begin MEASUREMENT v_inj_burst_intp_[61] "voltage burst signal (interpolated)" UWORD _CNV_A_R_LINEAR_____121_CM 1 0. 0. 255. DISPLAY_IDENTIFIER V_INJ_BURST_INTP__61_ ECU_ADDRESS 0x7fafec BYTE_ORDER MSB_LAST FORMAT "%4.1" /end MEASUREMENT
/begin MEASUREMENT v_inj_burst_intp_[62] "voltage burst signal (interpolated)" UWORD _CNV_A_R_LINEAR_____121_CM 1 0. 0. 255. DISPLAY_IDENTIFIER V_INJ_BURST_INTP__62_ ECU_ADDRESS 0x7fafee BYTE_ORDER MSB_LAST FORMAT "%4.1" /end MEASUREMENT
/begin MEASUREMENT v_inj_burst_intp_[63] "voltage burst signal (interpolated)" UWORD _CNV_A_R_LINEAR_____121_CM 1 0. 0. 255. DISPLAY_IDENTIFIER V_INJ_BURST_INTP__63_ ECU_ADDRESS 0x7faff0 BYTE_ORDER MSB_LAST FORMAT "%4.1" /end MEASUREMENT
/begin MEASUREMENT v_inj_burst_intp_[64] "voltage burst signal (interpolated)" UWORD _CNV_A_R_LINEAR_____121_CM 1 0. 0. 255. DISPLAY_IDENTIFIER V_INJ_BURST_INTP__64_ ECU_ADDRESS 0x7faff2 BYTE_ORDER MSB_LAST FORMAT "%4.1" /end MEASUREMENT
/begin MEASUREMENT v_inj_burst_intp_[65] "voltage burst signal (interpolated)" UWORD _CNV_A_R_LINEAR_____121_CM 1 0. 0. 255. DISPLAY_IDENTIFIER V_INJ_BURST_INTP__65_ ECU_ADDRESS 0x7faff4 BYTE_ORDER MSB_LAST FORMAT "%4.1" /end MEASUREMENT
/begin MEASUREMENT v_inj_burst_intp_[66] "voltage burst signal (interpolated)" UWORD _CNV_A_R_LINEAR_____121_CM 1 0. 0. 255. DISPLAY_IDENTIFIER V_INJ_BURST_INTP__66_ ECU_ADDRESS 0x7faff6 BYTE_ORDER MSB_LAST FORMAT "%4.1" /end MEASUREMENT
/begin MEASUREMENT v_inj_burst_intp_[67] "voltage burst signal (interpolated)" UWORD _CNV_A_R_LINEAR_____121_CM 1 0. 0. 255. DISPLAY_IDENTIFIER V_INJ_BURST_INTP__67_ ECU_ADDRESS 0x7faff8 BYTE_ORDER MSB_LAST FORMAT "%4.1" /end MEASUREMENT
/begin MEASUREMENT v_inj_burst_intp_[68] "voltage burst signal (interpolated)" UWORD _CNV_A_R_LINEAR_____121_CM 1 0. 0. 255. DISPLAY_IDENTIFIER V_INJ_BURST_INTP__68_ ECU_ADDRESS 0x7faffa BYTE_ORDER MSB_LAST FORMAT "%4.1" /end MEASUREMENT
/begin MEASUREMENT v_inj_burst_intp_[69] "voltage burst signal (interpolated)" UWORD _CNV_A_R_LINEAR_____121_CM 1 0. 0. 255. DISPLAY_IDENTIFIER V_INJ_BURST_INTP__69_ ECU_ADDRESS 0x7faffc BYTE_ORDER MSB_LAST FORMAT "%4.1" /end MEASUREMENT
/begin MEASUREMENT v_inj_burst_intp_[70] "voltage burst signal (interpolated)" UWORD _CNV_A_R_LINEAR_____121_CM 1 0. 0. 255. DISPLAY_IDENTIFIER V_INJ_BURST_INTP__70_ ECU_ADDRESS 0x7faffe BYTE_ORDER MSB_LAST FORMAT "%4.1" /end MEASUREMENT
/begin MEASUREMENT v_inj_burst_intp_[71] "voltage burst signal (interpolated)" UWORD _CNV_A_R_LINEAR_____121_CM 1 0. 0. 255. DISPLAY_IDENTIFIER V_INJ_BURST_INTP__71_ ECU_ADDRESS 0x7fb000 BYTE_ORDER MSB_LAST FORMAT "%4.1" /end MEASUREMENT
/begin MEASUREMENT v_inj_burst_intp_[72] "voltage burst signal (interpolated)" UWORD _CNV_A_R_LINEAR_____121_CM 1 0. 0. 255. DISPLAY_IDENTIFIER V_INJ_BURST_INTP__72_ ECU_ADDRESS 0x7fb002 BYTE_ORDER MSB_LAST FORMAT "%4.1" /end MEASUREMENT
/begin MEASUREMENT v_inj_burst_intp_[73] "voltage burst signal (interpolated)" UWORD _CNV_A_R_LINEAR_____121_CM 1 0. 0. 255. DISPLAY_IDENTIFIER V_INJ_BURST_INTP__73_ ECU_ADDRESS 0x7fb004 BYTE_ORDER MSB_LAST FORMAT "%4.1" /end MEASUREMENT
/begin MEASUREMENT v_inj_burst_intp_[74] "voltage burst signal (interpolated)" UWORD _CNV_A_R_LINEAR_____121_CM 1 0. 0. 255. DISPLAY_IDENTIFIER V_INJ_BURST_INTP__74_ ECU_ADDRESS 0x7fb006 BYTE_ORDER MSB_LAST FORMAT "%4.1" /end MEASUREMENT
/begin MEASUREMENT v_inj_burst_intp_[75] "voltage burst signal (interpolated)" UWORD _CNV_A_R_LINEAR_____121_CM 1 0. 0. 255. DISPLAY_IDENTIFIER V_INJ_BURST_INTP__75_ ECU_ADDRESS 0x7fb008 BYTE_ORDER MSB_LAST FORMAT "%4.1" /end MEASUREMENT
/begin MEASUREMENT v_inj_burst_intp_[76] "voltage burst signal (interpolated)" UWORD _CNV_A_R_LINEAR_____121_CM 1 0. 0. 255. DISPLAY_IDENTIFIER V_INJ_BURST_INTP__76_ ECU_ADDRESS 0x7fb00a BYTE_ORDER MSB_LAST FORMAT "%4.1" /end MEASUREMENT
/begin MEASUREMENT v_inj_burst_intp_[77] "voltage burst signal (interpolated)" UWORD _CNV_A_R_LINEAR_____121_CM 1 0. 0. 255. DISPLAY_IDENTIFIER V_INJ_BURST_INTP__77_ ECU_ADDRESS 0x7fb00c BYTE_ORDER MSB_LAST FORMAT "%4.1" /end MEASUREMENT
/begin MEASUREMENT v_inj_burst_intp_[78] "voltage burst signal (interpolated)" UWORD _CNV_A_R_LINEAR_____121_CM 1 0. 0. 255. DISPLAY_IDENTIFIER V_INJ_BURST_INTP__78_ ECU_ADDRESS 0x7fb00e BYTE_ORDER MSB_LAST FORMAT "%4.1" /end MEASUREMENT
/begin MEASUREMENT v_inj_burst_intp_[79] "voltage burst signal (interpolated)" UWORD _CNV_A_R_LINEAR_____121_CM 1 0. 0. 255. DISPLAY_IDENTIFIER V_INJ_BURST_INTP__79_ ECU_ADDRESS 0x7fb010 BYTE_ORDER MSB_LAST FORMAT "%4.1" /end MEASUREMENT
/begin MEASUREMENT v_inj_burst_intp_[80] "voltage burst signal (interpolated)" UWORD _CNV_A_R_LINEAR_____121_CM 1 0. 0. 255. DISPLAY_IDENTIFIER V_INJ_BURST_INTP__80_ ECU_ADDRESS 0x7fb012 BYTE_ORDER MSB_LAST FORMAT "%4.1" /end MEASUREMENT
/begin MEASUREMENT v_inj_burst_intp_[81] "voltage burst signal (interpolated)" UWORD _CNV_A_R_LINEAR_____121_CM 1 0. 0. 255. DISPLAY_IDENTIFIER V_INJ_BURST_INTP__81_ ECU_ADDRESS 0x7fb014 BYTE_ORDER MSB_LAST FORMAT "%4.1" /end MEASUREMENT
/begin MEASUREMENT v_inj_burst_intp_[82] "voltage burst signal (interpolated)" UWORD _CNV_A_R_LINEAR_____121_CM 1 0. 0. 255. DISPLAY_IDENTIFIER V_INJ_BURST_INTP__82_ ECU_ADDRESS 0x7fb016 BYTE_ORDER MSB_LAST FORMAT "%4.1" /end MEASUREMENT
/begin MEASUREMENT v_inj_burst_intp_[83] "voltage burst signal (interpolated)" UWORD _CNV_A_R_LINEAR_____121_CM 1 0. 0. 255. DISPLAY_IDENTIFIER V_INJ_BURST_INTP__83_ ECU_ADDRESS 0x7fb018 BYTE_ORDER MSB_LAST FORMAT "%4.1" /end MEASUREMENT
/begin MEASUREMENT v_inj_burst_intp_[84] "voltage burst signal (interpolated)" UWORD _CNV_A_R_LINEAR_____121_CM 1 0. 0. 255. DISPLAY_IDENTIFIER V_INJ_BURST_INTP__84_ ECU_ADDRESS 0x7fb01a BYTE_ORDER MSB_LAST FORMAT "%4.1" /end MEASUREMENT
/begin MEASUREMENT v_inj_burst_intp_[85] "voltage burst signal (interpolated)" UWORD _CNV_A_R_LINEAR_____121_CM 1 0. 0. 255. DISPLAY_IDENTIFIER V_INJ_BURST_INTP__85_ ECU_ADDRESS 0x7fb01c BYTE_ORDER MSB_LAST FORMAT "%4.1" /end MEASUREMENT
/begin MEASUREMENT v_inj_burst_intp_[86] "voltage burst signal (interpolated)" UWORD _CNV_A_R_LINEAR_____121_CM 1 0. 0. 255. DISPLAY_IDENTIFIER V_INJ_BURST_INTP__86_ ECU_ADDRESS 0x7fb01e BYTE_ORDER MSB_LAST FORMAT "%4.1" /end MEASUREMENT
/begin MEASUREMENT v_inj_burst_intp_[87] "voltage burst signal (interpolated)" UWORD _CNV_A_R_LINEAR_____121_CM 1 0. 0. 255. DISPLAY_IDENTIFIER V_INJ_BURST_INTP__87_ ECU_ADDRESS 0x7fb020 BYTE_ORDER MSB_LAST FORMAT "%4.1" /end MEASUREMENT
/begin MEASUREMENT v_iv_foc_[0] "injector voltage at detection point (cylinder individual)" UWORD _CNV_A_R_LINEAR_____121_CM 1 0. 0. 255. DISPLAY_IDENTIFIER V_IV_FOC__0_ ECU_ADDRESS 0x7fb022 BYTE_ORDER MSB_LAST FORMAT "%4.1" /end MEASUREMENT
/begin MEASUREMENT v_iv_foc_[1] "injector voltage at detection point (cylinder individual)" UWORD _CNV_A_R_LINEAR_____121_CM 1 0. 0. 255. DISPLAY_IDENTIFIER V_IV_FOC__1_ ECU_ADDRESS 0x7fb024 BYTE_ORDER MSB_LAST FORMAT "%4.1" /end MEASUREMENT
/begin MEASUREMENT v_iv_foc_[2] "injector voltage at detection point (cylinder individual)" UWORD _CNV_A_R_LINEAR_____121_CM 1 0. 0. 255. DISPLAY_IDENTIFIER V_IV_FOC__2_ ECU_ADDRESS 0x7fb026 BYTE_ORDER MSB_LAST FORMAT "%4.1" /end MEASUREMENT
/begin MEASUREMENT v_iv_foc_[3] "injector voltage at detection point (cylinder individual)" UWORD _CNV_A_R_LINEAR_____121_CM 1 0. 0. 255. DISPLAY_IDENTIFIER V_IV_FOC__3_ ECU_ADDRESS 0x7fb028 BYTE_ORDER MSB_LAST FORMAT "%4.1" /end MEASUREMENT
/begin CHARACTERISTIC c_acq_intp_fil_ini "initialisation value for FIR filter state variables" VALUE 0x84fb90 _REC_VAL_20_u2 255. _CNV_A_R_LINEAR_____559_CM 0. 255. DISPLAY_IDENTIFIER C_ACQ_INTP_FIL_INI FORMAT "%6.5" /end CHARACTERISTIC
/begin CHARACTERISTIC c_num_fil_value_egy_det_ma[0] "FIR filter numerator coefficient vector for egy_det_ma" VALUE 0x84fe56 _REC_VAL_20_s2 2. _CNV_A_R_LINEAR_____15_CM -1. 1. DISPLAY_IDENTIFIER C_NUM_FIL_VALUE_EGY_DET_MA_0_ FORMAT "%6.5" /end CHARACTERISTIC
/begin CHARACTERISTIC c_num_fil_value_egy_det_ma[1] "FIR filter numerator coefficient vector for egy_det_ma" VALUE 0x84fe58 _REC_VAL_20_s2 2. _CNV_A_R_LINEAR_____15_CM -1. 1. DISPLAY_IDENTIFIER C_NUM_FIL_VALUE_EGY_DET_MA_1_ FORMAT "%6.5" /end CHARACTERISTIC
/begin CHARACTERISTIC c_num_fil_value_egy_det_ma[2] "FIR filter numerator coefficient vector for egy_det_ma" VALUE 0x84fe5a _REC_VAL_20_s2 2. _CNV_A_R_LINEAR_____15_CM -1. 1. DISPLAY_IDENTIFIER C_NUM_FIL_VALUE_EGY_DET_MA_2_ FORMAT "%6.5" /end CHARACTERISTIC
/begin CHARACTERISTIC c_num_fil_value_egy_det_ma[3] "FIR filter numerator coefficient vector for egy_det_ma" VALUE 0x84fe5c _REC_VAL_20_s2 2. _CNV_A_R_LINEAR_____15_CM -1. 1. DISPLAY_IDENTIFIER C_NUM_FIL_VALUE_EGY_DET_MA_3_ FORMAT "%6.5" /end CHARACTERISTIC
/begin CHARACTERISTIC c_num_fil_value_egy_det_ma[4] "FIR filter numerator coefficient vector for egy_det_ma" VALUE 0x84fe5e _REC_VAL_20_s2 2. _CNV_A_R_LINEAR_____15_CM -1. 1. DISPLAY_IDENTIFIER C_NUM_FIL_VALUE_EGY_DET_MA_4_ FORMAT "%6.5" /end CHARACTERISTIC
/begin CHARACTERISTIC c_num_fil_value_egy_det_ma[5] "FIR filter numerator coefficient vector for egy_det_ma" VALUE 0x84fe60 _REC_VAL_20_s2 2. _CNV_A_R_LINEAR_____15_CM -1. 1. DISPLAY_IDENTIFIER C_NUM_FIL_VALUE_EGY_DET_MA_5_ FORMAT "%6.5" /end CHARACTERISTIC
/begin CHARACTERISTIC c_num_fil_value_egy_det_ma[6] "FIR filter numerator coefficient vector for egy_det_ma" VALUE 0x84fe62 _REC_VAL_20_s2 2. _CNV_A_R_LINEAR_____15_CM -1. 1. DISPLAY_IDENTIFIER C_NUM_FIL_VALUE_EGY_DET_MA_6_ FORMAT "%6.5" /end CHARACTERISTIC
/begin CHARACTERISTIC c_num_fil_value_egy_det_ma[7] "FIR filter numerator coefficient vector for egy_det_ma" VALUE 0x84fe64 _REC_VAL_20_s2 2. _CNV_A_R_LINEAR_____15_CM -1. 1. DISPLAY_IDENTIFIER C_NUM_FIL_VALUE_EGY_DET_MA_7_ FORMAT "%6.5" /end CHARACTERISTIC
/begin CHARACTERISTIC c_num_fil_value_egy_det_ma[8] "FIR filter numerator coefficient vector for egy_det_ma" VALUE 0x84fe66 _REC_VAL_20_s2 2. _CNV_A_R_LINEAR_____15_CM -1. 1. DISPLAY_IDENTIFIER C_NUM_FIL_VALUE_EGY_DET_MA_8_ FORMAT "%6.5" /end CHARACTERISTIC
/begin CHARACTERISTIC c_num_fil_value_egy_det_ma[9] "FIR filter numerator coefficient vector for egy_det_ma" VALUE 0x84fe68 _REC_VAL_20_s2 2. _CNV_A_R_LINEAR_____15_CM -1. 1. DISPLAY_IDENTIFIER C_NUM_FIL_VALUE_EGY_DET_MA_9_ FORMAT "%6.5" /end CHARACTERISTIC
/begin CHARACTERISTIC c_dnom_fil_value_egy_det_ma[0] "FIR filter denominator coefficient vector for egy_det_ma" VALUE 0x84fc26 _REC_VAL_20_s2 2. _CNV_A_R_LINEAR_____15_CM -1. 1. DISPLAY_IDENTIFIER C_DNOM_FIL_VALUE_EGY_DET_MA_0_ FORMAT "%6.5" /end CHARACTERISTIC
/begin CHARACTERISTIC c_dnom_fil_value_egy_det_ma[1] "FIR filter denominator coefficient vector for egy_det_ma" VALUE 0x84fc28 _REC_VAL_20_s2 2. _CNV_A_R_LINEAR_____15_CM -1. 1. DISPLAY_IDENTIFIER C_DNOM_FIL_VALUE_EGY_DET_MA_1_ FORMAT "%6.5" /end CHARACTERISTIC
/begin CHARACTERISTIC c_dnom_fil_value_egy_det_ma[2] "FIR filter denominator coefficient vector for egy_det_ma" VALUE 0x84fc2a _REC_VAL_20_s2 2. _CNV_A_R_LINEAR_____15_CM -1. 1. DISPLAY_IDENTIFIER C_DNOM_FIL_VALUE_EGY_DET_MA_2_ FORMAT "%6.5" /end CHARACTERISTIC
/begin CHARACTERISTIC c_dnom_fil_value_egy_det_ma[3] "FIR filter denominator coefficient vector for egy_det_ma" VALUE 0x84fc2c _REC_VAL_20_s2 2. _CNV_A_R_LINEAR_____15_CM -1. 1. DISPLAY_IDENTIFIER C_DNOM_FIL_VALUE_EGY_DET_MA_3_ FORMAT "%6.5" /end CHARACTERISTIC
/begin CHARACTERISTIC c_dnom_fil_value_egy_det_ma[4] "FIR filter denominator coefficient vector for egy_det_ma" VALUE 0x84fc2e _REC_VAL_20_s2 2. _CNV_A_R_LINEAR_____15_CM -1. 1. DISPLAY_IDENTIFIER C_DNOM_FIL_VALUE_EGY_DET_MA_4_ FORMAT "%6.5" /end CHARACTERISTIC
/begin CHARACTERISTIC c_dnom_fil_value_egy_det_ma[5] "FIR filter denominator coefficient vector for egy_det_ma" VALUE 0x84fc30 _REC_VAL_20_s2 2. _CNV_A_R_LINEAR_____15_CM -1. 1. DISPLAY_IDENTIFIER C_DNOM_FIL_VALUE_EGY_DET_MA_5_ FORMAT "%6.5" /end CHARACTERISTIC
/begin CHARACTERISTIC c_dnom_fil_value_egy_det_ma[6] "FIR filter denominator coefficient vector for egy_det_ma" VALUE 0x84fc32 _REC_VAL_20_s2 2. _CNV_A_R_LINEAR_____15_CM -1. 1. DISPLAY_IDENTIFIER C_DNOM_FIL_VALUE_EGY_DET_MA_6_ FORMAT "%6.5" /end CHARACTERISTIC
/begin CHARACTERISTIC c_dnom_fil_value_egy_det_ma[7] "FIR filter denominator coefficient vector for egy_det_ma" VALUE 0x84fc34 _REC_VAL_20_s2 2. _CNV_A_R_LINEAR_____15_CM -1. 1. DISPLAY_IDENTIFIER C_DNOM_FIL_VALUE_EGY_DET_MA_7_ FORMAT "%6.5" /end CHARACTERISTIC
/begin CHARACTERISTIC c_dnom_fil_value_egy_det_ma[8] "FIR filter denominator coefficient vector for egy_det_ma" VALUE 0x84fc36 _REC_VAL_20_s2 2. _CNV_A_R_LINEAR_____15_CM -1. 1. DISPLAY_IDENTIFIER C_DNOM_FIL_VALUE_EGY_DET_MA_8_ FORMAT "%6.5" /end CHARACTERISTIC
/begin CHARACTERISTIC c_dnom_fil_value_egy_det_ma[9] "FIR filter denominator coefficient vector for egy_det_ma" VALUE 0x84fc38 _REC_VAL_20_s2 2. _CNV_A_R_LINEAR_____15_CM -1. 1. DISPLAY_IDENTIFIER C_DNOM_FIL_VALUE_EGY_DET_MA_9_ FORMAT "%6.5" /end CHARACTERISTIC
/begin CHARACTERISTIC c_dnom_fil_value_acq_intp[0] "FIR filter denominator coefficient vector" VALUE 0x84fc14 _REC_VAL_20_s2 2. _CNV_A_R_LINEAR_____15_CM -1. 1. DISPLAY_IDENTIFIER C_DNOM_FIL_VALUE_ACQ_INTP_0_ FORMAT "%6.5" /end CHARACTERISTIC
/begin CHARACTERISTIC c_dnom_fil_value_acq_intp[1] "FIR filter denominator coefficient vector" VALUE 0x84fc16 _REC_VAL_20_s2 2. _CNV_A_R_LINEAR_____15_CM -1. 1. DISPLAY_IDENTIFIER C_DNOM_FIL_VALUE_ACQ_INTP_1_ FORMAT "%6.5" /end CHARACTERISTIC
/begin CHARACTERISTIC c_dnom_fil_value_acq_intp[2] "FIR filter denominator coefficient vector" VALUE 0x84fc18 _REC_VAL_20_s2 2. _CNV_A_R_LINEAR_____15_CM -1. 1. DISPLAY_IDENTIFIER C_DNOM_FIL_VALUE_ACQ_INTP_2_ FORMAT "%6.5" /end CHARACTERISTIC
/begin CHARACTERISTIC c_dnom_fil_value_acq_intp[3] "FIR filter denominator coefficient vector" VALUE 0x84fc1a _REC_VAL_20_s2 2. _CNV_A_R_LINEAR_____15_CM -1. 1. DISPLAY_IDENTIFIER C_DNOM_FIL_VALUE_ACQ_INTP_3_ FORMAT "%6.5" /end CHARACTERISTIC
/begin CHARACTERISTIC c_dnom_fil_value_acq_intp[4] "FIR filter denominator coefficient vector" VALUE 0x84fc1c _REC_VAL_20_s2 2. _CNV_A_R_LINEAR_____15_CM -1. 1. DISPLAY_IDENTIFIER C_DNOM_FIL_VALUE_ACQ_INTP_4_ FORMAT "%6.5" /end CHARACTERISTIC
/begin CHARACTERISTIC c_dnom_fil_value_acq_intp[5] "FIR filter denominator coefficient vector" VALUE 0x84fc1e _REC_VAL_20_s2 2. _CNV_A_R_LINEAR_____15_CM -1. 1. DISPLAY_IDENTIFIER C_DNOM_FIL_VALUE_ACQ_INTP_5_ FORMAT "%6.5" /end CHARACTERISTIC
/begin CHARACTERISTIC c_dnom_fil_value_acq_intp[6] "FIR filter denominator coefficient vector" VALUE 0x84fc20 _REC_VAL_20_s2 2. _CNV_A_R_LINEAR_____15_CM -1. 1. DISPLAY_IDENTIFIER C_DNOM_FIL_VALUE_ACQ_INTP_6_ FORMAT "%6.5" /end CHARACTERISTIC
/begin CHARACTERISTIC c_dnom_fil_value_acq_intp[7] "FIR filter denominator coefficient vector" VALUE 0x84fc22 _REC_VAL_20_s2 2. _CNV_A_R_LINEAR_____15_CM -1. 1. DISPLAY_IDENTIFIER C_DNOM_FIL_VALUE_ACQ_INTP_7_ FORMAT "%6.5" /end CHARACTERISTIC
/begin CHARACTERISTIC c_dnom_fil_value_acq_intp[8] "FIR filter denominator coefficient vector" VALUE 0x84fc24 _REC_VAL_20_s2 2. _CNV_A_R_LINEAR_____15_CM -1. 1. DISPLAY_IDENTIFIER C_DNOM_FIL_VALUE_ACQ_INTP_8_ FORMAT "%6.5" /end CHARACTERISTIC
/begin CHARACTERISTIC c_egy_det_ma_fil_ini "moving average EGY_INJ_DET filter initialisation value" VALUE 0x84fcd8 _REC_VAL_20_u2 522.7750632 _CNV_A_R_LINEAR_____541_CM 0. 522.7750632 DISPLAY_IDENTIFIER C_EGY_DET_MA_FIL_INI /end CHARACTERISTIC
/begin CHARACTERISTIC c_num_fil_value_acq_intp[0] "FIR filter numerator coefficient vector" VALUE 0x84fe44 _REC_VAL_20_s2 2. _CNV_A_R_LINEAR_____15_CM -1. 1. DISPLAY_IDENTIFIER C_NUM_FIL_VALUE_ACQ_INTP_0_ FORMAT "%6.5" /end CHARACTERISTIC
/begin CHARACTERISTIC c_num_fil_value_acq_intp[1] "FIR filter numerator coefficient vector" VALUE 0x84fe46 _REC_VAL_20_s2 2. _CNV_A_R_LINEAR_____15_CM -1. 1. DISPLAY_IDENTIFIER C_NUM_FIL_VALUE_ACQ_INTP_1_ FORMAT "%6.5" /end CHARACTERISTIC
/begin CHARACTERISTIC c_num_fil_value_acq_intp[2] "FIR filter numerator coefficient vector" VALUE 0x84fe48 _REC_VAL_20_s2 2. _CNV_A_R_LINEAR_____15_CM -1. 1. DISPLAY_IDENTIFIER C_NUM_FIL_VALUE_ACQ_INTP_2_ FORMAT "%6.5" /end CHARACTERISTIC
/begin CHARACTERISTIC c_num_fil_value_acq_intp[3] "FIR filter numerator coefficient vector" VALUE 0x84fe4a _REC_VAL_20_s2 2. _CNV_A_R_LINEAR_____15_CM -1. 1. DISPLAY_IDENTIFIER C_NUM_FIL_VALUE_ACQ_INTP_3_ FORMAT "%6.5" /end CHARACTERISTIC
/begin CHARACTERISTIC c_num_fil_value_acq_intp[4] "FIR filter numerator coefficient vector" VALUE 0x84fe4c _REC_VAL_20_s2 2. _CNV_A_R_LINEAR_____15_CM -1. 1. DISPLAY_IDENTIFIER C_NUM_FIL_VALUE_ACQ_INTP_4_ FORMAT "%6.5" /end CHARACTERISTIC
/begin CHARACTERISTIC c_num_fil_value_acq_intp[5] "FIR filter numerator coefficient vector" VALUE 0x84fe4e _REC_VAL_20_s2 2. _CNV_A_R_LINEAR_____15_CM -1. 1. DISPLAY_IDENTIFIER C_NUM_FIL_VALUE_ACQ_INTP_5_ FORMAT "%6.5" /end CHARACTERISTIC
/begin CHARACTERISTIC c_num_fil_value_acq_intp[6] "FIR filter numerator coefficient vector" VALUE 0x84fe50 _REC_VAL_20_s2 2. _CNV_A_R_LINEAR_____15_CM -1. 1. DISPLAY_IDENTIFIER C_NUM_FIL_VALUE_ACQ_INTP_6_ FORMAT "%6.5" /end CHARACTERISTIC
/begin CHARACTERISTIC c_num_fil_value_acq_intp[7] "FIR filter numerator coefficient vector" VALUE 0x84fe52 _REC_VAL_20_s2 2. _CNV_A_R_LINEAR_____15_CM -1. 1. DISPLAY_IDENTIFIER C_NUM_FIL_VALUE_ACQ_INTP_7_ FORMAT "%6.5" /end CHARACTERISTIC
/begin CHARACTERISTIC c_num_fil_value_acq_intp[8] "FIR filter numerator coefficient vector" VALUE 0x84fe54 _REC_VAL_20_s2 2. _CNV_A_R_LINEAR_____15_CM -1. 1. DISPLAY_IDENTIFIER C_NUM_FIL_VALUE_ACQ_INTP_8_ FORMAT "%6.5" /end CHARACTERISTIC
/begin CHARACTERISTIC c_sample_nr_det_beg "start sample of detection window" VALUE 0x84feea _REC_VAL_20_u1 255. _CNV_A_R_LINEAR_____0_CM 0. 255. DISPLAY_IDENTIFIER C_SAMPLE_NR_DET_BEG FORMAT "%3.0" /end CHARACTERISTIC
/begin CHARACTERISTIC c_sample_nr_det_dly "number of samples until trigger of detection" VALUE 0x84feeb _REC_VAL_20_u1 255. _CNV_A_R_LINEAR_____0_CM 0. 255. DISPLAY_IDENTIFIER C_SAMPLE_NR_DET_DLY FORMAT "%3.0" /end CHARACTERISTIC
/begin CHARACTERISTIC c_sample_nr_det_end "final sample of detection window" VALUE 0x84feec _REC_VAL_20_u1 255. _CNV_A_R_LINEAR_____0_CM 0. 255. DISPLAY_IDENTIFIER C_SAMPLE_NR_DET_END FORMAT "%3.0" /end CHARACTERISTIC
/begin CHARACTERISTIC c_sample_nr_det_lst "number of samples until last vector point (during detection)" VALUE 0x84feed _REC_VAL_20_u1 255. _CNV_A_R_LINEAR_____0_CM 0. 255. DISPLAY_IDENTIFIER C_SAMPLE_NR_DET_LST FORMAT "%3.0" /end CHARACTERISTIC
/begin CHARACTERISTIC c_t_egy_inj_det_dly "group delay of FIR moving average filter" VALUE 0x84ff74 _REC_VAL_20_s2 0.6553500000000001 _CNV_A_R_LINEAR_____560_CM -0.32768 0.32767 DISPLAY_IDENTIFIER C_T_EGY_INJ_DET_DLY FORMAT "%7.5" /end CHARACTERISTIC
/begin CHARACTERISTIC c_t_sample_burst "burst measurement sample time" VALUE 0x84ffe8 _REC_VAL_20_u2 0.32767 _CNV_A_R_LINEAR_____561_CM 0. 0.32767 DISPLAY_IDENTIFIER C_T_SAMPLE_BURST FORMAT "%7.5" /end CHARACTERISTIC
/begin CHARACTERISTIC c_v_inj_burst_dif_min "plausibility of signal minimum" VALUE 0x8500ac _REC_VAL_20_s2 511. _CNV_A_R_LINEAR_____558_CM -256. 255. DISPLAY_IDENTIFIER C_V_INJ_BURST_DIF_MIN FORMAT "%4.1" /end CHARACTERISTIC
/begin CHARACTERISTIC lc_v_inj_burst_dif_sel "select first or second order derivative" VALUE 0x85017e _REC_VAL_20_u1 1. _CNV_A_R_LINEAR_____0_CM 0. 1. DISPLAY_IDENTIFIER LC_V_INJ_BURST_DIF_SEL FORMAT "%1.0" /end CHARACTERISTIC
/begin CHARACTERISTIC lc_v_inj_burst_fil_max "single or multiple maximum detection" VALUE 0x85017f _REC_VAL_20_u1 1. _CNV_A_R_LINEAR_____0_CM 0. 1. DISPLAY_IDENTIFIER LC_V_INJ_BURST_FIL_MAX FORMAT "%1.0" /end CHARACTERISTIC
/begin CHARACTERISTIC lc_v_inj_burst_intp_on "switch interpolation of V_INJ_BURST on" VALUE 0x850180 _REC_VAL_20_u1 1. _CNV_A_R_LINEAR_____0_CM 0. 1. DISPLAY_IDENTIFIER LC_V_INJ_BURST_INTP_ON FORMAT "%1.0" /end CHARACTERISTIC
/begin CHARACTERISTIC lc_v_inj_burst_lnr_on "switch linearization of V_INJ_INTP" VALUE 0x850181 _REC_VAL_20_u1 1. _CNV_A_R_LINEAR_____0_CM 0. 1. DISPLAY_IDENTIFIER LC_V_INJ_BURST_LNR_ON FORMAT "%1.0" /end CHARACTERISTIC
/begin MEASUREMENT cnt_t_iv_close_stc_succ_[0] "success of t_iv_close determination counter (cylinder individual)" UWORD _CNV_A_R_LINEAR_____0_CM 1 0. 0. 65535. DISPLAY_IDENTIFIER CNT_T_IV_CLOSE_STC_SUCC__0_ ECU_ADDRESS 0x7fb02e BYTE_ORDER MSB_LAST FORMAT "%5.0" /end MEASUREMENT
/begin MEASUREMENT cnt_t_iv_close_stc_succ_[1] "success of t_iv_close determination counter (cylinder individual)" UWORD _CNV_A_R_LINEAR_____0_CM 1 0. 0. 65535. DISPLAY_IDENTIFIER CNT_T_IV_CLOSE_STC_SUCC__1_ ECU_ADDRESS 0x7fb030 BYTE_ORDER MSB_LAST FORMAT "%5.0" /end MEASUREMENT
/begin MEASUREMENT cnt_t_iv_close_stc_succ_[2] "success of t_iv_close determination counter (cylinder individual)" UWORD _CNV_A_R_LINEAR_____0_CM 1 0. 0. 65535. DISPLAY_IDENTIFIER CNT_T_IV_CLOSE_STC_SUCC__2_ ECU_ADDRESS 0x7fb032 BYTE_ORDER MSB_LAST FORMAT "%5.0" /end MEASUREMENT
/begin MEASUREMENT cnt_t_iv_close_stc_succ_[3] "success of t_iv_close determination counter (cylinder individual)" UWORD _CNV_A_R_LINEAR_____0_CM 1 0. 0. 65535. DISPLAY_IDENTIFIER CNT_T_IV_CLOSE_STC_SUCC__3_ ECU_ADDRESS 0x7fb034 BYTE_ORDER MSB_LAST FORMAT "%5.0" /end MEASUREMENT
/begin MEASUREMENT cnt_t_iv_close_stc_fail_cont_[0] "fail of t_iv_close determination continous counter (cylinder individual)" UWORD _CNV_A_R_LINEAR_____0_CM 1 0. 0. 65535. DISPLAY_IDENTIFIER CNT_T_IV_CLOSE_STC_FAIL_CONT__0_ ECU_ADDRESS 0x7fb036 BYTE_ORDER MSB_LAST FORMAT "%5.0" /end MEASUREMENT
/begin MEASUREMENT cnt_t_iv_close_stc_fail_cont_[1] "fail of t_iv_close determination continous counter (cylinder individual)" UWORD _CNV_A_R_LINEAR_____0_CM 1 0. 0. 65535. DISPLAY_IDENTIFIER CNT_T_IV_CLOSE_STC_FAIL_CONT__1_ ECU_ADDRESS 0x7fb038 BYTE_ORDER MSB_LAST FORMAT "%5.0" /end MEASUREMENT
/begin MEASUREMENT cnt_t_iv_close_stc_fail_cont_[2] "fail of t_iv_close determination continous counter (cylinder individual)" UWORD _CNV_A_R_LINEAR_____0_CM 1 0. 0. 65535. DISPLAY_IDENTIFIER CNT_T_IV_CLOSE_STC_FAIL_CONT__2_ ECU_ADDRESS 0x7fb03a BYTE_ORDER MSB_LAST FORMAT "%5.0" /end MEASUREMENT
/begin MEASUREMENT cnt_t_iv_close_stc_fail_cont_[3] "fail of t_iv_close determination continous counter (cylinder individual)" UWORD _CNV_A_R_LINEAR_____0_CM 1 0. 0. 65535. DISPLAY_IDENTIFIER CNT_T_IV_CLOSE_STC_FAIL_CONT__3_ ECU_ADDRESS 0x7fb03c BYTE_ORDER MSB_LAST FORMAT "%5.0" /end MEASUREMENT
/begin MEASUREMENT cnt_t_iv_close_stc_fail_[0] "fail of t_iv_close determination continous counter (cylinder individual)" UWORD _CNV_A_R_LINEAR_____0_CM 1 0. 0. 65535. DISPLAY_IDENTIFIER CNT_T_IV_CLOSE_STC_FAIL__0_ ECU_ADDRESS 0x7fb03e BYTE_ORDER MSB_LAST FORMAT "%5.0" /end MEASUREMENT
/begin MEASUREMENT cnt_t_iv_close_stc_fail_[1] "fail of t_iv_close determination continous counter (cylinder individual)" UWORD _CNV_A_R_LINEAR_____0_CM 1 0. 0. 65535. DISPLAY_IDENTIFIER CNT_T_IV_CLOSE_STC_FAIL__1_ ECU_ADDRESS 0x7fb040 BYTE_ORDER MSB_LAST FORMAT "%5.0" /end MEASUREMENT
/begin MEASUREMENT cnt_t_iv_close_stc_fail_[2] "fail of t_iv_close determination continous counter (cylinder individual)" UWORD _CNV_A_R_LINEAR_____0_CM 1 0. 0. 65535. DISPLAY_IDENTIFIER CNT_T_IV_CLOSE_STC_FAIL__2_ ECU_ADDRESS 0x7fb042 BYTE_ORDER MSB_LAST FORMAT "%5.0" /end MEASUREMENT
/begin MEASUREMENT cnt_t_iv_close_stc_fail_[3] "fail of t_iv_close determination continous counter (cylinder individual)" UWORD _CNV_A_R_LINEAR_____0_CM 1 0. 0. 65535. DISPLAY_IDENTIFIER CNT_T_IV_CLOSE_STC_FAIL__3_ ECU_ADDRESS 0x7fb044 BYTE_ORDER MSB_LAST FORMAT "%5.0" /end MEASUREMENT
/begin MEASUREMENT cnt_t_iv_close_stc_0[0] "fail of t_iv_close determination continous counter (cylinder 0)" UWORD _CNV_A_R_LINEAR_____0_CM 1 0. 0. 65535. DISPLAY_IDENTIFIER CNT_T_IV_CLOSE_STC_0_0_ ECU_ADDRESS 0x7fb046 BYTE_ORDER MSB_LAST FORMAT "%5.0" /end MEASUREMENT
/begin MEASUREMENT cnt_t_iv_close_stc_0[1] "fail of t_iv_close determination continous counter (cylinder 0)" UWORD _CNV_A_R_LINEAR_____0_CM 1 0. 0. 65535. DISPLAY_IDENTIFIER CNT_T_IV_CLOSE_STC_0_1_ ECU_ADDRESS 0x7fb048 BYTE_ORDER MSB_LAST FORMAT "%5.0" /end MEASUREMENT
/begin MEASUREMENT cnt_t_iv_close_stc_0[2] "fail of t_iv_close determination continous counter (cylinder 0)" UWORD _CNV_A_R_LINEAR_____0_CM 1 0. 0. 65535. DISPLAY_IDENTIFIER CNT_T_IV_CLOSE_STC_0_2_ ECU_ADDRESS 0x7fb04a BYTE_ORDER MSB_LAST FORMAT "%5.0" /end MEASUREMENT
/begin MEASUREMENT cnt_t_iv_close_stc_0[3] "fail of t_iv_close determination continous counter (cylinder 0)" UWORD _CNV_A_R_LINEAR_____0_CM 1 0. 0. 65535. DISPLAY_IDENTIFIER CNT_T_IV_CLOSE_STC_0_3_ ECU_ADDRESS 0x7fb04c BYTE_ORDER MSB_LAST FORMAT "%5.0" /end MEASUREMENT
/begin MEASUREMENT cnt_t_iv_close_stc_0[4] "fail of t_iv_close determination continous counter (cylinder 0)" UWORD _CNV_A_R_LINEAR_____0_CM 1 0. 0. 65535. DISPLAY_IDENTIFIER CNT_T_IV_CLOSE_STC_0_4_ ECU_ADDRESS 0x7fb04e BYTE_ORDER MSB_LAST FORMAT "%5.0" /end MEASUREMENT
/begin MEASUREMENT cnt_t_iv_close_stc_0[5] "fail of t_iv_close determination continous counter (cylinder 0)" UWORD _CNV_A_R_LINEAR_____0_CM 1 0. 0. 65535. DISPLAY_IDENTIFIER CNT_T_IV_CLOSE_STC_0_5_ ECU_ADDRESS 0x7fb050 BYTE_ORDER MSB_LAST FORMAT "%5.0" /end MEASUREMENT
/begin MEASUREMENT cnt_t_iv_close_stc_0[6] "fail of t_iv_close determination continous counter (cylinder 0)" UWORD _CNV_A_R_LINEAR_____0_CM 1 0. 0. 65535. DISPLAY_IDENTIFIER CNT_T_IV_CLOSE_STC_0_6_ ECU_ADDRESS 0x7fb052 BYTE_ORDER MSB_LAST FORMAT "%5.0" /end MEASUREMENT
/begin MEASUREMENT cnt_t_iv_close_stc_0[7] "fail of t_iv_close determination continous counter (cylinder 0)" UWORD _CNV_A_R_LINEAR_____0_CM 1 0. 0. 65535. DISPLAY_IDENTIFIER CNT_T_IV_CLOSE_STC_0_7_ ECU_ADDRESS 0x7fb054 BYTE_ORDER MSB_LAST FORMAT "%5.0" /end MEASUREMENT
/begin MEASUREMENT cnt_t_iv_close_stc_0[8] "fail of t_iv_close determination continous counter (cylinder 0)" UWORD _CNV_A_R_LINEAR_____0_CM 1 0. 0. 65535. DISPLAY_IDENTIFIER CNT_T_IV_CLOSE_STC_0_8_ ECU_ADDRESS 0x7fb056 BYTE_ORDER MSB_LAST FORMAT "%5.0" /end MEASUREMENT
/begin MEASUREMENT cnt_t_iv_close_stc_0[9] "fail of t_iv_close determination continous counter (cylinder 0)" UWORD _CNV_A_R_LINEAR_____0_CM 1 0. 0. 65535. DISPLAY_IDENTIFIER CNT_T_IV_CLOSE_STC_0_9_ ECU_ADDRESS 0x7fb058 BYTE_ORDER MSB_LAST FORMAT "%5.0" /end MEASUREMENT
/begin MEASUREMENT cnt_t_iv_close_stc_0[10] "fail of t_iv_close determination continous counter (cylinder 0)" UWORD _CNV_A_R_LINEAR_____0_CM 1 0. 0. 65535. DISPLAY_IDENTIFIER CNT_T_IV_CLOSE_STC_0_10_ ECU_ADDRESS 0x7fb05a BYTE_ORDER MSB_LAST FORMAT "%5.0" /end MEASUREMENT
/begin MEASUREMENT cnt_t_iv_close_stc_0[11] "fail of t_iv_close determination continous counter (cylinder 0)" UWORD _CNV_A_R_LINEAR_____0_CM 1 0. 0. 65535. DISPLAY_IDENTIFIER CNT_T_IV_CLOSE_STC_0_11_ ECU_ADDRESS 0x7fb05c BYTE_ORDER MSB_LAST FORMAT "%5.0" /end MEASUREMENT
/begin MEASUREMENT cnt_t_iv_close_stc_0[12] "fail of t_iv_close determination continous counter (cylinder 0)" UWORD _CNV_A_R_LINEAR_____0_CM 1 0. 0. 65535. DISPLAY_IDENTIFIER CNT_T_IV_CLOSE_STC_0_12_ ECU_ADDRESS 0x7fb05e BYTE_ORDER MSB_LAST FORMAT "%5.0" /end MEASUREMENT
/begin MEASUREMENT cnt_t_iv_close_stc_1[0] "fail of t_iv_close determination continous counter (cylinder 0)" UWORD _CNV_A_R_LINEAR_____0_CM 1 0. 0. 65535. DISPLAY_IDENTIFIER CNT_T_IV_CLOSE_STC_1_0_ ECU_ADDRESS 0x7fb060 BYTE_ORDER MSB_LAST FORMAT "%5.0" /end MEASUREMENT
/begin MEASUREMENT cnt_t_iv_close_stc_1[1] "fail of t_iv_close determination continous counter (cylinder 0)" UWORD _CNV_A_R_LINEAR_____0_CM 1 0. 0. 65535. DISPLAY_IDENTIFIER CNT_T_IV_CLOSE_STC_1_1_ ECU_ADDRESS 0x7fb062 BYTE_ORDER MSB_LAST FORMAT "%5.0" /end MEASUREMENT
/begin MEASUREMENT cnt_t_iv_close_stc_1[2] "fail of t_iv_close determination continous counter (cylinder 0)" UWORD _CNV_A_R_LINEAR_____0_CM 1 0. 0. 65535. DISPLAY_IDENTIFIER CNT_T_IV_CLOSE_STC_1_2_ ECU_ADDRESS 0x7fb064 BYTE_ORDER MSB_LAST FORMAT "%5.0" /end MEASUREMENT
/begin MEASUREMENT cnt_t_iv_close_stc_1[3] "fail of t_iv_close determination continous counter (cylinder 0)" UWORD _CNV_A_R_LINEAR_____0_CM 1 0. 0. 65535. DISPLAY_IDENTIFIER CNT_T_IV_CLOSE_STC_1_3_ ECU_ADDRESS 0x7fb066 BYTE_ORDER MSB_LAST FORMAT "%5.0" /end MEASUREMENT
/begin MEASUREMENT cnt_t_iv_close_stc_1[4] "fail of t_iv_close determination continous counter (cylinder 0)" UWORD _CNV_A_R_LINEAR_____0_CM 1 0. 0. 65535. DISPLAY_IDENTIFIER CNT_T_IV_CLOSE_STC_1_4_ ECU_ADDRESS 0x7fb068 BYTE_ORDER MSB_LAST FORMAT "%5.0" /end MEASUREMENT
/begin MEASUREMENT cnt_t_iv_close_stc_1[5] "fail of t_iv_close determination continous counter (cylinder 0)" UWORD _CNV_A_R_LINEAR_____0_CM 1 0. 0. 65535. DISPLAY_IDENTIFIER CNT_T_IV_CLOSE_STC_1_5_ ECU_ADDRESS 0x7fb06a BYTE_ORDER MSB_LAST FORMAT "%5.0" /end MEASUREMENT
/begin MEASUREMENT cnt_t_iv_close_stc_1[6] "fail of t_iv_close determination continous counter (cylinder 0)" UWORD _CNV_A_R_LINEAR_____0_CM 1 0. 0. 65535. DISPLAY_IDENTIFIER CNT_T_IV_CLOSE_STC_1_6_ ECU_ADDRESS 0x7fb06c BYTE_ORDER MSB_LAST FORMAT "%5.0" /end MEASUREMENT
/begin MEASUREMENT cnt_t_iv_close_stc_1[7] "fail of t_iv_close determination continous counter (cylinder 0)" UWORD _CNV_A_R_LINEAR_____0_CM 1 0. 0. 65535. DISPLAY_IDENTIFIER CNT_T_IV_CLOSE_STC_1_7_ ECU_ADDRESS 0x7fb06e BYTE_ORDER MSB_LAST FORMAT "%5.0" /end MEASUREMENT
/begin MEASUREMENT cnt_t_iv_close_stc_1[8] "fail of t_iv_close determination continous counter (cylinder 0)" UWORD _CNV_A_R_LINEAR_____0_CM 1 0. 0. 65535. DISPLAY_IDENTIFIER CNT_T_IV_CLOSE_STC_1_8_ ECU_ADDRESS 0x7fb070 BYTE_ORDER MSB_LAST FORMAT "%5.0" /end MEASUREMENT
/begin MEASUREMENT cnt_t_iv_close_stc_1[9] "fail of t_iv_close determination continous counter (cylinder 0)" UWORD _CNV_A_R_LINEAR_____0_CM 1 0. 0. 65535. DISPLAY_IDENTIFIER CNT_T_IV_CLOSE_STC_1_9_ ECU_ADDRESS 0x7fb072 BYTE_ORDER MSB_LAST FORMAT "%5.0" /end MEASUREMENT
/begin MEASUREMENT cnt_t_iv_close_stc_1[10] "fail of t_iv_close determination continous counter (cylinder 0)" UWORD _CNV_A_R_LINEAR_____0_CM 1 0. 0. 65535. DISPLAY_IDENTIFIER CNT_T_IV_CLOSE_STC_1_10_ ECU_ADDRESS 0x7fb074 BYTE_ORDER MSB_LAST FORMAT "%5.0" /end MEASUREMENT
/begin MEASUREMENT cnt_t_iv_close_stc_1[11] "fail of t_iv_close determination continous counter (cylinder 0)" UWORD _CNV_A_R_LINEAR_____0_CM 1 0. 0. 65535. DISPLAY_IDENTIFIER CNT_T_IV_CLOSE_STC_1_11_ ECU_ADDRESS 0x7fb076 BYTE_ORDER MSB_LAST FORMAT "%5.0" /end MEASUREMENT
/begin MEASUREMENT cnt_t_iv_close_stc_1[12] "fail of t_iv_close determination continous counter (cylinder 0)" UWORD _CNV_A_R_LINEAR_____0_CM 1 0. 0. 65535. DISPLAY_IDENTIFIER CNT_T_IV_CLOSE_STC_1_12_ ECU_ADDRESS 0x7fb078 BYTE_ORDER MSB_LAST FORMAT "%5.0" /end MEASUREMENT
/begin MEASUREMENT cnt_t_iv_close_stc_2[0] "fail of t_iv_close determination continous counter (cylinder 0)" UWORD _CNV_A_R_LINEAR_____0_CM 1 0. 0. 65535. DISPLAY_IDENTIFIER CNT_T_IV_CLOSE_STC_2_0_ ECU_ADDRESS 0x7fb07a BYTE_ORDER MSB_LAST FORMAT "%5.0" /end MEASUREMENT
/begin MEASUREMENT cnt_t_iv_close_stc_2[1] "fail of t_iv_close determination continous counter (cylinder 0)" UWORD _CNV_A_R_LINEAR_____0_CM 1 0. 0. 65535. DISPLAY_IDENTIFIER CNT_T_IV_CLOSE_STC_2_1_ ECU_ADDRESS 0x7fb07c BYTE_ORDER MSB_LAST FORMAT "%5.0" /end MEASUREMENT
/begin MEASUREMENT cnt_t_iv_close_stc_2[2] "fail of t_iv_close determination continous counter (cylinder 0)" UWORD _CNV_A_R_LINEAR_____0_CM 1 0. 0. 65535. DISPLAY_IDENTIFIER CNT_T_IV_CLOSE_STC_2_2_ ECU_ADDRESS 0x7fb07e BYTE_ORDER MSB_LAST FORMAT "%5.0" /end MEASUREMENT
/begin MEASUREMENT cnt_t_iv_close_stc_2[3] "fail of t_iv_close determination continous counter (cylinder 0)" UWORD _CNV_A_R_LINEAR_____0_CM 1 0. 0. 65535. DISPLAY_IDENTIFIER CNT_T_IV_CLOSE_STC_2_3_ ECU_ADDRESS 0x7fb080 BYTE_ORDER MSB_LAST FORMAT "%5.0" /end MEASUREMENT
/begin MEASUREMENT cnt_t_iv_close_stc_2[4] "fail of t_iv_close determination continous counter (cylinder 0)" UWORD _CNV_A_R_LINEAR_____0_CM 1 0. 0. 65535. DISPLAY_IDENTIFIER CNT_T_IV_CLOSE_STC_2_4_ ECU_ADDRESS 0x7fb082 BYTE_ORDER MSB_LAST FORMAT "%5.0" /end MEASUREMENT
/begin MEASUREMENT cnt_t_iv_close_stc_2[5] "fail of t_iv_close determination continous counter (cylinder 0)" UWORD _CNV_A_R_LINEAR_____0_CM 1 0. 0. 65535. DISPLAY_IDENTIFIER CNT_T_IV_CLOSE_STC_2_5_ ECU_ADDRESS 0x7fb084 BYTE_ORDER MSB_LAST FORMAT "%5.0" /end MEASUREMENT
/begin MEASUREMENT cnt_t_iv_close_stc_2[6] "fail of t_iv_close determination continous counter (cylinder 0)" UWORD _CNV_A_R_LINEAR_____0_CM 1 0. 0. 65535. DISPLAY_IDENTIFIER CNT_T_IV_CLOSE_STC_2_6_ ECU_ADDRESS 0x7fb086 BYTE_ORDER MSB_LAST FORMAT "%5.0" /end MEASUREMENT
/begin MEASUREMENT cnt_t_iv_close_stc_2[7] "fail of t_iv_close determination continous counter (cylinder 0)" UWORD _CNV_A_R_LINEAR_____0_CM 1 0. 0. 65535. DISPLAY_IDENTIFIER CNT_T_IV_CLOSE_STC_2_7_ ECU_ADDRESS 0x7fb088 BYTE_ORDER MSB_LAST FORMAT "%5.0" /end MEASUREMENT
/begin MEASUREMENT cnt_t_iv_close_stc_2[8] "fail of t_iv_close determination continous counter (cylinder 0)" UWORD _CNV_A_R_LINEAR_____0_CM 1 0. 0. 65535. DISPLAY_IDENTIFIER CNT_T_IV_CLOSE_STC_2_8_ ECU_ADDRESS 0x7fb08a BYTE_ORDER MSB_LAST FORMAT "%5.0" /end MEASUREMENT
/begin MEASUREMENT cnt_t_iv_close_stc_2[9] "fail of t_iv_close determination continous counter (cylinder 0)" UWORD _CNV_A_R_LINEAR_____0_CM 1 0. 0. 65535. DISPLAY_IDENTIFIER CNT_T_IV_CLOSE_STC_2_9_ ECU_ADDRESS 0x7fb08c BYTE_ORDER MSB_LAST FORMAT "%5.0" /end MEASUREMENT
/begin MEASUREMENT cnt_t_iv_close_stc_2[10] "fail of t_iv_close determination continous counter (cylinder 0)" UWORD _CNV_A_R_LINEAR_____0_CM 1 0. 0. 65535. DISPLAY_IDENTIFIER CNT_T_IV_CLOSE_STC_2_10_ ECU_ADDRESS 0x7fb08e BYTE_ORDER MSB_LAST FORMAT "%5.0" /end MEASUREMENT
/begin MEASUREMENT cnt_t_iv_close_stc_2[11] "fail of t_iv_close determination continous counter (cylinder 0)" UWORD _CNV_A_R_LINEAR_____0_CM 1 0. 0. 65535. DISPLAY_IDENTIFIER CNT_T_IV_CLOSE_STC_2_11_ ECU_ADDRESS 0x7fb090 BYTE_ORDER MSB_LAST FORMAT "%5.0" /end MEASUREMENT
/begin MEASUREMENT cnt_t_iv_close_stc_2[12] "fail of t_iv_close determination continous counter (cylinder 0)" UWORD _CNV_A_R_LINEAR_____0_CM 1 0. 0. 65535. DISPLAY_IDENTIFIER CNT_T_IV_CLOSE_STC_2_12_ ECU_ADDRESS 0x7fb092 BYTE_ORDER MSB_LAST FORMAT "%5.0" /end MEASUREMENT
/begin MEASUREMENT cnt_t_iv_close_stc_3[0] "fail of t_iv_close determination continous counter (cylinder 0)" UWORD _CNV_A_R_LINEAR_____0_CM 1 0. 0. 65535. DISPLAY_IDENTIFIER CNT_T_IV_CLOSE_STC_3_0_ ECU_ADDRESS 0x7fb094 BYTE_ORDER MSB_LAST FORMAT "%5.0" /end MEASUREMENT
/begin MEASUREMENT cnt_t_iv_close_stc_3[1] "fail of t_iv_close determination continous counter (cylinder 0)" UWORD _CNV_A_R_LINEAR_____0_CM 1 0. 0. 65535. DISPLAY_IDENTIFIER CNT_T_IV_CLOSE_STC_3_1_ ECU_ADDRESS 0x7fb096 BYTE_ORDER MSB_LAST FORMAT "%5.0" /end MEASUREMENT
/begin MEASUREMENT cnt_t_iv_close_stc_3[2] "fail of t_iv_close determination continous counter (cylinder 0)" UWORD _CNV_A_R_LINEAR_____0_CM 1 0. 0. 65535. DISPLAY_IDENTIFIER CNT_T_IV_CLOSE_STC_3_2_ ECU_ADDRESS 0x7fb098 BYTE_ORDER MSB_LAST FORMAT "%5.0" /end MEASUREMENT
/begin MEASUREMENT cnt_t_iv_close_stc_3[3] "fail of t_iv_close determination continous counter (cylinder 0)" UWORD _CNV_A_R_LINEAR_____0_CM 1 0. 0. 65535. DISPLAY_IDENTIFIER CNT_T_IV_CLOSE_STC_3_3_ ECU_ADDRESS 0x7fb09a BYTE_ORDER MSB_LAST FORMAT "%5.0" /end MEASUREMENT
/begin MEASUREMENT cnt_t_iv_close_stc_3[4] "fail of t_iv_close determination continous counter (cylinder 0)" UWORD _CNV_A_R_LINEAR_____0_CM 1 0. 0. 65535. DISPLAY_IDENTIFIER CNT_T_IV_CLOSE_STC_3_4_ ECU_ADDRESS 0x7fb09c BYTE_ORDER MSB_LAST FORMAT "%5.0" /end MEASUREMENT
/begin MEASUREMENT cnt_t_iv_close_stc_3[5] "fail of t_iv_close determination continous counter (cylinder 0)" UWORD _CNV_A_R_LINEAR_____0_CM 1 0. 0. 65535. DISPLAY_IDENTIFIER CNT_T_IV_CLOSE_STC_3_5_ ECU_ADDRESS 0x7fb09e BYTE_ORDER MSB_LAST FORMAT "%5.0" /end MEASUREMENT
/begin MEASUREMENT cnt_t_iv_close_stc_3[6] "fail of t_iv_close determination continous counter (cylinder 0)" UWORD _CNV_A_R_LINEAR_____0_CM 1 0. 0. 65535. DISPLAY_IDENTIFIER CNT_T_IV_CLOSE_STC_3_6_ ECU_ADDRESS 0x7fb0a0 BYTE_ORDER MSB_LAST FORMAT "%5.0" /end MEASUREMENT
/begin MEASUREMENT cnt_t_iv_close_stc_3[7] "fail of t_iv_close determination continous counter (cylinder 0)" UWORD _CNV_A_R_LINEAR_____0_CM 1 0. 0. 65535. DISPLAY_IDENTIFIER CNT_T_IV_CLOSE_STC_3_7_ ECU_ADDRESS 0x7fb0a2 BYTE_ORDER MSB_LAST FORMAT "%5.0" /end MEASUREMENT
/begin MEASUREMENT cnt_t_iv_close_stc_3[8] "fail of t_iv_close determination continous counter (cylinder 0)" UWORD _CNV_A_R_LINEAR_____0_CM 1 0. 0. 65535. DISPLAY_IDENTIFIER CNT_T_IV_CLOSE_STC_3_8_ ECU_ADDRESS 0x7fb0a4 BYTE_ORDER MSB_LAST FORMAT "%5.0" /end MEASUREMENT
/begin MEASUREMENT cnt_t_iv_close_stc_3[9] "fail of t_iv_close determination continous counter (cylinder 0)" UWORD _CNV_A_R_LINEAR_____0_CM 1 0. 0. 65535. DISPLAY_IDENTIFIER CNT_T_IV_CLOSE_STC_3_9_ ECU_ADDRESS 0x7fb0a6 BYTE_ORDER MSB_LAST FORMAT "%5.0" /end MEASUREMENT
/begin MEASUREMENT cnt_t_iv_close_stc_3[10] "fail of t_iv_close determination continous counter (cylinder 0)" UWORD _CNV_A_R_LINEAR_____0_CM 1 0. 0. 65535. DISPLAY_IDENTIFIER CNT_T_IV_CLOSE_STC_3_10_ ECU_ADDRESS 0x7fb0a8 BYTE_ORDER MSB_LAST FORMAT "%5.0" /end MEASUREMENT
/begin MEASUREMENT cnt_t_iv_close_stc_3[11] "fail of t_iv_close determination continous counter (cylinder 0)" UWORD _CNV_A_R_LINEAR_____0_CM 1 0. 0. 65535. DISPLAY_IDENTIFIER CNT_T_IV_CLOSE_STC_3_11_ ECU_ADDRESS 0x7fb0aa BYTE_ORDER MSB_LAST FORMAT "%5.0" /end MEASUREMENT
/begin MEASUREMENT cnt_t_iv_close_stc_3[12] "fail of t_iv_close determination continous counter (cylinder 0)" UWORD _CNV_A_R_LINEAR_____0_CM 1 0. 0. 65535. DISPLAY_IDENTIFIER CNT_T_IV_CLOSE_STC_3_12_ ECU_ADDRESS 0x7fb0ac BYTE_ORDER MSB_LAST FORMAT "%5.0" /end MEASUREMENT
/begin MEASUREMENT t_iv_close_last_[0] "last determined injector valve closing time (cylinder individual)" UWORD _CNV_A_R_LINEAR_____540_CM 1 0. 0. 0.512 DISPLAY_IDENTIFIER T_IV_CLOSE_LAST__0_ ECU_ADDRESS 0x7fb0ae BYTE_ORDER MSB_LAST FORMAT "%4.3" /end MEASUREMENT
/begin MEASUREMENT t_iv_close_last_[1] "last determined injector valve closing time (cylinder individual)" UWORD _CNV_A_R_LINEAR_____540_CM 1 0. 0. 0.512 DISPLAY_IDENTIFIER T_IV_CLOSE_LAST__1_ ECU_ADDRESS 0x7fb0b0 BYTE_ORDER MSB_LAST FORMAT "%4.3" /end MEASUREMENT
/begin MEASUREMENT t_iv_close_last_[2] "last determined injector valve closing time (cylinder individual)" UWORD _CNV_A_R_LINEAR_____540_CM 1 0. 0. 0.512 DISPLAY_IDENTIFIER T_IV_CLOSE_LAST__2_ ECU_ADDRESS 0x7fb0b2 BYTE_ORDER MSB_LAST FORMAT "%4.3" /end MEASUREMENT
/begin MEASUREMENT t_iv_close_last_[3] "last determined injector valve closing time (cylinder individual)" UWORD _CNV_A_R_LINEAR_____540_CM 1 0. 0. 0.512 DISPLAY_IDENTIFIER T_IV_CLOSE_LAST__3_ ECU_ADDRESS 0x7fb0b4 BYTE_ORDER MSB_LAST FORMAT "%4.3" /end MEASUREMENT
/begin CHARACTERISTIC c_t_iv_close_fail_replace "t_iv_close replacement value" VALUE 0x84ff9e _REC_VAL_20_u2 0.32767 _CNV_A_R_LINEAR_____561_CM 0. 0.32767 DISPLAY_IDENTIFIER C_T_IV_CLOSE_FAIL_REPLACE FORMAT "%7.5" /end CHARACTERISTIC
/begin CHARACTERISTIC c_cnt_t_iv_close_stc_max "t_iv_close replacement value" VALUE 0x84fbe2 _REC_VAL_20_u2 65535. _CNV_A_R_LINEAR_____0_CM 0. 65535. DISPLAY_IDENTIFIER C_CNT_T_IV_CLOSE_STC_MAX FORMAT "%5.0" /end CHARACTERISTIC
/begin CHARACTERISTIC c_cnt_t_iv_close_stc_repl_max "t_iv_close replacement value" VALUE 0x84fbe4 _REC_VAL_20_u2 65535. _CNV_A_R_LINEAR_____0_CM 0. 65535. DISPLAY_IDENTIFIER C_CNT_T_IV_CLOSE_STC_REPL_MAX FORMAT "%5.0" /end CHARACTERISTIC
/begin CHARACTERISTIC c_t_iv_close_stc_min_lim "t_iv_close statistics minimum limit" VALUE 0x84ffb0 _REC_VAL_20_u2 0.512 _CNV_A_R_LINEAR_____540_CM 0. 0.512 DISPLAY_IDENTIFIER C_T_IV_CLOSE_STC_MIN_LIM FORMAT "%4.3" /end CHARACTERISTIC
/begin CHARACTERISTIC c_t_iv_close_stc_max_lim "t_iv_close statistics maximum limit" VALUE 0x84ffae _REC_VAL_20_u2 0.512 _CNV_A_R_LINEAR_____540_CM 0. 0.512 DISPLAY_IDENTIFIER C_T_IV_CLOSE_STC_MAX_LIM FORMAT "%4.3" /end CHARACTERISTIC
/begin MEASUREMENT t_iv_close_stat_mean_[0] "mean value of injector valve closing time (cylinder individual)" UWORD _CNV_A_R_LINEAR_____540_CM 1 0. 0. 0.512 DISPLAY_IDENTIFIER T_IV_CLOSE_STAT_MEAN__0_ ECU_ADDRESS 0x7f9fee BYTE_ORDER MSB_LAST FORMAT "%4.3" /end MEASUREMENT
/begin MEASUREMENT t_iv_close_stat_mean_[1] "mean value of injector valve closing time (cylinder individual)" UWORD _CNV_A_R_LINEAR_____540_CM 1 0. 0. 0.512 DISPLAY_IDENTIFIER T_IV_CLOSE_STAT_MEAN__1_ ECU_ADDRESS 0x7f9ff0 BYTE_ORDER MSB_LAST FORMAT "%4.3" /end MEASUREMENT
/begin MEASUREMENT t_iv_close_stat_mean_[2] "mean value of injector valve closing time (cylinder individual)" UWORD _CNV_A_R_LINEAR_____540_CM 1 0. 0. 0.512 DISPLAY_IDENTIFIER T_IV_CLOSE_STAT_MEAN__2_ ECU_ADDRESS 0x7f9ff2 BYTE_ORDER MSB_LAST FORMAT "%4.3" /end MEASUREMENT
/begin MEASUREMENT t_iv_close_stat_mean_[3] "mean value of injector valve closing time (cylinder individual)" UWORD _CNV_A_R_LINEAR_____540_CM 1 0. 0. 0.512 DISPLAY_IDENTIFIER T_IV_CLOSE_STAT_MEAN__3_ ECU_ADDRESS 0x7f9ff4 BYTE_ORDER MSB_LAST FORMAT "%4.3" /end MEASUREMENT
/begin MEASUREMENT pct_t_iv_close_stc_[0] "percentage of successful t_iv_close determinations (cylinder individual)" UWORD _CNV_A_R_LINEAR_____0_CM 1 0. 0. 65535. DISPLAY_IDENTIFIER PCT_T_IV_CLOSE_STC__0_ ECU_ADDRESS 0x7f9fe6 BYTE_ORDER MSB_LAST FORMAT "%5.0" /end MEASUREMENT
/begin MEASUREMENT pct_t_iv_close_stc_[1] "percentage of successful t_iv_close determinations (cylinder individual)" UWORD _CNV_A_R_LINEAR_____0_CM 1 0. 0. 65535. DISPLAY_IDENTIFIER PCT_T_IV_CLOSE_STC__1_ ECU_ADDRESS 0x7f9fe8 BYTE_ORDER MSB_LAST FORMAT "%5.0" /end MEASUREMENT
/begin MEASUREMENT pct_t_iv_close_stc_[2] "percentage of successful t_iv_close determinations (cylinder individual)" UWORD _CNV_A_R_LINEAR_____0_CM 1 0. 0. 65535. DISPLAY_IDENTIFIER PCT_T_IV_CLOSE_STC__2_ ECU_ADDRESS 0x7f9fea BYTE_ORDER MSB_LAST FORMAT "%5.0" /end MEASUREMENT
/begin MEASUREMENT pct_t_iv_close_stc_[3] "percentage of successful t_iv_close determinations (cylinder individual)" UWORD _CNV_A_R_LINEAR_____0_CM 1 0. 0. 65535. DISPLAY_IDENTIFIER PCT_T_IV_CLOSE_STC__3_ ECU_ADDRESS 0x7f9fec BYTE_ORDER MSB_LAST FORMAT "%5.0" /end MEASUREMENT
/begin MEASUREMENT idx_max_t_iv_close_stc_[0] "Haeufigkeitspunkt of t_iv_close determination (cylinder individual)" UWORD _CNV_A_R_LINEAR_____540_CM 1 0. 0. 0.512 DISPLAY_IDENTIFIER IDX_MAX_T_IV_CLOSE_STC__0_ ECU_ADDRESS 0x7f9ff6 BYTE_ORDER MSB_LAST FORMAT "%4.3" /end MEASUREMENT
/begin MEASUREMENT idx_max_t_iv_close_stc_[1] "Haeufigkeitspunkt of t_iv_close determination (cylinder individual)" UWORD _CNV_A_R_LINEAR_____540_CM 1 0. 0. 0.512 DISPLAY_IDENTIFIER IDX_MAX_T_IV_CLOSE_STC__1_ ECU_ADDRESS 0x7f9ff8 BYTE_ORDER MSB_LAST FORMAT "%4.3" /end MEASUREMENT
/begin MEASUREMENT idx_max_t_iv_close_stc_[2] "Haeufigkeitspunkt of t_iv_close determination (cylinder individual)" UWORD _CNV_A_R_LINEAR_____540_CM 1 0. 0. 0.512 DISPLAY_IDENTIFIER IDX_MAX_T_IV_CLOSE_STC__2_ ECU_ADDRESS 0x7f9ffa BYTE_ORDER MSB_LAST FORMAT "%4.3" /end MEASUREMENT
/begin MEASUREMENT idx_max_t_iv_close_stc_[3] "Haeufigkeitspunkt of t_iv_close determination (cylinder individual)" UWORD _CNV_A_R_LINEAR_____540_CM 1 0. 0. 0.512 DISPLAY_IDENTIFIER IDX_MAX_T_IV_CLOSE_STC__3_ ECU_ADDRESS 0x7f9ffc BYTE_ORDER MSB_LAST FORMAT "%4.3" /end MEASUREMENT
/begin MEASUREMENT var_t_iv_close_stc_[0] "Varianz of t_iv_close determination (cylinder individual)" SLONG _CNV_A_R_LINEAR_____0_CM 1 0. -2147483648. 2147483647. DISPLAY_IDENTIFIER VAR_T_IV_CLOSE_STC__0_ ECU_ADDRESS 0x7f8690 BYTE_ORDER MSB_LAST FORMAT "%5.0" /end MEASUREMENT
/begin MEASUREMENT var_t_iv_close_stc_[1] "Varianz of t_iv_close determination (cylinder individual)" SLONG _CNV_A_R_LINEAR_____0_CM 1 0. -2147483648. 2147483647. DISPLAY_IDENTIFIER VAR_T_IV_CLOSE_STC__1_ ECU_ADDRESS 0x7f8694 BYTE_ORDER MSB_LAST FORMAT "%5.0" /end MEASUREMENT
/begin MEASUREMENT var_t_iv_close_stc_[2] "Varianz of t_iv_close determination (cylinder individual)" SLONG _CNV_A_R_LINEAR_____0_CM 1 0. -2147483648. 2147483647. DISPLAY_IDENTIFIER VAR_T_IV_CLOSE_STC__2_ ECU_ADDRESS 0x7f8698 BYTE_ORDER MSB_LAST FORMAT "%5.0" /end MEASUREMENT
/begin MEASUREMENT var_t_iv_close_stc_[3] "Varianz of t_iv_close determination (cylinder individual)" SLONG _CNV_A_R_LINEAR_____0_CM 1 0. -2147483648. 2147483647. DISPLAY_IDENTIFIER VAR_T_IV_CLOSE_STC__3_ ECU_ADDRESS 0x7f869c BYTE_ORDER MSB_LAST FORMAT "%5.0" /end MEASUREMENT
/begin MEASUREMENT cnt_v_delta_iv_foc_stc_succ_[0] "success of v_delta_iv_foc determination counter (cylinder individual)" UWORD _CNV_A_R_LINEAR_____0_CM 1 0. 0. 65535. DISPLAY_IDENTIFIER CNT_V_DELTA_IV_FOC_STC_SUCC__0_ ECU_ADDRESS 0x7fb0be BYTE_ORDER MSB_LAST FORMAT "%5.0" /end MEASUREMENT
/begin MEASUREMENT cnt_v_delta_iv_foc_stc_succ_[1] "success of v_delta_iv_foc determination counter (cylinder individual)" UWORD _CNV_A_R_LINEAR_____0_CM 1 0. 0. 65535. DISPLAY_IDENTIFIER CNT_V_DELTA_IV_FOC_STC_SUCC__1_ ECU_ADDRESS 0x7fb0c0 BYTE_ORDER MSB_LAST FORMAT "%5.0" /end MEASUREMENT
/begin MEASUREMENT cnt_v_delta_iv_foc_stc_succ_[2] "success of v_delta_iv_foc determination counter (cylinder individual)" UWORD _CNV_A_R_LINEAR_____0_CM 1 0. 0. 65535. DISPLAY_IDENTIFIER CNT_V_DELTA_IV_FOC_STC_SUCC__2_ ECU_ADDRESS 0x7fb0c2 BYTE_ORDER MSB_LAST FORMAT "%5.0" /end MEASUREMENT
/begin MEASUREMENT cnt_v_delta_iv_foc_stc_succ_[3] "success of v_delta_iv_foc determination counter (cylinder individual)" UWORD _CNV_A_R_LINEAR_____0_CM 1 0. 0. 65535. DISPLAY_IDENTIFIER CNT_V_DELTA_IV_FOC_STC_SUCC__3_ ECU_ADDRESS 0x7fb0c4 BYTE_ORDER MSB_LAST FORMAT "%5.0" /end MEASUREMENT
/begin MEASUREMENT cnt_v_delta_iv_foc_stc_fail_cont_[0] "fail of v_delta_iv_foc determination continous counter (cylinder individual)" UWORD _CNV_A_R_LINEAR_____0_CM 1 0. 0. 65535. DISPLAY_IDENTIFIER CNT_V_DELTA_IV_FOC_STC_FAIL_CONT__0_ ECU_ADDRESS 0x7fb0c6 BYTE_ORDER MSB_LAST FORMAT "%5.0" /end MEASUREMENT
/begin MEASUREMENT cnt_v_delta_iv_foc_stc_fail_cont_[1] "fail of v_delta_iv_foc determination continous counter (cylinder individual)" UWORD _CNV_A_R_LINEAR_____0_CM 1 0. 0. 65535. DISPLAY_IDENTIFIER CNT_V_DELTA_IV_FOC_STC_FAIL_CONT__1_ ECU_ADDRESS 0x7fb0c8 BYTE_ORDER MSB_LAST FORMAT "%5.0" /end MEASUREMENT
/begin MEASUREMENT cnt_v_delta_iv_foc_stc_fail_cont_[2] "fail of v_delta_iv_foc determination continous counter (cylinder individual)" UWORD _CNV_A_R_LINEAR_____0_CM 1 0. 0. 65535. DISPLAY_IDENTIFIER CNT_V_DELTA_IV_FOC_STC_FAIL_CONT__2_ ECU_ADDRESS 0x7fb0ca BYTE_ORDER MSB_LAST FORMAT "%5.0" /end MEASUREMENT
/begin MEASUREMENT cnt_v_delta_iv_foc_stc_fail_cont_[3] "fail of v_delta_iv_foc determination continous counter (cylinder individual)" UWORD _CNV_A_R_LINEAR_____0_CM 1 0. 0. 65535. DISPLAY_IDENTIFIER CNT_V_DELTA_IV_FOC_STC_FAIL_CONT__3_ ECU_ADDRESS 0x7fb0cc BYTE_ORDER MSB_LAST FORMAT "%5.0" /end MEASUREMENT
/begin MEASUREMENT cnt_v_delta_iv_foc_stc_fail_[0] "fail of v_delta_iv_foc determination continous counter (cylinder individual)" UWORD _CNV_A_R_LINEAR_____0_CM 1 0. 0. 65535. DISPLAY_IDENTIFIER CNT_V_DELTA_IV_FOC_STC_FAIL__0_ ECU_ADDRESS 0x7fb0ce BYTE_ORDER MSB_LAST FORMAT "%5.0" /end MEASUREMENT
/begin MEASUREMENT cnt_v_delta_iv_foc_stc_fail_[1] "fail of v_delta_iv_foc determination continous counter (cylinder individual)" UWORD _CNV_A_R_LINEAR_____0_CM 1 0. 0. 65535. DISPLAY_IDENTIFIER CNT_V_DELTA_IV_FOC_STC_FAIL__1_ ECU_ADDRESS 0x7fb0d0 BYTE_ORDER MSB_LAST FORMAT "%5.0" /end MEASUREMENT
/begin MEASUREMENT cnt_v_delta_iv_foc_stc_fail_[2] "fail of v_delta_iv_foc determination continous counter (cylinder individual)" UWORD _CNV_A_R_LINEAR_____0_CM 1 0. 0. 65535. DISPLAY_IDENTIFIER CNT_V_DELTA_IV_FOC_STC_FAIL__2_ ECU_ADDRESS 0x7fb0d2 BYTE_ORDER MSB_LAST FORMAT "%5.0" /end MEASUREMENT
/begin MEASUREMENT cnt_v_delta_iv_foc_stc_fail_[3] "fail of v_delta_iv_foc determination continous counter (cylinder individual)" UWORD _CNV_A_R_LINEAR_____0_CM 1 0. 0. 65535. DISPLAY_IDENTIFIER CNT_V_DELTA_IV_FOC_STC_FAIL__3_ ECU_ADDRESS 0x7fb0d4 BYTE_ORDER MSB_LAST FORMAT "%5.0" /end MEASUREMENT
/begin MEASUREMENT cnt_v_delta_iv_foc_stc_0[0] "fail of v_delta_iv_foc determination continous counter (cylinder 0)" UWORD _CNV_A_R_LINEAR_____0_CM 1 0. 0. 65535. DISPLAY_IDENTIFIER CNT_V_DELTA_IV_FOC_STC_0_0_ ECU_ADDRESS 0x7fb0d6 BYTE_ORDER MSB_LAST FORMAT "%5.0" /end MEASUREMENT
/begin MEASUREMENT cnt_v_delta_iv_foc_stc_0[1] "fail of v_delta_iv_foc determination continous counter (cylinder 0)" UWORD _CNV_A_R_LINEAR_____0_CM 1 0. 0. 65535. DISPLAY_IDENTIFIER CNT_V_DELTA_IV_FOC_STC_0_1_ ECU_ADDRESS 0x7fb0d8 BYTE_ORDER MSB_LAST FORMAT "%5.0" /end MEASUREMENT
/begin MEASUREMENT cnt_v_delta_iv_foc_stc_0[2] "fail of v_delta_iv_foc determination continous counter (cylinder 0)" UWORD _CNV_A_R_LINEAR_____0_CM 1 0. 0. 65535. DISPLAY_IDENTIFIER CNT_V_DELTA_IV_FOC_STC_0_2_ ECU_ADDRESS 0x7fb0da BYTE_ORDER MSB_LAST FORMAT "%5.0" /end MEASUREMENT
/begin MEASUREMENT cnt_v_delta_iv_foc_stc_0[3] "fail of v_delta_iv_foc determination continous counter (cylinder 0)" UWORD _CNV_A_R_LINEAR_____0_CM 1 0. 0. 65535. DISPLAY_IDENTIFIER CNT_V_DELTA_IV_FOC_STC_0_3_ ECU_ADDRESS 0x7fb0dc BYTE_ORDER MSB_LAST FORMAT "%5.0" /end MEASUREMENT
/begin MEASUREMENT cnt_v_delta_iv_foc_stc_0[4] "fail of v_delta_iv_foc determination continous counter (cylinder 0)" UWORD _CNV_A_R_LINEAR_____0_CM 1 0. 0. 65535. DISPLAY_IDENTIFIER CNT_V_DELTA_IV_FOC_STC_0_4_ ECU_ADDRESS 0x7fb0de BYTE_ORDER MSB_LAST FORMAT "%5.0" /end MEASUREMENT
/begin MEASUREMENT cnt_v_delta_iv_foc_stc_0[5] "fail of v_delta_iv_foc determination continous counter (cylinder 0)" UWORD _CNV_A_R_LINEAR_____0_CM 1 0. 0. 65535. DISPLAY_IDENTIFIER CNT_V_DELTA_IV_FOC_STC_0_5_ ECU_ADDRESS 0x7fb0e0 BYTE_ORDER MSB_LAST FORMAT "%5.0" /end MEASUREMENT
/begin MEASUREMENT cnt_v_delta_iv_foc_stc_0[6] "fail of v_delta_iv_foc determination continous counter (cylinder 0)" UWORD _CNV_A_R_LINEAR_____0_CM 1 0. 0. 65535. DISPLAY_IDENTIFIER CNT_V_DELTA_IV_FOC_STC_0_6_ ECU_ADDRESS 0x7fb0e2 BYTE_ORDER MSB_LAST FORMAT "%5.0" /end MEASUREMENT
/begin MEASUREMENT cnt_v_delta_iv_foc_stc_0[7] "fail of v_delta_iv_foc determination continous counter (cylinder 0)" UWORD _CNV_A_R_LINEAR_____0_CM 1 0. 0. 65535. DISPLAY_IDENTIFIER CNT_V_DELTA_IV_FOC_STC_0_7_ ECU_ADDRESS 0x7fb0e4 BYTE_ORDER MSB_LAST FORMAT "%5.0" /end MEASUREMENT
/begin MEASUREMENT cnt_v_delta_iv_foc_stc_0[8] "fail of v_delta_iv_foc determination continous counter (cylinder 0)" UWORD _CNV_A_R_LINEAR_____0_CM 1 0. 0. 65535. DISPLAY_IDENTIFIER CNT_V_DELTA_IV_FOC_STC_0_8_ ECU_ADDRESS 0x7fb0e6 BYTE_ORDER MSB_LAST FORMAT "%5.0" /end MEASUREMENT
/begin MEASUREMENT cnt_v_delta_iv_foc_stc_0[9] "fail of v_delta_iv_foc determination continous counter (cylinder 0)" UWORD _CNV_A_R_LINEAR_____0_CM 1 0. 0. 65535. DISPLAY_IDENTIFIER CNT_V_DELTA_IV_FOC_STC_0_9_ ECU_ADDRESS 0x7fb0e8 BYTE_ORDER MSB_LAST FORMAT "%5.0" /end MEASUREMENT
/begin MEASUREMENT cnt_v_delta_iv_foc_stc_0[10] "fail of v_delta_iv_foc determination continous counter (cylinder 0)" UWORD _CNV_A_R_LINEAR_____0_CM 1 0. 0. 65535. DISPLAY_IDENTIFIER CNT_V_DELTA_IV_FOC_STC_0_10_ ECU_ADDRESS 0x7fb0ea BYTE_ORDER MSB_LAST FORMAT "%5.0" /end MEASUREMENT
/begin MEASUREMENT cnt_v_delta_iv_foc_stc_0[11] "fail of v_delta_iv_foc determination continous counter (cylinder 0)" UWORD _CNV_A_R_LINEAR_____0_CM 1 0. 0. 65535. DISPLAY_IDENTIFIER CNT_V_DELTA_IV_FOC_STC_0_11_ ECU_ADDRESS 0x7fb0ec BYTE_ORDER MSB_LAST FORMAT "%5.0" /end MEASUREMENT
/begin MEASUREMENT cnt_v_delta_iv_foc_stc_0[12] "fail of v_delta_iv_foc determination continous counter (cylinder 0)" UWORD _CNV_A_R_LINEAR_____0_CM 1 0. 0. 65535. DISPLAY_IDENTIFIER CNT_V_DELTA_IV_FOC_STC_0_12_ ECU_ADDRESS 0x7fb0ee BYTE_ORDER MSB_LAST FORMAT "%5.0" /end MEASUREMENT
/begin MEASUREMENT cnt_v_delta_iv_foc_stc_0[13] "fail of v_delta_iv_foc determination continous counter (cylinder 0)" UWORD _CNV_A_R_LINEAR_____0_CM 1 0. 0. 65535. DISPLAY_IDENTIFIER CNT_V_DELTA_IV_FOC_STC_0_13_ ECU_ADDRESS 0x7fb0f0 BYTE_ORDER MSB_LAST FORMAT "%5.0" /end MEASUREMENT
/begin MEASUREMENT cnt_v_delta_iv_foc_stc_0[14] "fail of v_delta_iv_foc determination continous counter (cylinder 0)" UWORD _CNV_A_R_LINEAR_____0_CM 1 0. 0. 65535. DISPLAY_IDENTIFIER CNT_V_DELTA_IV_FOC_STC_0_14_ ECU_ADDRESS 0x7fb0f2 BYTE_ORDER MSB_LAST FORMAT "%5.0" /end MEASUREMENT
/begin MEASUREMENT cnt_v_delta_iv_foc_stc_0[15] "fail of v_delta_iv_foc determination continous counter (cylinder 0)" UWORD _CNV_A_R_LINEAR_____0_CM 1 0. 0. 65535. DISPLAY_IDENTIFIER CNT_V_DELTA_IV_FOC_STC_0_15_ ECU_ADDRESS 0x7fb0f4 BYTE_ORDER MSB_LAST FORMAT "%5.0" /end MEASUREMENT
/begin MEASUREMENT cnt_v_delta_iv_foc_stc_0[16] "fail of v_delta_iv_foc determination continous counter (cylinder 0)" UWORD _CNV_A_R_LINEAR_____0_CM 1 0. 0. 65535. DISPLAY_IDENTIFIER CNT_V_DELTA_IV_FOC_STC_0_16_ ECU_ADDRESS 0x7fb0f6 BYTE_ORDER MSB_LAST FORMAT "%5.0" /end MEASUREMENT
/begin MEASUREMENT cnt_v_delta_iv_foc_stc_0[17] "fail of v_delta_iv_foc determination continous counter (cylinder 0)" UWORD _CNV_A_R_LINEAR_____0_CM 1 0. 0. 65535. DISPLAY_IDENTIFIER CNT_V_DELTA_IV_FOC_STC_0_17_ ECU_ADDRESS 0x7fb0f8 BYTE_ORDER MSB_LAST FORMAT "%5.0" /end MEASUREMENT
/begin MEASUREMENT cnt_v_delta_iv_foc_stc_0[18] "fail of v_delta_iv_foc determination continous counter (cylinder 0)" UWORD _CNV_A_R_LINEAR_____0_CM 1 0. 0. 65535. DISPLAY_IDENTIFIER CNT_V_DELTA_IV_FOC_STC_0_18_ ECU_ADDRESS 0x7fb0fa BYTE_ORDER MSB_LAST FORMAT "%5.0" /end MEASUREMENT
/begin MEASUREMENT cnt_v_delta_iv_foc_stc_0[19] "fail of v_delta_iv_foc determination continous counter (cylinder 0)" UWORD _CNV_A_R_LINEAR_____0_CM 1 0. 0. 65535. DISPLAY_IDENTIFIER CNT_V_DELTA_IV_FOC_STC_0_19_ ECU_ADDRESS 0x7fb0fc BYTE_ORDER MSB_LAST FORMAT "%5.0" /end MEASUREMENT
/begin MEASUREMENT cnt_v_delta_iv_foc_stc_0[20] "fail of v_delta_iv_foc determination continous counter (cylinder 0)" UWORD _CNV_A_R_LINEAR_____0_CM 1 0. 0. 65535. DISPLAY_IDENTIFIER CNT_V_DELTA_IV_FOC_STC_0_20_ ECU_ADDRESS 0x7fb0fe BYTE_ORDER MSB_LAST FORMAT "%5.0" /end MEASUREMENT
/begin MEASUREMENT cnt_v_delta_iv_foc_stc_0[21] "fail of v_delta_iv_foc determination continous counter (cylinder 0)" UWORD _CNV_A_R_LINEAR_____0_CM 1 0. 0. 65535. DISPLAY_IDENTIFIER CNT_V_DELTA_IV_FOC_STC_0_21_ ECU_ADDRESS 0x7fb100 BYTE_ORDER MSB_LAST FORMAT "%5.0" /end MEASUREMENT
/begin MEASUREMENT cnt_v_delta_iv_foc_stc_1[0] "fail of v_delta_iv_foc determination continous counter (cylinder 0)" UWORD _CNV_A_R_LINEAR_____0_CM 1 0. 0. 65535. DISPLAY_IDENTIFIER CNT_V_DELTA_IV_FOC_STC_1_0_ ECU_ADDRESS 0x7fb180 BYTE_ORDER MSB_LAST FORMAT "%5.0" /end MEASUREMENT
/begin MEASUREMENT cnt_v_delta_iv_foc_stc_1[1] "fail of v_delta_iv_foc determination continous counter (cylinder 0)" UWORD _CNV_A_R_LINEAR_____0_CM 1 0. 0. 65535. DISPLAY_IDENTIFIER CNT_V_DELTA_IV_FOC_STC_1_1_ ECU_ADDRESS 0x7fb182 BYTE_ORDER MSB_LAST FORMAT "%5.0" /end MEASUREMENT
/begin MEASUREMENT cnt_v_delta_iv_foc_stc_1[2] "fail of v_delta_iv_foc determination continous counter (cylinder 0)" UWORD _CNV_A_R_LINEAR_____0_CM 1 0. 0. 65535. DISPLAY_IDENTIFIER CNT_V_DELTA_IV_FOC_STC_1_2_ ECU_ADDRESS 0x7fb184 BYTE_ORDER MSB_LAST FORMAT "%5.0" /end MEASUREMENT
/begin MEASUREMENT cnt_v_delta_iv_foc_stc_1[3] "fail of v_delta_iv_foc determination continous counter (cylinder 0)" UWORD _CNV_A_R_LINEAR_____0_CM 1 0. 0. 65535. DISPLAY_IDENTIFIER CNT_V_DELTA_IV_FOC_STC_1_3_ ECU_ADDRESS 0x7fb186 BYTE_ORDER MSB_LAST FORMAT "%5.0" /end MEASUREMENT
/begin MEASUREMENT cnt_v_delta_iv_foc_stc_1[4] "fail of v_delta_iv_foc determination continous counter (cylinder 0)" UWORD _CNV_A_R_LINEAR_____0_CM 1 0. 0. 65535. DISPLAY_IDENTIFIER CNT_V_DELTA_IV_FOC_STC_1_4_ ECU_ADDRESS 0x7fb188 BYTE_ORDER MSB_LAST FORMAT "%5.0" /end MEASUREMENT
/begin MEASUREMENT cnt_v_delta_iv_foc_stc_1[5] "fail of v_delta_iv_foc determination continous counter (cylinder 0)" UWORD _CNV_A_R_LINEAR_____0_CM 1 0. 0. 65535. DISPLAY_IDENTIFIER CNT_V_DELTA_IV_FOC_STC_1_5_ ECU_ADDRESS 0x7fb18a BYTE_ORDER MSB_LAST FORMAT "%5.0" /end MEASUREMENT
/begin MEASUREMENT cnt_v_delta_iv_foc_stc_1[6] "fail of v_delta_iv_foc determination continous counter (cylinder 0)" UWORD _CNV_A_R_LINEAR_____0_CM 1 0. 0. 65535. DISPLAY_IDENTIFIER CNT_V_DELTA_IV_FOC_STC_1_6_ ECU_ADDRESS 0x7fb18c BYTE_ORDER MSB_LAST FORMAT "%5.0" /end MEASUREMENT
/begin MEASUREMENT cnt_v_delta_iv_foc_stc_1[7] "fail of v_delta_iv_foc determination continous counter (cylinder 0)" UWORD _CNV_A_R_LINEAR_____0_CM 1 0. 0. 65535. DISPLAY_IDENTIFIER CNT_V_DELTA_IV_FOC_STC_1_7_ ECU_ADDRESS 0x7fb18e BYTE_ORDER MSB_LAST FORMAT "%5.0" /end MEASUREMENT
/begin MEASUREMENT cnt_v_delta_iv_foc_stc_1[8] "fail of v_delta_iv_foc determination continous counter (cylinder 0)" UWORD _CNV_A_R_LINEAR_____0_CM 1 0. 0. 65535. DISPLAY_IDENTIFIER CNT_V_DELTA_IV_FOC_STC_1_8_ ECU_ADDRESS 0x7fb190 BYTE_ORDER MSB_LAST FORMAT "%5.0" /end MEASUREMENT
/begin MEASUREMENT cnt_v_delta_iv_foc_stc_1[9] "fail of v_delta_iv_foc determination continous counter (cylinder 0)" UWORD _CNV_A_R_LINEAR_____0_CM 1 0. 0. 65535. DISPLAY_IDENTIFIER CNT_V_DELTA_IV_FOC_STC_1_9_ ECU_ADDRESS 0x7fb192 BYTE_ORDER MSB_LAST FORMAT "%5.0" /end MEASUREMENT
/begin MEASUREMENT cnt_v_delta_iv_foc_stc_1[10] "fail of v_delta_iv_foc determination continous counter (cylinder 0)" UWORD _CNV_A_R_LINEAR_____0_CM 1 0. 0. 65535. DISPLAY_IDENTIFIER CNT_V_DELTA_IV_FOC_STC_1_10_ ECU_ADDRESS 0x7fb194 BYTE_ORDER MSB_LAST FORMAT "%5.0" /end MEASUREMENT
/begin MEASUREMENT cnt_v_delta_iv_foc_stc_1[11] "fail of v_delta_iv_foc determination continous counter (cylinder 0)" UWORD _CNV_A_R_LINEAR_____0_CM 1 0. 0. 65535. DISPLAY_IDENTIFIER CNT_V_DELTA_IV_FOC_STC_1_11_ ECU_ADDRESS 0x7fb196 BYTE_ORDER MSB_LAST FORMAT "%5.0" /end MEASUREMENT
/begin MEASUREMENT cnt_v_delta_iv_foc_stc_1[12] "fail of v_delta_iv_foc determination continous counter (cylinder 0)" UWORD _CNV_A_R_LINEAR_____0_CM 1 0. 0. 65535. DISPLAY_IDENTIFIER CNT_V_DELTA_IV_FOC_STC_1_12_ ECU_ADDRESS 0x7fb198 BYTE_ORDER MSB_LAST FORMAT "%5.0" /end MEASUREMENT
/begin MEASUREMENT cnt_v_delta_iv_foc_stc_1[13] "fail of v_delta_iv_foc determination continous counter (cylinder 0)" UWORD _CNV_A_R_LINEAR_____0_CM 1 0. 0. 65535. DISPLAY_IDENTIFIER CNT_V_DELTA_IV_FOC_STC_1_13_ ECU_ADDRESS 0x7fb19a BYTE_ORDER MSB_LAST FORMAT "%5.0" /end MEASUREMENT
/begin MEASUREMENT cnt_v_delta_iv_foc_stc_1[14] "fail of v_delta_iv_foc determination continous counter (cylinder 0)" UWORD _CNV_A_R_LINEAR_____0_CM 1 0. 0. 65535. DISPLAY_IDENTIFIER CNT_V_DELTA_IV_FOC_STC_1_14_ ECU_ADDRESS 0x7fb19c BYTE_ORDER MSB_LAST FORMAT "%5.0" /end MEASUREMENT
/begin MEASUREMENT cnt_v_delta_iv_foc_stc_1[15] "fail of v_delta_iv_foc determination continous counter (cylinder 0)" UWORD _CNV_A_R_LINEAR_____0_CM 1 0. 0. 65535. DISPLAY_IDENTIFIER CNT_V_DELTA_IV_FOC_STC_1_15_ ECU_ADDRESS 0x7fb19e BYTE_ORDER MSB_LAST FORMAT "%5.0" /end MEASUREMENT
/begin MEASUREMENT cnt_v_delta_iv_foc_stc_1[16] "fail of v_delta_iv_foc determination continous counter (cylinder 0)" UWORD _CNV_A_R_LINEAR_____0_CM 1 0. 0. 65535. DISPLAY_IDENTIFIER CNT_V_DELTA_IV_FOC_STC_1_16_ ECU_ADDRESS 0x7fb1a0 BYTE_ORDER MSB_LAST FORMAT "%5.0" /end MEASUREMENT
/begin MEASUREMENT cnt_v_delta_iv_foc_stc_1[17] "fail of v_delta_iv_foc determination continous counter (cylinder 0)" UWORD _CNV_A_R_LINEAR_____0_CM 1 0. 0. 65535. DISPLAY_IDENTIFIER CNT_V_DELTA_IV_FOC_STC_1_17_ ECU_ADDRESS 0x7fb1a2 BYTE_ORDER MSB_LAST FORMAT "%5.0" /end MEASUREMENT
/begin MEASUREMENT cnt_v_delta_iv_foc_stc_1[18] "fail of v_delta_iv_foc determination continous counter (cylinder 0)" UWORD _CNV_A_R_LINEAR_____0_CM 1 0. 0. 65535. DISPLAY_IDENTIFIER CNT_V_DELTA_IV_FOC_STC_1_18_ ECU_ADDRESS 0x7fb1a4 BYTE_ORDER MSB_LAST FORMAT "%5.0" /end MEASUREMENT
/begin MEASUREMENT cnt_v_delta_iv_foc_stc_1[19] "fail of v_delta_iv_foc determination continous counter (cylinder 0)" UWORD _CNV_A_R_LINEAR_____0_CM 1 0. 0. 65535. DISPLAY_IDENTIFIER CNT_V_DELTA_IV_FOC_STC_1_19_ ECU_ADDRESS 0x7fb1a6 BYTE_ORDER MSB_LAST FORMAT "%5.0" /end MEASUREMENT
/begin MEASUREMENT cnt_v_delta_iv_foc_stc_1[20] "fail of v_delta_iv_foc determination continous counter (cylinder 0)" UWORD _CNV_A_R_LINEAR_____0_CM 1 0. 0. 65535. DISPLAY_IDENTIFIER CNT_V_DELTA_IV_FOC_STC_1_20_ ECU_ADDRESS 0x7fb1a8 BYTE_ORDER MSB_LAST FORMAT "%5.0" /end MEASUREMENT
/begin MEASUREMENT cnt_v_delta_iv_foc_stc_1[21] "fail of v_delta_iv_foc determination continous counter (cylinder 0)" UWORD _CNV_A_R_LINEAR_____0_CM 1 0. 0. 65535. DISPLAY_IDENTIFIER CNT_V_DELTA_IV_FOC_STC_1_21_ ECU_ADDRESS 0x7fb1aa BYTE_ORDER MSB_LAST FORMAT "%5.0" /end MEASUREMENT
/begin MEASUREMENT cnt_v_delta_iv_foc_stc_2[0] "fail of v_delta_iv_foc determination continous counter (cylinder 0)" UWORD _CNV_A_R_LINEAR_____0_CM 1 0. 0. 65535. DISPLAY_IDENTIFIER CNT_V_DELTA_IV_FOC_STC_2_0_ ECU_ADDRESS 0x7fb22a BYTE_ORDER MSB_LAST FORMAT "%5.0" /end MEASUREMENT
/begin MEASUREMENT cnt_v_delta_iv_foc_stc_2[1] "fail of v_delta_iv_foc determination continous counter (cylinder 0)" UWORD _CNV_A_R_LINEAR_____0_CM 1 0. 0. 65535. DISPLAY_IDENTIFIER CNT_V_DELTA_IV_FOC_STC_2_1_ ECU_ADDRESS 0x7fb22c BYTE_ORDER MSB_LAST FORMAT "%5.0" /end MEASUREMENT
/begin MEASUREMENT cnt_v_delta_iv_foc_stc_2[2] "fail of v_delta_iv_foc determination continous counter (cylinder 0)" UWORD _CNV_A_R_LINEAR_____0_CM 1 0. 0. 65535. DISPLAY_IDENTIFIER CNT_V_DELTA_IV_FOC_STC_2_2_ ECU_ADDRESS 0x7fb22e BYTE_ORDER MSB_LAST FORMAT "%5.0" /end MEASUREMENT
/begin MEASUREMENT cnt_v_delta_iv_foc_stc_2[3] "fail of v_delta_iv_foc determination continous counter (cylinder 0)" UWORD _CNV_A_R_LINEAR_____0_CM 1 0. 0. 65535. DISPLAY_IDENTIFIER CNT_V_DELTA_IV_FOC_STC_2_3_ ECU_ADDRESS 0x7fb230 BYTE_ORDER MSB_LAST FORMAT "%5.0" /end MEASUREMENT
/begin MEASUREMENT cnt_v_delta_iv_foc_stc_2[4] "fail of v_delta_iv_foc determination continous counter (cylinder 0)" UWORD _CNV_A_R_LINEAR_____0_CM 1 0. 0. 65535. DISPLAY_IDENTIFIER CNT_V_DELTA_IV_FOC_STC_2_4_ ECU_ADDRESS 0x7fb232 BYTE_ORDER MSB_LAST FORMAT "%5.0" /end MEASUREMENT
/begin MEASUREMENT cnt_v_delta_iv_foc_stc_2[5] "fail of v_delta_iv_foc determination continous counter (cylinder 0)" UWORD _CNV_A_R_LINEAR_____0_CM 1 0. 0. 65535. DISPLAY_IDENTIFIER CNT_V_DELTA_IV_FOC_STC_2_5_ ECU_ADDRESS 0x7fb234 BYTE_ORDER MSB_LAST FORMAT "%5.0" /end MEASUREMENT
/begin MEASUREMENT cnt_v_delta_iv_foc_stc_2[6] "fail of v_delta_iv_foc determination continous counter (cylinder 0)" UWORD _CNV_A_R_LINEAR_____0_CM 1 0. 0. 65535. DISPLAY_IDENTIFIER CNT_V_DELTA_IV_FOC_STC_2_6_ ECU_ADDRESS 0x7fb236 BYTE_ORDER MSB_LAST FORMAT "%5.0" /end MEASUREMENT
/begin MEASUREMENT cnt_v_delta_iv_foc_stc_2[7] "fail of v_delta_iv_foc determination continous counter (cylinder 0)" UWORD _CNV_A_R_LINEAR_____0_CM 1 0. 0. 65535. DISPLAY_IDENTIFIER CNT_V_DELTA_IV_FOC_STC_2_7_ ECU_ADDRESS 0x7fb238 BYTE_ORDER MSB_LAST FORMAT "%5.0" /end MEASUREMENT
/begin MEASUREMENT cnt_v_delta_iv_foc_stc_2[8] "fail of v_delta_iv_foc determination continous counter (cylinder 0)" UWORD _CNV_A_R_LINEAR_____0_CM 1 0. 0. 65535. DISPLAY_IDENTIFIER CNT_V_DELTA_IV_FOC_STC_2_8_ ECU_ADDRESS 0x7fb23a BYTE_ORDER MSB_LAST FORMAT "%5.0" /end MEASUREMENT
/begin MEASUREMENT cnt_v_delta_iv_foc_stc_2[9] "fail of v_delta_iv_foc determination continous counter (cylinder 0)" UWORD _CNV_A_R_LINEAR_____0_CM 1 0. 0. 65535. DISPLAY_IDENTIFIER CNT_V_DELTA_IV_FOC_STC_2_9_ ECU_ADDRESS 0x7fb23c BYTE_ORDER MSB_LAST FORMAT "%5.0" /end MEASUREMENT
/begin MEASUREMENT cnt_v_delta_iv_foc_stc_2[10] "fail of v_delta_iv_foc determination continous counter (cylinder 0)" UWORD _CNV_A_R_LINEAR_____0_CM 1 0. 0. 65535. DISPLAY_IDENTIFIER CNT_V_DELTA_IV_FOC_STC_2_10_ ECU_ADDRESS 0x7fb23e BYTE_ORDER MSB_LAST FORMAT "%5.0" /end MEASUREMENT
/begin MEASUREMENT cnt_v_delta_iv_foc_stc_2[11] "fail of v_delta_iv_foc determination continous counter (cylinder 0)" UWORD _CNV_A_R_LINEAR_____0_CM 1 0. 0. 65535. DISPLAY_IDENTIFIER CNT_V_DELTA_IV_FOC_STC_2_11_ ECU_ADDRESS 0x7fb240 BYTE_ORDER MSB_LAST FORMAT "%5.0" /end MEASUREMENT
/begin MEASUREMENT cnt_v_delta_iv_foc_stc_2[12] "fail of v_delta_iv_foc determination continous counter (cylinder 0)" UWORD _CNV_A_R_LINEAR_____0_CM 1 0. 0. 65535. DISPLAY_IDENTIFIER CNT_V_DELTA_IV_FOC_STC_2_12_ ECU_ADDRESS 0x7fb242 BYTE_ORDER MSB_LAST FORMAT "%5.0" /end MEASUREMENT
/begin MEASUREMENT cnt_v_delta_iv_foc_stc_2[13] "fail of v_delta_iv_foc determination continous counter (cylinder 0)" UWORD _CNV_A_R_LINEAR_____0_CM 1 0. 0. 65535. DISPLAY_IDENTIFIER CNT_V_DELTA_IV_FOC_STC_2_13_ ECU_ADDRESS 0x7fb244 BYTE_ORDER MSB_LAST FORMAT "%5.0" /end MEASUREMENT
/begin MEASUREMENT cnt_v_delta_iv_foc_stc_2[14] "fail of v_delta_iv_foc determination continous counter (cylinder 0)" UWORD _CNV_A_R_LINEAR_____0_CM 1 0. 0. 65535. DISPLAY_IDENTIFIER CNT_V_DELTA_IV_FOC_STC_2_14_ ECU_ADDRESS 0x7fb246 BYTE_ORDER MSB_LAST FORMAT "%5.0" /end MEASUREMENT
/begin MEASUREMENT cnt_v_delta_iv_foc_stc_2[15] "fail of v_delta_iv_foc determination continous counter (cylinder 0)" UWORD _CNV_A_R_LINEAR_____0_CM 1 0. 0. 65535. DISPLAY_IDENTIFIER CNT_V_DELTA_IV_FOC_STC_2_15_ ECU_ADDRESS 0x7fb248 BYTE_ORDER MSB_LAST FORMAT "%5.0" /end MEASUREMENT
/begin MEASUREMENT cnt_v_delta_iv_foc_stc_2[16] "fail of v_delta_iv_foc determination continous counter (cylinder 0)" UWORD _CNV_A_R_LINEAR_____0_CM 1 0. 0. 65535. DISPLAY_IDENTIFIER CNT_V_DELTA_IV_FOC_STC_2_16_ ECU_ADDRESS 0x7fb24a BYTE_ORDER MSB_LAST FORMAT "%5.0" /end MEASUREMENT
/begin MEASUREMENT cnt_v_delta_iv_foc_stc_2[17] "fail of v_delta_iv_foc determination continous counter (cylinder 0)" UWORD _CNV_A_R_LINEAR_____0_CM 1 0. 0. 65535. DISPLAY_IDENTIFIER CNT_V_DELTA_IV_FOC_STC_2_17_ ECU_ADDRESS 0x7fb24c BYTE_ORDER MSB_LAST FORMAT "%5.0" /end MEASUREMENT
/begin MEASUREMENT cnt_v_delta_iv_foc_stc_2[18] "fail of v_delta_iv_foc determination continous counter (cylinder 0)" UWORD _CNV_A_R_LINEAR_____0_CM 1 0. 0. 65535. DISPLAY_IDENTIFIER CNT_V_DELTA_IV_FOC_STC_2_18_ ECU_ADDRESS 0x7fb24e BYTE_ORDER MSB_LAST FORMAT "%5.0" /end MEASUREMENT
/begin MEASUREMENT cnt_v_delta_iv_foc_stc_2[19] "fail of v_delta_iv_foc determination continous counter (cylinder 0)" UWORD _CNV_A_R_LINEAR_____0_CM 1 0. 0. 65535. DISPLAY_IDENTIFIER CNT_V_DELTA_IV_FOC_STC_2_19_ ECU_ADDRESS 0x7fb250 BYTE_ORDER MSB_LAST FORMAT "%5.0" /end MEASUREMENT
/begin MEASUREMENT cnt_v_delta_iv_foc_stc_2[20] "fail of v_delta_iv_foc determination continous counter (cylinder 0)" UWORD _CNV_A_R_LINEAR_____0_CM 1 0. 0. 65535. DISPLAY_IDENTIFIER CNT_V_DELTA_IV_FOC_STC_2_20_ ECU_ADDRESS 0x7fb252 BYTE_ORDER MSB_LAST FORMAT "%5.0" /end MEASUREMENT
/begin MEASUREMENT cnt_v_delta_iv_foc_stc_2[21] "fail of v_delta_iv_foc determination continous counter (cylinder 0)" UWORD _CNV_A_R_LINEAR_____0_CM 1 0. 0. 65535. DISPLAY_IDENTIFIER CNT_V_DELTA_IV_FOC_STC_2_21_ ECU_ADDRESS 0x7fb254 BYTE_ORDER MSB_LAST FORMAT "%5.0" /end MEASUREMENT
/begin MEASUREMENT cnt_v_delta_iv_foc_stc_3[0] "fail of v_delta_iv_foc determination continous counter (cylinder 0)" UWORD _CNV_A_R_LINEAR_____0_CM 1 0. 0. 65535. DISPLAY_IDENTIFIER CNT_V_DELTA_IV_FOC_STC_3_0_ ECU_ADDRESS 0x7fb2d4 BYTE_ORDER MSB_LAST FORMAT "%5.0" /end MEASUREMENT
/begin MEASUREMENT cnt_v_delta_iv_foc_stc_3[1] "fail of v_delta_iv_foc determination continous counter (cylinder 0)" UWORD _CNV_A_R_LINEAR_____0_CM 1 0. 0. 65535. DISPLAY_IDENTIFIER CNT_V_DELTA_IV_FOC_STC_3_1_ ECU_ADDRESS 0x7fb2d6 BYTE_ORDER MSB_LAST FORMAT "%5.0" /end MEASUREMENT
/begin MEASUREMENT cnt_v_delta_iv_foc_stc_3[2] "fail of v_delta_iv_foc determination continous counter (cylinder 0)" UWORD _CNV_A_R_LINEAR_____0_CM 1 0. 0. 65535. DISPLAY_IDENTIFIER CNT_V_DELTA_IV_FOC_STC_3_2_ ECU_ADDRESS 0x7fb2d8 BYTE_ORDER MSB_LAST FORMAT "%5.0" /end MEASUREMENT
/begin MEASUREMENT cnt_v_delta_iv_foc_stc_3[3] "fail of v_delta_iv_foc determination continous counter (cylinder 0)" UWORD _CNV_A_R_LINEAR_____0_CM 1 0. 0. 65535. DISPLAY_IDENTIFIER CNT_V_DELTA_IV_FOC_STC_3_3_ ECU_ADDRESS 0x7fb2da BYTE_ORDER MSB_LAST FORMAT "%5.0" /end MEASUREMENT
/begin MEASUREMENT cnt_v_delta_iv_foc_stc_3[4] "fail of v_delta_iv_foc determination continous counter (cylinder 0)" UWORD _CNV_A_R_LINEAR_____0_CM 1 0. 0. 65535. DISPLAY_IDENTIFIER CNT_V_DELTA_IV_FOC_STC_3_4_ ECU_ADDRESS 0x7fb2dc BYTE_ORDER MSB_LAST FORMAT "%5.0" /end MEASUREMENT
/begin MEASUREMENT cnt_v_delta_iv_foc_stc_3[5] "fail of v_delta_iv_foc determination continous counter (cylinder 0)" UWORD _CNV_A_R_LINEAR_____0_CM 1 0. 0. 65535. DISPLAY_IDENTIFIER CNT_V_DELTA_IV_FOC_STC_3_5_ ECU_ADDRESS 0x7fb2de BYTE_ORDER MSB_LAST FORMAT "%5.0" /end MEASUREMENT
/begin MEASUREMENT cnt_v_delta_iv_foc_stc_3[6] "fail of v_delta_iv_foc determination continous counter (cylinder 0)" UWORD _CNV_A_R_LINEAR_____0_CM 1 0. 0. 65535. DISPLAY_IDENTIFIER CNT_V_DELTA_IV_FOC_STC_3_6_ ECU_ADDRESS 0x7fb2e0 BYTE_ORDER MSB_LAST FORMAT "%5.0" /end MEASUREMENT
/begin MEASUREMENT cnt_v_delta_iv_foc_stc_3[7] "fail of v_delta_iv_foc determination continous counter (cylinder 0)" UWORD _CNV_A_R_LINEAR_____0_CM 1 0. 0. 65535. DISPLAY_IDENTIFIER CNT_V_DELTA_IV_FOC_STC_3_7_ ECU_ADDRESS 0x7fb2e2 BYTE_ORDER MSB_LAST FORMAT "%5.0" /end MEASUREMENT
/begin MEASUREMENT cnt_v_delta_iv_foc_stc_3[8] "fail of v_delta_iv_foc determination continous counter (cylinder 0)" UWORD _CNV_A_R_LINEAR_____0_CM 1 0. 0. 65535. DISPLAY_IDENTIFIER CNT_V_DELTA_IV_FOC_STC_3_8_ ECU_ADDRESS 0x7fb2e4 BYTE_ORDER MSB_LAST FORMAT "%5.0" /end MEASUREMENT
/begin MEASUREMENT cnt_v_delta_iv_foc_stc_3[9] "fail of v_delta_iv_foc determination continous counter (cylinder 0)" UWORD _CNV_A_R_LINEAR_____0_CM 1 0. 0. 65535. DISPLAY_IDENTIFIER CNT_V_DELTA_IV_FOC_STC_3_9_ ECU_ADDRESS 0x7fb2e6 BYTE_ORDER MSB_LAST FORMAT "%5.0" /end MEASUREMENT
/begin MEASUREMENT cnt_v_delta_iv_foc_stc_3[10] "fail of v_delta_iv_foc determination continous counter (cylinder 0)" UWORD _CNV_A_R_LINEAR_____0_CM 1 0. 0. 65535. DISPLAY_IDENTIFIER CNT_V_DELTA_IV_FOC_STC_3_10_ ECU_ADDRESS 0x7fb2e8 BYTE_ORDER MSB_LAST FORMAT "%5.0" /end MEASUREMENT
/begin MEASUREMENT cnt_v_delta_iv_foc_stc_3[11] "fail of v_delta_iv_foc determination continous counter (cylinder 0)" UWORD _CNV_A_R_LINEAR_____0_CM 1 0. 0. 65535. DISPLAY_IDENTIFIER CNT_V_DELTA_IV_FOC_STC_3_11_ ECU_ADDRESS 0x7fb2ea BYTE_ORDER MSB_LAST FORMAT "%5.0" /end MEASUREMENT
/begin MEASUREMENT cnt_v_delta_iv_foc_stc_3[12] "fail of v_delta_iv_foc determination continous counter (cylinder 0)" UWORD _CNV_A_R_LINEAR_____0_CM 1 0. 0. 65535. DISPLAY_IDENTIFIER CNT_V_DELTA_IV_FOC_STC_3_12_ ECU_ADDRESS 0x7fb2ec BYTE_ORDER MSB_LAST FORMAT "%5.0" /end MEASUREMENT
/begin MEASUREMENT cnt_v_delta_iv_foc_stc_3[13] "fail of v_delta_iv_foc determination continous counter (cylinder 0)" UWORD _CNV_A_R_LINEAR_____0_CM 1 0. 0. 65535. DISPLAY_IDENTIFIER CNT_V_DELTA_IV_FOC_STC_3_13_ ECU_ADDRESS 0x7fb2ee BYTE_ORDER MSB_LAST FORMAT "%5.0" /end MEASUREMENT
/begin MEASUREMENT cnt_v_delta_iv_foc_stc_3[14] "fail of v_delta_iv_foc determination continous counter (cylinder 0)" UWORD _CNV_A_R_LINEAR_____0_CM 1 0. 0. 65535. DISPLAY_IDENTIFIER CNT_V_DELTA_IV_FOC_STC_3_14_ ECU_ADDRESS 0x7fb2f0 BYTE_ORDER MSB_LAST FORMAT "%5.0" /end MEASUREMENT
/begin MEASUREMENT cnt_v_delta_iv_foc_stc_3[15] "fail of v_delta_iv_foc determination continous counter (cylinder 0)" UWORD _CNV_A_R_LINEAR_____0_CM 1 0. 0. 65535. DISPLAY_IDENTIFIER CNT_V_DELTA_IV_FOC_STC_3_15_ ECU_ADDRESS 0x7fb2f2 BYTE_ORDER MSB_LAST FORMAT "%5.0" /end MEASUREMENT
/begin MEASUREMENT cnt_v_delta_iv_foc_stc_3[16] "fail of v_delta_iv_foc determination continous counter (cylinder 0)" UWORD _CNV_A_R_LINEAR_____0_CM 1 0. 0. 65535. DISPLAY_IDENTIFIER CNT_V_DELTA_IV_FOC_STC_3_16_ ECU_ADDRESS 0x7fb2f4 BYTE_ORDER MSB_LAST FORMAT "%5.0" /end MEASUREMENT
/begin MEASUREMENT cnt_v_delta_iv_foc_stc_3[17] "fail of v_delta_iv_foc determination continous counter (cylinder 0)" UWORD _CNV_A_R_LINEAR_____0_CM 1 0. 0. 65535. DISPLAY_IDENTIFIER CNT_V_DELTA_IV_FOC_STC_3_17_ ECU_ADDRESS 0x7fb2f6 BYTE_ORDER MSB_LAST FORMAT "%5.0" /end MEASUREMENT
/begin MEASUREMENT cnt_v_delta_iv_foc_stc_3[18] "fail of v_delta_iv_foc determination continous counter (cylinder 0)" UWORD _CNV_A_R_LINEAR_____0_CM 1 0. 0. 65535. DISPLAY_IDENTIFIER CNT_V_DELTA_IV_FOC_STC_3_18_ ECU_ADDRESS 0x7fb2f8 BYTE_ORDER MSB_LAST FORMAT "%5.0" /end MEASUREMENT
/begin MEASUREMENT cnt_v_delta_iv_foc_stc_3[19] "fail of v_delta_iv_foc determination continous counter (cylinder 0)" UWORD _CNV_A_R_LINEAR_____0_CM 1 0. 0. 65535. DISPLAY_IDENTIFIER CNT_V_DELTA_IV_FOC_STC_3_19_ ECU_ADDRESS 0x7fb2fa BYTE_ORDER MSB_LAST FORMAT "%5.0" /end MEASUREMENT
/begin MEASUREMENT cnt_v_delta_iv_foc_stc_3[20] "fail of v_delta_iv_foc determination continous counter (cylinder 0)" UWORD _CNV_A_R_LINEAR_____0_CM 1 0. 0. 65535. DISPLAY_IDENTIFIER CNT_V_DELTA_IV_FOC_STC_3_20_ ECU_ADDRESS 0x7fb2fc BYTE_ORDER MSB_LAST FORMAT "%5.0" /end MEASUREMENT
/begin MEASUREMENT cnt_v_delta_iv_foc_stc_3[21] "fail of v_delta_iv_foc determination continous counter (cylinder 0)" UWORD _CNV_A_R_LINEAR_____0_CM 1 0. 0. 65535. DISPLAY_IDENTIFIER CNT_V_DELTA_IV_FOC_STC_3_21_ ECU_ADDRESS 0x7fb2fe BYTE_ORDER MSB_LAST FORMAT "%5.0" /end MEASUREMENT
/begin MEASUREMENT v_delta_iv_foc_last_[0] "last determined iv_delta_iv_foc (cylinder individual)" UWORD _CNV_A_R_LINEAR_____121_CM 1 0. 0. 255. DISPLAY_IDENTIFIER V_DELTA_IV_FOC_LAST__0_ ECU_ADDRESS 0x7fb37e BYTE_ORDER MSB_LAST FORMAT "%4.1" /end MEASUREMENT
/begin MEASUREMENT v_delta_iv_foc_last_[1] "last determined iv_delta_iv_foc (cylinder individual)" UWORD _CNV_A_R_LINEAR_____121_CM 1 0. 0. 255. DISPLAY_IDENTIFIER V_DELTA_IV_FOC_LAST__1_ ECU_ADDRESS 0x7fb380 BYTE_ORDER MSB_LAST FORMAT "%4.1" /end MEASUREMENT
/begin MEASUREMENT v_delta_iv_foc_last_[2] "last determined iv_delta_iv_foc (cylinder individual)" UWORD _CNV_A_R_LINEAR_____121_CM 1 0. 0. 255. DISPLAY_IDENTIFIER V_DELTA_IV_FOC_LAST__2_ ECU_ADDRESS 0x7fb382 BYTE_ORDER MSB_LAST FORMAT "%4.1" /end MEASUREMENT
/begin MEASUREMENT v_delta_iv_foc_last_[3] "last determined iv_delta_iv_foc (cylinder individual)" UWORD _CNV_A_R_LINEAR_____121_CM 1 0. 0. 255. DISPLAY_IDENTIFIER V_DELTA_IV_FOC_LAST__3_ ECU_ADDRESS 0x7fb384 BYTE_ORDER MSB_LAST FORMAT "%4.1" /end MEASUREMENT
/begin CHARACTERISTIC c_v_delta_iv_foc_fail_replace "v_delta_iv_foc replacement value" VALUE 0x85008c _REC_VAL_20_u2 255. _CNV_A_R_LINEAR_____121_CM 0. 255. DISPLAY_IDENTIFIER C_V_DELTA_IV_FOC_FAIL_REPLACE FORMAT "%4.1" /end CHARACTERISTIC
/begin CHARACTERISTIC c_cnt_v_delta_iv_foc_stc_max "v_delta_iv_foc replacement value" VALUE 0x84fbe6 _REC_VAL_20_u2 65535. _CNV_A_R_LINEAR_____0_CM 0. 65535. DISPLAY_IDENTIFIER C_CNT_V_DELTA_IV_FOC_STC_MAX FORMAT "%5.0" /end CHARACTERISTIC
/begin CHARACTERISTIC c_cnt_v_delta_iv_foc_stc_repl_max "v_delta_iv_foc replacement value" VALUE 0x84fbe8 _REC_VAL_20_u2 65535. _CNV_A_R_LINEAR_____0_CM 0. 65535. DISPLAY_IDENTIFIER C_CNT_V_DELTA_IV_FOC_STC_REPL_MAX FORMAT "%5.0" /end CHARACTERISTIC
/begin CHARACTERISTIC c_v_delta_iv_foc_stc_min_lim "v_delta_iv_foc statistics minimum limit" VALUE 0x850092 _REC_VAL_20_u2 255. _CNV_A_R_LINEAR_____121_CM 0. 255. DISPLAY_IDENTIFIER C_V_DELTA_IV_FOC_STC_MIN_LIM FORMAT "%4.1" /end CHARACTERISTIC
/begin CHARACTERISTIC c_v_delta_iv_foc_stc_max_lim "v_delta_iv_foc statistics maximum limit" VALUE 0x850090 _REC_VAL_20_u2 255. _CNV_A_R_LINEAR_____121_CM 0. 255. DISPLAY_IDENTIFIER C_V_DELTA_IV_FOC_STC_MAX_LIM FORMAT "%4.1" /end CHARACTERISTIC
/begin MEASUREMENT v_delta_iv_foc_stat_mean_[0] "mean value of v_delta_iv_foc (cylinder individual)" UWORD _CNV_A_R_LINEAR_____121_CM 1 0. 0. 255. DISPLAY_IDENTIFIER V_DELTA_IV_FOC_STAT_MEAN__0_ ECU_ADDRESS 0x7fa006 BYTE_ORDER MSB_LAST FORMAT "%4.1" /end MEASUREMENT
/begin MEASUREMENT v_delta_iv_foc_stat_mean_[1] "mean value of v_delta_iv_foc (cylinder individual)" UWORD _CNV_A_R_LINEAR_____121_CM 1 0. 0. 255. DISPLAY_IDENTIFIER V_DELTA_IV_FOC_STAT_MEAN__1_ ECU_ADDRESS 0x7fa008 BYTE_ORDER MSB_LAST FORMAT "%4.1" /end MEASUREMENT
/begin MEASUREMENT v_delta_iv_foc_stat_mean_[2] "mean value of v_delta_iv_foc (cylinder individual)" UWORD _CNV_A_R_LINEAR_____121_CM 1 0. 0. 255. DISPLAY_IDENTIFIER V_DELTA_IV_FOC_STAT_MEAN__2_ ECU_ADDRESS 0x7fa00a BYTE_ORDER MSB_LAST FORMAT "%4.1" /end MEASUREMENT
/begin MEASUREMENT v_delta_iv_foc_stat_mean_[3] "mean value of v_delta_iv_foc (cylinder individual)" UWORD _CNV_A_R_LINEAR_____121_CM 1 0. 0. 255. DISPLAY_IDENTIFIER V_DELTA_IV_FOC_STAT_MEAN__3_ ECU_ADDRESS 0x7fa00c BYTE_ORDER MSB_LAST FORMAT "%4.1" /end MEASUREMENT
/begin MEASUREMENT pct_v_delta_iv_foc_stc_[0] "percentage of successful v_delta_iv_foc determinations (cylinder individual)" UWORD _CNV_A_R_LINEAR_____0_CM 1 0. 0. 65535. DISPLAY_IDENTIFIER PCT_V_DELTA_IV_FOC_STC__0_ ECU_ADDRESS 0x7f9ffe BYTE_ORDER MSB_LAST FORMAT "%5.0" /end MEASUREMENT
/begin MEASUREMENT pct_v_delta_iv_foc_stc_[1] "percentage of successful v_delta_iv_foc determinations (cylinder individual)" UWORD _CNV_A_R_LINEAR_____0_CM 1 0. 0. 65535. DISPLAY_IDENTIFIER PCT_V_DELTA_IV_FOC_STC__1_ ECU_ADDRESS 0x7fa000 BYTE_ORDER MSB_LAST FORMAT "%5.0" /end MEASUREMENT
/begin MEASUREMENT pct_v_delta_iv_foc_stc_[2] "percentage of successful v_delta_iv_foc determinations (cylinder individual)" UWORD _CNV_A_R_LINEAR_____0_CM 1 0. 0. 65535. DISPLAY_IDENTIFIER PCT_V_DELTA_IV_FOC_STC__2_ ECU_ADDRESS 0x7fa002 BYTE_ORDER MSB_LAST FORMAT "%5.0" /end MEASUREMENT
/begin MEASUREMENT pct_v_delta_iv_foc_stc_[3] "percentage of successful v_delta_iv_foc determinations (cylinder individual)" UWORD _CNV_A_R_LINEAR_____0_CM 1 0. 0. 65535. DISPLAY_IDENTIFIER PCT_V_DELTA_IV_FOC_STC__3_ ECU_ADDRESS 0x7fa004 BYTE_ORDER MSB_LAST FORMAT "%5.0" /end MEASUREMENT
/begin MEASUREMENT idx_max_v_delta_iv_foc_stc_[0] "Haeufigkeitspunkt of v_delta_iv_foc determination (cylinder individual)" UWORD _CNV_A_R_LINEAR_____121_CM 1 0. 0. 255. DISPLAY_IDENTIFIER IDX_MAX_V_DELTA_IV_FOC_STC__0_ ECU_ADDRESS 0x7fa016 BYTE_ORDER MSB_LAST FORMAT "%4.1" /end MEASUREMENT
/begin MEASUREMENT idx_max_v_delta_iv_foc_stc_[1] "Haeufigkeitspunkt of v_delta_iv_foc determination (cylinder individual)" UWORD _CNV_A_R_LINEAR_____121_CM 1 0. 0. 255. DISPLAY_IDENTIFIER IDX_MAX_V_DELTA_IV_FOC_STC__1_ ECU_ADDRESS 0x7fa018 BYTE_ORDER MSB_LAST FORMAT "%4.1" /end MEASUREMENT
/begin MEASUREMENT idx_max_v_delta_iv_foc_stc_[2] "Haeufigkeitspunkt of v_delta_iv_foc determination (cylinder individual)" UWORD _CNV_A_R_LINEAR_____121_CM 1 0. 0. 255. DISPLAY_IDENTIFIER IDX_MAX_V_DELTA_IV_FOC_STC__2_ ECU_ADDRESS 0x7fa01a BYTE_ORDER MSB_LAST FORMAT "%4.1" /end MEASUREMENT
/begin MEASUREMENT idx_max_v_delta_iv_foc_stc_[3] "Haeufigkeitspunkt of v_delta_iv_foc determination (cylinder individual)" UWORD _CNV_A_R_LINEAR_____121_CM 1 0. 0. 255. DISPLAY_IDENTIFIER IDX_MAX_V_DELTA_IV_FOC_STC__3_ ECU_ADDRESS 0x7fa01c BYTE_ORDER MSB_LAST FORMAT "%4.1" /end MEASUREMENT
/begin MEASUREMENT var_v_delta_iv_foc_stc_[0] "Varianz of v_delta_iv_foc determination (cylinder individual)" SLONG _CNV_A_R_LINEAR_____0_CM 1 0. -2147483648. 2147483647. DISPLAY_IDENTIFIER VAR_V_DELTA_IV_FOC_STC__0_ ECU_ADDRESS 0x7f86a0 BYTE_ORDER MSB_LAST FORMAT "%5.0" /end MEASUREMENT
/begin MEASUREMENT var_v_delta_iv_foc_stc_[1] "Varianz of v_delta_iv_foc determination (cylinder individual)" SLONG _CNV_A_R_LINEAR_____0_CM 1 0. -2147483648. 2147483647. DISPLAY_IDENTIFIER VAR_V_DELTA_IV_FOC_STC__1_ ECU_ADDRESS 0x7f86a4 BYTE_ORDER MSB_LAST FORMAT "%5.0" /end MEASUREMENT
/begin MEASUREMENT var_v_delta_iv_foc_stc_[2] "Varianz of v_delta_iv_foc determination (cylinder individual)" SLONG _CNV_A_R_LINEAR_____0_CM 1 0. -2147483648. 2147483647. DISPLAY_IDENTIFIER VAR_V_DELTA_IV_FOC_STC__2_ ECU_ADDRESS 0x7f86a8 BYTE_ORDER MSB_LAST FORMAT "%5.0" /end MEASUREMENT
/begin MEASUREMENT var_v_delta_iv_foc_stc_[3] "Varianz of v_delta_iv_foc determination (cylinder individual)" SLONG _CNV_A_R_LINEAR_____0_CM 1 0. -2147483648. 2147483647. DISPLAY_IDENTIFIER VAR_V_DELTA_IV_FOC_STC__3_ ECU_ADDRESS 0x7f86ac BYTE_ORDER MSB_LAST FORMAT "%5.0" /end MEASUREMENT
/begin CHARACTERISTIC c_v_delta_iv_foc_stat_mv "v_delta_iv_foc_mv filter coefficient" VALUE 0x85008e _REC_VAL_20_u2 1. _CNV_A_R_LINEAR_____562_CM 0. 1. DISPLAY_IDENTIFIER C_V_DELTA_IV_FOC_STAT_MV FORMAT "%6.5" /end CHARACTERISTIC
/begin MEASUREMENT ctr_v_delta_iv_foc_ctl_vld_[0] "v_delta_iv_foc_mean_ valid counter (cylinder individual)" UWORD _CNV_A_R_LINEAR_____0_CM 1 0. 0. 65535. DISPLAY_IDENTIFIER CTR_V_DELTA_IV_FOC_CTL_VLD__0_ ECU_ADDRESS 0x7fa01e BYTE_ORDER MSB_LAST FORMAT "%5.0" /end MEASUREMENT
/begin MEASUREMENT ctr_v_delta_iv_foc_ctl_vld_[1] "v_delta_iv_foc_mean_ valid counter (cylinder individual)" UWORD _CNV_A_R_LINEAR_____0_CM 1 0. 0. 65535. DISPLAY_IDENTIFIER CTR_V_DELTA_IV_FOC_CTL_VLD__1_ ECU_ADDRESS 0x7fa020 BYTE_ORDER MSB_LAST FORMAT "%5.0" /end MEASUREMENT
/begin MEASUREMENT ctr_v_delta_iv_foc_ctl_vld_[2] "v_delta_iv_foc_mean_ valid counter (cylinder individual)" UWORD _CNV_A_R_LINEAR_____0_CM 1 0. 0. 65535. DISPLAY_IDENTIFIER CTR_V_DELTA_IV_FOC_CTL_VLD__2_ ECU_ADDRESS 0x7fa022 BYTE_ORDER MSB_LAST FORMAT "%5.0" /end MEASUREMENT
/begin MEASUREMENT ctr_v_delta_iv_foc_ctl_vld_[3] "v_delta_iv_foc_mean_ valid counter (cylinder individual)" UWORD _CNV_A_R_LINEAR_____0_CM 1 0. 0. 65535. DISPLAY_IDENTIFIER CTR_V_DELTA_IV_FOC_CTL_VLD__3_ ECU_ADDRESS 0x7fa024 BYTE_ORDER MSB_LAST FORMAT "%5.0" /end MEASUREMENT
/begin COMPU_METHOD _CNV_A_R_LINEAR_____0_CM "" RAT_FUNC "%6.3" "[-]" COEFFS 0 1. 0. 0 0 1 /end COMPU_METHOD
/begin COMPU_METHOD _CNV_A_R_LINEAR_____5_CM "" RAT_FUNC "%6.3" "[rpm]" COEFFS 0 1. 0. 0 0 1 /end COMPU_METHOD
/begin COMPU_METHOD _CNV_A_R_LINEAR_____8_CM "" RAT_FUNC "%6.3" "[%]" COEFFS 0 655.3599999999997 0. 0 0 1 /end COMPU_METHOD
/begin COMPU_METHOD _CNV_S_2_RANGE______11_CM "" TAB_VERB "%6.3" "[-]" COMPU_TAB_REF _CNV_S_2_RANGE______11 /end COMPU_METHOD
/begin COMPU_VTAB _CNV_S_2_RANGE______11 "" TAB_VERB 2 0 "0" 1 "1" /end COMPU_VTAB
/begin COMPU_METHOD _CNV_A_R_LINEAR_____15_CM "" RAT_FUNC "%6.3" "[-]" COEFFS 0 16384. 0. 0 0 1 /end COMPU_METHOD
/begin COMPU_METHOD _CNV_A_R_LINEAR_____48_CM "" RAT_FUNC "%6.3" "[-]" COEFFS 0 32767.99807357072 0. 0 0 1 /end COMPU_METHOD
/begin COMPU_METHOD _CNV_A_R_LINEAR_____121_CM "" RAT_FUNC "%6.3" "[V]" COEFFS 0 4.011764705882353 0. 0 0 1 /end COMPU_METHOD
/begin COMPU_METHOD _CNV_A_R_LINEAR_____211_CM "" RAT_FUNC "%6.3" "[ms]" COEFFS 0 999.9999999999999 0. 0 0 1 /end COMPU_METHOD
/begin COMPU_METHOD _CNV_A_R_LINEAR_____408_CM "" RAT_FUNC "%6.3" "[-]" COEFFS 0 16383.99985599781 -2.880043903132901e-004 0 0 1 /end COMPU_METHOD
/begin COMPU_METHOD _CNV_A_R_LINEAR_____540_CM "" RAT_FUNC "%6.3" "[ms]" COEFFS 0 1000. 0. 0 0 1 /end COMPU_METHOD
/begin COMPU_METHOD _CNV_A_R_LINEAR_____541_CM "" RAT_FUNC "%6.3" "[mJ]" COEFFS 0 125.3598432925406 0. 0 0 1 /end COMPU_METHOD
/begin COMPU_METHOD _CNV_A_R_LINEAR_____542_CM "" RAT_FUNC "%6.3" "[%]" COEFFS 0 655.3600000071681 3.584063961170614e-007 0 0 1 /end COMPU_METHOD
/begin COMPU_METHOD _CNV_A_R_LINEAR_____543_CM "" RAT_FUNC "%6.3" "[mJ]" COEFFS 0 125.3598433405 -0.5 0 0 1 /end COMPU_METHOD
/begin COMPU_METHOD _CNV_A_R_LINEAR_____544_CM "" RAT_FUNC "%6.3" "[%/mJ]" COEFFS 0 327.6800000003072 3.071909304708242e-008 0 0 1 /end COMPU_METHOD
/begin COMPU_METHOD _CNV_A_R_LINEAR_____545_CM "" RAT_FUNC "%6.3" "[%]" COEFFS 0 655.3600015872485 0. 0 0 1 /end COMPU_METHOD
/begin COMPU_METHOD _CNV_A_R_LINEAR_____546_CM "" RAT_FUNC "%6.3" "[%]" COEFFS 0 655.36 0. 0 0 1 /end COMPU_METHOD
/begin COMPU_METHOD _CNV_A_R_LINEAR_____547_CM "" RAT_FUNC "%6.3" "[-]" COEFFS 0 655.3600000071681 3.584063961170614e-007 0 0 1 /end COMPU_METHOD
/begin COMPU_METHOD _CNV_A_R_LINEAR_____548_CM "" RAT_FUNC "%6.3" "[ms]" COEFFS 0 10. 0. 0 0 1 /end COMPU_METHOD
/begin COMPU_METHOD _CNV_A_R_LINEAR_____549_CM "" RAT_FUNC "%6.3" "[ms]" COEFFS 0 1000. 32768. 0 0 1 /end COMPU_METHOD
/begin COMPU_METHOD _CNV_A_R_LINEAR_____550_CM "" RAT_FUNC "%6.3" "[-]" COEFFS 0 8224. 128. 0 0 1 /end COMPU_METHOD
/begin COMPU_METHOD _CNV_A_R_LINEAR_____558_CM "" RAT_FUNC "%6.3" "[V]" COEFFS 0 4.00587084148728 1.502935420743597 0 0 1 /end COMPU_METHOD
/begin COMPU_METHOD _CNV_A_R_LINEAR_____559_CM "" RAT_FUNC "%6.3" "[-]" COEFFS 0 4.011764705882353 0. 0 0 1 /end COMPU_METHOD
/begin COMPU_METHOD _CNV_A_R_LINEAR_____560_CM "" RAT_FUNC "%6.3" "[ms]" COEFFS 0 99999.99999999999 -3.637978807091713e-012 0 0 1 /end COMPU_METHOD
/begin COMPU_METHOD _CNV_A_R_LINEAR_____561_CM "" RAT_FUNC "%6.3" "[ms]" COEFFS 0 100000. 0. 0 0 1 /end COMPU_METHOD
/begin COMPU_METHOD _CNV_A_R_LINEAR_____562_CM "" RAT_FUNC "%6.3" "[V]" COEFFS 0 65535. 0. 0 0 1 /end COMPU_METHOD
/begin RECORD_LAYOUT _REC_VAL_20_u1 FNC_VALUES 1 UBYTE COLUMN_DIR DIRECT /end RECORD_LAYOUT
/begin RECORD_LAYOUT _REC_AXS_20_u2 NO_AXIS_PTS_X 1 UWORD AXIS_PTS_X 2 UWORD INDEX_INCR DIRECT /end RECORD_LAYOUT
/begin RECORD_LAYOUT _REC_VAL_20_u2 FNC_VALUES 1 UWORD COLUMN_DIR DIRECT /end RECORD_LAYOUT
/begin RECORD_LAYOUT _REC_VAL_20_s2 FNC_VALUES 1 SWORD COLUMN_DIR DIRECT /end RECORD_LAYOUT
/begin RECORD_LAYOUT _REC_CUR_20_u2_u2 FNC_VALUES 1 UWORD COLUMN_DIR DIRECT /end RECORD_LAYOUT
/begin FUNCTION PECO_ACQU ""
 /begin DEF_CHARACTERISTIC c_acq_intp_fil_ini c_num_fil_value_egy_det_ma[0] c_num_fil_value_egy_det_ma[1] c_num_fil_value_egy_det_ma[2] c_num_fil_value_egy_det_ma[3] c_num_fil_value_egy_det_ma[4] c_num_fil_value_egy_det_ma[5] c_num_fil_value_egy_det_ma[6] c_num_fil_value_egy_det_ma[7] c_num_fil_value_egy_det_ma[8] c_num_fil_value_egy_det_ma[9] c_dnom_fil_value_egy_det_ma[0] c_dnom_fil_value_egy_det_ma[1] c_dnom_fil_value_egy_det_ma[2] c_dnom_fil_value_egy_det_ma[3] c_dnom_fil_value_egy_det_ma[4] c_dnom_fil_value_egy_det_ma[5] c_dnom_fil_value_egy_det_ma[6] c_dnom_fil_value_egy_det_ma[7] c_dnom_fil_value_egy_det_ma[8] c_dnom_fil_value_egy_det_ma[9] c_dnom_fil_value_acq_intp[0] c_dnom_fil_value_acq_intp[1] c_dnom_fil_value_acq_intp[2] c_dnom_fil_value_acq_intp[3] c_dnom_fil_value_acq_intp[4] c_dnom_fil_value_acq_intp[5] c_dnom_fil_value_acq_intp[6] c_dnom_fil_value_acq_intp[7] c_dnom_fil_value_acq_intp[8] c_egy_det_ma_fil_ini c_num_fil_value_acq_intp[0] c_num_fil_value_acq_intp[1] c_num_fil_value_acq_intp[2] c_num_fil_value_acq_intp[3] c_num_fil_value_acq_intp[4] c_num_fil_value_acq_intp[5] c_num_fil_value_acq_intp[6] c_num_fil_value_acq_intp[7] c_num_fil_value_acq_intp[8] c_sample_nr_det_beg c_sample_nr_det_dly c_sample_nr_det_end c_sample_nr_det_lst c_t_egy_inj_det_dly c_t_sample_burst c_v_inj_burst_dif_min lc_v_inj_burst_dif_sel lc_v_inj_burst_fil_max lc_v_inj_burst_intp_on lc_v_inj_burst_lnr_on c_t_iv_close_fail_replace c_cnt_t_iv_close_stc_max c_cnt_t_iv_close_stc_repl_max c_t_iv_close_stc_min_lim c_t_iv_close_stc_max_lim c_v_delta_iv_foc_fail_replace c_cnt_v_delta_iv_foc_stc_max c_cnt_v_delta_iv_foc_stc_repl_max c_v_delta_iv_foc_stc_min_lim c_v_delta_iv_foc_stc_max_lim c_v_delta_iv_foc_stat_mv /end DEF_CHARACTERISTIC
 /begin OUT_MEASUREMENT v_inj_burst_act_max_[1] v_inj_burst_act_max_[2] v_inj_burst_act_max_[3] v_inj_burst_act_[0] v_inj_burst_act_[1] v_inj_burst_act_[2] v_inj_burst_act_[3] v_inj_burst_act_[4] v_inj_burst_act_[5] v_inj_burst_act_[6] v_inj_burst_act_[7] v_inj_burst_act_[8] v_inj_burst_act_[9] v_inj_burst_act_[10] v_inj_burst_act_[11] v_inj_burst_act_[12] v_inj_burst_act_[13] v_inj_burst_act_[14] v_inj_burst_act_[15] v_inj_burst_act_[16] v_inj_burst_act_[17] v_inj_burst_act_[18] v_inj_burst_act_[19] v_inj_burst_act_[20] v_inj_burst_act_[21] v_inj_burst_act_[22] v_inj_burst_act_[23] v_inj_burst_act_[24] v_inj_burst_act_[25] v_inj_burst_act_[26] v_inj_burst_act_[27] v_inj_burst_act_[28] v_inj_burst_act_[29] v_inj_burst_act_[30] v_inj_burst_act_[31] v_inj_burst_act_[32] v_inj_burst_act_[33] v_inj_burst_act_[34] v_inj_burst_act_[35] v_inj_burst_act_[36] v_inj_burst_act_[37] v_inj_burst_act_[38] v_inj_burst_act_[39] v_inj_burst_act_[40] v_inj_burst_act_[41] v_inj_burst_act_[42] v_inj_burst_act_[43] v_inj_burst_act_[44] v_inj_burst_act_[45] v_inj_burst_act_[46] v_inj_burst_act_[47] v_inj_burst_act_[48] v_inj_burst_act_[49] v_inj_burst_act_[50] v_inj_burst_act_[51] v_inj_burst_act_[52] v_inj_burst_act_[53] v_inj_burst_act_[54] v_inj_burst_act_[55] v_inj_burst_act_[56] v_inj_burst_act_[57] v_inj_burst_act_[58] v_inj_burst_act_[59] v_inj_burst_act_[60] v_inj_burst_act_[61] v_inj_burst_act_[62] v_inj_burst_act_[63] v_inj_burst_act_[64] v_inj_burst_act_[65] v_inj_burst_act_[66] v_inj_burst_act_[67] v_inj_burst_act_[68] v_inj_burst_act_[69] v_inj_burst_act_[70] v_inj_burst_act_[71] v_inj_burst_act_[72] v_inj_burst_act_[73] v_inj_burst_act_[74] v_inj_burst_act_[75] v_inj_burst_act_[76] v_inj_burst_act_[77] v_inj_burst_act_[78] v_inj_burst_act_[79] v_inj_burst_act_[80] v_inj_burst_act_[81] v_inj_burst_act_[82] v_inj_burst_act_[83] v_inj_burst_act_[84] v_inj_burst_act_[85] v_inj_burst_act_[86] v_inj_burst_act_[87] v_inj_burst_dif1_[0] v_inj_burst_dif1_[1] v_inj_burst_dif1_[2] v_inj_burst_dif1_[3] v_inj_burst_dif2_[0] v_inj_burst_dif2_[1] v_inj_burst_dif2_[2] v_inj_burst_dif2_[3] v_inj_burst_exp_[0] v_inj_burst_exp_[1] v_inj_burst_exp_[2] v_inj_burst_exp_[3] v_inj_burst_exp_[4] v_inj_burst_exp_[5] v_inj_burst_exp_[6] v_inj_burst_exp_[7] v_inj_burst_exp_[8] v_inj_burst_exp_[9] v_inj_burst_exp_[10] v_inj_burst_exp_[11] v_inj_burst_exp_[12] v_inj_burst_exp_[13] v_inj_burst_exp_[14] v_inj_burst_exp_[15] v_inj_burst_exp_[16] v_inj_burst_exp_[17] v_inj_burst_exp_[18] v_inj_burst_exp_[19] v_inj_burst_exp_[20] v_inj_burst_exp_[21] v_inj_burst_exp_[22] v_inj_burst_exp_[23] v_inj_burst_exp_[24] v_inj_burst_exp_[25] v_inj_burst_exp_[26] v_inj_burst_exp_[27] v_inj_burst_exp_[28] v_inj_burst_exp_[29] v_inj_burst_exp_[30] v_inj_burst_exp_[31] v_inj_burst_exp_[32] v_inj_burst_exp_[33] v_inj_burst_exp_[34] v_inj_burst_exp_[35] v_inj_burst_exp_[36] v_inj_burst_exp_[37] v_inj_burst_exp_[38] v_inj_burst_exp_[39] v_inj_burst_exp_[40] v_inj_burst_exp_[41] v_inj_burst_exp_[42] v_inj_burst_exp_[43] v_inj_burst_exp_[44] v_inj_burst_exp_[45] v_inj_burst_exp_[46] v_inj_burst_exp_[47] v_inj_burst_exp_[48] v_inj_burst_exp_[49] v_inj_burst_exp_[50] v_inj_burst_exp_[51] v_inj_burst_exp_[52] v_inj_burst_exp_[53] v_inj_burst_exp_[54] v_inj_burst_exp_[55] v_inj_burst_exp_[56] v_inj_burst_exp_[57] v_inj_burst_exp_[58] v_inj_burst_exp_[59] v_inj_burst_exp_[60] v_inj_burst_exp_[61] v_inj_burst_exp_[62] v_inj_burst_exp_[63] v_inj_burst_exp_[64] v_inj_burst_exp_[65] v_inj_burst_exp_[66] v_inj_burst_exp_[67] v_inj_burst_exp_[68] v_inj_burst_exp_[69] v_inj_burst_exp_[70] v_inj_burst_exp_[71] v_inj_burst_exp_[72] v_inj_burst_exp_[73] v_inj_burst_exp_[74] v_inj_burst_exp_[75] v_inj_burst_exp_[76] v_inj_burst_exp_[77] v_inj_burst_exp_[78] v_inj_burst_exp_[79] v_inj_burst_exp_[80] v_inj_burst_exp_[81] v_inj_burst_exp_[82] v_inj_burst_exp_[83] v_inj_burst_exp_[84] v_inj_burst_exp_[85] v_inj_burst_exp_[86] v_inj_burst_exp_[87] v_inj_burst_fil_max_[0] v_inj_burst_fil_max_[1] v_inj_burst_fil_max_[2] v_inj_burst_fil_max_[3] v_inj_burst_fil_max_[4] v_inj_burst_fil_max_[5] v_inj_burst_intp_[0] v_inj_burst_intp_[1] v_inj_burst_intp_[2] v_inj_burst_intp_[3] v_inj_burst_intp_[4] v_inj_burst_intp_[5] v_inj_burst_intp_[6] v_inj_burst_intp_[7] v_inj_burst_intp_[8] v_inj_burst_intp_[9] v_inj_burst_intp_[10] v_inj_burst_intp_[11] v_inj_burst_intp_[12] v_inj_burst_intp_[13] v_inj_burst_intp_[14] v_inj_burst_intp_[15] v_inj_burst_intp_[16] v_inj_burst_intp_[17] v_inj_burst_intp_[18] v_inj_burst_intp_[19] v_inj_burst_intp_[20] v_inj_burst_intp_[21] v_inj_burst_intp_[22] v_inj_burst_intp_[23] v_inj_burst_intp_[24] v_inj_burst_intp_[25] v_inj_burst_intp_[26] v_inj_burst_intp_[27] v_inj_burst_intp_[28] v_inj_burst_intp_[29] v_inj_burst_intp_[30] v_inj_burst_intp_[31] v_inj_burst_intp_[32] v_inj_burst_intp_[33] v_inj_burst_intp_[34] v_inj_burst_intp_[35] v_inj_burst_intp_[36] v_inj_burst_intp_[37] v_inj_burst_intp_[38] v_inj_burst_intp_[39] v_inj_burst_intp_[40] v_inj_burst_intp_[41] v_inj_burst_intp_[42] v_inj_burst_intp_[43] v_inj_burst_intp_[44] v_inj_burst_intp_[45] v_inj_burst_intp_[46] v_inj_burst_intp_[47] v_inj_burst_intp_[48] v_inj_burst_intp_[49] v_inj_burst_intp_[50] v_inj_burst_intp_[51] v_inj_burst_intp_[52] v_inj_burst_intp_[53] v_inj_burst_intp_[54] v_inj_burst_intp_[55] v_inj_burst_intp_[56] v_inj_burst_intp_[57] v_inj_burst_intp_[58] v_inj_burst_intp_[59] v_inj_burst_intp_[60] v_inj_burst_intp_[61] v_inj_burst_intp_[62] v_inj_burst_intp_[63] v_inj_burst_intp_[64] v_inj_burst_intp_[65] v_inj_burst_intp_[66] v_inj_burst_intp_[67] v_inj_burst_intp_[68] v_inj_burst_intp_[69] v_inj_burst_intp_[70] v_inj_burst_intp_[71] v_inj_burst_intp_[72] v_inj_burst_intp_[73] v_inj_burst_intp_[74] v_inj_burst_intp_[75] v_inj_burst_intp_[76] v_inj_burst_intp_[77] v_inj_burst_intp_[78] v_inj_burst_intp_[79] v_inj_burst_intp_[80] v_inj_burst_intp_[81] v_inj_burst_intp_[82] v_inj_burst_intp_[83] v_inj_burst_intp_[84] v_inj_burst_intp_[85] v_inj_burst_intp_[86] v_inj_burst_intp_[87] v_iv_foc_[0] v_iv_foc_[1] v_iv_foc_[2] v_iv_foc_[3] cnt_t_iv_close_stc_succ_[0] cnt_t_iv_close_stc_succ_[1] cnt_t_iv_close_stc_succ_[2] cnt_t_iv_close_stc_succ_[3] cnt_t_iv_close_stc_fail_cont_[0] cnt_t_iv_close_stc_fail_cont_[1] cnt_t_iv_close_stc_fail_cont_[2] cnt_t_iv_close_stc_fail_cont_[3] cnt_t_iv_close_stc_fail_[0] cnt_t_iv_close_stc_fail_[1] cnt_t_iv_close_stc_fail_[2] cnt_t_iv_close_stc_fail_[3] cnt_t_iv_close_stc_0[0] cnt_t_iv_close_stc_0[1] cnt_t_iv_close_stc_0[2] cnt_t_iv_close_stc_0[3] cnt_t_iv_close_stc_0[4] cnt_t_iv_close_stc_0[5] cnt_t_iv_close_stc_0[6] cnt_t_iv_close_stc_0[7] cnt_t_iv_close_stc_0[8] cnt_t_iv_close_stc_0[9] cnt_t_iv_close_stc_0[10] cnt_t_iv_close_stc_0[11] cnt_t_iv_close_stc_0[12] cnt_t_iv_close_stc_1[0] cnt_t_iv_close_stc_1[1] cnt_t_iv_close_stc_1[2] cnt_t_iv_close_stc_1[3] cnt_t_iv_close_stc_1[4] cnt_t_iv_close_stc_1[5] cnt_t_iv_close_stc_1[6] cnt_t_iv_close_stc_1[7] cnt_t_iv_close_stc_1[8] cnt_t_iv_close_stc_1[9] cnt_t_iv_close_stc_1[10] cnt_t_iv_close_stc_1[11] cnt_t_iv_close_stc_1[12] cnt_t_iv_close_stc_2[0] cnt_t_iv_close_stc_2[1] cnt_t_iv_close_stc_2[2] cnt_t_iv_close_stc_2[3] cnt_t_iv_close_stc_2[4] cnt_t_iv_close_stc_2[5] cnt_t_iv_close_stc_2[6] cnt_t_iv_close_stc_2[7] cnt_t_iv_close_stc_2[8] cnt_t_iv_close_stc_2[9] cnt_t_iv_close_stc_2[10] cnt_t_iv_close_stc_2[11] cnt_t_iv_close_stc_2[12] cnt_t_iv_close_stc_3[0] cnt_t_iv_close_stc_3[1] cnt_t_iv_close_stc_3[2] cnt_t_iv_close_stc_3[3] cnt_t_iv_close_stc_3[4] cnt_t_iv_close_stc_3[5] cnt_t_iv_close_stc_3[6] cnt_t_iv_close_stc_3[7] cnt_t_iv_close_stc_3[8] cnt_t_iv_close_stc_3[9] cnt_t_iv_close_stc_3[10] cnt_t_iv_close_stc_3[11] cnt_t_iv_close_stc_3[12] t_iv_close_last_[0] t_iv_close_last_[1] t_iv_close_last_[2] t_iv_close_last_[3] t_iv_close_stat_mean_[0] t_iv_close_stat_mean_[1] t_iv_close_stat_mean_[2] t_iv_close_stat_mean_[3] pct_t_iv_close_stc_[0] pct_t_iv_close_stc_[1] pct_t_iv_close_stc_[2] pct_t_iv_close_stc_[3] idx_max_t_iv_close_stc_[0] idx_max_t_iv_close_stc_[1] idx_max_t_iv_close_stc_[2] idx_max_t_iv_close_stc_[3] var_t_iv_close_stc_[0] var_t_iv_close_stc_[1] var_t_iv_close_stc_[2] var_t_iv_close_stc_[3] cnt_v_delta_iv_foc_stc_succ_[0] cnt_v_delta_iv_foc_stc_succ_[1] cnt_v_delta_iv_foc_stc_succ_[2] cnt_v_delta_iv_foc_stc_succ_[3] cnt_v_delta_iv_foc_stc_fail_cont_[0] cnt_v_delta_iv_foc_stc_fail_cont_[1] cnt_v_delta_iv_foc_stc_fail_cont_[2] cnt_v_delta_iv_foc_stc_fail_cont_[3] cnt_v_delta_iv_foc_stc_fail_[0] cnt_v_delta_iv_foc_stc_fail_[1] cnt_v_delta_iv_foc_stc_fail_[2] cnt_v_delta_iv_foc_stc_fail_[3] cnt_v_delta_iv_foc_stc_0[0] cnt_v_delta_iv_foc_stc_0[1] cnt_v_delta_iv_foc_stc_0[2] cnt_v_delta_iv_foc_stc_0[3] cnt_v_delta_iv_foc_stc_0[4] cnt_v_delta_iv_foc_stc_0[5] cnt_v_delta_iv_foc_stc_0[6] cnt_v_delta_iv_foc_stc_0[7] cnt_v_delta_iv_foc_stc_0[8] cnt_v_delta_iv_foc_stc_0[9] cnt_v_delta_iv_foc_stc_0[10] cnt_v_delta_iv_foc_stc_0[11] cnt_v_delta_iv_foc_stc_0[12] cnt_v_delta_iv_foc_stc_0[13] cnt_v_delta_iv_foc_stc_0[14] cnt_v_delta_iv_foc_stc_0[15] cnt_v_delta_iv_foc_stc_0[16] cnt_v_delta_iv_foc_stc_0[17] cnt_v_delta_iv_foc_stc_0[18] cnt_v_delta_iv_foc_stc_0[19] cnt_v_delta_iv_foc_stc_0[20] cnt_v_delta_iv_foc_stc_0[21] cnt_v_delta_iv_foc_stc_1[0] cnt_v_delta_iv_foc_stc_1[1] cnt_v_delta_iv_foc_stc_1[2] cnt_v_delta_iv_foc_stc_1[3] cnt_v_delta_iv_foc_stc_1[4] cnt_v_delta_iv_foc_stc_1[5] cnt_v_delta_iv_foc_stc_1[6] cnt_v_delta_iv_foc_stc_1[7] cnt_v_delta_iv_foc_stc_1[8] cnt_v_delta_iv_foc_stc_1[9] cnt_v_delta_iv_foc_stc_1[10] cnt_v_delta_iv_foc_stc_1[11] cnt_v_delta_iv_foc_stc_1[12] cnt_v_delta_iv_foc_stc_1[13] cnt_v_delta_iv_foc_stc_1[14] cnt_v_delta_iv_foc_stc_1[15] cnt_v_delta_iv_foc_stc_1[16] cnt_v_delta_iv_foc_stc_1[17] cnt_v_delta_iv_foc_stc_1[18] cnt_v_delta_iv_foc_stc_1[19] cnt_v_delta_iv_foc_stc_1[20] cnt_v_delta_iv_foc_stc_1[21] cnt_v_delta_iv_foc_stc_2[0] cnt_v_delta_iv_foc_stc_2[1] cnt_v_delta_iv_foc_stc_2[2] cnt_v_delta_iv_foc_stc_2[3] cnt_v_delta_iv_foc_stc_2[4] cnt_v_delta_iv_foc_stc_2[5] cnt_v_delta_iv_foc_stc_2[6] cnt_v_delta_iv_foc_stc_2[7] cnt_v_delta_iv_foc_stc_2[8] cnt_v_delta_iv_foc_stc_2[9] cnt_v_delta_iv_foc_stc_2[10] cnt_v_delta_iv_foc_stc_2[11] cnt_v_delta_iv_foc_stc_2[12] cnt_v_delta_iv_foc_stc_2[13] cnt_v_delta_iv_foc_stc_2[14] cnt_v_delta_iv_foc_stc_2[15] cnt_v_delta_iv_foc_stc_2[16] cnt_v_delta_iv_foc_stc_2[17] cnt_v_delta_iv_foc_stc_2[18] cnt_v_delta_iv_foc_stc_2[19] cnt_v_delta_iv_foc_stc_2[20] cnt_v_delta_iv_foc_stc_2[21] cnt_v_delta_iv_foc_stc_3[0] cnt_v_delta_iv_foc_stc_3[1] cnt_v_delta_iv_foc_stc_3[2] cnt_v_delta_iv_foc_stc_3[3] cnt_v_delta_iv_foc_stc_3[4] cnt_v_delta_iv_foc_stc_3[5] cnt_v_delta_iv_foc_stc_3[6] cnt_v_delta_iv_foc_stc_3[7] cnt_v_delta_iv_foc_stc_3[8] cnt_v_delta_iv_foc_stc_3[9] cnt_v_delta_iv_foc_stc_3[10] cnt_v_delta_iv_foc_stc_3[11] cnt_v_delta_iv_foc_stc_3[12] cnt_v_delta_iv_foc_stc_3[13] cnt_v_delta_iv_foc_stc_3[14] cnt_v_delta_iv_foc_stc_3[15] cnt_v_delta_iv_foc_stc_3[16] cnt_v_delta_iv_foc_stc_3[17] cnt_v_delta_iv_foc_stc_3[18] cnt_v_delta_iv_foc_stc_3[19] cnt_v_delta_iv_foc_stc_3[20] cnt_v_delta_iv_foc_stc_3[21] v_delta_iv_foc_last_[0] v_delta_iv_foc_last_[1] v_delta_iv_foc_last_[2] v_delta_iv_foc_last_[3] v_delta_iv_foc_stat_mean_[0] v_delta_iv_foc_stat_mean_[1] v_delta_iv_foc_stat_mean_[2] v_delta_iv_foc_stat_mean_[3] pct_v_delta_iv_foc_stc_[0] pct_v_delta_iv_foc_stc_[1] pct_v_delta_iv_foc_stc_[2] pct_v_delta_iv_foc_stc_[3] idx_max_v_delta_iv_foc_stc_[0] idx_max_v_delta_iv_foc_stc_[1] idx_max_v_delta_iv_foc_stc_[2] idx_max_v_delta_iv_foc_stc_[3] var_v_delta_iv_foc_stc_[0] var_v_delta_iv_foc_stc_[1] var_v_delta_iv_foc_stc_[2] var_v_delta_iv_foc_stc_[3] ctr_v_delta_iv_foc_ctl_vld_[0] ctr_v_delta_iv_foc_ctl_vld_[1] ctr_v_delta_iv_foc_ctl_vld_[2] ctr_v_delta_iv_foc_ctl_vld_[3] /end OUT_MEASUREMENT
/end FUNCTION
/begin FUNCTION PECO_ENCO ""
 /begin DEF_CHARACTERISTIC c_egy_inj_sp_man_[0] c_egy_inj_sp_man_[1] c_egy_inj_sp_man_[2] c_egy_inj_sp_man_[3] c_egy_inj_sp_max c_egy_inj_sp_min c_fac_pwm_dcha_pwm_cha c_kr_pi_egy_ctl c_lim_pi_egy_ctl_max c_lim_pi_egy_ctl_min c_lim_pwm_cha_err_ctl_max c_lim_pwm_cha_err_ctl_min c_pwm_cha_ini_[0] c_pwm_cha_ini_[1] c_pwm_cha_ini_[2] c_pwm_cha_ini_[3] c_pwm_cha_max c_pwm_cha_min c_pwm_dcha_man_[0] c_pwm_dcha_man_[1] c_pwm_dcha_man_[2] c_pwm_dcha_man_[3] c_pwm_dcha_max c_pwm_dcha_min c_pwm_dcha_ofs lc_dcha_ctl_on lc_egy_ctl_on lc_egy_inj_sp_man id_fac_egy_inj_sp_cor__t_cha ldp_t_cha_id_fac_egy_inj_sp_cor ip_pwm_cha_pctl__egy ldp_egy_ip_pwm_cha_pctl ip_tn_pi_neg_egy_ctl__n ldpm_n_ip_tn_pi_egy_ctl ip_tn_pi_pos_egy_ctl__n ip_t_eoi_ofs_ctl__pwm ldp_pwm_ip_t_eoi_ofs_ctl c_fac_eoi_ofs_ctl_[0] c_fac_eoi_ofs_ctl_[1] c_fac_eoi_ofs_ctl_[2] c_fac_eoi_ofs_ctl_[3] lc_egy_sp_cor_on /end DEF_CHARACTERISTIC
 /begin OUT_MEASUREMENT pwm_cha_[0] pwm_cha_[1] pwm_cha_[2] pwm_cha_[3] pwm_dcha_[0] pwm_dcha_[1] pwm_dcha_[2] pwm_dcha_[3] t_eoi_ofs_ctl_[0] t_eoi_ofs_ctl_[1] t_eoi_ofs_ctl_[2] t_eoi_ofs_ctl_[3] sf_pi_ctl_egy_max egy_inj_sp_[0] egy_inj_sp_[1] egy_inj_sp_[2] egy_inj_sp_[3] lv_egy_ctl_act lv_egy_ctl_ini lv_dcha_ctl_on egy_step_sp_[0] egy_step_sp_[1] egy_step_sp_[2] egy_step_sp_[3] egy_inj_sp_pctl_[0] egy_inj_sp_pctl_[1] egy_inj_sp_pctl_[2] egy_inj_sp_pctl_[3] seg_nr_egy_ctl pwm_cha_ctl_[0] pwm_cha_ctl_[1] pwm_cha_ctl_[2] pwm_cha_ctl_[3] pwm_cha_err_ctl_[0] pwm_cha_err_ctl_[1] pwm_cha_err_ctl_[2] pwm_cha_err_ctl_[3] p_ctl_egy_[0] p_ctl_egy_[1] p_ctl_egy_[2] p_ctl_egy_[3] i_ctl_egy_[0] i_ctl_egy_[1] i_ctl_egy_[2] i_ctl_egy_[3] sf_pi_ctl_egy_min egy_inj_dif_[0] egy_inj_dif_[1] egy_inj_dif_[2] egy_inj_dif_[3] /end OUT_MEASUREMENT
/end FUNCTION
/end MODULE
/end PROJECT
