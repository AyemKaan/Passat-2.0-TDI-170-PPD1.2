ASAP2_VERSION 1 41
/begin PROJECT SN0 "SIMOS PPD"
/begin HEADER "_default_HeaderComment" PROJECT_NO PRJ_NUM /end HEADER
/begin MODULE _default_ModuleName "_default_ModuleLongIdentifier"
/begin MOD_COMMON "_default_ModCommonComment" DEPOSIT ABSOLUTE BYTE_ORDER MSB_FIRST ALIGNMENT_BYTE 1 ALIGNMENT_WORD 2 ALIGNMENT_LONG 4 ALIGNMENT_FLOAT32_IEEE 4 ALIGNMENT_FLOAT64_IEEE 8 /end MOD_COMMON
/begin MEASUREMENT n_sp_is_add_comp "additive idle speed setpoint correction for components" UWORD _CNV_A_R_LINEAR_____5_CM 1 0. 0. 6375. DISPLAY_IDENTIFIER N_SP_IS_ADD_COMP ECU_ADDRESS 0x7f9ce6 BYTE_ORDER MSB_LAST FORMAT "%4.0" /end MEASUREMENT
/begin MEASUREMENT lv_req_n_sp_is_min "Requirement of minimum idle speed setpoint " UBYTE _CNV_S_2_RANGE______11_CM 1 0. 0. 1. DISPLAY_IDENTIFIER LV_REQ_N_SP_IS_MIN ECU_ADDRESS 0x7fba24 /end MEASUREMENT
/begin MEASUREMENT n_sp_is_min "Minimum Idle Speed Required" UWORD _CNV_A_R_LINEAR_____5_CM 1 0. 0. 6375. DISPLAY_IDENTIFIER N_SP_IS_MIN ECU_ADDRESS 0x7f9ce8 BYTE_ORDER MSB_LAST FORMAT "%4.0" /end MEASUREMENT
/begin CHARACTERISTIC c_n_sp_is_add_acin "additive idle speed setpoint aircondition" VALUE 0x85cb42 _REC_VAL_20_u2 6375. _CNV_A_R_LINEAR_____5_CM 0. 6375. DISPLAY_IDENTIFIER C_N_SP_IS_ADD_ACIN FORMAT "%4.0" /end CHARACTERISTIC
/begin CHARACTERISTIC c_n_sp_is_min_heat "Minimum Idle Speed Required" VALUE 0x85cb46 _REC_VAL_20_u2 6375. _CNV_A_R_LINEAR_____5_CM 0. 6375. DISPLAY_IDENTIFIER C_N_SP_IS_MIN_HEAT FORMAT "%4.0" /end CHARACTERISTIC
/begin CHARACTERISTIC c_n_sp_is_min "maximum idle speed setpoint" VALUE 0x85cb44 _REC_VAL_20_u2 6375. _CNV_A_R_LINEAR_____5_CM 0. 6375. DISPLAY_IDENTIFIER C_N_SP_IS_MIN FORMAT "%4.0" /end CHARACTERISTIC
/begin MEASUREMENT lv_cs "" UBYTE _CNV_S_2_RANGE______11_CM 1 0. 0. 1. DISPLAY_IDENTIFIER LV_CS ECU_ADDRESS 0x7fce8f /end MEASUREMENT
/begin MEASUREMENT lv_get_cs "" UBYTE _CNV_S_2_RANGE______11_CM 1 0. 0. 1. DISPLAY_IDENTIFIER LV_GET_CS ECU_ADDRESS 0x7fce90 /end MEASUREMENT
/begin MEASUREMENT lv_cs_raw "" UBYTE _CNV_S_2_RANGE______11_CM 1 0. 0. 1. DISPLAY_IDENTIFIER LV_CS_RAW ECU_ADDRESS 0x7fce91 /end MEASUREMENT
/begin MEASUREMENT lv_cs_fil "" UBYTE _CNV_S_2_RANGE______11_CM 1 0. 0. 1. DISPLAY_IDENTIFIER LV_CS_FIL ECU_ADDRESS 0x7fce92 /end MEASUREMENT
/begin MEASUREMENT t_cs_fil "" UWORD _CNV_A_R_LINEAR_____56_CM 1 0. 0. 655.35 DISPLAY_IDENTIFIER T_CS_FIL ECU_ADDRESS 0x7fcde4 BYTE_ORDER MSB_LAST FORMAT "%5.2" /end MEASUREMENT
/begin MEASUREMENT sf_clu "" UBYTE _CNV_A_R_LINEAR_____0_CM 1 0. 0. 255. DISPLAY_IDENTIFIER SF_CLU ECU_ADDRESS 0x7fce93 FORMAT "%1.0" /end MEASUREMENT
/begin CHARACTERISTIC c_vs_cs "" VALUE 0x85ce2f _REC_VAL_20_u1 255. _CNV_A_R_LINEAR_____34_CM 0. 255. DISPLAY_IDENTIFIER C_VS_CS FORMAT "%3.0" /end CHARACTERISTIC
/begin CHARACTERISTIC c_t_max_cs_fil "" VALUE 0x85cc5c _REC_VAL_20_u2 655.35 _CNV_A_R_LINEAR_____56_CM 0. 655.35 DISPLAY_IDENTIFIER C_T_MAX_CS_FIL FORMAT "%5.2" /end CHARACTERISTIC
/begin CHARACTERISTIC lc_conf_cs "" VALUE 0x85ce5e _REC_VAL_20_u1 1. _CNV_A_R_LINEAR_____0_CM 0. 1. DISPLAY_IDENTIFIER LC_CONF_CS FORMAT "%1.0" /end CHARACTERISTIC
/begin CHARACTERISTIC c_cs_sub_diag "" VALUE 0x85c91e _REC_VAL_20_u1 1. _CNV_A_R_LINEAR_____0_CM 0. 1. DISPLAY_IDENTIFIER C_CS_SUB_DIAG FORMAT "%1.0" /end CHARACTERISTIC
/begin CHARACTERISTIC lc_bts_det_on "" VALUE 0x85ce58 _REC_VAL_20_u1 1. _CNV_A_R_LINEAR_____0_CM 0. 1. DISPLAY_IDENTIFIER LC_BTS_DET_ON FORMAT "%1.0" /end CHARACTERISTIC
/begin CHARACTERISTIC lc_bls_can "" VALUE 0x85ce4d _REC_VAL_20_u1 1. _CNV_A_R_LINEAR_____0_CM 0. 1. DISPLAY_IDENTIFIER LC_BLS_CAN FORMAT "%2.0" /end CHARACTERISTIC
/begin MEASUREMENT lv_bls "" UBYTE _CNV_S_2_RANGE______11_CM 1 0. 0. 1. DISPLAY_IDENTIFIER LV_BLS ECU_ADDRESS 0x7fbb55 /end MEASUREMENT
/begin MEASUREMENT lv_get_bls "" UBYTE _CNV_S_2_RANGE______11_CM 1 0. 0. 1. DISPLAY_IDENTIFIER LV_GET_BLS ECU_ADDRESS 0x7fbb58 /end MEASUREMENT
/begin MEASUREMENT lv_get_bts "" UBYTE _CNV_S_2_RANGE______11_CM 1 0. 0. 1. DISPLAY_IDENTIFIER LV_GET_BTS ECU_ADDRESS 0x7fbb57 /end MEASUREMENT
/begin MEASUREMENT lv_bts "" UBYTE _CNV_S_2_RANGE______11_CM 1 0. 0. 1. DISPLAY_IDENTIFIER LV_BTS ECU_ADDRESS 0x7fbb56 /end MEASUREMENT
/begin MEASUREMENT capa_inj_seq1_[0] "piezo injector capacity of injection sequence 1 (vector)" UBYTE _CNV_A_R_LINEAR_____120_CM 1 0. 0. 31.96875 DISPLAY_IDENTIFIER CAPA_INJ_SEQ1__0_ ECU_ADDRESS 0x7fbac7 FORMAT "%4.2" /end MEASUREMENT
/begin MEASUREMENT capa_inj_seq1_[1] "piezo injector capacity of injection sequence 1 (vector)" UBYTE _CNV_A_R_LINEAR_____120_CM 1 0. 0. 31.96875 DISPLAY_IDENTIFIER CAPA_INJ_SEQ1__1_ ECU_ADDRESS 0x7fbac8 FORMAT "%4.2" /end MEASUREMENT
/begin MEASUREMENT capa_inj_seq1_[2] "piezo injector capacity of injection sequence 1 (vector)" UBYTE _CNV_A_R_LINEAR_____120_CM 1 0. 0. 31.96875 DISPLAY_IDENTIFIER CAPA_INJ_SEQ1__2_ ECU_ADDRESS 0x7fbac9 FORMAT "%4.2" /end MEASUREMENT
/begin MEASUREMENT capa_inj_seq1_[3] "piezo injector capacity of injection sequence 1 (vector)" UBYTE _CNV_A_R_LINEAR_____120_CM 1 0. 0. 31.96875 DISPLAY_IDENTIFIER CAPA_INJ_SEQ1__3_ ECU_ADDRESS 0x7fbaca FORMAT "%4.2" /end MEASUREMENT
/begin MEASUREMENT capa_inj_seq1 "piezo injector capacity of injection sequence 1" UBYTE _CNV_A_R_LINEAR_____120_CM 1 0. 0. 31.96875 DISPLAY_IDENTIFIER CAPA_INJ_SEQ1 ECU_ADDRESS 0x7fbac6 FORMAT "%4.2" /end MEASUREMENT
/begin MEASUREMENT v_inj_beg_main1_[0] "piezo injector voltage of injection MAIN1 (vector)" UWORD _CNV_A_R_LINEAR_____121_CM 1 0. 0. 255. DISPLAY_IDENTIFIER V_INJ_BEG_MAIN1__0_ ECU_ADDRESS 0x7f9dfc BYTE_ORDER MSB_LAST FORMAT "%4.1" /end MEASUREMENT
/begin MEASUREMENT v_inj_beg_main1_[1] "piezo injector voltage of injection MAIN1 (vector)" UWORD _CNV_A_R_LINEAR_____121_CM 1 0. 0. 255. DISPLAY_IDENTIFIER V_INJ_BEG_MAIN1__1_ ECU_ADDRESS 0x7f9dfe BYTE_ORDER MSB_LAST FORMAT "%4.1" /end MEASUREMENT
/begin MEASUREMENT v_inj_beg_main1_[2] "piezo injector voltage of injection MAIN1 (vector)" UWORD _CNV_A_R_LINEAR_____121_CM 1 0. 0. 255. DISPLAY_IDENTIFIER V_INJ_BEG_MAIN1__2_ ECU_ADDRESS 0x7f9e00 BYTE_ORDER MSB_LAST FORMAT "%4.1" /end MEASUREMENT
/begin MEASUREMENT v_inj_beg_main1_[3] "piezo injector voltage of injection MAIN1 (vector)" UWORD _CNV_A_R_LINEAR_____121_CM 1 0. 0. 255. DISPLAY_IDENTIFIER V_INJ_BEG_MAIN1__3_ ECU_ADDRESS 0x7f9e02 BYTE_ORDER MSB_LAST FORMAT "%4.1" /end MEASUREMENT
/begin MEASUREMENT v_inj_beg_main1 "piezo injector voltage of injection MAIN1" UWORD _CNV_A_R_LINEAR_____121_CM 1 0. 0. 255. DISPLAY_IDENTIFIER V_INJ_BEG_MAIN1 ECU_ADDRESS 0x7f9df2 BYTE_ORDER MSB_LAST FORMAT "%4.1" /end MEASUREMENT
/begin MEASUREMENT v_inj_beg_prev1 "piezo injector voltage of injection PREV1" UWORD _CNV_A_R_LINEAR_____121_CM 1 0. 0. 255. DISPLAY_IDENTIFIER V_INJ_BEG_PREV1 ECU_ADDRESS 0x7f9df0 BYTE_ORDER MSB_LAST FORMAT "%4.1" /end MEASUREMENT
/begin MEASUREMENT q_inj_seq1_[0] "piezo injector charge of sequence 1 (vector)" UWORD _CNV_A_R_LINEAR_____122_CM 1 0. 0. 4095.9375 DISPLAY_IDENTIFIER Q_INJ_SEQ1__0_ ECU_ADDRESS 0x7f9f06 BYTE_ORDER MSB_LAST FORMAT "%5.1" /end MEASUREMENT
/begin MEASUREMENT q_inj_seq1_[1] "piezo injector charge of sequence 1 (vector)" UWORD _CNV_A_R_LINEAR_____122_CM 1 0. 0. 4095.9375 DISPLAY_IDENTIFIER Q_INJ_SEQ1__1_ ECU_ADDRESS 0x7f9f08 BYTE_ORDER MSB_LAST FORMAT "%5.1" /end MEASUREMENT
/begin MEASUREMENT q_inj_seq1_[2] "piezo injector charge of sequence 1 (vector)" UWORD _CNV_A_R_LINEAR_____122_CM 1 0. 0. 4095.9375 DISPLAY_IDENTIFIER Q_INJ_SEQ1__2_ ECU_ADDRESS 0x7f9f0a BYTE_ORDER MSB_LAST FORMAT "%5.1" /end MEASUREMENT
/begin MEASUREMENT q_inj_seq1_[3] "piezo injector charge of sequence 1 (vector)" UWORD _CNV_A_R_LINEAR_____122_CM 1 0. 0. 4095.9375 DISPLAY_IDENTIFIER Q_INJ_SEQ1__3_ ECU_ADDRESS 0x7f9f0c BYTE_ORDER MSB_LAST FORMAT "%5.1" /end MEASUREMENT
/begin MEASUREMENT q_inj_seq1 "piezo injector charge of sequence 1" UWORD _CNV_A_R_LINEAR_____122_CM 1 0. 0. 4095.9375 DISPLAY_IDENTIFIER Q_INJ_SEQ1 ECU_ADDRESS 0x7f9f04 BYTE_ORDER MSB_LAST FORMAT "%5.1" /end MEASUREMENT
/begin MEASUREMENT v_ofs_cha_cal_0 "piezo injector calibration offset value bank 0" UWORD _CNV_A_R_LINEAR_____123_CM 1 0. 0. 4.995117 DISPLAY_IDENTIFIER V_OFS_CHA_CAL_0 ECU_ADDRESS 0x7f9e0e BYTE_ORDER MSB_LAST FORMAT "%4.1" /end MEASUREMENT
/begin MEASUREMENT fac_slop_cha_cal_0 "piezo injector calibration slope factor bank 0" UWORD _CNV_A_R_LINEAR_____124_CM 1 0. 0. 1023. DISPLAY_IDENTIFIER FAC_SLOP_CHA_CAL_0 ECU_ADDRESS 0x7f9e10 BYTE_ORDER MSB_LAST FORMAT "%5.2" /end MEASUREMENT
/begin CHARACTERISTIC c_fac_cha_cal_0 "factor for calculation of q_inj calibration slope bank 0" VALUE 0x85c9be _REC_VAL_20_u2 320. _CNV_A_R_LINEAR_____125_CM 0. 320. DISPLAY_IDENTIFIER C_FAC_CHA_CAL_0 FORMAT "%5.2" /end CHARACTERISTIC
/begin CHARACTERISTIC c_fac_cha_cal_1 "factor for calculation of q_inj calibration slope bank 1" VALUE 0x85c9c0 _REC_VAL_20_u2 320. _CNV_A_R_LINEAR_____125_CM 0. 320. DISPLAY_IDENTIFIER C_FAC_CHA_CAL_1 FORMAT "%5.2" /end CHARACTERISTIC
/begin CHARACTERISTIC c_v_cha_cal1 "replace value for v_cha_cal1" VALUE 0x85cd6e _REC_VAL_20_u2 4.995117 _CNV_A_R_LINEAR_____123_CM 0. 4.995117 DISPLAY_IDENTIFIER C_V_CHA_CAL1 FORMAT "%5.3" /end CHARACTERISTIC
/begin CHARACTERISTIC c_v_cha_cal0 "replace value for v_cha_cal0" VALUE 0x85cd6c _REC_VAL_20_u2 4.995117 _CNV_A_R_LINEAR_____123_CM 0. 4.995117 DISPLAY_IDENTIFIER C_V_CHA_CAL0 FORMAT "%5.3" /end CHARACTERISTIC
/begin MEASUREMENT v_inj_beg_prev1_[0] "piezo injector voltage of injection PREV1 (vector)" UWORD _CNV_A_R_LINEAR_____121_CM 1 0. 0. 255. DISPLAY_IDENTIFIER V_INJ_BEG_PREV1__0_ ECU_ADDRESS 0x7f9df4 BYTE_ORDER MSB_LAST FORMAT "%4.1" /end MEASUREMENT
/begin MEASUREMENT v_inj_beg_prev1_[1] "piezo injector voltage of injection PREV1 (vector)" UWORD _CNV_A_R_LINEAR_____121_CM 1 0. 0. 255. DISPLAY_IDENTIFIER V_INJ_BEG_PREV1__1_ ECU_ADDRESS 0x7f9df6 BYTE_ORDER MSB_LAST FORMAT "%4.1" /end MEASUREMENT
/begin MEASUREMENT v_inj_beg_prev1_[2] "piezo injector voltage of injection PREV1 (vector)" UWORD _CNV_A_R_LINEAR_____121_CM 1 0. 0. 255. DISPLAY_IDENTIFIER V_INJ_BEG_PREV1__2_ ECU_ADDRESS 0x7f9df8 BYTE_ORDER MSB_LAST FORMAT "%4.1" /end MEASUREMENT
/begin MEASUREMENT v_inj_beg_prev1_[3] "piezo injector voltage of injection PREV1 (vector)" UWORD _CNV_A_R_LINEAR_____121_CM 1 0. 0. 255. DISPLAY_IDENTIFIER V_INJ_BEG_PREV1__3_ ECU_ADDRESS 0x7f9dfa BYTE_ORDER MSB_LAST FORMAT "%4.1" /end MEASUREMENT
/begin MEASUREMENT v_inj_burst_soi_[0] "voltage values of burst measurement triggered on SOI" UWORD _CNV_A_R_LINEAR_____126_CM 1 0. 0. 255. DISPLAY_IDENTIFIER V_INJ_BURST_SOI__0_ ECU_ADDRESS 0x7f9e14 BYTE_ORDER MSB_LAST FORMAT "%4.1" /end MEASUREMENT
/begin MEASUREMENT v_inj_burst_soi_[1] "voltage values of burst measurement triggered on SOI" UWORD _CNV_A_R_LINEAR_____126_CM 1 0. 0. 255. DISPLAY_IDENTIFIER V_INJ_BURST_SOI__1_ ECU_ADDRESS 0x7f9e16 BYTE_ORDER MSB_LAST FORMAT "%4.1" /end MEASUREMENT
/begin MEASUREMENT v_inj_burst_soi_[2] "voltage values of burst measurement triggered on SOI" UWORD _CNV_A_R_LINEAR_____126_CM 1 0. 0. 255. DISPLAY_IDENTIFIER V_INJ_BURST_SOI__2_ ECU_ADDRESS 0x7f9e18 BYTE_ORDER MSB_LAST FORMAT "%4.1" /end MEASUREMENT
/begin MEASUREMENT v_inj_burst_soi_[3] "voltage values of burst measurement triggered on SOI" UWORD _CNV_A_R_LINEAR_____126_CM 1 0. 0. 255. DISPLAY_IDENTIFIER V_INJ_BURST_SOI__3_ ECU_ADDRESS 0x7f9e1a BYTE_ORDER MSB_LAST FORMAT "%4.1" /end MEASUREMENT
/begin MEASUREMENT v_inj_burst_soi_[4] "voltage values of burst measurement triggered on SOI" UWORD _CNV_A_R_LINEAR_____126_CM 1 0. 0. 255. DISPLAY_IDENTIFIER V_INJ_BURST_SOI__4_ ECU_ADDRESS 0x7f9e1c BYTE_ORDER MSB_LAST FORMAT "%4.1" /end MEASUREMENT
/begin MEASUREMENT v_inj_burst_soi_[5] "voltage values of burst measurement triggered on SOI" UWORD _CNV_A_R_LINEAR_____126_CM 1 0. 0. 255. DISPLAY_IDENTIFIER V_INJ_BURST_SOI__5_ ECU_ADDRESS 0x7f9e1e BYTE_ORDER MSB_LAST FORMAT "%4.1" /end MEASUREMENT
/begin MEASUREMENT v_inj_burst_soi_[6] "voltage values of burst measurement triggered on SOI" UWORD _CNV_A_R_LINEAR_____126_CM 1 0. 0. 255. DISPLAY_IDENTIFIER V_INJ_BURST_SOI__6_ ECU_ADDRESS 0x7f9e20 BYTE_ORDER MSB_LAST FORMAT "%4.1" /end MEASUREMENT
/begin MEASUREMENT v_inj_burst_soi_[7] "voltage values of burst measurement triggered on SOI" UWORD _CNV_A_R_LINEAR_____126_CM 1 0. 0. 255. DISPLAY_IDENTIFIER V_INJ_BURST_SOI__7_ ECU_ADDRESS 0x7f9e22 BYTE_ORDER MSB_LAST FORMAT "%4.1" /end MEASUREMENT
/begin MEASUREMENT v_inj_burst_soi_[8] "voltage values of burst measurement triggered on SOI" UWORD _CNV_A_R_LINEAR_____126_CM 1 0. 0. 255. DISPLAY_IDENTIFIER V_INJ_BURST_SOI__8_ ECU_ADDRESS 0x7f9e24 BYTE_ORDER MSB_LAST FORMAT "%4.1" /end MEASUREMENT
/begin MEASUREMENT v_inj_burst_soi_[9] "voltage values of burst measurement triggered on SOI" UWORD _CNV_A_R_LINEAR_____126_CM 1 0. 0. 255. DISPLAY_IDENTIFIER V_INJ_BURST_SOI__9_ ECU_ADDRESS 0x7f9e26 BYTE_ORDER MSB_LAST FORMAT "%4.1" /end MEASUREMENT
/begin MEASUREMENT v_inj_burst_soi_[10] "voltage values of burst measurement triggered on SOI" UWORD _CNV_A_R_LINEAR_____126_CM 1 0. 0. 255. DISPLAY_IDENTIFIER V_INJ_BURST_SOI__10_ ECU_ADDRESS 0x7f9e28 BYTE_ORDER MSB_LAST FORMAT "%4.1" /end MEASUREMENT
/begin MEASUREMENT v_inj_burst_soi_[11] "voltage values of burst measurement triggered on SOI" UWORD _CNV_A_R_LINEAR_____126_CM 1 0. 0. 255. DISPLAY_IDENTIFIER V_INJ_BURST_SOI__11_ ECU_ADDRESS 0x7f9e2a BYTE_ORDER MSB_LAST FORMAT "%4.1" /end MEASUREMENT
/begin MEASUREMENT v_inj_burst_soi_[12] "voltage values of burst measurement triggered on SOI" UWORD _CNV_A_R_LINEAR_____126_CM 1 0. 0. 255. DISPLAY_IDENTIFIER V_INJ_BURST_SOI__12_ ECU_ADDRESS 0x7f9e2c BYTE_ORDER MSB_LAST FORMAT "%4.1" /end MEASUREMENT
/begin MEASUREMENT v_inj_burst_soi_[13] "voltage values of burst measurement triggered on SOI" UWORD _CNV_A_R_LINEAR_____126_CM 1 0. 0. 255. DISPLAY_IDENTIFIER V_INJ_BURST_SOI__13_ ECU_ADDRESS 0x7f9e2e BYTE_ORDER MSB_LAST FORMAT "%4.1" /end MEASUREMENT
/begin MEASUREMENT v_inj_burst_soi_[14] "voltage values of burst measurement triggered on SOI" UWORD _CNV_A_R_LINEAR_____126_CM 1 0. 0. 255. DISPLAY_IDENTIFIER V_INJ_BURST_SOI__14_ ECU_ADDRESS 0x7f9e30 BYTE_ORDER MSB_LAST FORMAT "%4.1" /end MEASUREMENT
/begin MEASUREMENT v_inj_burst_soi_[15] "voltage values of burst measurement triggered on SOI" UWORD _CNV_A_R_LINEAR_____126_CM 1 0. 0. 255. DISPLAY_IDENTIFIER V_INJ_BURST_SOI__15_ ECU_ADDRESS 0x7f9e32 BYTE_ORDER MSB_LAST FORMAT "%4.1" /end MEASUREMENT
/begin MEASUREMENT v_inj_burst_soi_[16] "voltage values of burst measurement triggered on SOI" UWORD _CNV_A_R_LINEAR_____126_CM 1 0. 0. 255. DISPLAY_IDENTIFIER V_INJ_BURST_SOI__16_ ECU_ADDRESS 0x7f9e34 BYTE_ORDER MSB_LAST FORMAT "%4.1" /end MEASUREMENT
/begin MEASUREMENT v_inj_burst_soi_[17] "voltage values of burst measurement triggered on SOI" UWORD _CNV_A_R_LINEAR_____126_CM 1 0. 0. 255. DISPLAY_IDENTIFIER V_INJ_BURST_SOI__17_ ECU_ADDRESS 0x7f9e36 BYTE_ORDER MSB_LAST FORMAT "%4.1" /end MEASUREMENT
/begin MEASUREMENT v_inj_burst_soi_[18] "voltage values of burst measurement triggered on SOI" UWORD _CNV_A_R_LINEAR_____126_CM 1 0. 0. 255. DISPLAY_IDENTIFIER V_INJ_BURST_SOI__18_ ECU_ADDRESS 0x7f9e38 BYTE_ORDER MSB_LAST FORMAT "%4.1" /end MEASUREMENT
/begin MEASUREMENT v_inj_burst_soi_[19] "voltage values of burst measurement triggered on SOI" UWORD _CNV_A_R_LINEAR_____126_CM 1 0. 0. 255. DISPLAY_IDENTIFIER V_INJ_BURST_SOI__19_ ECU_ADDRESS 0x7f9e3a BYTE_ORDER MSB_LAST FORMAT "%4.1" /end MEASUREMENT
/begin MEASUREMENT v_inj_burst_soi_[20] "voltage values of burst measurement triggered on SOI" UWORD _CNV_A_R_LINEAR_____126_CM 1 0. 0. 255. DISPLAY_IDENTIFIER V_INJ_BURST_SOI__20_ ECU_ADDRESS 0x7f9e3c BYTE_ORDER MSB_LAST FORMAT "%4.1" /end MEASUREMENT
/begin MEASUREMENT v_inj_burst_soi_[21] "voltage values of burst measurement triggered on SOI" UWORD _CNV_A_R_LINEAR_____126_CM 1 0. 0. 255. DISPLAY_IDENTIFIER V_INJ_BURST_SOI__21_ ECU_ADDRESS 0x7f9e3e BYTE_ORDER MSB_LAST FORMAT "%4.1" /end MEASUREMENT
/begin MEASUREMENT v_inj_burst_soi_[22] "voltage values of burst measurement triggered on SOI" UWORD _CNV_A_R_LINEAR_____126_CM 1 0. 0. 255. DISPLAY_IDENTIFIER V_INJ_BURST_SOI__22_ ECU_ADDRESS 0x7f9e40 BYTE_ORDER MSB_LAST FORMAT "%4.1" /end MEASUREMENT
/begin MEASUREMENT v_inj_burst_soi_[23] "voltage values of burst measurement triggered on SOI" UWORD _CNV_A_R_LINEAR_____126_CM 1 0. 0. 255. DISPLAY_IDENTIFIER V_INJ_BURST_SOI__23_ ECU_ADDRESS 0x7f9e42 BYTE_ORDER MSB_LAST FORMAT "%4.1" /end MEASUREMENT
/begin MEASUREMENT v_inj_burst_soi_[24] "voltage values of burst measurement triggered on SOI" UWORD _CNV_A_R_LINEAR_____126_CM 1 0. 0. 255. DISPLAY_IDENTIFIER V_INJ_BURST_SOI__24_ ECU_ADDRESS 0x7f9e44 BYTE_ORDER MSB_LAST FORMAT "%4.1" /end MEASUREMENT
/begin MEASUREMENT v_inj_burst_soi_[25] "voltage values of burst measurement triggered on SOI" UWORD _CNV_A_R_LINEAR_____126_CM 1 0. 0. 255. DISPLAY_IDENTIFIER V_INJ_BURST_SOI__25_ ECU_ADDRESS 0x7f9e46 BYTE_ORDER MSB_LAST FORMAT "%4.1" /end MEASUREMENT
/begin MEASUREMENT v_inj_burst_soi_[26] "voltage values of burst measurement triggered on SOI" UWORD _CNV_A_R_LINEAR_____126_CM 1 0. 0. 255. DISPLAY_IDENTIFIER V_INJ_BURST_SOI__26_ ECU_ADDRESS 0x7f9e48 BYTE_ORDER MSB_LAST FORMAT "%4.1" /end MEASUREMENT
/begin MEASUREMENT v_inj_burst_soi_[27] "voltage values of burst measurement triggered on SOI" UWORD _CNV_A_R_LINEAR_____126_CM 1 0. 0. 255. DISPLAY_IDENTIFIER V_INJ_BURST_SOI__27_ ECU_ADDRESS 0x7f9e4a BYTE_ORDER MSB_LAST FORMAT "%4.1" /end MEASUREMENT
/begin MEASUREMENT v_inj_burst_soi_[28] "voltage values of burst measurement triggered on SOI" UWORD _CNV_A_R_LINEAR_____126_CM 1 0. 0. 255. DISPLAY_IDENTIFIER V_INJ_BURST_SOI__28_ ECU_ADDRESS 0x7f9e4c BYTE_ORDER MSB_LAST FORMAT "%4.1" /end MEASUREMENT
/begin MEASUREMENT v_inj_burst_soi_[29] "voltage values of burst measurement triggered on SOI" UWORD _CNV_A_R_LINEAR_____126_CM 1 0. 0. 255. DISPLAY_IDENTIFIER V_INJ_BURST_SOI__29_ ECU_ADDRESS 0x7f9e4e BYTE_ORDER MSB_LAST FORMAT "%4.1" /end MEASUREMENT
/begin MEASUREMENT v_inj_burst_soi_[30] "voltage values of burst measurement triggered on SOI" UWORD _CNV_A_R_LINEAR_____126_CM 1 0. 0. 255. DISPLAY_IDENTIFIER V_INJ_BURST_SOI__30_ ECU_ADDRESS 0x7f9e50 BYTE_ORDER MSB_LAST FORMAT "%4.1" /end MEASUREMENT
/begin MEASUREMENT v_inj_burst_soi_[31] "voltage values of burst measurement triggered on SOI" UWORD _CNV_A_R_LINEAR_____126_CM 1 0. 0. 255. DISPLAY_IDENTIFIER V_INJ_BURST_SOI__31_ ECU_ADDRESS 0x7f9e52 BYTE_ORDER MSB_LAST FORMAT "%4.1" /end MEASUREMENT
/begin MEASUREMENT v_inj_burst_soi_[32] "voltage values of burst measurement triggered on SOI" UWORD _CNV_A_R_LINEAR_____126_CM 1 0. 0. 255. DISPLAY_IDENTIFIER V_INJ_BURST_SOI__32_ ECU_ADDRESS 0x7f9e54 BYTE_ORDER MSB_LAST FORMAT "%4.1" /end MEASUREMENT
/begin MEASUREMENT v_inj_burst_soi_[33] "voltage values of burst measurement triggered on SOI" UWORD _CNV_A_R_LINEAR_____126_CM 1 0. 0. 255. DISPLAY_IDENTIFIER V_INJ_BURST_SOI__33_ ECU_ADDRESS 0x7f9e56 BYTE_ORDER MSB_LAST FORMAT "%4.1" /end MEASUREMENT
/begin MEASUREMENT v_inj_burst_soi_[34] "voltage values of burst measurement triggered on SOI" UWORD _CNV_A_R_LINEAR_____126_CM 1 0. 0. 255. DISPLAY_IDENTIFIER V_INJ_BURST_SOI__34_ ECU_ADDRESS 0x7f9e58 BYTE_ORDER MSB_LAST FORMAT "%4.1" /end MEASUREMENT
/begin MEASUREMENT v_inj_burst_soi_[35] "voltage values of burst measurement triggered on SOI" UWORD _CNV_A_R_LINEAR_____126_CM 1 0. 0. 255. DISPLAY_IDENTIFIER V_INJ_BURST_SOI__35_ ECU_ADDRESS 0x7f9e5a BYTE_ORDER MSB_LAST FORMAT "%4.1" /end MEASUREMENT
/begin MEASUREMENT v_inj_burst_soi_[36] "voltage values of burst measurement triggered on SOI" UWORD _CNV_A_R_LINEAR_____126_CM 1 0. 0. 255. DISPLAY_IDENTIFIER V_INJ_BURST_SOI__36_ ECU_ADDRESS 0x7f9e5c BYTE_ORDER MSB_LAST FORMAT "%4.1" /end MEASUREMENT
/begin MEASUREMENT v_inj_burst_soi_[37] "voltage values of burst measurement triggered on SOI" UWORD _CNV_A_R_LINEAR_____126_CM 1 0. 0. 255. DISPLAY_IDENTIFIER V_INJ_BURST_SOI__37_ ECU_ADDRESS 0x7f9e5e BYTE_ORDER MSB_LAST FORMAT "%4.1" /end MEASUREMENT
/begin MEASUREMENT v_inj_burst_soi_[38] "voltage values of burst measurement triggered on SOI" UWORD _CNV_A_R_LINEAR_____126_CM 1 0. 0. 255. DISPLAY_IDENTIFIER V_INJ_BURST_SOI__38_ ECU_ADDRESS 0x7f9e60 BYTE_ORDER MSB_LAST FORMAT "%4.1" /end MEASUREMENT
/begin MEASUREMENT v_inj_burst_soi_[39] "voltage values of burst measurement triggered on SOI" UWORD _CNV_A_R_LINEAR_____126_CM 1 0. 0. 255. DISPLAY_IDENTIFIER V_INJ_BURST_SOI__39_ ECU_ADDRESS 0x7f9e62 BYTE_ORDER MSB_LAST FORMAT "%4.1" /end MEASUREMENT
/begin MEASUREMENT v_inj_burst_eoi_[0] "voltage values of burst measurement triggered on EOI" UWORD _CNV_A_R_LINEAR_____126_CM 1 0. 0. 255. DISPLAY_IDENTIFIER V_INJ_BURST_EOI__0_ ECU_ADDRESS 0x7f9e8c BYTE_ORDER MSB_LAST FORMAT "%4.1" /end MEASUREMENT
/begin MEASUREMENT v_inj_burst_eoi_[1] "voltage values of burst measurement triggered on EOI" UWORD _CNV_A_R_LINEAR_____126_CM 1 0. 0. 255. DISPLAY_IDENTIFIER V_INJ_BURST_EOI__1_ ECU_ADDRESS 0x7f9e8e BYTE_ORDER MSB_LAST FORMAT "%4.1" /end MEASUREMENT
/begin MEASUREMENT v_inj_burst_eoi_[2] "voltage values of burst measurement triggered on EOI" UWORD _CNV_A_R_LINEAR_____126_CM 1 0. 0. 255. DISPLAY_IDENTIFIER V_INJ_BURST_EOI__2_ ECU_ADDRESS 0x7f9e90 BYTE_ORDER MSB_LAST FORMAT "%4.1" /end MEASUREMENT
/begin MEASUREMENT v_inj_burst_eoi_[3] "voltage values of burst measurement triggered on EOI" UWORD _CNV_A_R_LINEAR_____126_CM 1 0. 0. 255. DISPLAY_IDENTIFIER V_INJ_BURST_EOI__3_ ECU_ADDRESS 0x7f9e92 BYTE_ORDER MSB_LAST FORMAT "%4.1" /end MEASUREMENT
/begin MEASUREMENT v_inj_burst_eoi_[4] "voltage values of burst measurement triggered on EOI" UWORD _CNV_A_R_LINEAR_____126_CM 1 0. 0. 255. DISPLAY_IDENTIFIER V_INJ_BURST_EOI__4_ ECU_ADDRESS 0x7f9e94 BYTE_ORDER MSB_LAST FORMAT "%4.1" /end MEASUREMENT
/begin MEASUREMENT v_inj_burst_eoi_[5] "voltage values of burst measurement triggered on EOI" UWORD _CNV_A_R_LINEAR_____126_CM 1 0. 0. 255. DISPLAY_IDENTIFIER V_INJ_BURST_EOI__5_ ECU_ADDRESS 0x7f9e96 BYTE_ORDER MSB_LAST FORMAT "%4.1" /end MEASUREMENT
/begin MEASUREMENT v_inj_burst_eoi_[6] "voltage values of burst measurement triggered on EOI" UWORD _CNV_A_R_LINEAR_____126_CM 1 0. 0. 255. DISPLAY_IDENTIFIER V_INJ_BURST_EOI__6_ ECU_ADDRESS 0x7f9e98 BYTE_ORDER MSB_LAST FORMAT "%4.1" /end MEASUREMENT
/begin MEASUREMENT v_inj_burst_eoi_[7] "voltage values of burst measurement triggered on EOI" UWORD _CNV_A_R_LINEAR_____126_CM 1 0. 0. 255. DISPLAY_IDENTIFIER V_INJ_BURST_EOI__7_ ECU_ADDRESS 0x7f9e9a BYTE_ORDER MSB_LAST FORMAT "%4.1" /end MEASUREMENT
/begin MEASUREMENT v_inj_burst_eoi_[8] "voltage values of burst measurement triggered on EOI" UWORD _CNV_A_R_LINEAR_____126_CM 1 0. 0. 255. DISPLAY_IDENTIFIER V_INJ_BURST_EOI__8_ ECU_ADDRESS 0x7f9e9c BYTE_ORDER MSB_LAST FORMAT "%4.1" /end MEASUREMENT
/begin MEASUREMENT v_inj_burst_eoi_[9] "voltage values of burst measurement triggered on EOI" UWORD _CNV_A_R_LINEAR_____126_CM 1 0. 0. 255. DISPLAY_IDENTIFIER V_INJ_BURST_EOI__9_ ECU_ADDRESS 0x7f9e9e BYTE_ORDER MSB_LAST FORMAT "%4.1" /end MEASUREMENT
/begin MEASUREMENT v_inj_burst_eoi_[10] "voltage values of burst measurement triggered on EOI" UWORD _CNV_A_R_LINEAR_____126_CM 1 0. 0. 255. DISPLAY_IDENTIFIER V_INJ_BURST_EOI__10_ ECU_ADDRESS 0x7f9ea0 BYTE_ORDER MSB_LAST FORMAT "%4.1" /end MEASUREMENT
/begin MEASUREMENT v_inj_burst_eoi_[11] "voltage values of burst measurement triggered on EOI" UWORD _CNV_A_R_LINEAR_____126_CM 1 0. 0. 255. DISPLAY_IDENTIFIER V_INJ_BURST_EOI__11_ ECU_ADDRESS 0x7f9ea2 BYTE_ORDER MSB_LAST FORMAT "%4.1" /end MEASUREMENT
/begin MEASUREMENT v_inj_burst_eoi_[12] "voltage values of burst measurement triggered on EOI" UWORD _CNV_A_R_LINEAR_____126_CM 1 0. 0. 255. DISPLAY_IDENTIFIER V_INJ_BURST_EOI__12_ ECU_ADDRESS 0x7f9ea4 BYTE_ORDER MSB_LAST FORMAT "%4.1" /end MEASUREMENT
/begin MEASUREMENT v_inj_burst_eoi_[13] "voltage values of burst measurement triggered on EOI" UWORD _CNV_A_R_LINEAR_____126_CM 1 0. 0. 255. DISPLAY_IDENTIFIER V_INJ_BURST_EOI__13_ ECU_ADDRESS 0x7f9ea6 BYTE_ORDER MSB_LAST FORMAT "%4.1" /end MEASUREMENT
/begin MEASUREMENT v_inj_burst_eoi_[14] "voltage values of burst measurement triggered on EOI" UWORD _CNV_A_R_LINEAR_____126_CM 1 0. 0. 255. DISPLAY_IDENTIFIER V_INJ_BURST_EOI__14_ ECU_ADDRESS 0x7f9ea8 BYTE_ORDER MSB_LAST FORMAT "%4.1" /end MEASUREMENT
/begin MEASUREMENT v_inj_burst_eoi_[15] "voltage values of burst measurement triggered on EOI" UWORD _CNV_A_R_LINEAR_____126_CM 1 0. 0. 255. DISPLAY_IDENTIFIER V_INJ_BURST_EOI__15_ ECU_ADDRESS 0x7f9eaa BYTE_ORDER MSB_LAST FORMAT "%4.1" /end MEASUREMENT
/begin MEASUREMENT v_inj_burst_eoi_[16] "voltage values of burst measurement triggered on EOI" UWORD _CNV_A_R_LINEAR_____126_CM 1 0. 0. 255. DISPLAY_IDENTIFIER V_INJ_BURST_EOI__16_ ECU_ADDRESS 0x7f9eac BYTE_ORDER MSB_LAST FORMAT "%4.1" /end MEASUREMENT
/begin MEASUREMENT v_inj_burst_eoi_[17] "voltage values of burst measurement triggered on EOI" UWORD _CNV_A_R_LINEAR_____126_CM 1 0. 0. 255. DISPLAY_IDENTIFIER V_INJ_BURST_EOI__17_ ECU_ADDRESS 0x7f9eae BYTE_ORDER MSB_LAST FORMAT "%4.1" /end MEASUREMENT
/begin MEASUREMENT v_inj_burst_eoi_[18] "voltage values of burst measurement triggered on EOI" UWORD _CNV_A_R_LINEAR_____126_CM 1 0. 0. 255. DISPLAY_IDENTIFIER V_INJ_BURST_EOI__18_ ECU_ADDRESS 0x7f9eb0 BYTE_ORDER MSB_LAST FORMAT "%4.1" /end MEASUREMENT
/begin MEASUREMENT v_inj_burst_eoi_[19] "voltage values of burst measurement triggered on EOI" UWORD _CNV_A_R_LINEAR_____126_CM 1 0. 0. 255. DISPLAY_IDENTIFIER V_INJ_BURST_EOI__19_ ECU_ADDRESS 0x7f9eb2 BYTE_ORDER MSB_LAST FORMAT "%4.1" /end MEASUREMENT
/begin MEASUREMENT v_inj_burst_eoi_[20] "voltage values of burst measurement triggered on EOI" UWORD _CNV_A_R_LINEAR_____126_CM 1 0. 0. 255. DISPLAY_IDENTIFIER V_INJ_BURST_EOI__20_ ECU_ADDRESS 0x7f9eb4 BYTE_ORDER MSB_LAST FORMAT "%4.1" /end MEASUREMENT
/begin MEASUREMENT v_inj_burst_eoi_[21] "voltage values of burst measurement triggered on EOI" UWORD _CNV_A_R_LINEAR_____126_CM 1 0. 0. 255. DISPLAY_IDENTIFIER V_INJ_BURST_EOI__21_ ECU_ADDRESS 0x7f9eb6 BYTE_ORDER MSB_LAST FORMAT "%4.1" /end MEASUREMENT
/begin MEASUREMENT v_inj_burst_eoi_[22] "voltage values of burst measurement triggered on EOI" UWORD _CNV_A_R_LINEAR_____126_CM 1 0. 0. 255. DISPLAY_IDENTIFIER V_INJ_BURST_EOI__22_ ECU_ADDRESS 0x7f9eb8 BYTE_ORDER MSB_LAST FORMAT "%4.1" /end MEASUREMENT
/begin MEASUREMENT v_inj_burst_eoi_[23] "voltage values of burst measurement triggered on EOI" UWORD _CNV_A_R_LINEAR_____126_CM 1 0. 0. 255. DISPLAY_IDENTIFIER V_INJ_BURST_EOI__23_ ECU_ADDRESS 0x7f9eba BYTE_ORDER MSB_LAST FORMAT "%4.1" /end MEASUREMENT
/begin MEASUREMENT v_inj_burst_eoi_[24] "voltage values of burst measurement triggered on EOI" UWORD _CNV_A_R_LINEAR_____126_CM 1 0. 0. 255. DISPLAY_IDENTIFIER V_INJ_BURST_EOI__24_ ECU_ADDRESS 0x7f9ebc BYTE_ORDER MSB_LAST FORMAT "%4.1" /end MEASUREMENT
/begin MEASUREMENT v_inj_burst_eoi_[25] "voltage values of burst measurement triggered on EOI" UWORD _CNV_A_R_LINEAR_____126_CM 1 0. 0. 255. DISPLAY_IDENTIFIER V_INJ_BURST_EOI__25_ ECU_ADDRESS 0x7f9ebe BYTE_ORDER MSB_LAST FORMAT "%4.1" /end MEASUREMENT
/begin MEASUREMENT v_inj_burst_eoi_[26] "voltage values of burst measurement triggered on EOI" UWORD _CNV_A_R_LINEAR_____126_CM 1 0. 0. 255. DISPLAY_IDENTIFIER V_INJ_BURST_EOI__26_ ECU_ADDRESS 0x7f9ec0 BYTE_ORDER MSB_LAST FORMAT "%4.1" /end MEASUREMENT
/begin MEASUREMENT v_inj_burst_eoi_[27] "voltage values of burst measurement triggered on EOI" UWORD _CNV_A_R_LINEAR_____126_CM 1 0. 0. 255. DISPLAY_IDENTIFIER V_INJ_BURST_EOI__27_ ECU_ADDRESS 0x7f9ec2 BYTE_ORDER MSB_LAST FORMAT "%4.1" /end MEASUREMENT
/begin MEASUREMENT v_inj_burst_eoi_[28] "voltage values of burst measurement triggered on EOI" UWORD _CNV_A_R_LINEAR_____126_CM 1 0. 0. 255. DISPLAY_IDENTIFIER V_INJ_BURST_EOI__28_ ECU_ADDRESS 0x7f9ec4 BYTE_ORDER MSB_LAST FORMAT "%4.1" /end MEASUREMENT
/begin MEASUREMENT v_inj_burst_eoi_[29] "voltage values of burst measurement triggered on EOI" UWORD _CNV_A_R_LINEAR_____126_CM 1 0. 0. 255. DISPLAY_IDENTIFIER V_INJ_BURST_EOI__29_ ECU_ADDRESS 0x7f9ec6 BYTE_ORDER MSB_LAST FORMAT "%4.1" /end MEASUREMENT
/begin MEASUREMENT v_inj_burst_eoi_[30] "voltage values of burst measurement triggered on EOI" UWORD _CNV_A_R_LINEAR_____126_CM 1 0. 0. 255. DISPLAY_IDENTIFIER V_INJ_BURST_EOI__30_ ECU_ADDRESS 0x7f9ec8 BYTE_ORDER MSB_LAST FORMAT "%4.1" /end MEASUREMENT
/begin MEASUREMENT v_inj_burst_eoi_[31] "voltage values of burst measurement triggered on EOI" UWORD _CNV_A_R_LINEAR_____126_CM 1 0. 0. 255. DISPLAY_IDENTIFIER V_INJ_BURST_EOI__31_ ECU_ADDRESS 0x7f9eca BYTE_ORDER MSB_LAST FORMAT "%4.1" /end MEASUREMENT
/begin MEASUREMENT v_inj_burst_eoi_[32] "voltage values of burst measurement triggered on EOI" UWORD _CNV_A_R_LINEAR_____126_CM 1 0. 0. 255. DISPLAY_IDENTIFIER V_INJ_BURST_EOI__32_ ECU_ADDRESS 0x7f9ecc BYTE_ORDER MSB_LAST FORMAT "%4.1" /end MEASUREMENT
/begin MEASUREMENT v_inj_burst_eoi_[33] "voltage values of burst measurement triggered on EOI" UWORD _CNV_A_R_LINEAR_____126_CM 1 0. 0. 255. DISPLAY_IDENTIFIER V_INJ_BURST_EOI__33_ ECU_ADDRESS 0x7f9ece BYTE_ORDER MSB_LAST FORMAT "%4.1" /end MEASUREMENT
/begin MEASUREMENT v_inj_burst_eoi_[34] "voltage values of burst measurement triggered on EOI" UWORD _CNV_A_R_LINEAR_____126_CM 1 0. 0. 255. DISPLAY_IDENTIFIER V_INJ_BURST_EOI__34_ ECU_ADDRESS 0x7f9ed0 BYTE_ORDER MSB_LAST FORMAT "%4.1" /end MEASUREMENT
/begin MEASUREMENT v_inj_burst_eoi_[35] "voltage values of burst measurement triggered on EOI" UWORD _CNV_A_R_LINEAR_____126_CM 1 0. 0. 255. DISPLAY_IDENTIFIER V_INJ_BURST_EOI__35_ ECU_ADDRESS 0x7f9ed2 BYTE_ORDER MSB_LAST FORMAT "%4.1" /end MEASUREMENT
/begin MEASUREMENT v_inj_burst_eoi_[36] "voltage values of burst measurement triggered on EOI" UWORD _CNV_A_R_LINEAR_____126_CM 1 0. 0. 255. DISPLAY_IDENTIFIER V_INJ_BURST_EOI__36_ ECU_ADDRESS 0x7f9ed4 BYTE_ORDER MSB_LAST FORMAT "%4.1" /end MEASUREMENT
/begin MEASUREMENT v_inj_burst_eoi_[37] "voltage values of burst measurement triggered on EOI" UWORD _CNV_A_R_LINEAR_____126_CM 1 0. 0. 255. DISPLAY_IDENTIFIER V_INJ_BURST_EOI__37_ ECU_ADDRESS 0x7f9ed6 BYTE_ORDER MSB_LAST FORMAT "%4.1" /end MEASUREMENT
/begin MEASUREMENT v_inj_burst_eoi_[38] "voltage values of burst measurement triggered on EOI" UWORD _CNV_A_R_LINEAR_____126_CM 1 0. 0. 255. DISPLAY_IDENTIFIER V_INJ_BURST_EOI__38_ ECU_ADDRESS 0x7f9ed8 BYTE_ORDER MSB_LAST FORMAT "%4.1" /end MEASUREMENT
/begin MEASUREMENT v_inj_burst_eoi_[39] "voltage values of burst measurement triggered on EOI" UWORD _CNV_A_R_LINEAR_____126_CM 1 0. 0. 255. DISPLAY_IDENTIFIER V_INJ_BURST_EOI__39_ ECU_ADDRESS 0x7f9eda BYTE_ORDER MSB_LAST FORMAT "%4.1" /end MEASUREMENT
/begin MEASUREMENT q_inj_burst_soi_[0] "charge values of burst measurement mode" UWORD _CNV_A_R_LINEAR_____122_CM 1 0. 0. 4095.9375 DISPLAY_IDENTIFIER Q_INJ_BURST_SOI__0_ ECU_ADDRESS 0x7f9e64 BYTE_ORDER MSB_LAST FORMAT "%5.1" /end MEASUREMENT
/begin MEASUREMENT q_inj_burst_soi_[1] "charge values of burst measurement mode" UWORD _CNV_A_R_LINEAR_____122_CM 1 0. 0. 4095.9375 DISPLAY_IDENTIFIER Q_INJ_BURST_SOI__1_ ECU_ADDRESS 0x7f9e66 BYTE_ORDER MSB_LAST FORMAT "%5.1" /end MEASUREMENT
/begin MEASUREMENT q_inj_burst_soi_[2] "charge values of burst measurement mode" UWORD _CNV_A_R_LINEAR_____122_CM 1 0. 0. 4095.9375 DISPLAY_IDENTIFIER Q_INJ_BURST_SOI__2_ ECU_ADDRESS 0x7f9e68 BYTE_ORDER MSB_LAST FORMAT "%5.1" /end MEASUREMENT
/begin MEASUREMENT q_inj_burst_soi_[3] "charge values of burst measurement mode" UWORD _CNV_A_R_LINEAR_____122_CM 1 0. 0. 4095.9375 DISPLAY_IDENTIFIER Q_INJ_BURST_SOI__3_ ECU_ADDRESS 0x7f9e6a BYTE_ORDER MSB_LAST FORMAT "%5.1" /end MEASUREMENT
/begin MEASUREMENT q_inj_burst_soi_[4] "charge values of burst measurement mode" UWORD _CNV_A_R_LINEAR_____122_CM 1 0. 0. 4095.9375 DISPLAY_IDENTIFIER Q_INJ_BURST_SOI__4_ ECU_ADDRESS 0x7f9e6c BYTE_ORDER MSB_LAST FORMAT "%5.1" /end MEASUREMENT
/begin MEASUREMENT q_inj_burst_soi_[5] "charge values of burst measurement mode" UWORD _CNV_A_R_LINEAR_____122_CM 1 0. 0. 4095.9375 DISPLAY_IDENTIFIER Q_INJ_BURST_SOI__5_ ECU_ADDRESS 0x7f9e6e BYTE_ORDER MSB_LAST FORMAT "%5.1" /end MEASUREMENT
/begin MEASUREMENT q_inj_burst_soi_[6] "charge values of burst measurement mode" UWORD _CNV_A_R_LINEAR_____122_CM 1 0. 0. 4095.9375 DISPLAY_IDENTIFIER Q_INJ_BURST_SOI__6_ ECU_ADDRESS 0x7f9e70 BYTE_ORDER MSB_LAST FORMAT "%5.1" /end MEASUREMENT
/begin MEASUREMENT q_inj_burst_soi_[7] "charge values of burst measurement mode" UWORD _CNV_A_R_LINEAR_____122_CM 1 0. 0. 4095.9375 DISPLAY_IDENTIFIER Q_INJ_BURST_SOI__7_ ECU_ADDRESS 0x7f9e72 BYTE_ORDER MSB_LAST FORMAT "%5.1" /end MEASUREMENT
/begin MEASUREMENT q_inj_burst_soi_[8] "charge values of burst measurement mode" UWORD _CNV_A_R_LINEAR_____122_CM 1 0. 0. 4095.9375 DISPLAY_IDENTIFIER Q_INJ_BURST_SOI__8_ ECU_ADDRESS 0x7f9e74 BYTE_ORDER MSB_LAST FORMAT "%5.1" /end MEASUREMENT
/begin MEASUREMENT q_inj_burst_soi_[9] "charge values of burst measurement mode" UWORD _CNV_A_R_LINEAR_____122_CM 1 0. 0. 4095.9375 DISPLAY_IDENTIFIER Q_INJ_BURST_SOI__9_ ECU_ADDRESS 0x7f9e76 BYTE_ORDER MSB_LAST FORMAT "%5.1" /end MEASUREMENT
/begin MEASUREMENT q_inj_burst_soi_[10] "charge values of burst measurement mode" UWORD _CNV_A_R_LINEAR_____122_CM 1 0. 0. 4095.9375 DISPLAY_IDENTIFIER Q_INJ_BURST_SOI__10_ ECU_ADDRESS 0x7f9e78 BYTE_ORDER MSB_LAST FORMAT "%5.1" /end MEASUREMENT
/begin MEASUREMENT q_inj_burst_soi_[11] "charge values of burst measurement mode" UWORD _CNV_A_R_LINEAR_____122_CM 1 0. 0. 4095.9375 DISPLAY_IDENTIFIER Q_INJ_BURST_SOI__11_ ECU_ADDRESS 0x7f9e7a BYTE_ORDER MSB_LAST FORMAT "%5.1" /end MEASUREMENT
/begin MEASUREMENT q_inj_burst_soi_[12] "charge values of burst measurement mode" UWORD _CNV_A_R_LINEAR_____122_CM 1 0. 0. 4095.9375 DISPLAY_IDENTIFIER Q_INJ_BURST_SOI__12_ ECU_ADDRESS 0x7f9e7c BYTE_ORDER MSB_LAST FORMAT "%5.1" /end MEASUREMENT
/begin MEASUREMENT q_inj_burst_soi_[13] "charge values of burst measurement mode" UWORD _CNV_A_R_LINEAR_____122_CM 1 0. 0. 4095.9375 DISPLAY_IDENTIFIER Q_INJ_BURST_SOI__13_ ECU_ADDRESS 0x7f9e7e BYTE_ORDER MSB_LAST FORMAT "%5.1" /end MEASUREMENT
/begin MEASUREMENT q_inj_burst_soi_[14] "charge values of burst measurement mode" UWORD _CNV_A_R_LINEAR_____122_CM 1 0. 0. 4095.9375 DISPLAY_IDENTIFIER Q_INJ_BURST_SOI__14_ ECU_ADDRESS 0x7f9e80 BYTE_ORDER MSB_LAST FORMAT "%5.1" /end MEASUREMENT
/begin MEASUREMENT q_inj_burst_soi_[15] "charge values of burst measurement mode" UWORD _CNV_A_R_LINEAR_____122_CM 1 0. 0. 4095.9375 DISPLAY_IDENTIFIER Q_INJ_BURST_SOI__15_ ECU_ADDRESS 0x7f9e82 BYTE_ORDER MSB_LAST FORMAT "%5.1" /end MEASUREMENT
/begin MEASUREMENT q_inj_burst_soi_[16] "charge values of burst measurement mode" UWORD _CNV_A_R_LINEAR_____122_CM 1 0. 0. 4095.9375 DISPLAY_IDENTIFIER Q_INJ_BURST_SOI__16_ ECU_ADDRESS 0x7f9e84 BYTE_ORDER MSB_LAST FORMAT "%5.1" /end MEASUREMENT
/begin MEASUREMENT q_inj_burst_soi_[17] "charge values of burst measurement mode" UWORD _CNV_A_R_LINEAR_____122_CM 1 0. 0. 4095.9375 DISPLAY_IDENTIFIER Q_INJ_BURST_SOI__17_ ECU_ADDRESS 0x7f9e86 BYTE_ORDER MSB_LAST FORMAT "%5.1" /end MEASUREMENT
/begin MEASUREMENT q_inj_burst_soi_[18] "charge values of burst measurement mode" UWORD _CNV_A_R_LINEAR_____122_CM 1 0. 0. 4095.9375 DISPLAY_IDENTIFIER Q_INJ_BURST_SOI__18_ ECU_ADDRESS 0x7f9e88 BYTE_ORDER MSB_LAST FORMAT "%5.1" /end MEASUREMENT
/begin MEASUREMENT q_inj_burst_soi_[19] "charge values of burst measurement mode" UWORD _CNV_A_R_LINEAR_____122_CM 1 0. 0. 4095.9375 DISPLAY_IDENTIFIER Q_INJ_BURST_SOI__19_ ECU_ADDRESS 0x7f9e8a BYTE_ORDER MSB_LAST FORMAT "%5.1" /end MEASUREMENT
/begin MEASUREMENT cur_inj_burst_[0] "current values of burst measurement mode" UWORD _CNV_A_R_A_127_CM 1 0. 0. 65535. DISPLAY_IDENTIFIER CUR_INJ_BURST__0_ ECU_ADDRESS 0x7f9e12 BYTE_ORDER MSB_LAST FORMAT "%5.1" /end MEASUREMENT
/begin MEASUREMENT lf_burst_prev1_act "burst measurement on PREV1 injection on/off (cylinder individual)" UWORD _CNV_A_R_LINEAR_____0_CM 1 0. 0. 65535. DISPLAY_IDENTIFIER LF_BURST_PREV1_ACT ECU_ADDRESS 0x7f9ede BYTE_ORDER MSB_LAST FORMAT "%5.0" /end MEASUREMENT
/begin MEASUREMENT lf_burst_main1_act "burst measurement on MAIN1 injection on/off (cylinder individual)" UWORD _CNV_A_R_LINEAR_____0_CM 1 0. 0. 65535. DISPLAY_IDENTIFIER LF_BURST_MAIN1_ACT ECU_ADDRESS 0x7f9edc BYTE_ORDER MSB_LAST FORMAT "%5.0" /end MEASUREMENT
/begin MEASUREMENT lf_burst_norm_act "burst measurement on test pulse on/off (cylinder individual)" UWORD _CNV_A_R_LINEAR_____0_CM 1 0. 0. 65535. DISPLAY_IDENTIFIER LF_BURST_NORM_ACT ECU_ADDRESS 0x7f9ee0 BYTE_ORDER MSB_LAST FORMAT "%5.0" /end MEASUREMENT
/begin CHARACTERISTIC c_fac_v_inj_burst_0 "factor for calculation of injector burst voltage (bank0)" VALUE 0x85ca24 _REC_VAL_20_u2 100. _CNV_A_R_LINEAR_____128_CM 0. 100. DISPLAY_IDENTIFIER C_FAC_V_INJ_BURST_0 FORMAT "%5.2" /end CHARACTERISTIC
/begin CHARACTERISTIC c_fac_cur_inj_burst_0 "factor for calculation of injector burst current (bank0)" VALUE 0x85c9ca _REC_VAL_20_u2 10. _CNV_A_R_LINEAR_____129_CM 0. 10. DISPLAY_IDENTIFIER C_FAC_CUR_INJ_BURST_0 FORMAT "%5.2" /end CHARACTERISTIC
/begin CHARACTERISTIC c_ofs_v_inj_burst_0 "offset value for calculation of injector burst voltage (bank0)" VALUE 0x85cb5a _REC_VAL_20_u2 5. _CNV_A_R_LINEAR_____130_CM 0. 5. DISPLAY_IDENTIFIER C_OFS_V_INJ_BURST_0 FORMAT "%5.2" /end CHARACTERISTIC
/begin CHARACTERISTIC c_ofs_cur_inj_burst_0 "offset value for calculation of injector burst current (bank0)" VALUE 0x85cb54 _REC_VAL_20_u2 5. _CNV_A_R_LINEAR_____130_CM 0. 5. DISPLAY_IDENTIFIER C_OFS_CUR_INJ_BURST_0 FORMAT "%5.2" /end CHARACTERISTIC
/begin CHARACTERISTIC c_fac_v_inj_burst_1 "factor for calculation of injector burst voltage (bank1)" VALUE 0x85ca26 _REC_VAL_20_u2 100. _CNV_A_R_LINEAR_____128_CM 0. 100. DISPLAY_IDENTIFIER C_FAC_V_INJ_BURST_1 FORMAT "%5.2" /end CHARACTERISTIC
/begin CHARACTERISTIC c_fac_cur_inj_burst_1 "factor for calculation of injector burst current (bank1)" VALUE 0x85c9cc _REC_VAL_20_u2 10. _CNV_A_R_LINEAR_____129_CM 0. 10. DISPLAY_IDENTIFIER C_FAC_CUR_INJ_BURST_1 FORMAT "%5.2" /end CHARACTERISTIC
/begin CHARACTERISTIC c_ofs_v_inj_burst_1 "offset value for calculation of injector burst voltage (bank1)" VALUE 0x85cb5c _REC_VAL_20_u2 5. _CNV_A_R_LINEAR_____130_CM 0. 5. DISPLAY_IDENTIFIER C_OFS_V_INJ_BURST_1 FORMAT "%5.2" /end CHARACTERISTIC
/begin CHARACTERISTIC c_ofs_cur_inj_burst_1 "offset value for calculation of injector burst current (bank1)" VALUE 0x85cb56 _REC_VAL_20_u2 5. _CNV_A_R_LINEAR_____130_CM 0. 5. DISPLAY_IDENTIFIER C_OFS_CUR_INJ_BURST_1 FORMAT "%5.2" /end CHARACTERISTIC
/begin CHARACTERISTIC c_burst_inj_mode "Mode 0: measure on norm. pulse, Mode 1: measure on main pulse" VALUE 0x85c8d1 _REC_VAL_20_u1 15. _CNV_A_R_LINEAR_____0_CM 0. 15. DISPLAY_IDENTIFIER C_BURST_INJ_MODE FORMAT "%1.0" /end CHARACTERISTIC
/begin CHARACTERISTIC c_burst_mes_soi_eoi "select: burst measurement on SOI or EOI" VALUE 0x85c8d2 _REC_VAL_20_u1 15. _CNV_A_R_LINEAR_____0_CM 0. 15. DISPLAY_IDENTIFIER C_BURST_MES_SOI_EOI FORMAT "%1.0" /end CHARACTERISTIC
/begin MEASUREMENT lf_pps_mes_vld " PPS measurement valid flag word (cylinder individual)" UWORD _CNV_A_R_LINEAR_____0_CM 1 0. 0. 65535. DISPLAY_IDENTIFIER LF_PPS_MES_VLD ECU_ADDRESS 0x7f9ee2 BYTE_ORDER MSB_LAST FORMAT "%5.0" /end MEASUREMENT
/begin MEASUREMENT v_cha_cal0 " calibration charge measurement" UWORD _CNV_A_R_LINEAR_____123_CM 1 0. 0. 4.995117 DISPLAY_IDENTIFIER V_CHA_CAL0 ECU_ADDRESS 0x7f9f18 BYTE_ORDER MSB_LAST FORMAT "%5.3" /end MEASUREMENT
/begin MEASUREMENT v_cha_cal1 " calibration charge measurement" UWORD _CNV_A_R_LINEAR_____123_CM 1 0. 0. 4.995117 DISPLAY_IDENTIFIER V_CHA_CAL1 ECU_ADDRESS 0x7f9f1a BYTE_ORDER MSB_LAST FORMAT "%5.3" /end MEASUREMENT
/begin MEASUREMENT q_inj_beg_prev1_[0] "piezo injector charge of pulse PREV1 (vector)" UWORD _CNV_A_R_LINEAR_____122_CM 1 0. 0. 4095.9375 DISPLAY_IDENTIFIER Q_INJ_BEG_PREV1__0_ ECU_ADDRESS 0x7f9e06 BYTE_ORDER MSB_LAST FORMAT "%5.1" /end MEASUREMENT
/begin MEASUREMENT q_inj_beg_prev1_[1] "piezo injector charge of pulse PREV1 (vector)" UWORD _CNV_A_R_LINEAR_____122_CM 1 0. 0. 4095.9375 DISPLAY_IDENTIFIER Q_INJ_BEG_PREV1__1_ ECU_ADDRESS 0x7f9e08 BYTE_ORDER MSB_LAST FORMAT "%5.1" /end MEASUREMENT
/begin MEASUREMENT q_inj_beg_prev1_[2] "piezo injector charge of pulse PREV1 (vector)" UWORD _CNV_A_R_LINEAR_____122_CM 1 0. 0. 4095.9375 DISPLAY_IDENTIFIER Q_INJ_BEG_PREV1__2_ ECU_ADDRESS 0x7f9e0a BYTE_ORDER MSB_LAST FORMAT "%5.1" /end MEASUREMENT
/begin MEASUREMENT q_inj_beg_prev1_[3] "piezo injector charge of pulse PREV1 (vector)" UWORD _CNV_A_R_LINEAR_____122_CM 1 0. 0. 4095.9375 DISPLAY_IDENTIFIER Q_INJ_BEG_PREV1__3_ ECU_ADDRESS 0x7f9e0c BYTE_ORDER MSB_LAST FORMAT "%5.1" /end MEASUREMENT
/begin MEASUREMENT q_inj_beg_prev1 "piezo injector charge of pulse PREV1" UWORD _CNV_A_R_LINEAR_____122_CM 1 0. 0. 4095.9375 DISPLAY_IDENTIFIER Q_INJ_BEG_PREV1 ECU_ADDRESS 0x7f9e04 BYTE_ORDER MSB_LAST FORMAT "%5.1" /end MEASUREMENT
/begin MEASUREMENT q_inj_beg_main1_[0] "piezo injector charge of pulse MAIN1 (vector)" UWORD _CNV_A_R_LINEAR_____122_CM 1 0. 0. 4095.9375 DISPLAY_IDENTIFIER Q_INJ_BEG_MAIN1__0_ ECU_ADDRESS 0x7f9f10 BYTE_ORDER MSB_LAST FORMAT "%5.1" /end MEASUREMENT
/begin MEASUREMENT q_inj_beg_main1_[1] "piezo injector charge of pulse MAIN1 (vector)" UWORD _CNV_A_R_LINEAR_____122_CM 1 0. 0. 4095.9375 DISPLAY_IDENTIFIER Q_INJ_BEG_MAIN1__1_ ECU_ADDRESS 0x7f9f12 BYTE_ORDER MSB_LAST FORMAT "%5.1" /end MEASUREMENT
/begin MEASUREMENT q_inj_beg_main1_[2] "piezo injector charge of pulse MAIN1 (vector)" UWORD _CNV_A_R_LINEAR_____122_CM 1 0. 0. 4095.9375 DISPLAY_IDENTIFIER Q_INJ_BEG_MAIN1__2_ ECU_ADDRESS 0x7f9f14 BYTE_ORDER MSB_LAST FORMAT "%5.1" /end MEASUREMENT
/begin MEASUREMENT q_inj_beg_main1_[3] "piezo injector charge of pulse MAIN1 (vector)" UWORD _CNV_A_R_LINEAR_____122_CM 1 0. 0. 4095.9375 DISPLAY_IDENTIFIER Q_INJ_BEG_MAIN1__3_ ECU_ADDRESS 0x7f9f16 BYTE_ORDER MSB_LAST FORMAT "%5.1" /end MEASUREMENT
/begin MEASUREMENT q_inj_beg_main1 "piezo injector charge of pulse MAIN1" UWORD _CNV_A_R_LINEAR_____122_CM 1 0. 0. 4095.9375 DISPLAY_IDENTIFIER Q_INJ_BEG_MAIN1 ECU_ADDRESS 0x7f9f0e BYTE_ORDER MSB_LAST FORMAT "%5.1" /end MEASUREMENT
/begin MEASUREMENT v_inj_frze_prev1_[0] "piezo injector voltage of pulse FRZE PREV1 (vector)" UWORD _CNV_A_R_LINEAR_____121_CM 1 0. 0. 255. DISPLAY_IDENTIFIER V_INJ_FRZE_PREV1__0_ ECU_ADDRESS 0x7f9ee4 BYTE_ORDER MSB_LAST FORMAT "%4.1" /end MEASUREMENT
/begin MEASUREMENT v_inj_frze_prev1_[1] "piezo injector voltage of pulse FRZE PREV1 (vector)" UWORD _CNV_A_R_LINEAR_____121_CM 1 0. 0. 255. DISPLAY_IDENTIFIER V_INJ_FRZE_PREV1__1_ ECU_ADDRESS 0x7f9ee6 BYTE_ORDER MSB_LAST FORMAT "%4.1" /end MEASUREMENT
/begin MEASUREMENT v_inj_frze_prev1_[2] "piezo injector voltage of pulse FRZE PREV1 (vector)" UWORD _CNV_A_R_LINEAR_____121_CM 1 0. 0. 255. DISPLAY_IDENTIFIER V_INJ_FRZE_PREV1__2_ ECU_ADDRESS 0x7f9ee8 BYTE_ORDER MSB_LAST FORMAT "%4.1" /end MEASUREMENT
/begin MEASUREMENT v_inj_frze_prev1_[3] "piezo injector voltage of pulse FRZE PREV1 (vector)" UWORD _CNV_A_R_LINEAR_____121_CM 1 0. 0. 255. DISPLAY_IDENTIFIER V_INJ_FRZE_PREV1__3_ ECU_ADDRESS 0x7f9eea BYTE_ORDER MSB_LAST FORMAT "%4.1" /end MEASUREMENT
/begin MEASUREMENT v_inj_toze_prev1_[0] "piezo injector voltage of pulse TOZE PREV1 (vector)" UWORD _CNV_A_R_LINEAR_____121_CM 1 0. 0. 255. DISPLAY_IDENTIFIER V_INJ_TOZE_PREV1__0_ ECU_ADDRESS 0x7f9eec BYTE_ORDER MSB_LAST FORMAT "%4.1" /end MEASUREMENT
/begin MEASUREMENT v_inj_toze_prev1_[1] "piezo injector voltage of pulse TOZE PREV1 (vector)" UWORD _CNV_A_R_LINEAR_____121_CM 1 0. 0. 255. DISPLAY_IDENTIFIER V_INJ_TOZE_PREV1__1_ ECU_ADDRESS 0x7f9eee BYTE_ORDER MSB_LAST FORMAT "%4.1" /end MEASUREMENT
/begin MEASUREMENT v_inj_toze_prev1_[2] "piezo injector voltage of pulse TOZE PREV1 (vector)" UWORD _CNV_A_R_LINEAR_____121_CM 1 0. 0. 255. DISPLAY_IDENTIFIER V_INJ_TOZE_PREV1__2_ ECU_ADDRESS 0x7f9ef0 BYTE_ORDER MSB_LAST FORMAT "%4.1" /end MEASUREMENT
/begin MEASUREMENT v_inj_toze_prev1_[3] "piezo injector voltage of pulse TOZE PREV1 (vector)" UWORD _CNV_A_R_LINEAR_____121_CM 1 0. 0. 255. DISPLAY_IDENTIFIER V_INJ_TOZE_PREV1__3_ ECU_ADDRESS 0x7f9ef2 BYTE_ORDER MSB_LAST FORMAT "%4.1" /end MEASUREMENT
/begin MEASUREMENT v_inj_frze_main1_[0] "piezo injector voltage of pulse FRZE MAIN1 (vector)" UWORD _CNV_A_R_LINEAR_____121_CM 1 0. 0. 255. DISPLAY_IDENTIFIER V_INJ_FRZE_MAIN1__0_ ECU_ADDRESS 0x7f9ef4 BYTE_ORDER MSB_LAST FORMAT "%4.1" /end MEASUREMENT
/begin MEASUREMENT v_inj_frze_main1_[1] "piezo injector voltage of pulse FRZE MAIN1 (vector)" UWORD _CNV_A_R_LINEAR_____121_CM 1 0. 0. 255. DISPLAY_IDENTIFIER V_INJ_FRZE_MAIN1__1_ ECU_ADDRESS 0x7f9ef6 BYTE_ORDER MSB_LAST FORMAT "%4.1" /end MEASUREMENT
/begin MEASUREMENT v_inj_frze_main1_[2] "piezo injector voltage of pulse FRZE MAIN1 (vector)" UWORD _CNV_A_R_LINEAR_____121_CM 1 0. 0. 255. DISPLAY_IDENTIFIER V_INJ_FRZE_MAIN1__2_ ECU_ADDRESS 0x7f9ef8 BYTE_ORDER MSB_LAST FORMAT "%4.1" /end MEASUREMENT
/begin MEASUREMENT v_inj_frze_main1_[3] "piezo injector voltage of pulse FRZE MAIN1 (vector)" UWORD _CNV_A_R_LINEAR_____121_CM 1 0. 0. 255. DISPLAY_IDENTIFIER V_INJ_FRZE_MAIN1__3_ ECU_ADDRESS 0x7f9efa BYTE_ORDER MSB_LAST FORMAT "%4.1" /end MEASUREMENT
/begin MEASUREMENT v_inj_toze_main1_[0] "piezo injector voltage of pulse TOZE MAIN1 (vector)" UWORD _CNV_A_R_LINEAR_____121_CM 1 0. 0. 255. DISPLAY_IDENTIFIER V_INJ_TOZE_MAIN1__0_ ECU_ADDRESS 0x7f9efc BYTE_ORDER MSB_LAST FORMAT "%4.1" /end MEASUREMENT
/begin MEASUREMENT v_inj_toze_main1_[1] "piezo injector voltage of pulse TOZE MAIN1 (vector)" UWORD _CNV_A_R_LINEAR_____121_CM 1 0. 0. 255. DISPLAY_IDENTIFIER V_INJ_TOZE_MAIN1__1_ ECU_ADDRESS 0x7f9efe BYTE_ORDER MSB_LAST FORMAT "%4.1" /end MEASUREMENT
/begin MEASUREMENT v_inj_toze_main1_[2] "piezo injector voltage of pulse TOZE MAIN1 (vector)" UWORD _CNV_A_R_LINEAR_____121_CM 1 0. 0. 255. DISPLAY_IDENTIFIER V_INJ_TOZE_MAIN1__2_ ECU_ADDRESS 0x7f9f00 BYTE_ORDER MSB_LAST FORMAT "%4.1" /end MEASUREMENT
/begin MEASUREMENT v_inj_toze_main1_[3] "piezo injector voltage of pulse TOZE MAIN1 (vector)" UWORD _CNV_A_R_LINEAR_____121_CM 1 0. 0. 255. DISPLAY_IDENTIFIER V_INJ_TOZE_MAIN1__3_ ECU_ADDRESS 0x7f9f02 BYTE_ORDER MSB_LAST FORMAT "%4.1" /end MEASUREMENT
/begin MEASUREMENT tco_sub "TCO substitute value" UBYTE _CNV_A_R_LINEAR_____18_CM 1 0. -50. 205. DISPLAY_IDENTIFIER TCO_SUB ECU_ADDRESS 0x7fbb61 FORMAT "%3.0" /end MEASUREMENT
/begin MEASUREMENT tco_1_sub "TCO substitute values for individual sensor j" UBYTE _CNV_A_R_LINEAR_____18_CM 1 0. -50. 205. DISPLAY_IDENTIFIER TCO_1_SUB ECU_ADDRESS 0x7fbb62 FORMAT "%3.0" /end MEASUREMENT
/begin MEASUREMENT tco_2_sub "TCO substitute values for individual sensor j" UBYTE _CNV_A_R_LINEAR_____18_CM 1 0. -50. 205. DISPLAY_IDENTIFIER TCO_2_SUB ECU_ADDRESS 0x7fbb63 FORMAT "%3.0" /end MEASUREMENT
/begin CHARACTERISTIC c_tco_sub_ini "universal initialization value for TCO_SUB as long as no measured substitutional value is available" VALUE 0x85ccc4 _REC_VAL_20_u1 255. _CNV_A_R_LINEAR_____18_CM -50. 205. DISPLAY_IDENTIFIER C_TCO_SUB_INI FORMAT "%3.0" /end CHARACTERISTIC
/begin CHARACTERISTIC c_tco_sub_grd "gradient for the calculation of the coolant temperature substitutional value" VALUE 0x85ccc2 _REC_VAL_20_u2 255.99609375 _CNV_A_R_LINEAR_____135_CM 0. 255.99609375 DISPLAY_IDENTIFIER C_TCO_SUB_GRD /end CHARACTERISTIC
/begin CHARACTERISTIC c_tco_sub_tol "maximal limit for the coolant temperature substitutional value" VALUE 0x85ccc5 _REC_VAL_20_u1 255. _CNV_A_R_LINEAR_____18_CM -50. 205. DISPLAY_IDENTIFIER C_TCO_SUB_TOL FORMAT "%3.0" /end CHARACTERISTIC
/begin CHARACTERISTIC c_tco_2_dif_sub "offset between TCO and TCO_2_SUB" VALUE 0x85cca1 _REC_VAL_20_u1 255. _CNV_A_R_LINEAR_____18_CM -50. 205. DISPLAY_IDENTIFIER C_TCO_2_DIF_SUB FORMAT "%3.0" /end CHARACTERISTIC
/begin MEASUREMENT tco "coolant temperature TCO" UBYTE _CNV_A_R_LINEAR_____18_CM 1 0. -50. 205. DISPLAY_IDENTIFIER TCO ECU_ADDRESS 0x7fce76 FORMAT "%3.0" /end MEASUREMENT
/begin MEASUREMENT tco_mes "measured coolant temperature TCO_MES" UBYTE _CNV_A_R_LINEAR_____18_CM 1 0. -50. 205. DISPLAY_IDENTIFIER TCO_MES ECU_ADDRESS 0x7fce77 FORMAT "%3.0" /end MEASUREMENT
/begin MEASUREMENT tco_st "coolant temperature at start TCO_ST" UBYTE _CNV_A_R_LINEAR_____18_CM 1 0. -50. 205. DISPLAY_IDENTIFIER TCO_ST ECU_ADDRESS 0x7fce78 FORMAT "%3.0" /end MEASUREMENT
/begin MEASUREMENT tco_1 "coolant temperature of individual sensor j: j = ( 1 .. NC_TCO_NR )" UBYTE _CNV_A_R_LINEAR_____18_CM 1 0. -50. 205. DISPLAY_IDENTIFIER TCO_1 ECU_ADDRESS 0x7fce79 FORMAT "%3.0" /end MEASUREMENT
/begin MEASUREMENT tco_2 "coolant temperature of individual sensor j: j = ( 1 .. NC_TCO_NR )" UBYTE _CNV_A_R_LINEAR_____18_CM 1 0. -50. 205. DISPLAY_IDENTIFIER TCO_2 ECU_ADDRESS 0x7fce7b FORMAT "%3.0" /end MEASUREMENT
/begin MEASUREMENT tco_1_mes "measured coolant temperature of individual sensor j: j = ( 1 .. NC_TCO_NR )" UBYTE _CNV_A_R_LINEAR_____18_CM 1 0. -50. 205. DISPLAY_IDENTIFIER TCO_1_MES ECU_ADDRESS 0x7fce7a FORMAT "%3.0" /end MEASUREMENT
/begin MEASUREMENT tco_2_mes "measured coolant temperature of individual sensor j: j = ( 1 .. NC_TCO_NR )" UBYTE _CNV_A_R_LINEAR_____18_CM 1 0. -50. 205. DISPLAY_IDENTIFIER TCO_2_MES ECU_ADDRESS 0x7fce7c FORMAT "%3.0" /end MEASUREMENT
/begin MEASUREMENT v_tco_1 "voltage of individual coolant temperature sensor j: j = ( 1 .. NC_TCO_NR )" UWORD _CNV_A_R_LINEAR_____28_CM 1 0. 0. 4.9951171875 DISPLAY_IDENTIFIER V_TCO_1 ECU_ADDRESS 0x7fcdaa BYTE_ORDER MSB_LAST FORMAT "%4.3" /end MEASUREMENT
/begin MEASUREMENT v_tco_2 "voltage of individual coolant temperature sensor j: j = ( 1 .. NC_TCO_NR )" UWORD _CNV_A_R_LINEAR_____28_CM 1 0. 0. 4.9951171875 DISPLAY_IDENTIFIER V_TCO_2 ECU_ADDRESS 0x7fcdac BYTE_ORDER MSB_LAST FORMAT "%4.3" /end MEASUREMENT
/begin CHARACTERISTIC c_tco_grd_max "temperature gradient maximum" VALUE 0x85ccac _REC_VAL_20_u1 255. _CNV_A_R_LINEAR_____17_CM 0. 255. DISPLAY_IDENTIFIER C_TCO_GRD_MAX FORMAT "%3.0" /end CHARACTERISTIC
/begin CHARACTERISTIC ip_tco_1_mes__v_tco_1 "SYS_VAR: TCO_1_MES sensor map" CURVE 0x85b116 _REC_CUR_20_u1_u2 255. _CNV_A_R_LINEAR_____18_CM -50. 205. DISPLAY_IDENTIFIER IP_TCO_1_MES__V_TCO_1 FORMAT "%3.0"
 /begin AXIS_DESCR COM_AXIS tco_1_mes _CNV_A_R_LINEAR_____28_CM 16 0. 4.9951171875 FORMAT "%4.3" AXIS_PTS_REF ldpm_v_tco__ip_tco_1_mes /end AXIS_DESCR
/end CHARACTERISTIC
/begin CHARACTERISTIC ip_tco_2_mes__v_tco_2 "SYS_VAR: TCO_2_MES sensor map" CURVE 0x85b126 _REC_CUR_20_u1_u2 255. _CNV_A_R_LINEAR_____18_CM -50. 205. DISPLAY_IDENTIFIER IP_TCO_2_MES__V_TCO_2 FORMAT "%3.0"
 /begin AXIS_DESCR COM_AXIS tco_2_mes _CNV_A_R_LINEAR_____28_CM 16 0. 4.9951171875 FORMAT "%4.3" AXIS_PTS_REF ldpm_v_tco__ip_tco_2_mes /end AXIS_DESCR
/end CHARACTERISTIC
/begin AXIS_PTS ldpm_v_tco__ip_tco_1_mes "TCO_1_MES sensor map" 0x843eee tco_1_mes _REC_AXS_20_u2 4.9951171875 _CNV_A_R_LINEAR_____28_CM 16 0. 4.9951171875 FORMAT "%4.3" /end AXIS_PTS
/begin AXIS_PTS ldpm_v_tco__ip_tco_2_mes "TCO_2_MES sensor map" 0x843f10 tco_2_mes _REC_AXS_20_u2 4.9951171875 _CNV_A_R_LINEAR_____28_CM 16 0. 4.9951171875 FORMAT "%4.3" /end AXIS_PTS
/begin MEASUREMENT ducy_acp_pwm "air conditioning pressure" UBYTE _CNV_A_R_LINEAR_____39_CM 1 0. 0. 100. DISPLAY_IDENTIFIER DUCY_ACP_PWM ECU_ADDRESS 0x7fbfed FORMAT "%4.0" /end MEASUREMENT
/begin MEASUREMENT acp "air conditioning pressure" UBYTE _CNV_A_R_LINEAR_____209_CM 1 0. 0. 3100. DISPLAY_IDENTIFIER ACP ECU_ADDRESS 0x7fbc04 FORMAT "%4.0" /end MEASUREMENT
/begin MEASUREMENT acp_mes "measured air conditioning pressure" UBYTE _CNV_A_R_LINEAR_____209_CM 1 0. 0. 3100. DISPLAY_IDENTIFIER ACP_MES ECU_ADDRESS 0x7fbc05 FORMAT "%4.0" /end MEASUREMENT
/begin MEASUREMENT tq_loss_acc_inp "Torque Loss of ACC (only CAN)" SWORD _CNV_A_R_LINEAR_____52_CM 1 0. -1024. 1023.96875 DISPLAY_IDENTIFIER TQ_LOSS_ACC_INP ECU_ADDRESS 0x7fa314 BYTE_ORDER MSB_LAST FORMAT "%6.2" /end MEASUREMENT
/begin MEASUREMENT lv_acp_orng "ACP pressure invalid" UBYTE _CNV_S_2_RANGE______11_CM 1 0. 0. 1. DISPLAY_IDENTIFIER LV_ACP_ORNG ECU_ADDRESS 0x7fbc06 /end MEASUREMENT
/begin MEASUREMENT lv_tq_loss_acc_inp_orng "Torque Loss invalid" UBYTE _CNV_S_2_RANGE______11_CM 1 0. 0. 1. DISPLAY_IDENTIFIER LV_TQ_LOSS_ACC_INP_ORNG ECU_ADDRESS 0x7fbc07 /end MEASUREMENT
/begin CHARACTERISTIC lc_tq_acc_can_use "Switch to activate the demand of Torque of the air conditioning ECU" VALUE 0x85ceb8 _REC_VAL_20_u1 1. _CNV_A_R_LINEAR_____0_CM 0. 1. DISPLAY_IDENTIFIER LC_TQ_ACC_CAN_USE FORMAT "%1.0" /end CHARACTERISTIC
/begin CHARACTERISTIC ip_acp_mes__ducy_acp_pwm "SYS_VAR: ACP_MES sensor map" CURVE 0x8508bc _REC_CUR_20_u1_u1 3100. _CNV_A_R_LINEAR_____209_CM 0. 3100. DISPLAY_IDENTIFIER IP_ACP_MES__DUCY_ACP_PWM FORMAT "%4.0"
 /begin AXIS_DESCR COM_AXIS ducy_acp_pwm _CNV_A_R_LINEAR_____210_CM 16 0. 100. FORMAT "%3.1" AXIS_PTS_REF ldp_ducy_acp_pwm_ip_acp_mes /end AXIS_DESCR
/end CHARACTERISTIC
/begin AXIS_PTS ldp_ducy_acp_pwm_ip_acp_mes "ACP_MES sensor map" 0x841633 ducy_acp_pwm _REC_AXS_20_u1 100. _CNV_A_R_LINEAR_____210_CM 16 0. 100. FORMAT "%3.1" /end AXIS_PTS
/begin CHARACTERISTIC c_acp_sub_diag "Subsitute value for air conditioning pressure " VALUE 0x85c868 _REC_VAL_20_u1 3100. _CNV_A_R_LINEAR_____209_CM 0. 3100. DISPLAY_IDENTIFIER C_ACP_SUB_DIAG FORMAT "%4.0" /end CHARACTERISTIC
/begin MEASUREMENT lv_can_ena "" UBYTE _CNV_S_2_RANGE__0___85_CM 1 0. 0. 1. DISPLAY_IDENTIFIER LV_CAN_ENA ECU_ADDRESS 0x7fbc79 BIT_MASK 0x1 /end MEASUREMENT
/begin MEASUREMENT lv_slp_idc_update "" UBYTE _CNV_S_2_RANGE__0___85_CM 1 0. 0. 1. DISPLAY_IDENTIFIER LV_SLP_IDC_UPDATE ECU_ADDRESS 0x7fbd69 BIT_MASK 0x1 /end MEASUREMENT
/begin MEASUREMENT lv_stop_rcv_can_msg "" UBYTE _CNV_S_2_RANGE__0___85_CM 1 0. 0. 1. DISPLAY_IDENTIFIER LV_STOP_RCV_CAN_MSG ECU_ADDRESS 0x7fbd24 BIT_MASK 0x1 /end MEASUREMENT
/begin MEASUREMENT lv_dlc_tcs1_nvld "" UBYTE _CNV_S_2_RANGE__0___85_CM 1 0. 0. 1. DISPLAY_IDENTIFIER LV_DLC_TCS1_NVLD ECU_ADDRESS 0x7fb6ef BIT_MASK 0x1 /end MEASUREMENT
/begin MEASUREMENT lv_dlc_tcs2_nvld "" UBYTE _CNV_S_2_RANGE__0___85_CM 1 0. 0. 1. DISPLAY_IDENTIFIER LV_DLC_TCS2_NVLD ECU_ADDRESS 0x7fb6f0 BIT_MASK 0x1 /end MEASUREMENT
/begin MEASUREMENT lv_dlc_tcs3_nvld "" UBYTE _CNV_S_2_RANGE__0___85_CM 1 0. 0. 1. DISPLAY_IDENTIFIER LV_DLC_TCS3_NVLD ECU_ADDRESS 0x7fb6f1 BIT_MASK 0x1 /end MEASUREMENT
/begin MEASUREMENT lv_dlc_tcs8_nvld "" UBYTE _CNV_S_2_RANGE__0___85_CM 1 0. 0. 1. DISPLAY_IDENTIFIER LV_DLC_TCS8_NVLD ECU_ADDRESS 0x7fb6f2 BIT_MASK 0x1 /end MEASUREMENT
/begin MEASUREMENT lv_dlc_tcu1_nvld "" UBYTE _CNV_S_2_RANGE__0___85_CM 1 0. 0. 1. DISPLAY_IDENTIFIER LV_DLC_TCU1_NVLD ECU_ADDRESS 0x7fb6f3 BIT_MASK 0x1 /end MEASUREMENT
/begin MEASUREMENT lv_dlc_tcu2_nvld "" UBYTE _CNV_S_2_RANGE__0___85_CM 1 0. 0. 1. DISPLAY_IDENTIFIER LV_DLC_TCU2_NVLD ECU_ADDRESS 0x7fb6f4 BIT_MASK 0x1 /end MEASUREMENT
/begin MEASUREMENT lv_dlc_airb1_nvld "" UBYTE _CNV_S_2_RANGE__0___85_CM 1 0. 0. 1. DISPLAY_IDENTIFIER LV_DLC_AIRB1_NVLD ECU_ADDRESS 0x7fb6f5 BIT_MASK 0x1 /end MEASUREMENT
/begin MEASUREMENT lv_dlc_imor_nvld "" UBYTE _CNV_S_2_RANGE__0___85_CM 1 0. 0. 1. DISPLAY_IDENTIFIER LV_DLC_IMOR_NVLD ECU_ADDRESS 0x7fb6f6 BIT_MASK 0x1 /end MEASUREMENT
/begin MEASUREMENT lv_dlc_icl1_nvld "" UBYTE _CNV_S_2_RANGE__0___85_CM 1 0. 0. 1. DISPLAY_IDENTIFIER LV_DLC_ICL1_NVLD ECU_ADDRESS 0x7fb6f7 BIT_MASK 0x1 /end MEASUREMENT
/begin MEASUREMENT lv_dlc_ac1_nvld "" UBYTE _CNV_S_2_RANGE__0___85_CM 1 0. 0. 1. DISPLAY_IDENTIFIER LV_DLC_AC1_NVLD ECU_ADDRESS 0x7fb6f8 BIT_MASK 0x1 /end MEASUREMENT
/begin MEASUREMENT lv_dlc_bem_nvld "" UBYTE _CNV_S_2_RANGE__0___85_CM 1 0. 0. 1. DISPLAY_IDENTIFIER LV_DLC_BEM_NVLD ECU_ADDRESS 0x7fb6f9 BIT_MASK 0x1 /end MEASUREMENT
/begin MEASUREMENT lv_dlc_cru_nvld "" UBYTE _CNV_S_2_RANGE__0___85_CM 1 0. 0. 1. DISPLAY_IDENTIFIER LV_DLC_CRU_NVLD ECU_ADDRESS 0x7fb6fa BIT_MASK 0x1 /end MEASUREMENT
/begin MEASUREMENT lv_dlc_eilu1_nvld "" UBYTE _CNV_S_2_RANGE__0___85_CM 1 0. 0. 1. DISPLAY_IDENTIFIER LV_DLC_EILU1_NVLD ECU_ADDRESS 0x7fb6fb BIT_MASK 0x1 /end MEASUREMENT
/begin MEASUREMENT lv_dlc_vecu1_nvld "" UBYTE _CNV_S_2_RANGE__0___85_CM 1 0. 0. 1. DISPLAY_IDENTIFIER LV_DLC_VECU1_NVLD ECU_ADDRESS 0x7fb6fc BIT_MASK 0x1 /end MEASUREMENT
/begin MEASUREMENT lv_dlc_if_cft_1_nvld "" UBYTE _CNV_S_2_RANGE__0___85_CM 1 0. 0. 1. DISPLAY_IDENTIFIER LV_DLC_IF_CFT_1_NVLD ECU_ADDRESS 0x7fb6fd BIT_MASK 0x1 /end MEASUREMENT
/begin MEASUREMENT lv_dlc_icl2_nvld "" UBYTE _CNV_S_2_RANGE__0___85_CM 1 0. 0. 1. DISPLAY_IDENTIFIER LV_DLC_ICL2_NVLD ECU_ADDRESS 0x7fb6fe BIT_MASK 0x1 /end MEASUREMENT
/begin MEASUREMENT lv_dlc_icl3_nvld "" UBYTE _CNV_S_2_RANGE__0___85_CM 1 0. 0. 1. DISPLAY_IDENTIFIER LV_DLC_ICL3_NVLD ECU_ADDRESS 0x7fb6ff BIT_MASK 0x1 /end MEASUREMENT
/begin MEASUREMENT lv_dlc_tog1_nvld "" UBYTE _CNV_S_2_RANGE__0___85_CM 1 0. 0. 1. DISPLAY_IDENTIFIER LV_DLC_TOG1_NVLD ECU_ADDRESS 0x7fb700 BIT_MASK 0x1 /end MEASUREMENT
/begin MEASUREMENT lv_dlc_whl_nvld "" UBYTE _CNV_S_2_RANGE__0___85_CM 1 0. 0. 1. DISPLAY_IDENTIFIER LV_DLC_WHL_NVLD ECU_ADDRESS 0x7fb6ea BIT_MASK 0x1 /end MEASUREMENT
/begin MEASUREMENT lv_dlc_sys_info_nvld "" UBYTE _CNV_S_2_RANGE__0___85_CM 1 0. 0. 1. DISPLAY_IDENTIFIER LV_DLC_SYS_INFO_NVLD ECU_ADDRESS 0x7fb6eb BIT_MASK 0x1 /end MEASUREMENT
/begin MEASUREMENT lv_slp_idc "" UBYTE _CNV_S_2_RANGE__0___85_CM 1 0. 0. 1. DISPLAY_IDENTIFIER LV_SLP_IDC ECU_ADDRESS 0x7fb6e8 BIT_MASK 0x1 /end MEASUREMENT
/begin MEASUREMENT lv_dlc_nom_sys_nvld "" UBYTE _CNV_S_2_RANGE__0___85_CM 1 0. 0. 1. DISPLAY_IDENTIFIER LV_DLC_NOM_SYS_NVLD ECU_ADDRESS 0x7fb6ec BIT_MASK 0x1 /end MEASUREMENT
/begin MEASUREMENT lv_pste_can_vld "Logische Variable fuer erkannte gueltige Botschaft Lenkwinkel 1" UBYTE _CNV_S_2_RANGE__0___85_CM 1 0. 0. 1. DISPLAY_IDENTIFIER LV_PSTE_CAN_VLD ECU_ADDRESS 0x7fb772 BIT_MASK 0x1 /end MEASUREMENT
/begin MEASUREMENT ang_pste "Steering angle" UWORD _CNV_A_R_LINEAR_____231_CM 1 0. 0. 1433.55625 DISPLAY_IDENTIFIER ANG_PSTE ECU_ADDRESS 0x7f9800 BYTE_ORDER MSB_LAST FORMAT "%10.5" /end MEASUREMENT
/begin MEASUREMENT ang_grd_pste "Steering angle gradient" UWORD _CNV_A_R_LINEAR_____232_CM 1 0. 0. 1433.55625 DISPLAY_IDENTIFIER ANG_GRD_PSTE ECU_ADDRESS 0x7f9802 BYTE_ORDER MSB_LAST FORMAT "%10.5" /end MEASUREMENT
/begin MEASUREMENT lv_n_sp_is_bem_1 "Logische Variable fuer aktive Forderung der Erhoehung der Leerlaufsolldrehzahl Stufe 1" UBYTE _CNV_S_2_RANGE__0___85_CM 1 0. 0. 1. DISPLAY_IDENTIFIER LV_N_SP_IS_BEM_1 ECU_ADDRESS 0x7fb76f BIT_MASK 0x1 /end MEASUREMENT
/begin MEASUREMENT lv_n_sp_is_bem_2 "Logische Variable fuer aktive Forderung der Erhoehung der Leerlaufsolldrehzahl Stufe 2" UBYTE _CNV_S_2_RANGE__0___85_CM 1 0. 0. 1. DISPLAY_IDENTIFIER LV_N_SP_IS_BEM_2 ECU_ADDRESS 0x7fb770 BIT_MASK 0x1 /end MEASUREMENT
/begin MEASUREMENT lv_bem_can_vld "Logische Variable fuer erkannte gueltige Botschaft BEM" UBYTE _CNV_S_2_RANGE__0___85_CM 1 0. 0. 1. DISPLAY_IDENTIFIER LV_BEM_CAN_VLD ECU_ADDRESS 0x7fb771 BIT_MASK 0x1 /end MEASUREMENT
/begin MEASUREMENT gen_load_tq_can "Generatotorlastmoment (FFH = Fehler)" UBYTE _CNV_A_R_LINEAR_____233_CM 1 0. 0. 127.5 DISPLAY_IDENTIFIER GEN_LOAD_TQ_CAN ECU_ADDRESS 0x7fb76d FORMAT "%5.1" /end MEASUREMENT
/begin MEASUREMENT gen_load_pow_can "Leistungsaufnahme Generator (FFH = Fehler)" UBYTE _CNV_A_R_LINEAR_____234_CM 1 0. 0. 12750. DISPLAY_IDENTIFIER GEN_LOAD_POW_CAN ECU_ADDRESS 0x7fb76e FORMAT "%5.0" /end MEASUREMENT
/begin MEASUREMENT lv_if_cft_1_can_vld "Logische Variable fuer erkannte gueltige Botschaft interface-comfort" UBYTE _CNV_S_2_RANGE__0___85_CM 1 0. 0. 1. DISPLAY_IDENTIFIER LV_IF_CFT_1_CAN_VLD ECU_ADDRESS 0x7fb798 BIT_MASK 0x1 /end MEASUREMENT
/begin MEASUREMENT lv_stb_ack "Bit Sleep Acknowledge" UBYTE _CNV_S_2_RANGE__0___85_CM 1 0. 0. 1. DISPLAY_IDENTIFIER LV_STB_ACK ECU_ADDRESS 0x7fb799 BIT_MASK 0x1 /end MEASUREMENT
/begin MEASUREMENT lv_trl_msg_ood_can "Bit Anhaengerbotschaft veraltet" UBYTE _CNV_S_2_RANGE__0___85_CM 1 0. 0. 1. DISPLAY_IDENTIFIER LV_TRL_MSG_OOD_CAN ECU_ADDRESS 0x7fb79a BIT_MASK 0x1 /end MEASUREMENT
/begin MEASUREMENT lv_lamp_re_msg_ood_can "Bit Licht-Hinten-Botschaft veraltet" UBYTE _CNV_S_2_RANGE__0___85_CM 1 0. 0. 1. DISPLAY_IDENTIFIER LV_LAMP_RE_MSG_OOD_CAN ECU_ADDRESS 0x7fb79b BIT_MASK 0x1 /end MEASUREMENT
/begin MEASUREMENT lv_brake_lamp_le_err_can "Bit Bremslicht links defekt" UBYTE _CNV_S_2_RANGE__0___85_CM 1 0. 0. 1. DISPLAY_IDENTIFIER LV_BRAKE_LAMP_LE_ERR_CAN ECU_ADDRESS 0x7fb79c BIT_MASK 0x1 /end MEASUREMENT
/begin MEASUREMENT lv_brake_lamp_ri_err_can "Bit Bremslicht rechts defekt" UBYTE _CNV_S_2_RANGE__0___85_CM 1 0. 0. 1. DISPLAY_IDENTIFIER LV_BRAKE_LAMP_RI_ERR_CAN ECU_ADDRESS 0x7fb79d BIT_MASK 0x1 /end MEASUREMENT
/begin MEASUREMENT lv_brake_lamp_mid_err_can "Bit Bremslicht mitte defekt" UBYTE _CNV_S_2_RANGE__0___85_CM 1 0. 0. 1. DISPLAY_IDENTIFIER LV_BRAKE_LAMP_MID_ERR_CAN ECU_ADDRESS 0x7fb79e BIT_MASK 0x1 /end MEASUREMENT
/begin MEASUREMENT lv_trl_act_can "Bit Anhaenger erkannt" UBYTE _CNV_S_2_RANGE__0___85_CM 1 0. 0. 1. DISPLAY_IDENTIFIER LV_TRL_ACT_CAN ECU_ADDRESS 0x7fb79f BIT_MASK 0x1 /end MEASUREMENT
/begin MEASUREMENT lv_brake_lamp_trl_err_can "Bit Bremslicht Anhaenger defekt" UBYTE _CNV_S_2_RANGE__0___85_CM 1 0. 0. 1. DISPLAY_IDENTIFIER LV_BRAKE_LAMP_TRL_ERR_CAN ECU_ADDRESS 0x7fb7a0 BIT_MASK 0x1 /end MEASUREMENT
/begin MEASUREMENT lv_state_ctl_dece_err_can "Bit ECD ILM unplausibel" UBYTE _CNV_S_2_RANGE__0___85_CM 1 0. 0. 1. DISPLAY_IDENTIFIER LV_STATE_CTL_DECE_ERR_CAN ECU_ADDRESS 0x7fb7a1 BIT_MASK 0x1 /end MEASUREMENT
/begin MEASUREMENT lv_state_ctl_dece_trlcu_err_can "Bit ECD AAG unplausibel" UBYTE _CNV_S_2_RANGE__0___85_CM 1 0. 0. 1. DISPLAY_IDENTIFIER LV_STATE_CTL_DECE_TRLCU_ERR_CAN ECU_ADDRESS 0x7fb7a2 BIT_MASK 0x1 /end MEASUREMENT
/begin MEASUREMENT brake_lamp_msg_ctr "Botschaftzaehler Bremslicht" UBYTE _CNV_A_R_LINEAR_____0_CM 1 0. 0. 15. DISPLAY_IDENTIFIER BRAKE_LAMP_MSG_CTR ECU_ADDRESS 0x7fb7a3 FORMAT "%2.0" /end MEASUREMENT
/begin MEASUREMENT lv_err_ctr_msg_brake_lamp "Fehlerbit Botschaftzaehler Bremslicht" UBYTE _CNV_S_2_RANGE__0___85_CM 1 0. 0. 1. DISPLAY_IDENTIFIER LV_ERR_CTR_MSG_BRAKE_LAMP ECU_ADDRESS 0x7fb7a4 BIT_MASK 0x1 /end MEASUREMENT
/begin MEASUREMENT trlcu_msg_ctr "Botschaftzaehler AAG" UBYTE _CNV_A_R_LINEAR_____0_CM 1 0. 0. 15. DISPLAY_IDENTIFIER TRLCU_MSG_CTR ECU_ADDRESS 0x7fb7a5 FORMAT "%2.0" /end MEASUREMENT
/begin MEASUREMENT lv_err_ctr_msg_trlcu "Fehlerbit Botschaftzaehler AAG" UBYTE _CNV_S_2_RANGE__0___85_CM 1 0. 0. 1. DISPLAY_IDENTIFIER LV_ERR_CTR_MSG_TRLCU ECU_ADDRESS 0x7fb7a6 BIT_MASK 0x1 /end MEASUREMENT
/begin MEASUREMENT lv_ich_conf_can "Standheizung verbaut" UBYTE _CNV_S_2_RANGE__0___85_CM 1 0. 0. 1. DISPLAY_IDENTIFIER LV_ICH_CONF_CAN ECU_ADDRESS 0x7fb7a8 BIT_MASK 0x1 /end MEASUREMENT
/begin MEASUREMENT can_vs_abs "Vehicle Speed from TCS" UWORD _CNV_A_R_LINEAR_____71_CM 1 0. 0. 327.67 DISPLAY_IDENTIFIER CAN_VS_ABS ECU_ADDRESS 0x7f97f2 BYTE_ORDER MSB_LAST FORMAT "%5.2" /end MEASUREMENT
/begin MEASUREMENT lv_err_vs_can "" UBYTE _CNV_A_R_LINEAR_____0_CM 1 0. 0. 1. DISPLAY_IDENTIFIER LV_ERR_VS_CAN ECU_ADDRESS 0x7fb729 FORMAT "%1.0" /end MEASUREMENT
/begin MEASUREMENT altpwm "generator load value ( 0 .. 100% )" UWORD _CNV_A_R_LINEAR_____134_CM 1 0. 0. 100. DISPLAY_IDENTIFIER ALTPWM ECU_ADDRESS 0x7fa164 BYTE_ORDER MSB_LAST FORMAT "%4.1" /end MEASUREMENT
/begin CHARACTERISTIC c_fac_altpwm_ducy_alter_pwm "Conversion factor between DUCY_ALTER_PWM (0..100%) and ALTPWM (0 .. 100%)" VALUE 0x85c9a6 _REC_VAL_20_u1 1. _CNV_A_R_LINEAR_____239_CM 0. 1. DISPLAY_IDENTIFIER C_FAC_ALTPWM_DUCY_ALTER_PWM FORMAT "%3.2" /end CHARACTERISTIC
/begin CHARACTERISTIC c_altpwm_sub "substitute value for ALTPWM" VALUE 0x85c872 _REC_VAL_20_u2 100. _CNV_A_R_LINEAR_____134_CM 0. 100. DISPLAY_IDENTIFIER C_ALTPWM_SUB FORMAT "%4.1" /end CHARACTERISTIC
/begin MEASUREMENT tco_sp "coolant temperature setpoint for cooling management functions" UBYTE _CNV_A_R_LINEAR_____241_CM 1 0. -48. 142.5 DISPLAY_IDENTIFIER TCO_SP ECU_ADDRESS 0x7fbb05 FORMAT "%5.1" /end MEASUREMENT
/begin MEASUREMENT tco_sp_1 "basic TCO_SP vs. engine speed and load" UBYTE _CNV_A_R_LINEAR_____241_CM 1 0. -48. 142.5 DISPLAY_IDENTIFIER TCO_SP_1 ECU_ADDRESS 0x7fbf41 FORMAT "%5.1" /end MEASUREMENT
/begin MEASUREMENT tco_sp_2 "basic TCO_SP vs. vehicle speed and TIA or TAM" UBYTE _CNV_A_R_LINEAR_____241_CM 1 0. -48. 142.5 DISPLAY_IDENTIFIER TCO_SP_2 ECU_ADDRESS 0x7fbf42 FORMAT "%5.1" /end MEASUREMENT
/begin MEASUREMENT tco_sp_knk "TCO_SP based on knock intensity" UBYTE _CNV_A_R_LINEAR_____241_CM 1 0. -48. 142.5 DISPLAY_IDENTIFIER TCO_SP_KNK ECU_ADDRESS 0x7fbf43 FORMAT "%5.1" /end MEASUREMENT
/begin MEASUREMENT tco_sp_tcu "TCO_SP based on TCU request" UBYTE _CNV_A_R_LINEAR_____241_CM 1 0. -48. 142.5 DISPLAY_IDENTIFIER TCO_SP_TCU ECU_ADDRESS 0x7fbf44 FORMAT "%5.1" /end MEASUREMENT
/begin MEASUREMENT tco_sp_toil "TCO_SP based on TOIL_CAN" UBYTE _CNV_A_R_LINEAR_____241_CM 1 0. -48. 142.5 DISPLAY_IDENTIFIER TCO_SP_TOIL ECU_ADDRESS 0x7fbf45 FORMAT "%5.1" /end MEASUREMENT
/begin MEASUREMENT tco_sp_min_hvr "minimum TCO_SP based on cooling request" UBYTE _CNV_A_R_LINEAR_____241_CM 1 0. -48. 142.5 DISPLAY_IDENTIFIER TCO_SP_MIN_HVR ECU_ADDRESS 0x7fbf46 FORMAT "%5.1" /end MEASUREMENT
/begin MEASUREMENT tco_sp_max_hvr "maximum TCO_SP based on cooling request" UBYTE _CNV_A_R_LINEAR_____241_CM 1 0. -48. 142.5 DISPLAY_IDENTIFIER TCO_SP_MAX_HVR ECU_ADDRESS 0x7fbf47 FORMAT "%5.1" /end MEASUREMENT
/begin MEASUREMENT tco_sp_inter "TCO_SP after minimum selection" UBYTE _CNV_A_R_LINEAR_____241_CM 1 0. -48. 142.5 DISPLAY_IDENTIFIER TCO_SP_INTER ECU_ADDRESS 0x7fbf48 FORMAT "%5.1" /end MEASUREMENT
/begin MEASUREMENT tco_sp_raw "TCO_SP after maximum selection" UBYTE _CNV_A_R_LINEAR_____241_CM 1 0. -48. 142.5 DISPLAY_IDENTIFIER TCO_SP_RAW ECU_ADDRESS 0x7fbf49 FORMAT "%5.1" /end MEASUREMENT
/begin MEASUREMENT tco_sp_clc "TCO_SP before failure evaluation" UBYTE _CNV_A_R_LINEAR_____241_CM 1 0. -48. 142.5 DISPLAY_IDENTIFIER TCO_SP_CLC ECU_ADDRESS 0x7fbf4a FORMAT "%5.1" /end MEASUREMENT
/begin CHARACTERISTIC lc_use_cool_req_tcu_can "switch to activate using of IP_TCO_SP_TCU" VALUE 0x850178 _REC_VAL_20_u1 1. _CNV_A_R_LINEAR_____1_CM 0. 1. DISPLAY_IDENTIFIER LC_USE_COOL_REQ_TCU_CAN FORMAT "%1.0" /end CHARACTERISTIC
/begin CHARACTERISTIC lc_use_tia_tco_sp "switch to use TIA or TAM within map IP_TCO_SP_2 (1 means use TIA))" VALUE 0x850179 _REC_VAL_20_u1 1. _CNV_A_R_LINEAR_____1_CM 0. 1. DISPLAY_IDENTIFIER LC_USE_TIA_TCO_SP FORMAT "%1.0" /end CHARACTERISTIC
/begin CHARACTERISTIC c_tco_sp_tcu_sub "substitute value for TCO_SP_TCU" VALUE 0x850026 _REC_VAL_20_u1 190.5 _CNV_A_R_LINEAR_____241_CM -48. 142.5 DISPLAY_IDENTIFIER C_TCO_SP_TCU_SUB FORMAT "%5.1" /end CHARACTERISTIC
/begin CHARACTERISTIC c_tco_min_hvr_sub "substitute value for TCO_SP_MIN_HVR" VALUE 0x850022 _REC_VAL_20_u1 190.5 _CNV_A_R_LINEAR_____241_CM -48. 142.5 DISPLAY_IDENTIFIER C_TCO_MIN_HVR_SUB FORMAT "%5.1" /end CHARACTERISTIC
/begin CHARACTERISTIC c_tco_max_hvr_sub "substitute value for TCO_SP_MAX_HVR" VALUE 0x85001c _REC_VAL_20_u1 190.5 _CNV_A_R_LINEAR_____241_CM -48. 142.5 DISPLAY_IDENTIFIER C_TCO_MAX_HVR_SUB FORMAT "%5.1" /end CHARACTERISTIC
/begin CHARACTERISTIC c_tco_sp_sub "substitute value for TCO_SP in case of failure" VALUE 0x850025 _REC_VAL_20_u1 190.5 _CNV_A_R_LINEAR_____241_CM -48. 142.5 DISPLAY_IDENTIFIER C_TCO_SP_SUB FORMAT "%5.1" /end CHARACTERISTIC
/begin CHARACTERISTIC c_crlc_tco_sp_down "TP1 filter constant for TCO_SP for decreasing values" VALUE 0x84fbfc _REC_VAL_20_u1 0.99609375 _CNV_A_R_LINEAR_____254_CM 0. 0.99609375 DISPLAY_IDENTIFIER C_CRLC_TCO_SP_DOWN FORMAT "%5.3" /end CHARACTERISTIC
/begin CHARACTERISTIC c_crlc_tco_sp_up "TP1 filter constant for TCO_SP for increasing values" VALUE 0x84fbfd _REC_VAL_20_u1 0.99609375 _CNV_A_R_LINEAR_____254_CM 0. 0.99609375 DISPLAY_IDENTIFIER C_CRLC_TCO_SP_UP FORMAT "%5.3" /end CHARACTERISTIC
/begin AXIS_PTS ldp_n_32__tco_sp "" 0x844066 n_32 _REC_AXS_20_u1 8160. _CNV_A_R_LINEAR_____81_CM 8 0. 8160. FORMAT "%4.0" /end AXIS_PTS
/begin AXIS_PTS ldp_tqi_req_tra__tco_sp "" 0x844312 tqi_req_tra _REC_AXS_20_u2 1023.96875 _CNV_A_R_LINEAR_____52_CM 8 0. 1023.96875 FORMAT "%7.2" /end AXIS_PTS
/begin CHARACTERISTIC ip_tco_sp_1 "basic TCO_SP vs. engine speed and load" MAP 0x84f228 _REC_MAP_20_u1_u1_u2 190.5 _CNV_A_R_LINEAR_____241_CM -48. 142.5 DISPLAY_IDENTIFIER IP_TCO_SP_1 FORMAT "%5.1"
 /begin AXIS_DESCR COM_AXIS n_32 _CNV_A_R_LINEAR_____81_CM 8 0. 8160. FORMAT "%4.0" AXIS_PTS_REF ldp_n_32__tco_sp /end AXIS_DESCR
 /begin AXIS_DESCR COM_AXIS tqi_req_tra _CNV_A_R_LINEAR_____52_CM 8 0. 1023.96875 FORMAT "%7.2" AXIS_PTS_REF ldp_tqi_req_tra__tco_sp /end AXIS_DESCR
/end CHARACTERISTIC
/begin AXIS_PTS ldp_iga_mv_knk__tco_sp "" 0x844039 NO_INPUT_QUANTITY _REC_AXS_20_u1 48. _CNV_A_R_LINEAR_____264_CM 4 -48. 0. FORMAT "%5.1" /end AXIS_PTS
/begin CHARACTERISTIC ip_tco_sp_knk "TCO_SP vs. knock intensity" CURVE 0x84f4a8 _REC_CUR_20_u1_u1 190.5 _CNV_A_R_LINEAR_____241_CM -48. 142.5 DISPLAY_IDENTIFIER IP_TCO_SP_KNK FORMAT "%5.1"
 /begin AXIS_DESCR COM_AXIS NO_INPUT_QUANTITY _CNV_A_R_LINEAR_____264_CM 4 -48. 0. FORMAT "%5.1" AXIS_PTS_REF ldp_iga_mv_knk__tco_sp /end AXIS_DESCR
/end CHARACTERISTIC
/begin AXIS_PTS ldp_vs__tco_sp "" 0x844358 vs _REC_AXS_20_u1 255. _CNV_A_R_LINEAR_____245_CM 8 0. 255. FORMAT "%3.0" /end AXIS_PTS
/begin AXIS_PTS ldp_tia_tam__tco_sp "" 0x8442c2 online_dummy _REC_AXS_20_u1 190.5 _CNV_A_R_LINEAR_____241_CM 8 -48. 142.5 FORMAT "%5.1" /end AXIS_PTS
/begin CHARACTERISTIC ip_tco_sp_2 "TCO_SP vs. vehicle speed and TIA or TAM (depending on switch LC_USE_TIA_TCO_SP)" MAP 0x84f268 _REC_MAP_20_u1_u1_u1 190.5 _CNV_A_R_LINEAR_____241_CM -48. 142.5 DISPLAY_IDENTIFIER IP_TCO_SP_2 FORMAT "%5.1"
 /begin AXIS_DESCR COM_AXIS vs _CNV_A_R_LINEAR_____245_CM 8 0. 255. FORMAT "%3.0" AXIS_PTS_REF ldp_vs__tco_sp /end AXIS_DESCR
 /begin AXIS_DESCR COM_AXIS online_dummy _CNV_A_R_LINEAR_____241_CM 8 -48. 142.5 FORMAT "%5.1" AXIS_PTS_REF ldp_tia_tam__tco_sp /end AXIS_DESCR
/end CHARACTERISTIC
/begin AXIS_PTS ldp_cool_req_tcu_can__tco_sp "" 0x843fa3 cool_req_tcu_can _REC_AXS_20_u1 3. _CNV_A_R_LINEAR_____1_CM 4 0. 3. FORMAT "%3.0" /end AXIS_PTS
/begin CHARACTERISTIC ip_tco_sp_tcu "TCO_SP vs. cooling request of TCU" CURVE 0x84f4b2 _REC_CUR_20_u1_u1 190.5 _CNV_A_R_LINEAR_____241_CM -48. 142.5 DISPLAY_IDENTIFIER IP_TCO_SP_TCU FORMAT "%5.1"
 /begin AXIS_DESCR COM_AXIS cool_req_tcu_can _CNV_A_R_LINEAR_____1_CM 4 0. 3. FORMAT "%3.0" AXIS_PTS_REF ldp_cool_req_tcu_can__tco_sp /end AXIS_DESCR
/end CHARACTERISTIC
/begin AXIS_PTS ldp_toil__tco_sp "" 0x8442d0 toil _REC_AXS_20_u1 200. _CNV_A_R_LINEAR_____65_CM 4 -40. 160. FORMAT "%3.0" /end AXIS_PTS
/begin CHARACTERISTIC ip_tco_sp_toil "TCO_SP vs. oil temperature" CURVE 0x84f4b6 _REC_CUR_20_u1_u1 190.5 _CNV_A_R_LINEAR_____241_CM -48. 142.5 DISPLAY_IDENTIFIER IP_TCO_SP_TOIL FORMAT "%5.1"
 /begin AXIS_DESCR COM_AXIS toil _CNV_A_R_LINEAR_____65_CM 4 -40. 160. FORMAT "%3.0" AXIS_PTS_REF ldp_toil__tco_sp /end AXIS_DESCR
/end CHARACTERISTIC
/begin AXIS_PTS ldpm_v_hvr__tco_hvr "" 0x844448 online_dummy _REC_AXS_20_u2 4.9951171875 _CNV_A_R_LINEAR_____265_CM 3 0. 4.9951171875 FORMAT "%5.3" /end AXIS_PTS
/begin CHARACTERISTIC ip_tco_min_hvr "minimum TCO_SP depending on cooling request" CURVE 0x84f225 _REC_CUR_20_u1_u2 190.5 _CNV_A_R_LINEAR_____241_CM -48. 142.5 DISPLAY_IDENTIFIER IP_TCO_MIN_HVR FORMAT "%5.1"
 /begin AXIS_DESCR COM_AXIS online_dummy _CNV_A_R_LINEAR_____265_CM 3 0. 4.9951171875 FORMAT "%5.3" AXIS_PTS_REF ldpm_v_hvr__tco_hvr /end AXIS_DESCR
/end CHARACTERISTIC
/begin CHARACTERISTIC ip_tco_max_hvr "maximum TCO_SP depending on cooling request" CURVE 0x84f222 _REC_CUR_20_u1_u2 190.5 _CNV_A_R_LINEAR_____241_CM -48. 142.5 DISPLAY_IDENTIFIER IP_TCO_MAX_HVR FORMAT "%5.1"
 /begin AXIS_DESCR COM_AXIS online_dummy _CNV_A_R_LINEAR_____265_CM 3 0. 4.9951171875 FORMAT "%5.3" AXIS_PTS_REF ldpm_v_hvr__tco_hvr /end AXIS_DESCR
/end CHARACTERISTIC
/begin MEASUREMENT tco_dif "difference between TCO_SP and actual TCO" SBYTE _CNV_A_R_LINEAR_____260_CM 1 0. -96. 95.25 DISPLAY_IDENTIFIER TCO_DIF ECU_ADDRESS 0x7fbb07 FORMAT "%4.1" /end MEASUREMENT
/begin MEASUREMENT tco_1_2 "difference between actual TCO and TCO_2 (TCO difference before and after cooler)" UBYTE _CNV_A_R_LINEAR_____249_CM 1 0. 0. 190.5 DISPLAY_IDENTIFIER TCO_1_2 ECU_ADDRESS 0x7fbb06 FORMAT "%5.1" /end MEASUREMENT
/begin MEASUREMENT lv_ect_act "electrical heated thermostat available and cooling system without failures (for CAN output)" UBYTE _CNV_S_2_RANGE__0___85_CM 1 0. 0. 1. DISPLAY_IDENTIFIER LV_ECT_ACT ECU_ADDRESS 0x7fbb08 BIT_MASK 0x1 /end MEASUREMENT
/begin CHARACTERISTIC c_tco_sub_tco_dif "substitute value for TCO for TCO_DIF calculation in case of TCO failure detected" VALUE 0x850027 _REC_VAL_20_u1 190.5 _CNV_A_R_LINEAR_____241_CM -48. 142.5 DISPLAY_IDENTIFIER C_TCO_SUB_TCO_DIF FORMAT "%5.1" /end CHARACTERISTIC
/begin MEASUREMENT tam "Ambient air temperature" UBYTE _CNV_A_R_LINEAR_____241_CM 1 0. -48. 142.5 DISPLAY_IDENTIFIER TAM ECU_ADDRESS 0x7fbb70 FORMAT "%5.1" /end MEASUREMENT
/begin CHARACTERISTIC c_tam_sub "Default value for ambient air temperature" VALUE 0x85000a _REC_VAL_20_u1 190.5 _CNV_A_R_LINEAR_____241_CM -48. 142.5 DISPLAY_IDENTIFIER C_TAM_SUB FORMAT "%5.1" /end CHARACTERISTIC
/begin CHARACTERISTIC lc_tam_can_use "Logical value to use the CAN message for TAM evaluation (LC_TAM_CAN_USE = 1)" VALUE 0x85016c _REC_VAL_20_u1 1. _CNV_S_2_RANGE__0___85_CM 0. 1. DISPLAY_IDENTIFIER LC_TAM_CAN_USE /end CHARACTERISTIC
/begin CHARACTERISTIC lc_tia_sub_mdl "" VALUE 0x85ceb7 _REC_VAL_20_u1 1. _CNV_A_R_LINEAR_____0_CM 0. 1. DISPLAY_IDENTIFIER LC_TIA_SUB_MDL FORMAT "%2.0" /end CHARACTERISTIC
/begin MEASUREMENT pv_av "global degree of activation of the accelerator pedal" UWORD _CNV_A_R_LINEAR_____78_CM 1 0. 0. 100. DISPLAY_IDENTIFIER PV_AV ECU_ADDRESS 0x7fcd84 BYTE_ORDER MSB_LAST FORMAT "%4.2" /end MEASUREMENT
/begin MEASUREMENT lv_kd "flag for Kick-Down Recognition" UBYTE _CNV_S_2_RANGE______11_CM 1 0. 0. 1. DISPLAY_IDENTIFIER LV_KD ECU_ADDRESS 0x7fce6a /end MEASUREMENT
/begin MEASUREMENT pv_av_1 "degree of activation of the accelerator pedal from PVS-channel 1" UWORD _CNV_A_R_LINEAR_____78_CM 1 0. 0. 100. DISPLAY_IDENTIFIER PV_AV_1 ECU_ADDRESS 0x7fcd8a BYTE_ORDER MSB_LAST FORMAT "%4.2" /end MEASUREMENT
/begin MEASUREMENT pv_av_2 "degree of activation of the accelerator pedal from PVS-channel 2" UWORD _CNV_A_R_LINEAR_____78_CM 1 0. 0. 100. DISPLAY_IDENTIFIER PV_AV_2 ECU_ADDRESS 0x7fcd8c BYTE_ORDER MSB_LAST FORMAT "%4.2" /end MEASUREMENT
/begin MEASUREMENT lv_pvs_kd "flag for kick-down-recognition (internally recognized from both PVS-Voltages)" UBYTE _CNV_S_2_RANGE______11_CM 1 0. 0. 1. DISPLAY_IDENTIFIER LV_PVS_KD ECU_ADDRESS 0x7fce6b /end MEASUREMENT
/begin MEASUREMENT v_pvs_fil_1 "filtered voltage of pedal value sensor 1" UWORD _CNV_A_R_LINEAR_____28_CM 1 0. 0. 4.9951171875 DISPLAY_IDENTIFIER V_PVS_FIL_1 ECU_ADDRESS 0x7fcd9a BYTE_ORDER MSB_LAST FORMAT "%4.3" /end MEASUREMENT
/begin MEASUREMENT v_pvs_fil_2 "filtered voltage of pedal value sensor 2" UWORD _CNV_A_R_LINEAR_____28_CM 1 0. 0. 4.9951171875 DISPLAY_IDENTIFIER V_PVS_FIL_2 ECU_ADDRESS 0x7fcd9c BYTE_ORDER MSB_LAST FORMAT "%4.3" /end MEASUREMENT
/begin MEASUREMENT pv_av_grd "gradient of PV_AV" SWORD _CNV_A_R_LINEAR_____266_CM 1 0. -99.90000000000001 99.90000000000001 DISPLAY_IDENTIFIER PV_AV_GRD ECU_ADDRESS 0x7fcd88 BYTE_ORDER MSB_LAST FORMAT "%4.2" /end MEASUREMENT
/begin MEASUREMENT pv_av_sel "activation of the accelerator pedal raw value" UWORD _CNV_A_R_LINEAR_____78_CM 1 0. 0. 100. DISPLAY_IDENTIFIER PV_AV_SEL ECU_ADDRESS 0x7fcd86 BYTE_ORDER MSB_LAST FORMAT "%4.2" /end MEASUREMENT
/begin CHARACTERISTIC c_v_pvs_hys_fil "band width of dejitter filter" VALUE 0x85cd9e _REC_VAL_20_u2 4.9951171875 _CNV_A_R_LINEAR_____28_CM 0. 4.9951171875 DISPLAY_IDENTIFIER C_V_PVS_HYS_FIL FORMAT "%4.3" /end CHARACTERISTIC
/begin CHARACTERISTIC c_v_pvs_thd_is_l_1 "threshold for idle speed recognition (low) of channel 1" VALUE 0x85cdd0 _REC_VAL_20_u2 4.9951171875 _CNV_A_R_LINEAR_____28_CM 0. 4.9951171875 DISPLAY_IDENTIFIER C_V_PVS_THD_IS_L_1 FORMAT "%4.3" /end CHARACTERISTIC
/begin CHARACTERISTIC c_v_pvs_sp_fl_1 "threshold for full load recognition of channel 1" VALUE 0x85cdc0 _REC_VAL_20_u2 4.9951171875 _CNV_A_R_LINEAR_____28_CM 0. 4.9951171875 DISPLAY_IDENTIFIER C_V_PVS_SP_FL_1 FORMAT "%4.3" /end CHARACTERISTIC
/begin CHARACTERISTIC c_v_pvs_thd_is_h_1 "threshold for idle speed recognition (high) of channel 1" VALUE 0x85cdcc _REC_VAL_20_u2 4.9951171875 _CNV_A_R_LINEAR_____28_CM 0. 4.9951171875 DISPLAY_IDENTIFIER C_V_PVS_THD_IS_H_1 FORMAT "%4.3" /end CHARACTERISTIC
/begin CHARACTERISTIC c_v_pvs_thd_is_l_2 "threshold for idle speed recognition (low) of channel 2" VALUE 0x85cdd2 _REC_VAL_20_u2 4.9951171875 _CNV_A_R_LINEAR_____28_CM 0. 4.9951171875 DISPLAY_IDENTIFIER C_V_PVS_THD_IS_L_2 FORMAT "%4.3" /end CHARACTERISTIC
/begin CHARACTERISTIC c_v_pvs_thd_is_h_2 "threshold for idle speed recognition (high) of channel 2" VALUE 0x85cdce _REC_VAL_20_u2 4.9951171875 _CNV_A_R_LINEAR_____28_CM 0. 4.9951171875 DISPLAY_IDENTIFIER C_V_PVS_THD_IS_H_2 FORMAT "%4.3" /end CHARACTERISTIC
/begin CHARACTERISTIC c_v_pvs_sp_fl_2 "threshold for full load recognition of channel 2" VALUE 0x85cdc2 _REC_VAL_20_u2 4.9951171875 _CNV_A_R_LINEAR_____28_CM 0. 4.9951171875 DISPLAY_IDENTIFIER C_V_PVS_SP_FL_2 FORMAT "%4.3" /end CHARACTERISTIC
/begin CHARACTERISTIC c_v_pvs_thd_kd_1 "difference between V_PVS_MAX_1 and Kick-Down-Recognition (channel 1)" VALUE 0x85cdd4 _REC_VAL_20_u2 4.9951171875 _CNV_A_R_LINEAR_____28_CM 0. 4.9951171875 DISPLAY_IDENTIFIER C_V_PVS_THD_KD_1 FORMAT "%4.3" /end CHARACTERISTIC
/begin CHARACTERISTIC c_v_pvs_thd_kd_2 "difference between V_PVS_MAX_2 and Kick-Down-Recognition (channel 2)" VALUE 0x85cdd6 _REC_VAL_20_u2 4.9951171875 _CNV_A_R_LINEAR_____28_CM 0. 4.9951171875 DISPLAY_IDENTIFIER C_V_PVS_THD_KD_2 FORMAT "%4.3" /end CHARACTERISTIC
/begin CHARACTERISTIC c_ctr_max_pvs_is_rng_h "PVS_IS_RNG_H counter maximum value" VALUE 0x85c96d _REC_VAL_20_u1 255. _CNV_A_R_LINEAR_____0_CM 0. 255. DISPLAY_IDENTIFIER C_CTR_MAX_PVS_IS_RNG_H FORMAT "%3.0" /end CHARACTERISTIC
/begin CHARACTERISTIC c_ctr_max_pvs_is_rng_l "PVS_IS_RNG_L counter maximum value" VALUE 0x85c96e _REC_VAL_20_u1 255. _CNV_A_R_LINEAR_____0_CM 0. 255. DISPLAY_IDENTIFIER C_CTR_MAX_PVS_IS_RNG_L FORMAT "%3.0" /end CHARACTERISTIC
/begin CHARACTERISTIC c_pv_grd_lih_max "maximum positive gradient of PV_AV in case of failure" VALUE 0x85cb6e _REC_VAL_20_u2 100. _CNV_A_R_LINEAR_____268_CM 0. 100. DISPLAY_IDENTIFIER C_PV_GRD_LIH_MAX FORMAT "%4.2" /end CHARACTERISTIC
/begin CHARACTERISTIC c_pv_lih_max "maximum value of PV_AV in case of failure" VALUE 0x85cb70 _REC_VAL_20_u2 100. _CNV_A_R_LINEAR_____78_CM 0. 100. DISPLAY_IDENTIFIER C_PV_LIH_MAX FORMAT "%4.2" /end CHARACTERISTIC
/begin CHARACTERISTIC c_pvs_bls_bts_plaus_lgrd_neg "negative gradient limitation of PV_AV at PVS_BLS_BTS_PLAUS-check" VALUE 0x85cb74 _REC_VAL_20_u2 100. _CNV_A_R_LINEAR_____268_CM 0. 100. DISPLAY_IDENTIFIER C_PVS_BLS_BTS_PLAUS_LGRD_NEG FORMAT "%4.2" /end CHARACTERISTIC
/begin CHARACTERISTIC c_pvs_bls_bts_plaus_lgrd_pos "positive gradient limitation of PV_AV at PVS_BLS_BTS_PLAUS-check" VALUE 0x85cb76 _REC_VAL_20_u2 100. _CNV_A_R_LINEAR_____268_CM 0. 100. DISPLAY_IDENTIFIER C_PVS_BLS_BTS_PLAUS_LGRD_POS FORMAT "%4.2" /end CHARACTERISTIC
/begin CHARACTERISTIC c_v_pvs_sp_max_1 "maximum voltage of PVS-channel 1" VALUE 0x85cdc4 _REC_VAL_20_u2 4.9951171875 _CNV_A_R_LINEAR_____28_CM 0. 4.9951171875 DISPLAY_IDENTIFIER C_V_PVS_SP_MAX_1 FORMAT "%4.3" /end CHARACTERISTIC
/begin CHARACTERISTIC c_v_pvs_sp_max_2 "maximum voltage of PVS-channel 2" VALUE 0x85cdc6 _REC_VAL_20_u2 4.9951171875 _CNV_A_R_LINEAR_____28_CM 0. 4.9951171875 DISPLAY_IDENTIFIER C_V_PVS_SP_MAX_2 FORMAT "%4.3" /end CHARACTERISTIC
/begin CHARACTERISTIC c_v_pvs_thd_grd_1 "threshold for gradient of V_PVS_1" VALUE 0x85cdc8 _REC_VAL_20_u2 4.9951171875 _CNV_A_R_LINEAR_____28_CM 0. 4.9951171875 DISPLAY_IDENTIFIER C_V_PVS_THD_GRD_1 FORMAT "%4.3" /end CHARACTERISTIC
/begin CHARACTERISTIC c_v_pvs_thd_grd_2 "threshold for gradient of V_PVS_2" VALUE 0x85cdca _REC_VAL_20_u2 4.9951171875 _CNV_A_R_LINEAR_____28_CM 0. 4.9951171875 DISPLAY_IDENTIFIER C_V_PVS_THD_GRD_2 FORMAT "%4.3" /end CHARACTERISTIC
/begin MEASUREMENT cru_swi_pos "CRU SWITCH position which is read either from CAN or Discrete PINS based on CRU - CONF" UBYTE _CNV_A_R_LINEAR_____1_CM 1 0. 0. 255. DISPLAY_IDENTIFIER CRU_SWI_POS ECU_ADDRESS 0x7fb7fb FORMAT "%3.0" /end MEASUREMENT
/begin MEASUREMENT cru_swi_pos_deb "debouced hardware state of lever from CAN" UBYTE _CNV_A_R_LINEAR_____1_CM 1 0. 0. 255. DISPLAY_IDENTIFIER CRU_SWI_POS_DEB ECU_ADDRESS 0x7fb7fc FORMAT "%3.0" /end MEASUREMENT
/begin MEASUREMENT cru_swi_pos_can "Variable zur Darstellung der Schaltzustaende der GRA (empfangene Botschaft)" UBYTE _CNV_A_R_LINEAR_____1_CM 1 0. 0. 255. DISPLAY_IDENTIFIER CRU_SWI_POS_CAN ECU_ADDRESS 0x7fb7a9 FORMAT "%3.0" /end MEASUREMENT
/begin MEASUREMENT lv_cru_can_vld "Flag fuer \"GRA-Botschaft gueltig / fehlerfrei\"" UBYTE _CNV_S_2_RANGE__0___85_CM 1 0. 0. 1. DISPLAY_IDENTIFIER LV_CRU_CAN_VLD ECU_ADDRESS 0x7fb7ab BIT_MASK 0x1 /end MEASUREMENT
/begin MEASUREMENT lv_err_cru_dvc_smls "Flag fuer \"GRA-Bedienteilfehler vom sendenden Steuergeraet erkannt\"" UBYTE _CNV_S_2_RANGE__0___85_CM 1 0. 0. 1. DISPLAY_IDENTIFIER LV_ERR_CRU_DVC_SMLS ECU_ADDRESS 0x7fb7ac BIT_MASK 0x1 /end MEASUREMENT
/begin MEASUREMENT lv_cru_dcc_conf "Kodierinfo vom SMLS; 0=GRA, 1=ACC" UBYTE _CNV_S_2_RANGE__0___85_CM 1 0. 0. 1. DISPLAY_IDENTIFIER LV_CRU_DCC_CONF ECU_ADDRESS 0x7fb7ad BIT_MASK 0x1 /end MEASUREMENT
/begin MEASUREMENT lv_err_cru_conf "Flag fuer \"Fehler in GRA-Bedienteilkonfiguration erkannt\"" UBYTE _CNV_S_2_RANGE__0___85_CM 1 0. 0. 1. DISPLAY_IDENTIFIER LV_ERR_CRU_CONF ECU_ADDRESS 0x7fb7ae BIT_MASK 0x1 /end MEASUREMENT
/begin MEASUREMENT lv_err_ctr_msg_cru "Flag fuer \"Botschaftszaehlerfehler erkannt\"" UBYTE _CNV_S_2_RANGE__0___85_CM 1 0. 0. 1. DISPLAY_IDENTIFIER LV_ERR_CTR_MSG_CRU ECU_ADDRESS 0x7fb7af BIT_MASK 0x1 /end MEASUREMENT
/begin MEASUREMENT lv_err_cks_cru_can_diag "Flag fuer \"Checksummenfehler erkannt\"" UBYTE _CNV_S_2_RANGE__0___85_CM 1 0. 0. 1. DISPLAY_IDENTIFIER LV_ERR_CKS_CRU_CAN_DIAG ECU_ADDRESS 0x7fb7b1 BIT_MASK 0x1 /end MEASUREMENT
/begin MEASUREMENT lv_err_cks_cru_can "Flag fuer \"Checksumme unplausibel\"" UBYTE _CNV_S_2_RANGE__0___85_CM 1 0. 0. 1. DISPLAY_IDENTIFIER LV_ERR_CKS_CRU_CAN ECU_ADDRESS 0x7fb7b0 BIT_MASK 0x1 /end MEASUREMENT
/begin MEASUREMENT cru_conf "GRA-Konfiguration" UBYTE _CNV_S_3_STATE_CRU__337_CM 1 0. 0. 3. DISPLAY_IDENTIFIER CRU_CONF ECU_ADDRESS 0x7fb7aa /end MEASUREMENT
/begin MEASUREMENT lv_cru_swi_main "Typ Hauptschalter" UBYTE _CNV_S_2_RANGE__0___85_CM 1 0. 0. 1. DISPLAY_IDENTIFIER LV_CRU_SWI_MAIN ECU_ADDRESS 0x7fb7b2 BIT_MASK 0x1 /end MEASUREMENT
/begin MEASUREMENT n_max_thd "actual engine speed limit" UWORD _CNV_A_R_LINEAR_____5_CM 1 0. 0. 6375. DISPLAY_IDENTIFIER N_MAX_THD ECU_ADDRESS 0x7fa138 BYTE_ORDER MSB_LAST FORMAT "%4.0" /end MEASUREMENT
/begin CHARACTERISTIC c_n_max "general engine speed threshold for engine speed limitation" VALUE 0x84fdf4 _REC_VAL_20_u2 6375. _CNV_A_R_LINEAR_____5_CM 0. 6375. DISPLAY_IDENTIFIER C_N_MAX FORMAT "%4.0" /end CHARACTERISTIC
/begin CHARACTERISTIC c_n_max_mt "engine speed limit for engine speed limitation of stopped vehicle" VALUE 0x85cb28 _REC_VAL_20_u2 6375. _CNV_A_R_LINEAR_____5_CM 0. 6375. DISPLAY_IDENTIFIER C_N_MAX_MT FORMAT "%4.0" /end CHARACTERISTIC
/begin CHARACTERISTIC c_n_max_mon "engine speed limit in case of detected error by process monitoring" VALUE 0x85cb26 _REC_VAL_20_u2 6375. _CNV_A_R_LINEAR_____5_CM 0. 6375. DISPLAY_IDENTIFIER C_N_MAX_MON FORMAT "%4.0" /end CHARACTERISTIC
/begin CHARACTERISTIC c_n_max_tqi "engine speed limit for torque limitation" VALUE 0x85cb30 _REC_VAL_20_u2 6375. _CNV_A_R_LINEAR_____5_CM 0. 6375. DISPLAY_IDENTIFIER C_N_MAX_TQI FORMAT "%4.0" /end CHARACTERISTIC
/begin CHARACTERISTIC c_n_max_etc "engine speed limit for pedal value" VALUE 0x85cb18 _REC_VAL_20_u2 6375. _CNV_A_R_LINEAR_____5_CM 0. 6375. DISPLAY_IDENTIFIER C_N_MAX_ETC FORMAT "%4.0" /end CHARACTERISTIC
/begin MEASUREMENT tba "charge air temperature" UBYTE _CNV_A_R_LINEAR_____18_CM 1 0. -50. 205. DISPLAY_IDENTIFIER TBA ECU_ADDRESS 0x7fce84 FORMAT "%3.0" /end MEASUREMENT
/begin CHARACTERISTIC c_tba_sub_diag "charge air temperature substitute value" VALUE 0x85cca0 _REC_VAL_20_u1 255. _CNV_A_R_LINEAR_____18_CM -50. 205. DISPLAY_IDENTIFIER C_TBA_SUB_DIAG FORMAT "%3.0" /end CHARACTERISTIC
/begin MEASUREMENT v_tba "charge air temperature (voltage)" UWORD _CNV_A_R_LINEAR_____28_CM 1 0. 0. 4.9951171875 DISPLAY_IDENTIFIER V_TBA ECU_ADDRESS 0x7fcdb0 BYTE_ORDER MSB_LAST FORMAT "%4.3" /end MEASUREMENT
/begin MEASUREMENT tba_mes "measured charge air temperature" UBYTE _CNV_A_R_LINEAR_____18_CM 1 0. -50. 205. DISPLAY_IDENTIFIER TBA_MES ECU_ADDRESS 0x7fce85 FORMAT "%3.0" /end MEASUREMENT
/begin CHARACTERISTIC ip_tba_mes__v_tba "SYS_VAR: TBA sensor map" CURVE 0x85b0d6 _REC_CUR_20_u1_u2 255. _CNV_A_R_LINEAR_____18_CM -50. 205. DISPLAY_IDENTIFIER IP_TBA_MES__V_TBA FORMAT "%3.0"
 /begin AXIS_DESCR COM_AXIS v_tba _CNV_A_R_LINEAR_____28_CM 16 0. 4.9951171875 FORMAT "%4.3" AXIS_PTS_REF ldp_v_tba_ip_tba_mes /end AXIS_DESCR
/end CHARACTERISTIC
/begin AXIS_PTS ldp_v_tba_ip_tba_mes "" 0x842a1e v_tba _REC_AXS_20_u2 4.9951171875 _CNV_A_R_LINEAR_____28_CM 16 0. 4.9951171875 FORMAT "%4.3" /end AXIS_PTS
/begin MEASUREMENT map_mes "measured intake manifold pressure per segment" UWORD _CNV_A_R_LINEAR_____45_CM 1 0. 0. 5434. DISPLAY_IDENTIFIER MAP_MES ECU_ADDRESS 0x7fcd80 BYTE_ORDER MSB_LAST FORMAT "%6.2" /end MEASUREMENT
/begin MEASUREMENT map "intake manifold pressure (incl. substitute value)" UWORD _CNV_A_R_LINEAR_____45_CM 1 0. 0. 5434. DISPLAY_IDENTIFIER MAP ECU_ADDRESS 0x7fcd7e BYTE_ORDER MSB_LAST FORMAT "%6.2" /end MEASUREMENT
/begin CHARACTERISTIC ip_map_mes__v_map "AMAP: conversion characteristic for MAP_MES" CURVE 0x854936 _REC_CUR_20_u2_u2 5434. _CNV_A_R_LINEAR_____45_CM 0. 5434. DISPLAY_IDENTIFIER IP_MAP_MES__V_MAP FORMAT "%6.2"
 /begin AXIS_DESCR COM_AXIS v_map _CNV_A_R_LINEAR_____47_CM 2 0. 4.9999237 FORMAT "%4.3" AXIS_PTS_REF ldp_v_map_ip_map_mes /end AXIS_DESCR
/end CHARACTERISTIC
/begin AXIS_PTS ldp_v_map_ip_map_mes "" 0x8429ca v_map _REC_AXS_20_u2 4.9999237 _CNV_A_R_LINEAR_____47_CM 2 0. 4.9999237 FORMAT "%4.3" /end AXIS_PTS
/begin CHARACTERISTIC c_map_sub_diag "intake manifold pressure substitute value" VALUE 0x85cac8 _REC_VAL_20_u2 5434. _CNV_A_R_LINEAR_____45_CM 0. 5434. DISPLAY_IDENTIFIER C_MAP_SUB_DIAG FORMAT "%6.2" /end CHARACTERISTIC
/begin MEASUREMENT map_mmv "moving mean value of the manifold pressure" UWORD _CNV_A_R_LINEAR_____45_CM 1 0. 0. 5434. DISPLAY_IDENTIFIER MAP_MMV ECU_ADDRESS 0x7fcd82 BYTE_ORDER MSB_LAST FORMAT "%6.2" /end MEASUREMENT
/begin CHARACTERISTIC c_fac_map_fil "filter factor for the moving mean value of the manifold pressure" VALUE 0x85c9f4 _REC_VAL_20_u2 0.9999874 _CNV_A_R_LINEAR_____87_CM 0. 0.9999874 DISPLAY_IDENTIFIER C_FAC_MAP_FIL FORMAT "%6.5" /end CHARACTERISTIC
/begin MEASUREMENT trt "total running time ECU" ULONG _CNV_A_R_LINEAR_____16_CM 1 0. 0. 4294967295. DISPLAY_IDENTIFIER TRT ECU_ADDRESS 0x7fccc8 BYTE_ORDER MSB_LAST FORMAT "%10.0" /end MEASUREMENT
/begin MEASUREMENT t_on_ecu "Key ON duration" UWORD _CNV_A_R_LINEAR_____16_CM 1 0. 0. 65535. DISPLAY_IDENTIFIER T_ON_ECU ECU_ADDRESS 0x7fcdae BYTE_ORDER MSB_LAST FORMAT "%5.0" /end MEASUREMENT
/begin MEASUREMENT t_sys "system time" ULONG _CNV_A_R_LINEAR_____226_CM 1 0. 0. 42949672.95 DISPLAY_IDENTIFIER T_SYS ECU_ADDRESS 0x7f8660 BYTE_ORDER MSB_LAST FORMAT "%11.5" /end MEASUREMENT
/begin MEASUREMENT t_igk "time \"ignition key on\"" UWORD _CNV_A_R_LINEAR_____226_CM 1 0. 0. 655.35 DISPLAY_IDENTIFIER T_IGK ECU_ADDRESS 0x7f9da0 BYTE_ORDER MSB_LAST FORMAT "%6.2" /end MEASUREMENT
/begin CHARACTERISTIC c_toil_grd_max_diag "Schwelle zur Gradientenüberwachung TOIL" VALUE 0x850044 _REC_VAL_20_u1 200. _CNV_A_R_LINEAR_____369_CM 0. 200. DISPLAY_IDENTIFIER C_TOIL_GRD_MAX_DIAG FORMAT "%3.0" /end CHARACTERISTIC
/begin MEASUREMENT toil "oil temperature" UBYTE _CNV_A_R_LINEAR_____65_CM 1 0. -40. 160. DISPLAY_IDENTIFIER TOIL ECU_ADDRESS 0x7fbb67 FORMAT "%3.0" /end MEASUREMENT
/begin CHARACTERISTIC c_toil_sub_crlc "" VALUE 0x85004c _REC_VAL_20_u2 0.9999847412109381 _CNV_A_R_LINEAR_____137_CM 0. 0.9999847412109381 DISPLAY_IDENTIFIER C_TOIL_SUB_CRLC FORMAT "%7.5" /end CHARACTERISTIC
/begin CHARACTERISTIC c_tco_swi_cwp_toil "" VALUE 0x850028 _REC_VAL_20_u1 190.5 _CNV_A_R_LINEAR_____241_CM -48. 142.5 DISPLAY_IDENTIFIER C_TCO_SWI_CWP_TOIL FORMAT "%5.1" /end CHARACTERISTIC
/begin CHARACTERISTIC c_tco_swi_toil_mdl_h "" VALUE 0x850029 _REC_VAL_20_u1 190.5 _CNV_A_R_LINEAR_____241_CM -48. 142.5 DISPLAY_IDENTIFIER C_TCO_SWI_TOIL_MDL_H FORMAT "%5.1" /end CHARACTERISTIC
/begin CHARACTERISTIC c_toil_sub_h_crlc "" VALUE 0x85004e _REC_VAL_20_u2 0.9999847412109381 _CNV_A_R_LINEAR_____137_CM 0. 0.9999847412109381 DISPLAY_IDENTIFIER C_TOIL_SUB_H_CRLC FORMAT "%7.5" /end CHARACTERISTIC
/begin CHARACTERISTIC ip_toil_crlc_ofs__t_ast "Korrelationskonstante für TOIL_MDL_OFS" CURVE 0x84f68e _REC_CUR_20_u2_u2 0.9999847412109381 _CNV_A_R_LINEAR_____137_CM 0. 0.9999847412109381 DISPLAY_IDENTIFIER IP_TOIL_CRLC_OFS__T_AST FORMAT "%7.5"
 /begin AXIS_DESCR COM_AXIS t_ast _CNV_A_R_LINEAR_____240_CM 6 0.1 6553.5 FORMAT "%6.1" AXIS_PTS_REF ldp_t_ast__toil_crlc_ofs /end AXIS_DESCR
/end CHARACTERISTIC
/begin AXIS_PTS ldp_t_ast__toil_crlc_ofs "" 0x844168 t_ast _REC_AXS_20_u2 6553.400000000001 _CNV_A_R_LINEAR_____240_CM 6 0.1 6553.5 FORMAT "%6.1" /end AXIS_PTS
/begin CHARACTERISTIC ip_toil_ofs__toil_mdl_grd__n_32 "Additiver Offset für TOIL-Berechnung" MAP 0x84f6cc _REC_MAP_20_u2_u2_u1 255.996094 _CNV_A_R_LINEAR_____370_CM -128. 127.996094 DISPLAY_IDENTIFIER IP_TOIL_OFS__TOIL_MDL_GRD__N_32 FORMAT "%8.3"
 /begin AXIS_DESCR COM_AXIS NO_INPUT_QUANTITY _CNV_A_R_LINEAR_____370_CM 9 -128. 127.996094 FORMAT "%8.3" AXIS_PTS_REF ldp_toil_mdl_grd_toil_add_ofs /end AXIS_DESCR
 /begin AXIS_DESCR COM_AXIS n_32 _CNV_A_R_LINEAR_____81_CM 4 0. 8160. FORMAT "%4.0" AXIS_PTS_REF ldpm_n_32_toil_sub /end AXIS_DESCR
/end CHARACTERISTIC
/begin AXIS_PTS ldp_toil_mdl_grd_toil_add_ofs "" 0x8442d6 NO_INPUT_QUANTITY _REC_AXS_20_u2 255.996094 _CNV_A_R_LINEAR_____370_CM 9 -128. 127.996094 FORMAT "%8.3" /end AXIS_PTS
/begin AXIS_PTS ldpm_n_32_toil_sub "" 0x84440e n_32 _REC_AXS_20_u1 8160. _CNV_A_R_LINEAR_____81_CM 4 0. 8160. FORMAT "%4.0" /end AXIS_PTS
/begin CHARACTERISTIC ip_crlc_toil_mdl_3__n_32 "Wichtungsfaktor TOIL-Berechnung (N)" CURVE 0x845124 _REC_CUR_20_u2_u1 0.9999847412109381 _CNV_A_R_LINEAR_____137_CM 0. 0.9999847412109381 DISPLAY_IDENTIFIER IP_CRLC_TOIL_MDL_3__N_32 FORMAT "%7.5"
 /begin AXIS_DESCR COM_AXIS n_32 _CNV_A_R_LINEAR_____81_CM 4 0. 8160. FORMAT "%4.0" AXIS_PTS_REF ldpm_n_32_toil_sub /end AXIS_DESCR
/end CHARACTERISTIC
/begin CHARACTERISTIC ip_crlc_toil_mdl_2__tco "Wichtungsfaktor TOIL-Berechnung (TCO)" CURVE 0x845112 _REC_CUR_20_u2_u1 0.9999847412109381 _CNV_A_R_LINEAR_____137_CM 0. 0.9999847412109381 DISPLAY_IDENTIFIER IP_CRLC_TOIL_MDL_2__TCO FORMAT "%7.5"
 /begin AXIS_DESCR COM_AXIS tco _CNV_A_R_LINEAR_____241_CM 9 -48. 142.5 FORMAT "%5.1" AXIS_PTS_REF ldp_tco_crlc_toil_mdl_2 /end AXIS_DESCR
/end CHARACTERISTIC
/begin AXIS_PTS ldp_tco_crlc_toil_mdl_2 "" 0x84424f tco _REC_AXS_20_u1 190.5 _CNV_A_R_LINEAR_____241_CM 9 -48. 142.5 FORMAT "%5.1" /end AXIS_PTS
/begin CHARACTERISTIC ip_crlc_toil_mdl_1__vs__tia "Wichtungsfaktor TOIL-Berechnung (VS, TIA)" MAP 0x8450ca _REC_MAP_20_u2_u1_u1 0.9999847412109381 _CNV_A_R_LINEAR_____137_CM 0. 0.9999847412109381 DISPLAY_IDENTIFIER IP_CRLC_TOIL_MDL_1__VS__TIA FORMAT "%7.5"
 /begin AXIS_DESCR COM_AXIS vs _CNV_A_R_LINEAR_____245_CM 6 0. 255. FORMAT "%3.0" AXIS_PTS_REF ldp_vs_crlc_toil_mdl_1 /end AXIS_DESCR
 /begin AXIS_DESCR COM_AXIS tia _CNV_A_R_LINEAR_____241_CM 6 -48. 142.5 FORMAT "%5.1" AXIS_PTS_REF ldp_tia_crlc_toil_mdl_1 /end AXIS_DESCR
/end CHARACTERISTIC
/begin AXIS_PTS ldp_vs_crlc_toil_mdl_1 "" 0x844373 vs _REC_AXS_20_u1 255. _CNV_A_R_LINEAR_____245_CM 6 0. 255. FORMAT "%3.0" /end AXIS_PTS
/begin AXIS_PTS ldp_tia_crlc_toil_mdl_1 "" 0x8442bb tia _REC_AXS_20_u1 190.5 _CNV_A_R_LINEAR_____241_CM 6 -48. 142.5 FORMAT "%5.1" /end AXIS_PTS
/begin CHARACTERISTIC ip_crlc_toil_mdl_4__t_ast__tco "Wichtungsfaktor TOIL-Berechnung (T_AST, TCO)" MAP 0x84512c _REC_MAP_20_u2_u2_u1 0.9999847412109381 _CNV_A_R_LINEAR_____137_CM 0. 0.9999847412109381 DISPLAY_IDENTIFIER IP_CRLC_TOIL_MDL_4__T_AST__TCO FORMAT "%7.5"
 /begin AXIS_DESCR COM_AXIS t_ast _CNV_A_R_LINEAR_____240_CM 6 0.1 6553.5 FORMAT "%6.1" AXIS_PTS_REF ldp_t_ast_crlc_toil_mdl_4 /end AXIS_DESCR
 /begin AXIS_DESCR COM_AXIS tco _CNV_A_R_LINEAR_____241_CM 4 -48. 142.5 FORMAT "%5.1" AXIS_PTS_REF ldp_tco_crlc_toil_mdl_4 /end AXIS_DESCR
/end CHARACTERISTIC
/begin AXIS_PTS ldp_t_ast_crlc_toil_mdl_4 "" 0x844176 t_ast _REC_AXS_20_u2 6553.400000000001 _CNV_A_R_LINEAR_____240_CM 6 0.1 6553.5 FORMAT "%6.1" /end AXIS_PTS
/begin AXIS_PTS ldp_tco_crlc_toil_mdl_4 "" 0x844259 tco _REC_AXS_20_u1 190.5 _CNV_A_R_LINEAR_____241_CM 4 -48. 142.5 FORMAT "%5.1" /end AXIS_PTS
/begin CHARACTERISTIC ip_toil_sub__n_32__maf "Öltemperatur" MAP 0x84f714 _REC_MAP_20_u1_u1_u1 200. _CNV_A_R_LINEAR_____65_CM -40. 160. DISPLAY_IDENTIFIER IP_TOIL_SUB__N_32__MAF FORMAT "%3.0"
 /begin AXIS_DESCR COM_AXIS n_32 _CNV_A_R_LINEAR_____81_CM 4 0. 8160. FORMAT "%4.0" AXIS_PTS_REF ldpm_n_32_toil_sub /end AXIS_DESCR
 /begin AXIS_DESCR COM_AXIS maf_hb _CNV_A_R_LINEAR_____371_CM 4 0. 1389. FORMAT "%4.0" AXIS_PTS_REF ldp_maf_toil_sub /end AXIS_DESCR
/end CHARACTERISTIC
/begin AXIS_PTS ldp_maf_toil_sub "" 0x84403e maf_hb _REC_AXS_20_u1 1389. _CNV_A_R_LINEAR_____371_CM 4 0. 1389. FORMAT "%4.0" /end AXIS_PTS
/begin MEASUREMENT toil_max "maximum oil temperature during driving cycle" UBYTE _CNV_A_R_LINEAR_____65_CM 1 0. -40. 160. DISPLAY_IDENTIFIER TOIL_MAX ECU_ADDRESS 0x7fbb68 FORMAT "%3.0" /end MEASUREMENT
/begin MEASUREMENT toil_sens "oil temperature from sensor" UBYTE _CNV_A_R_LINEAR_____65_CM 1 0. -40. 160. DISPLAY_IDENTIFIER TOIL_SENS ECU_ADDRESS 0x7fbb69 FORMAT "%3.0" /end MEASUREMENT
/begin CHARACTERISTIC lc_var_toil_sens "flag for TOIL-sensor (1 = available)" VALUE 0x85018c _REC_VAL_20_u1 1. _CNV_A_R_LINEAR_____1_CM 0. 1. DISPLAY_IDENTIFIER LC_VAR_TOIL_SENS FORMAT "%1.0" /end CHARACTERISTIC
/begin AXIS_PTS ldp_v_toil_10__toil "" 0x844324 v_toil _REC_AXS_20_u2 4.9951171875 _CNV_A_R_LINEAR_____265_CM 16 0. 4.9951171875 FORMAT "%5.3" /end AXIS_PTS
/begin CHARACTERISTIC ip_toil__v_toil "characteristic line of oil temperature sensor" CURVE 0x84f67e _REC_CUR_20_u1_u2 200. _CNV_A_R_LINEAR_____65_CM -40. 160. DISPLAY_IDENTIFIER IP_TOIL__V_TOIL FORMAT "%3.0"
 /begin AXIS_DESCR COM_AXIS v_toil _CNV_A_R_LINEAR_____265_CM 16 0. 4.9951171875 FORMAT "%5.3" AXIS_PTS_REF ldp_v_toil_10__toil /end AXIS_DESCR
/end CHARACTERISTIC
/begin CHARACTERISTIC c_toil_grd_max "" VALUE 0x850043 _REC_VAL_20_u1 200. _CNV_A_R_LINEAR_____369_CM 0. 200. DISPLAY_IDENTIFIER C_TOIL_GRD_MAX FORMAT "%3.0" /end CHARACTERISTIC
/begin CHARACTERISTIC c_crk_dif_max_er "limitation of adaptation range ( mechanical tolerance)" VALUE 0x85c8f0 _REC_VAL_20_u2 7.8125 _CNV_A_R_LINEAR_____381_CM 0. 7.8125 DISPLAY_IDENTIFIER C_CRK_DIF_MAX_ER FORMAT "%3.2" /end CHARACTERISTIC
/begin CHARACTERISTIC c_n_seg_t_ad_max_er "Maximum engine speed threshold for crankshaft position wheel learning" VALUE 0x85cb40 _REC_VAL_20_u1 8160. _CNV_A_R_LINEAR_____55_CM 0. 8160. DISPLAY_IDENTIFIER C_N_SEG_T_AD_MAX_ER FORMAT "%4.0" /end CHARACTERISTIC
/begin CHARACTERISTIC c_n_seg_t_ad_min_er "Minimum engine speed threshold for crankshaft position wheel learning" VALUE 0x85cb41 _REC_VAL_20_u1 8160. _CNV_A_R_LINEAR_____55_CM 0. 8160. DISPLAY_IDENTIFIER C_N_SEG_T_AD_MIN_ER FORMAT "%4.0" /end CHARACTERISTIC
/begin CHARACTERISTIC c_seg_t_ad_cor_drv1_max_er "Maximum value of dynamic part of engine roughness" VALUE 0x85cb8e _REC_VAL_20_u2 32767. _CNV_A_R_LINEAR_____362_CM 0. 32767. DISPLAY_IDENTIFIER C_SEG_T_AD_COR_DRV1_MAX_ER FORMAT "%5.0" /end CHARACTERISTIC
/begin CHARACTERISTIC c_seg_t_ad_crlc_er "Correlation factor for segment adaptation" VALUE 0x85cb90 _REC_VAL_20_u2 0.9999847412109381 _CNV_A_R_LINEAR_____14_CM 0. 0.9999847412109381 DISPLAY_IDENTIFIER C_SEG_T_AD_CRLC_ER FORMAT "%6.5" /end CHARACTERISTIC
/begin CHARACTERISTIC c_seg_t_fast_ad_crlc_er "correlation factor for segment adaptation fast (only necessary if NC_USE_EXT_ADJ = 1)" VALUE 0x85cb92 _REC_VAL_20_u2 0.9999847412109381 _CNV_A_R_LINEAR_____14_CM 0. 0.9999847412109381 DISPLAY_IDENTIFIER C_SEG_T_FAST_AD_CRLC_ER FORMAT "%6.5" /end CHARACTERISTIC
/begin CHARACTERISTIC c_t_seg_ad_dly "" VALUE 0x85cc98 _REC_VAL_20_u1 25.5 _CNV_A_R_LINEAR_____19_CM 0. 25.5 DISPLAY_IDENTIFIER C_T_SEG_AD_DLY FORMAT "%3.1" /end CHARACTERISTIC
/begin MEASUREMENT drv0_er "static component for engine roughness calvulation update each SEG" SLONG _CNV_A_R_LINEAR_____362_CM 1 0. -2147483648. 2147483647. DISPLAY_IDENTIFIER DRV0_ER ECU_ADDRESS 0x7f865c BYTE_ORDER MSB_LAST FORMAT "%11.0" /end MEASUREMENT
/begin MEASUREMENT drv2_mmv_er "averaged curvature for engine roughness calculation update each SEG" SWORD _CNV_A_R_LINEAR_____362_CM 1 0. -32768. 32767. DISPLAY_IDENTIFIER DRV2_MMV_ER ECU_ADDRESS 0x7f99e0 BYTE_ORDER MSB_LAST FORMAT "%6.0" /end MEASUREMENT
/begin MEASUREMENT er[0] "" SWORD _CNV_A_R_LINEAR_____362_CM 1 0. -32768. 32767. DISPLAY_IDENTIFIER ER_0_ ECU_ADDRESS 0x7f99e8 BYTE_ORDER MSB_LAST FORMAT "%6.0" /end MEASUREMENT
/begin MEASUREMENT er[1] "" SWORD _CNV_A_R_LINEAR_____362_CM 1 0. -32768. 32767. DISPLAY_IDENTIFIER ER_1_ ECU_ADDRESS 0x7f99ea BYTE_ORDER MSB_LAST FORMAT "%6.0" /end MEASUREMENT
/begin MEASUREMENT er[2] "" SWORD _CNV_A_R_LINEAR_____362_CM 1 0. -32768. 32767. DISPLAY_IDENTIFIER ER_2_ ECU_ADDRESS 0x7f99ec BYTE_ORDER MSB_LAST FORMAT "%6.0" /end MEASUREMENT
/begin MEASUREMENT er_av "currently used engine roughness value updated each SEG" SWORD _CNV_A_R_LINEAR_____362_CM 1 0. -32768. 32767. DISPLAY_IDENTIFIER ER_AV ECU_ADDRESS 0x7f99dc BYTE_ORDER MSB_LAST FORMAT "%6.0" /end MEASUREMENT
/begin MEASUREMENT er_rr "currently used engine roughness value without DRV2_MMV_ER, updated each SEG" SWORD _CNV_A_R_LINEAR_____362_CM 1 0. -32768. 32767. DISPLAY_IDENTIFIER ER_RR ECU_ADDRESS 0x7f99e6 BYTE_ORDER MSB_LAST FORMAT "%6.0" /end MEASUREMENT
/begin MEASUREMENT lv_seg_ad_act_state "boolean for state of segment adaptation process (Passive : Active)" UBYTE _CNV_S_2_RANGE______11_CM 1 0. 0. 1. DISPLAY_IDENTIFIER LV_SEG_AD_ACT_STATE ECU_ADDRESS 0x7fb8aa /end MEASUREMENT
/begin MEASUREMENT lv_seg_ad_lim "boolean for segment adaptation values at limit" UBYTE _CNV_S_2_RANGE______11_CM 1 0. 0. 1. DISPLAY_IDENTIFIER LV_SEG_AD_LIM ECU_ADDRESS 0x7fb8a8 /end MEASUREMENT
/begin MEASUREMENT seg_ad_mmv[0] "adaptation values for each segment(x = 0...NC_CYL_NR-1)" SWORD _CNV_A_R_LINEAR_____382_CM 1 0. -7.812507 7.812269 DISPLAY_IDENTIFIER SEG_AD_MMV_0_ ECU_ADDRESS 0x7f99d4 BYTE_ORDER MSB_LAST FORMAT "%7.5" /end MEASUREMENT
/begin MEASUREMENT seg_ad_mmv[1] "adaptation values for each segment(x = 0...NC_CYL_NR-1)" SWORD _CNV_A_R_LINEAR_____382_CM 1 0. -7.812507 7.812269 DISPLAY_IDENTIFIER SEG_AD_MMV_1_ ECU_ADDRESS 0x7f99d6 BYTE_ORDER MSB_LAST FORMAT "%7.5" /end MEASUREMENT
/begin MEASUREMENT seg_ad_mmv[2] "adaptation values for each segment(x = 0...NC_CYL_NR-1)" SWORD _CNV_A_R_LINEAR_____382_CM 1 0. -7.812507 7.812269 DISPLAY_IDENTIFIER SEG_AD_MMV_2_ ECU_ADDRESS 0x7f99d8 BYTE_ORDER MSB_LAST FORMAT "%7.5" /end MEASUREMENT
/begin MEASUREMENT seg_nr_er "segment counter for segment identification (0...NC_CYL_NR - 1)" UBYTE _CNV_A_R_LINEAR_____0_CM 1 0. 0. 30. DISPLAY_IDENTIFIER SEG_NR_ER ECU_ADDRESS 0x7fb8a9 FORMAT "%2.0" /end MEASUREMENT
/begin MEASUREMENT seg_t_cor "corrected, measured segment time, calculated every segment" UWORD _CNV_A_R_LINEAR_____362_CM 1 0. 0. 65535. DISPLAY_IDENTIFIER SEG_T_COR ECU_ADDRESS 0x7f99e4 BYTE_ORDER MSB_LAST FORMAT "%5.0" /end MEASUREMENT
/begin MEASUREMENT seg_t_cor_buf[0] "" UWORD _CNV_A_R_LINEAR_____362_CM 1 0. 0. 65535. DISPLAY_IDENTIFIER SEG_T_COR_BUF_0_ ECU_ADDRESS 0x7f99f0 BYTE_ORDER MSB_LAST FORMAT "%5.0" /end MEASUREMENT
/begin MEASUREMENT seg_t_cor_buf[1] "" UWORD _CNV_A_R_LINEAR_____362_CM 1 0. 0. 65535. DISPLAY_IDENTIFIER SEG_T_COR_BUF_1_ ECU_ADDRESS 0x7f99f2 BYTE_ORDER MSB_LAST FORMAT "%5.0" /end MEASUREMENT
/begin MEASUREMENT seg_t_cor_buf[2] "" UWORD _CNV_A_R_LINEAR_____362_CM 1 0. 0. 65535. DISPLAY_IDENTIFIER SEG_T_COR_BUF_2_ ECU_ADDRESS 0x7f99f4 BYTE_ORDER MSB_LAST FORMAT "%5.0" /end MEASUREMENT
/begin MEASUREMENT seg_t_cor_buf[3] "" UWORD _CNV_A_R_LINEAR_____362_CM 1 0. 0. 65535. DISPLAY_IDENTIFIER SEG_T_COR_BUF_3_ ECU_ADDRESS 0x7f99f6 BYTE_ORDER MSB_LAST FORMAT "%5.0" /end MEASUREMENT
/begin MEASUREMENT seg_t_cor_buf[4] "" UWORD _CNV_A_R_LINEAR_____362_CM 1 0. 0. 65535. DISPLAY_IDENTIFIER SEG_T_COR_BUF_4_ ECU_ADDRESS 0x7f99f8 BYTE_ORDER MSB_LAST FORMAT "%5.0" /end MEASUREMENT
/begin MEASUREMENT seg_t_cor_buf[5] "" UWORD _CNV_A_R_LINEAR_____362_CM 1 0. 0. 65535. DISPLAY_IDENTIFIER SEG_T_COR_BUF_5_ ECU_ADDRESS 0x7f99fa BYTE_ORDER MSB_LAST FORMAT "%5.0" /end MEASUREMENT
/begin AXIS_PTS ldpm_n_32__drv2_er "ER: weighting factor for engine roughness curvature component calculation (correction amount), MT vehicle" 0x842ec0 n_32 _REC_AXS_20_u1 8160. _CNV_A_R_LINEAR_____55_CM 4 0. 8160. FORMAT "%4.0" /end AXIS_PTS
/begin CHARACTERISTIC ip_crlc_drv2_er_mt "ER: correlation coefficient for drv2 MT" CURVE 0x851d2e _REC_CUR_20_u1_u1 0.99609375 _CNV_A_R_LINEAR_____29_CM 0. 0.99609375 DISPLAY_IDENTIFIER IP_CRLC_DRV2_ER_MT FORMAT "%4.3"
 /begin AXIS_DESCR COM_AXIS n_32 _CNV_A_R_LINEAR_____55_CM 4 0. 8160. FORMAT "%4.0" AXIS_PTS_REF ldpm_n_32__drv2_er /end AXIS_DESCR
/end CHARACTERISTIC
/begin CHARACTERISTIC ip_fac_drv2_er_at "ER: weighting factor for engine roughness curvature component calculation (correction amount), AT vehicle" CURVE 0x85240e _REC_CUR_20_u1_u1 3.984375 _CNV_A_R_LINEAR_____95_CM 0. 3.984375 DISPLAY_IDENTIFIER IP_FAC_DRV2_ER_AT FORMAT "%4.3"
 /begin AXIS_DESCR COM_AXIS n_32 _CNV_A_R_LINEAR_____55_CM 4 0. 8160. FORMAT "%4.0" AXIS_PTS_REF ldpm_n_32__drv2_er /end AXIS_DESCR
/end CHARACTERISTIC
/begin CHARACTERISTIC ip_fac_drv2_er_mt "ER: factor for drv2 MT" CURVE 0x852412 _REC_CUR_20_u1_u1 3.984375 _CNV_A_R_LINEAR_____95_CM 0. 3.984375 DISPLAY_IDENTIFIER IP_FAC_DRV2_ER_MT FORMAT "%4.3"
 /begin AXIS_DESCR COM_AXIS n_32 _CNV_A_R_LINEAR_____55_CM 4 0. 8160. FORMAT "%4.0" AXIS_PTS_REF ldpm_n_32__drv2_er /end AXIS_DESCR
/end CHARACTERISTIC
/begin CHARACTERISTIC ip_crlc_drv2_er_at "ER: correlation factor for engine roughness curvature component calculation (correction duration), AT vehicle" CURVE 0x851d2a _REC_CUR_20_u1_u1 0.99609375 _CNV_A_R_LINEAR_____29_CM 0. 0.99609375 DISPLAY_IDENTIFIER IP_CRLC_DRV2_ER_AT FORMAT "%4.3"
 /begin AXIS_DESCR COM_AXIS n_32 _CNV_A_R_LINEAR_____55_CM 4 0. 8160. FORMAT "%4.0" AXIS_PTS_REF ldpm_n_32__drv2_er /end AXIS_DESCR
/end CHARACTERISTIC
/begin MEASUREMENT drv1_er "dynamic component for engine roughness calculation update each SEG" SWORD _CNV_A_R_LINEAR_____362_CM 1 0. -32768. 32767. DISPLAY_IDENTIFIER DRV1_ER ECU_ADDRESS 0x7f99de BYTE_ORDER MSB_LAST FORMAT "%6.0" /end MEASUREMENT
/begin MEASUREMENT iv_off_er "byte buffer that shows the injector status" UBYTE _CNV_A_R_LINEAR_____0_CM 1 0. 0. 255. DISPLAY_IDENTIFIER IV_OFF_ER ECU_ADDRESS 0x7fb8ab FORMAT "%3.0" /end MEASUREMENT
/begin MEASUREMENT lv_inh_seg_ad "boolean for segment time adaptation activation set by project specific conditions" UBYTE _CNV_A_R_LINEAR_____0_CM 1 0. 0. 1. DISPLAY_IDENTIFIER LV_INH_SEG_AD ECU_ADDRESS 0x7fb8ac FORMAT "%1.0" /end MEASUREMENT
/begin MEASUREMENT lv_seg_ad_fdout "boolean for segment time adaptation activation set by DS-specific conditions" UBYTE _CNV_S_2_RANGE______11_CM 1 0. 0. 1. DISPLAY_IDENTIFIER LV_SEG_AD_FDOUT ECU_ADDRESS 0x7fb8ad /end MEASUREMENT
/begin MEASUREMENT maf "total air mass" UWORD _CNV_A_R_LINEAR_____60_CM 1 0. 0. 1389. DISPLAY_IDENTIFIER MAF ECU_ADDRESS 0x7fcd62 BYTE_ORDER MSB_LAST FORMAT "%6.2" /end MEASUREMENT
/begin MEASUREMENT maf_kgh "total mass air flow" UWORD _CNV_A_R_LINEAR_____110_CM 1 0. 0. 1023.984375 DISPLAY_IDENTIFIER MAF_KGH ECU_ADDRESS 0x7fcd66 BYTE_ORDER MSB_LAST FORMAT "%6.2" /end MEASUREMENT
/begin MEASUREMENT maf_kgh_mes "measured total mass air flow" UWORD _CNV_A_R_LINEAR_____110_CM 1 0. 0. 1023.984375 DISPLAY_IDENTIFIER MAF_KGH_MES ECU_ADDRESS 0x7fcd6a BYTE_ORDER MSB_LAST FORMAT "%5.0" /end MEASUREMENT
/begin MEASUREMENT maf_mmv "moving mean value of the global air mass flow MAF" UWORD _CNV_A_R_LINEAR_____60_CM 1 0. 0. 1389. DISPLAY_IDENTIFIER MAF_MMV ECU_ADDRESS 0x7fcd72 BYTE_ORDER MSB_LAST FORMAT "%6.2" /end MEASUREMENT
/begin MEASUREMENT v_maf "mass air flow raw acquisition (1ms recurrence)" UWORD _CNV_A_R_LINEAR_____28_CM 1 0. 0. 4.9951171875 DISPLAY_IDENTIFIER V_MAF ECU_ADDRESS 0x7fcd78 BYTE_ORDER MSB_LAST FORMAT "%3.2" /end MEASUREMENT
/begin MEASUREMENT v_maf_x "" UBYTE _CNV_A_R_LINEAR_____0_CM 1 0. 0. 15. DISPLAY_IDENTIFIER V_MAF_X ECU_ADDRESS 0x7fce52 FORMAT "%2.0" /end MEASUREMENT
/begin MEASUREMENT v_maf_y "" UBYTE _CNV_A_R_LINEAR_____0_CM 1 0. 0. 15. DISPLAY_IDENTIFIER V_MAF_Y ECU_ADDRESS 0x7fce53 FORMAT "%2.0" /end MEASUREMENT
/begin MEASUREMENT lv_maf_0_puls "flag for detection of air mass flow pulsation; j = 0 ... (NC_MAF_NR - 1)" UBYTE _CNV_S_2_RANGE______11_CM 1 0. 0. 1. DISPLAY_IDENTIFIER LV_MAF_0_PULS ECU_ADDRESS 0x7fce58 /end MEASUREMENT
/begin MEASUREMENT maf_0 "air mass; j = 0 ... (NC_MAF_NR - 1)" UWORD _CNV_A_R_LINEAR_____60_CM 1 0. 0. 1389. DISPLAY_IDENTIFIER MAF_0 ECU_ADDRESS 0x7fcd64 BYTE_ORDER MSB_LAST FORMAT "%6.2" /end MEASUREMENT
/begin MEASUREMENT maf_0_kgh "mass air flow; j = 0 ... (NC_MAF_NR - 1)" UWORD _CNV_A_R_LINEAR_____110_CM 1 0. 0. 1023.984375 DISPLAY_IDENTIFIER MAF_0_KGH ECU_ADDRESS 0x7fcd68 BYTE_ORDER MSB_LAST FORMAT "%6.2" /end MEASUREMENT
/begin MEASUREMENT maf_0_kgh_grd "gradient of air mass flow; j = 0 ... (NC_MAF_NR - 1)" SWORD _CNV_A_R_LINEAR_____110_CM 1 0. -512. 511.984375 DISPLAY_IDENTIFIER MAF_0_KGH_GRD ECU_ADDRESS 0x7fcd70 BYTE_ORDER MSB_LAST FORMAT "%6.2" /end MEASUREMENT
/begin MEASUREMENT maf_0_kgh_mes "measured mass air flow; j = 0 ... (NC_MAF_NR - 1)" UWORD _CNV_A_R_LINEAR_____110_CM 1 0. 0. 1023.984375 DISPLAY_IDENTIFIER MAF_0_KGH_MES ECU_ADDRESS 0x7fcd6c BYTE_ORDER MSB_LAST FORMAT "%5.0" /end MEASUREMENT
/begin MEASUREMENT maf_0_kgh_puls "air mass flow pulsation; j = 0 ... (NC_MAF_NR - 1)" UWORD _CNV_A_R_LINEAR_____110_CM 1 0. 0. 1023.984375 DISPLAY_IDENTIFIER MAF_0_KGH_PULS ECU_ADDRESS 0x7fcd76 BYTE_ORDER MSB_LAST FORMAT "%6.2" /end MEASUREMENT
/begin MEASUREMENT maf_0_kgh_sub "substitutional value for MAF_j_KGH; j = 0 ... (NC_MAF_NR - 1)" UWORD _CNV_A_R_LINEAR_____110_CM 1 0. 0. 1023.984375 DISPLAY_IDENTIFIER MAF_0_KGH_SUB ECU_ADDRESS 0x7fcd6e BYTE_ORDER MSB_LAST FORMAT "%5.0" /end MEASUREMENT
/begin MEASUREMENT maf_0_mmv "moving mean value of the air mass flow MAF_j; j = 0 ... (NC_MAF_NR - 1)" UWORD _CNV_A_R_LINEAR_____60_CM 1 0. 0. 1389. DISPLAY_IDENTIFIER MAF_0_MMV ECU_ADDRESS 0x7fcd74 BYTE_ORDER MSB_LAST FORMAT "%6.2" /end MEASUREMENT
/begin CHARACTERISTIC c_ctr_maf_kgh_puls "counter for pulsation detection and reset" VALUE 0x85c961 _REC_VAL_20_u1 15. _CNV_A_R_LINEAR_____0_CM 0. 15. DISPLAY_IDENTIFIER C_CTR_MAF_KGH_PULS FORMAT "%2.0" /end CHARACTERISTIC
/begin CHARACTERISTIC c_n_32_max_puls "maximum engine speed for pulsation detection" VALUE 0x85cafc _REC_VAL_20_u1 8160. _CNV_A_R_LINEAR_____55_CM 0. 8160. DISPLAY_IDENTIFIER C_N_32_MAX_PULS FORMAT "%5.1" /end CHARACTERISTIC
/begin CHARACTERISTIC c_maf_kgh_grd_max_puls "MAF_KGH_GRD threshold for pulsation detection" VALUE 0x85ca98 _REC_VAL_20_s2 1023.984375 _CNV_A_R_LINEAR_____110_CM -512. 511.984375 DISPLAY_IDENTIFIER C_MAF_KGH_GRD_MAX_PULS FORMAT "%7.2" /end CHARACTERISTIC
/begin CHARACTERISTIC c_maf_kgh_puls_hys "MAF_KGH_PULS hysteresis for IP_MAF_KGH_PULS_MAX threshold" VALUE 0x85caa2 _REC_VAL_20_u2 1023.984375 _CNV_A_R_LINEAR_____110_CM 0. 1023.984375 DISPLAY_IDENTIFIER C_MAF_KGH_PULS_HYS FORMAT "%7.2" /end CHARACTERISTIC
/begin CHARACTERISTIC c_thrpwm_max_puls "minimum throttle PWM for pulsation detection" VALUE 0x85cd18 _REC_VAL_20_u2 99.99847412109381 _CNV_A_R_LINEAR_____8_CM 0. 99.99847412109381 DISPLAY_IDENTIFIER C_THRPWM_MAX_PULS FORMAT "%5.3" /end CHARACTERISTIC
/begin CHARACTERISTIC c_t_thrpwm_max_puls "filter time for THRPWM for pulsation detection" VALUE 0x85cc9a _REC_VAL_20_u2 4.19424 _CNV_A_R_LINEAR_____64_CM 0. 4.19424 DISPLAY_IDENTIFIER C_T_THRPWM_MAX_PULS FORMAT "%5.4" /end CHARACTERISTIC
/begin CHARACTERISTIC ip_maf_kgh_puls_max__n_32 "MAF: MAF_KGH_PULS threshold for pulsation detection" CURVE 0x8536f4 _REC_CUR_20_u2_u1 1023.984375 _CNV_A_R_LINEAR_____110_CM 0. 1023.984375 DISPLAY_IDENTIFIER IP_MAF_KGH_PULS_MAX__N_32 FORMAT "%7.3"
 /begin AXIS_DESCR COM_AXIS n_32 _CNV_A_R_LINEAR_____55_CM 6 0. 8160. FORMAT "%4.0" AXIS_PTS_REF ldp_n_32_ip_maf_kgh_puls_max /end AXIS_DESCR
/end CHARACTERISTIC
/begin AXIS_PTS ldp_n_32_ip_maf_kgh_puls_max "MAF: MAF_KGH_PULS threshold for pulsation detection" 0x84190f n_32 _REC_AXS_20_u1 8160. _CNV_A_R_LINEAR_____55_CM 6 0. 8160. FORMAT "%4.0" /end AXIS_PTS
/begin CHARACTERISTIC c_fac_maf_fil "filter factor for MAF_MMV" VALUE 0x85c9ec _REC_VAL_20_u2 0.9999847412109381 _CNV_A_R_LINEAR_____14_CM 0. 0.9999847412109381 DISPLAY_IDENTIFIER C_FAC_MAF_FIL FORMAT "%5.4" /end CHARACTERISTIC
/begin CHARACTERISTIC ip_fac_maf__n_32 "MAF: recovery factor" CURVE 0x852558 _REC_CUR_20_u1_u1 1.9921875 _CNV_A_R_LINEAR_____101_CM 0. 1.9921875 DISPLAY_IDENTIFIER IP_FAC_MAF__N_32 FORMAT "%4.3"
 /begin AXIS_DESCR COM_AXIS n_32 _CNV_A_R_LINEAR_____55_CM 6 0. 8160. FORMAT "%4.0" AXIS_PTS_REF ldp_n_32_ip_fac_maf /end AXIS_DESCR
/end CHARACTERISTIC
/begin AXIS_PTS ldp_n_32_ip_fac_maf "MAF: factor for MAF_CYL_KGH" 0x841908 n_32 _REC_AXS_20_u1 8160. _CNV_A_R_LINEAR_____55_CM 6 0. 8160. FORMAT "%4.0" /end AXIS_PTS
/begin CHARACTERISTIC lc_maf_frq "activation of signal processing for frequency MAF sensor" VALUE 0x85ce88 _REC_VAL_20_u1 1. _CNV_A_R_LINEAR_____0_CM 0. 1. DISPLAY_IDENTIFIER LC_MAF_FRQ FORMAT "%1.0" /end CHARACTERISTIC
/begin CHARACTERISTIC c_tac_sub_diag "Exhaust temperature after catalyst substitute value" VALUE 0x843f3a _REC_VAL_20_u2 1024. _CNV_A_R_LINEAR_____51_CM 0. 1024. DISPLAY_IDENTIFIER C_TAC_SUB_DIAG FORMAT "%6.2" /end CHARACTERISTIC
/begin MEASUREMENT tac_mes "Measured exhaust gas temperature after catalyst" UWORD _CNV_A_R_LINEAR_____51_CM 1 0. 0. 1024. DISPLAY_IDENTIFIER TAC_MES ECU_ADDRESS 0x7fa13c BYTE_ORDER MSB_LAST FORMAT "%6.2" /end MEASUREMENT
/begin MEASUREMENT v_tac "Exhaust gas temperature after catalyst" UWORD _CNV_A_R_LINEAR_____28_CM 1 0. 0. 4.9951171875 DISPLAY_IDENTIFIER V_TAC ECU_ADDRESS 0x7fa13e BYTE_ORDER MSB_LAST FORMAT "%3.2" /end MEASUREMENT
/begin AXIS_PTS ldp_tac_bas_ip_tac_mes "TAC sensor map" 0x842232 v_tac _REC_AXS_20_u2 4.9951171875 _CNV_A_R_LINEAR_____28_CM 16 0. 4.9951171875 FORMAT "%3.2" /end AXIS_PTS
/begin CHARACTERISTIC ip_tac_mes__tac_bas "TAC Exhaust gas temperature" CURVE 0x85b0b6 _REC_CUR_20_u2_u2 1024. _CNV_A_R_LINEAR_____51_CM 0. 1024. DISPLAY_IDENTIFIER IP_TAC_MES__TAC_BAS FORMAT "%6.2"
 /begin AXIS_DESCR COM_AXIS v_tac _CNV_A_R_LINEAR_____28_CM 16 0. 4.9951171875 FORMAT "%3.2" AXIS_PTS_REF ldp_tac_bas_ip_tac_mes /end AXIS_DESCR
/end CHARACTERISTIC
/begin MEASUREMENT tac "Exhaust gas temperature after catalyst" UWORD _CNV_A_R_LINEAR_____51_CM 1 0. 0. 1024. DISPLAY_IDENTIFIER TAC ECU_ADDRESS 0x7fa13a BYTE_ORDER MSB_LAST FORMAT "%6.2" /end MEASUREMENT
/begin MEASUREMENT tia "Intake air temperature" UBYTE _CNV_A_R_LINEAR_____18_CM 1 0. -50. 205. DISPLAY_IDENTIFIER TIA ECU_ADDRESS 0x7fbb66 FORMAT "%3.0" /end MEASUREMENT
/begin MEASUREMENT v_toil "oil temperature (voltage)" UBYTE _CNV_A_R_LINEAR_____368_CM 1 0. 0. 4.98046875 DISPLAY_IDENTIFIER V_TOIL ECU_ADDRESS 0x7fbb7d FORMAT "%3.1" /end MEASUREMENT
/begin MEASUREMENT ang_bpa[0] "valve opening" SWORD _CNV_A_R_LINEAR_____12_CM 1 0. -100. 99.996948242 DISPLAY_IDENTIFIER ANG_BPA_0_ ECU_ADDRESS 0x7fa146 BYTE_ORDER MSB_LAST FORMAT "%5.3" /end MEASUREMENT
/begin MEASUREMENT v_bpa[0] "boost pressure actuator position ( j=0..NC_BPA_NR-1 )" UWORD _CNV_A_R_LINEAR_____28_CM 1 0. 0. 4.9951171875 DISPLAY_IDENTIFIER V_BPA_0_ ECU_ADDRESS 0x7fa148 BYTE_ORDER MSB_LAST FORMAT "%4.3" /end MEASUREMENT
/begin MEASUREMENT v_bpa_mes[0] "measured boost pressure actuator position ( j=0..NC_BPA_NR-1 )" UWORD _CNV_A_R_LINEAR_____28_CM 1 0. 0. 4.9951171875 DISPLAY_IDENTIFIER V_BPA_MES_0_ ECU_ADDRESS 0x7fa14a BYTE_ORDER MSB_LAST FORMAT "%4.3" /end MEASUREMENT
/begin CHARACTERISTIC lc_v_bpa_bol_man[0] "" VALUE 0x85cec5 _REC_VAL_20_u1 1. _CNV_A_R_LINEAR_____0_CM 0. 1. DISPLAY_IDENTIFIER LC_V_BPA_BOL_MAN_0_ FORMAT "%1.0" /end CHARACTERISTIC
/begin CHARACTERISTIC c_v_bpa_bol_man[0] "" VALUE 0x85cd4e _REC_VAL_20_u2 319.995172 _CNV_A_R_LINEAR_____415_CM 0. 319.995172 DISPLAY_IDENTIFIER C_V_BPA_BOL_MAN_0_ /end CHARACTERISTIC
/begin CHARACTERISTIC c_ang_bpa_tol[0] "" VALUE 0x85c880 _REC_VAL_20_s2 399.99389 _CNV_A_R_LINEAR_____402_CM -200. 199.99389 DISPLAY_IDENTIFIER C_ANG_BPA_TOL_0_ /end CHARACTERISTIC
/begin CHARACTERISTIC c_ang_bpa_bol[0] "" VALUE 0x85c87e _REC_VAL_20_s2 399.99389 _CNV_A_R_LINEAR_____402_CM -200. 199.99389 DISPLAY_IDENTIFIER C_ANG_BPA_BOL_0_ /end CHARACTERISTIC
/begin CHARACTERISTIC lc_v_bpa_dif_bol_tol_man[0] "" VALUE 0x85cec7 _REC_VAL_20_u1 1. _CNV_A_R_LINEAR_____0_CM 0. 1. DISPLAY_IDENTIFIER LC_V_BPA_DIF_BOL_TOL_MAN_0_ FORMAT "%1.0" /end CHARACTERISTIC
/begin CHARACTERISTIC c_v_bpa_dif_bol_tol_man[0] "" VALUE 0x85cd52 _REC_VAL_20_u2 319.995172 _CNV_A_R_LINEAR_____415_CM 0. 319.995172 DISPLAY_IDENTIFIER C_V_BPA_DIF_BOL_TOL_MAN_0_ /end CHARACTERISTIC
/begin CHARACTERISTIC c_v_bpa_sub_diag "BPA position substitute value" VALUE 0x85cd60 _REC_VAL_20_u2 4.9951171875 _CNV_A_R_LINEAR_____28_CM 0. 4.9951171875 DISPLAY_IDENTIFIER C_V_BPA_SUB_DIAG FORMAT "%4.3" /end CHARACTERISTIC
/begin MEASUREMENT ang_egrv[0] "valve opening" SWORD _CNV_A_R_LINEAR_____12_CM 1 0. -100. 99.996948242 DISPLAY_IDENTIFIER ANG_EGRV_0_ ECU_ADDRESS 0x7fa140 BYTE_ORDER MSB_LAST FORMAT "%5.3" /end MEASUREMENT
/begin MEASUREMENT v_egrv[0] "EGR valve position for valve j ( j=0..NC_EGRV_NR-1 )" UWORD _CNV_A_R_LINEAR_____28_CM 1 0. 0. 4.9951171875 DISPLAY_IDENTIFIER V_EGRV_0_ ECU_ADDRESS 0x7fa142 BYTE_ORDER MSB_LAST FORMAT "%4.3" /end MEASUREMENT
/begin MEASUREMENT v_egrv_mes[0] "measured EGR valve position for valve j ( j=0..NC_EGRV_NR-1 )" UWORD _CNV_A_R_LINEAR_____28_CM 1 0. 0. 4.9951171875 DISPLAY_IDENTIFIER V_EGRV_MES_0_ ECU_ADDRESS 0x7fa144 BYTE_ORDER MSB_LAST FORMAT "%4.3" /end MEASUREMENT
/begin CHARACTERISTIC lc_v_egrv_bol_man[0] "" VALUE 0x85cec9 _REC_VAL_20_u1 1. _CNV_A_R_LINEAR_____0_CM 0. 1. DISPLAY_IDENTIFIER LC_V_EGRV_BOL_MAN_0_ FORMAT "%1.0" /end CHARACTERISTIC
/begin CHARACTERISTIC c_v_egrv_bol_man[0] "" VALUE 0x85cd74 _REC_VAL_20_u2 319.995172 _CNV_A_R_LINEAR_____415_CM 0. 319.995172 DISPLAY_IDENTIFIER C_V_EGRV_BOL_MAN_0_ /end CHARACTERISTIC
/begin CHARACTERISTIC c_v_egrv_dif_bol_tol_man[0] "" VALUE 0x85cd78 _REC_VAL_20_u2 319.995172 _CNV_A_R_LINEAR_____415_CM 0. 319.995172 DISPLAY_IDENTIFIER C_V_EGRV_DIF_BOL_TOL_MAN_0_ /end CHARACTERISTIC
/begin CHARACTERISTIC lc_v_egrv_dif_bol_tol_man[0] "" VALUE 0x85cecb _REC_VAL_20_u1 1. _CNV_A_R_LINEAR_____0_CM 0. 1. DISPLAY_IDENTIFIER LC_V_EGRV_DIF_BOL_TOL_MAN_0_ FORMAT "%1.0" /end CHARACTERISTIC
/begin CHARACTERISTIC c_ang_egrv_tol[0] "" VALUE 0x85c884 _REC_VAL_20_s2 399.99389 _CNV_A_R_LINEAR_____402_CM -200. 199.99389 DISPLAY_IDENTIFIER C_ANG_EGRV_TOL_0_ /end CHARACTERISTIC
/begin CHARACTERISTIC c_ang_egrv_bol[0] "" VALUE 0x85c882 _REC_VAL_20_s2 399.99389 _CNV_A_R_LINEAR_____402_CM -200. 199.99389 DISPLAY_IDENTIFIER C_ANG_EGRV_BOL_0_ /end CHARACTERISTIC
/begin CHARACTERISTIC c_v_egrv_sub_diag "EGRV position substitute value" VALUE 0x85cd8c _REC_VAL_20_u2 4.9951171875 _CNV_A_R_LINEAR_____28_CM 0. 4.9951171875 DISPLAY_IDENTIFIER C_V_EGRV_SUB_DIAG FORMAT "%4.3" /end CHARACTERISTIC
/begin MEASUREMENT lv_tcu1_can_vld "logische Variable fuer erkannte gueltige Botschaft TCU1" UBYTE _CNV_S_2_RANGE__0___85_CM 1 0. 0. 1. DISPLAY_IDENTIFIER LV_TCU1_CAN_VLD ECU_ADDRESS 0x7fb750 BIT_MASK 0x1 /end MEASUREMENT
/begin MEASUREMENT lv_gs_act "logische Variable fuer Schaltung aktiv" UBYTE _CNV_S_2_RANGE__0___85_CM 1 0. 0. 1. DISPLAY_IDENTIFIER LV_GS_ACT ECU_ADDRESS 0x7fb751 BIT_MASK 0x1 /end MEASUREMENT
/begin MEASUREMENT lv_tqi_gs_fast_dec_inh "Logische Variable fuer Unterdrueckung der Zuendwinkelruecknahme waehrend aktiver Schaltung" UBYTE _CNV_S_2_RANGE__0___85_CM 1 0. 0. 1. DISPLAY_IDENTIFIER LV_TQI_GS_FAST_DEC_INH ECU_ADDRESS 0x7fb752 BIT_MASK 0x1 /end MEASUREMENT
/begin MEASUREMENT lv_acc_off_can_tcu1 "logische Variable fuer Anforderung der Abschaltung Klimakompressor" UBYTE _CNV_S_2_RANGE__0___85_CM 1 0. 0. 1. DISPLAY_IDENTIFIER LV_ACC_OFF_CAN_TCU1 ECU_ADDRESS 0x7fb753 BIT_MASK 0x1 /end MEASUREMENT
/begin MEASUREMENT state_cc "Zustand Wandlerkupplung" UBYTE _CNV_S_4_STATE_CC_R_430_CM 1 0. 0. 3. DISPLAY_IDENTIFIER STATE_CC ECU_ADDRESS 0x7fb747 /end MEASUREMENT
/begin MEASUREMENT lv_n_sp_is_tcu_ena "Logische Variable fuer Anforderung der Anhebung der Leerlaufsolldrehzahl durch Getriebe" UBYTE _CNV_S_2_RANGE__0___85_CM 1 0. 0. 1. DISPLAY_IDENTIFIER LV_N_SP_IS_TCU_ENA ECU_ADDRESS 0x7fb754 BIT_MASK 0x1 /end MEASUREMENT
/begin MEASUREMENT lv_gs_req "logische Variable fuer Schaltanforderung (Byte 3 wird gueltig)" UBYTE _CNV_S_2_RANGE__0___85_CM 1 0. 0. 1. DISPLAY_IDENTIFIER LV_GS_REQ ECU_ADDRESS 0x7fb755 BIT_MASK 0x1 /end MEASUREMENT
/begin MEASUREMENT gear_can "Zielgang oder eingelegter Gang" UBYTE _CNV_S_12_GEAR_CAN_R_431_CM 1 0. 0. 15. DISPLAY_IDENTIFIER GEAR_CAN ECU_ADDRESS 0x7fb748 /end MEASUREMENT
/begin MEASUREMENT sel_psn "Waehlhebelposition" UBYTE _CNV_S_16_SEL_PSN_RA_432_CM 1 0. 0. 15. DISPLAY_IDENTIFIER SEL_PSN ECU_ADDRESS 0x7fb749 /end MEASUREMENT
/begin MEASUREMENT gear_ratio_tcu1 "Uebertragungsfunktion NRad / NKurbelwelle" UBYTE _CNV_A_R_LINEAR_____263_CM 1 0. 0. 25.5 DISPLAY_IDENTIFIER GEAR_RATIO_TCU1 ECU_ADDRESS 0x7fb74a FORMAT "%4.1" /end MEASUREMENT
/begin MEASUREMENT tqi_gs_req_can "inneres Sollmotormoment (normiert auf C_TQI_STDN)" UBYTE _CNV_A_R_LINEAR_____433_CM 1 0. 0. 99.45 DISPLAY_IDENTIFIER TQI_GS_REQ_CAN ECU_ADDRESS 0x7fb74d FORMAT "%4.1" /end MEASUREMENT
/begin MEASUREMENT tqi_gs_req "inneres Sollmotormoment" SWORD _CNV_A_R_LINEAR_____52_CM 1 0. 0. 1023.96875 DISPLAY_IDENTIFIER TQI_GS_REQ ECU_ADDRESS 0x7f97fa BYTE_ORDER MSB_LAST FORMAT "%7.2" /end MEASUREMENT
/begin MEASUREMENT cool_req_tcu_can "Kuehlleistungsanforderung Getriebesteuergeraet" UBYTE _CNV_A_R_LINEAR_____1_CM 1 0. 0. 255. DISPLAY_IDENTIFIER COOL_REQ_TCU_CAN ECU_ADDRESS 0x7fb74b FORMAT "%3.0" /end MEASUREMENT
/begin MEASUREMENT lv_mil_on_can "OBD-Status (geforderte Aktivierung OBD-Fehlerlampe)" UBYTE _CNV_S_2_RANGE__0___85_CM 1 0. 0. 1. DISPLAY_IDENTIFIER LV_MIL_ON_CAN ECU_ADDRESS 0x7fb756 BIT_MASK 0x1 /end MEASUREMENT
/begin MEASUREMENT lv_mil_on_tcu1 "OBD- Bit Getriebesteuergeraetes (geforderte Aktivierung OBD-Fehlerlampe)" UBYTE _CNV_S_2_RANGE__0___85_CM 1 0. 0. 1. DISPLAY_IDENTIFIER LV_MIL_ON_TCU1 ECU_ADDRESS 0x7fb757 BIT_MASK 0x1 /end MEASUREMENT
/begin MEASUREMENT tq_loss_tcu1_can "Belastungsmoment durch Gertriebe (normiert auf C_TQI_STND)" UBYTE _CNV_A_R_LINEAR_____433_CM 1 0. 0. 99.45 DISPLAY_IDENTIFIER TQ_LOSS_TCU1_CAN ECU_ADDRESS 0x7fbd93 FORMAT "%4.1" /end MEASUREMENT
/begin MEASUREMENT tq_loss_tcu1 "Belastungsmoment durch Getriebe" SWORD _CNV_A_R_LINEAR_____52_CM 1 0. 0. 1023.96875 DISPLAY_IDENTIFIER TQ_LOSS_TCU1 ECU_ADDRESS 0x7f97fc BYTE_ORDER MSB_LAST FORMAT "%7.2" /end MEASUREMENT
/begin MEASUREMENT tcu1_msg_ctr "Botschaftszaehler zur Lebenderkennung der TCU1-Botschaft" UBYTE _CNV_A_R_LINEAR_____1_CM 1 0. 0. 255. DISPLAY_IDENTIFIER TCU1_MSG_CTR ECU_ADDRESS 0x7fb74f FORMAT "%3.0" /end MEASUREMENT
/begin MEASUREMENT state_mil_on_tcu1 "OBD- Status des Getriebesteuergeraetes (geforderte Aktivierung OBD- Fehlerlampe)" UBYTE _CNV_S_4_STATE_MIL__434_CM 1 0. 0. 3. DISPLAY_IDENTIFIER STATE_MIL_ON_TCU1 ECU_ADDRESS 0x7fb74c /end MEASUREMENT
/begin MEASUREMENT drg_tcu "Fahrwiderstandsindex, normiert auf % Steigung am Berg" UBYTE _CNV_A_R_LINEAR_____332_CM 1 0. -31.623 31.872 DISPLAY_IDENTIFIER DRG_TCU ECU_ADDRESS 0x7fb74e FORMAT "%5.1" /end MEASUREMENT
/begin MEASUREMENT drg_tcu_can "CAN-Botschaft Fahrwiderstandsindex, inclusive Fehlerfall" UBYTE _CNV_A_R_LINEAR_____332_CM 1 0. -31.623 31.872 DISPLAY_IDENTIFIER DRG_TCU_CAN ECU_ADDRESS 0x7fbd94 FORMAT "%5.1" /end MEASUREMENT
/begin MEASUREMENT lv_err_ctr_msg_tcu1 "logische Variable fuer Fehler Botschaftszaehler" UBYTE _CNV_S_2_RANGE__0___85_CM 1 0. 0. 1. DISPLAY_IDENTIFIER LV_ERR_CTR_MSG_TCU1 ECU_ADDRESS 0x7fb758 BIT_MASK 0x1 /end MEASUREMENT
/begin MEASUREMENT lv_tcu2_can_vld "logische Variable fuer erkannte gueltige Botschaft TCU2" UBYTE _CNV_S_2_RANGE__0___85_CM 1 0. 0. 1. DISPLAY_IDENTIFIER LV_TCU2_CAN_VLD ECU_ADDRESS 0x7fb759 BIT_MASK 0x1 /end MEASUREMENT
/begin MEASUREMENT lv_is_ad_inh_tcu2 "Logische Variable zur Sperrung der Leerlauffuellungsadaption" UBYTE _CNV_S_2_RANGE__0___85_CM 1 0. 0. 1. DISPLAY_IDENTIFIER LV_IS_AD_INH_TCU2 ECU_ADDRESS 0x7fb75a BIT_MASK 0x1 /end MEASUREMENT
/begin MEASUREMENT lv_req_puc_deac_tcu2 "Logische Variable zum Verlassen des Motorbetriebszustandes PUC" UBYTE _CNV_S_2_RANGE__0___85_CM 1 0. 0. 1. DISPLAY_IDENTIFIER LV_REQ_PUC_DEAC_TCU2 ECU_ADDRESS 0x7fb75b BIT_MASK 0x1 /end MEASUREMENT
/begin MEASUREMENT tcu2_msg_ctr "Botschaftszaehler zur Lebenderkennung der TCU2-Botschaft" UBYTE _CNV_A_R_LINEAR_____1_CM 1 0. 0. 255. DISPLAY_IDENTIFIER TCU2_MSG_CTR ECU_ADDRESS 0x7fb75d FORMAT "%3.0" /end MEASUREMENT
/begin MEASUREMENT n_sp_is_tcu2 "Leerlaufwunschsolldrehzahl vom Getriebe" UWORD _CNV_A_R_LINEAR_____154_CM 1 0. 0. 8160. DISPLAY_IDENTIFIER N_SP_IS_TCU2 ECU_ADDRESS 0x7f97fe BYTE_ORDER MSB_LAST FORMAT "%4.0" /end MEASUREMENT
/begin MEASUREMENT tq_dif_tra_max "Maximaler Gradient des Motordrehmomentes fuer Teillastanfahrten" UBYTE _CNV_A_R_LINEAR_____435_CM 1 0. 0. 2550. DISPLAY_IDENTIFIER TQ_DIF_TRA_MAX ECU_ADDRESS 0x7fb75e FORMAT "%4.0" /end MEASUREMENT
/begin MEASUREMENT lv_n_tcu_req "Zwischengasflag" UBYTE _CNV_S_2_RANGE__0___85_CM 1 0. 0. 1. DISPLAY_IDENTIFIER LV_N_TCU_REQ ECU_ADDRESS 0x7fb764 BIT_MASK 0x1 /end MEASUREMENT
/begin MEASUREMENT n_tcu_req "Synchronisations-Wunschdrehzahl" UBYTE _CNV_A_R_LINEAR_____436_CM 1 0. 0. 6375. DISPLAY_IDENTIFIER N_TCU_REQ ECU_ADDRESS 0x7fb761 FORMAT "%4.0" /end MEASUREMENT
/begin MEASUREMENT n_tcu_req_ivs "Synchronisations-Wunschdrehzahl (aus bitinvertierter Uebertragung)" UBYTE _CNV_A_R_LINEAR_____436_CM 1 0. 0. 6375. DISPLAY_IDENTIFIER N_TCU_REQ_IVS ECU_ADDRESS 0x7fb762 FORMAT "%4.0" /end MEASUREMENT
/begin MEASUREMENT t_n_tcu_req "Synchronisationszeit" UBYTE _CNV_A_R_LINEAR_____437_CM 1 0. 0. 5100. DISPLAY_IDENTIFIER T_N_TCU_REQ ECU_ADDRESS 0x7fb763 FORMAT "%4.0" /end MEASUREMENT
/begin MEASUREMENT lv_err_ctr_msg_tcu2 "logische Variable fuer Fehler Botschaftszaehler" UBYTE _CNV_S_2_RANGE__0___85_CM 1 0. 0. 1. DISPLAY_IDENTIFIER LV_ERR_CTR_MSG_TCU2 ECU_ADDRESS 0x7fb75c BIT_MASK 0x1 /end MEASUREMENT
/begin MEASUREMENT lv_tcu_cod_vld "Getriebekodierung ist im Motorsteuergeraet in Ordnung" UBYTE _CNV_S_2_RANGE__0___85_CM 1 0. 0. 1. DISPLAY_IDENTIFIER LV_TCU_COD_VLD ECU_ADDRESS 0x7fb760 BIT_MASK 0x1 /end MEASUREMENT
/begin MEASUREMENT tcu_lih_can "Getriebenotlauf" UBYTE _CNV_A_R_LINEAR_____0_CM 1 0. 0. 15. DISPLAY_IDENTIFIER TCU_LIH_CAN ECU_ADDRESS 0x7fb75f FORMAT "%2.0" /end MEASUREMENT
/begin MEASUREMENT lv_ac1_can_vld "logische Variable fuer erkannte gueltige Botschaft AC1" UBYTE _CNV_S_2_RANGE__0___85_CM 1 0. 0. 1. DISPLAY_IDENTIFIER LV_AC1_CAN_VLD ECU_ADDRESS 0x7fb707 BIT_MASK 0x1 /end MEASUREMENT
/begin MEASUREMENT lv_acin_can "logische Variable fuer Klimabereitschaft" UBYTE _CNV_S_2_RANGE__0___85_CM 1 0. 0. 1. DISPLAY_IDENTIFIER LV_ACIN_CAN ECU_ADDRESS 0x7fb708 BIT_MASK 0x1 /end MEASUREMENT
/begin MEASUREMENT lv_accin_on_can "logische Variable fuer Kompressorzustand (beim Klimahalbautomat AC-Schalter)" UBYTE _CNV_S_2_RANGE__0___85_CM 1 0. 0. 1. DISPLAY_IDENTIFIER LV_ACCIN_ON_CAN ECU_ADDRESS 0x7fb709 BIT_MASK 0x1 /end MEASUREMENT
/begin MEASUREMENT acp_can "Klimadrucksignal" UBYTE _CNV_A_R_LINEAR_____438_CM 1 0. 0. 51. DISPLAY_IDENTIFIER ACP_CAN ECU_ADDRESS 0x7fb703 FORMAT "%4.1" /end MEASUREMENT
/begin MEASUREMENT tq_acc_can "Kompressorlast" UBYTE _CNV_A_R_LINEAR_____90_CM 1 0. 0. 63.75 DISPLAY_IDENTIFIER TQ_ACC_CAN ECU_ADDRESS 0x7fb704 FORMAT "%4.1" /end MEASUREMENT
/begin MEASUREMENT lv_ac_sw_can "Logische Variable fuer AC-Schalter Klimahalbautomat" UBYTE _CNV_S_2_RANGE__0___85_CM 1 0. 0. 1. DISPLAY_IDENTIFIER LV_AC_SW_CAN ECU_ADDRESS 0x7fb70a BIT_MASK 0x1 /end MEASUREMENT
/begin MEASUREMENT ecf_req_ac_can "Forderung Kuehlerluefteransteuerung" UBYTE _CNV_A_R_LINEAR_____79_CM 1 0. 0. 99.609375 DISPLAY_IDENTIFIER ECF_REQ_AC_CAN ECU_ADDRESS 0x7fb705 FORMAT "%4.1" /end MEASUREMENT
/begin MEASUREMENT lv_ecf_req_ac_can_err "Fehlerflag Kuehlerluefteransteuerung" UBYTE _CNV_S_2_RANGE__0___85_CM 1 0. 0. 1. DISPLAY_IDENTIFIER LV_ECF_REQ_AC_CAN_ERR ECU_ADDRESS 0x7fb70b BIT_MASK 0x1 /end MEASUREMENT
/begin MEASUREMENT state_ich "Zustand Standheizung" UBYTE _CNV_S_3_STATE_ICH__439_CM 1 0. 0. 2. DISPLAY_IDENTIFIER STATE_ICH ECU_ADDRESS 0x7fb706 /end MEASUREMENT
/begin MEASUREMENT lv_req_heat_can "Fahrerwunsch Zuheizer" UBYTE _CNV_S_2_RANGE__0___85_CM 1 0. 0. 1. DISPLAY_IDENTIFIER LV_REQ_HEAT_CAN ECU_ADDRESS 0x7fb70c BIT_MASK 0x1 /end MEASUREMENT
/begin MEASUREMENT lv_st_req_can "logische variable for Startanforderung (Klemme 50)" UBYTE _CNV_S_2_RANGE__0___85_CM 1 0. 0. 1. DISPLAY_IDENTIFIER LV_ST_REQ_CAN ECU_ADDRESS 0x7fb7c2 BIT_MASK 0x1 /end MEASUREMENT
/begin MEASUREMENT lv_eilu_can_vld "logische variable for erkannte gueltige botschaft vom ZAS1/ EILU " UBYTE _CNV_S_2_RANGE__0___85_CM 1 0. 0. 1. DISPLAY_IDENTIFIER LV_EILU_CAN_VLD ECU_ADDRESS 0x7fb7c1 BIT_MASK 0x1 /end MEASUREMENT
/begin MEASUREMENT lv_igk_can "Zuendung ein (Klemme 15)" UBYTE _CNV_S_2_RANGE__0___85_CM 1 0. 0. 1. DISPLAY_IDENTIFIER LV_IGK_CAN ECU_ADDRESS 0x7fb7c3 BIT_MASK 0x1 /end MEASUREMENT
/begin CHARACTERISTIC c_can_vers "CAN-Version" VALUE 0x84fbe1 _REC_VAL_20_u1 36. _CNV_S_17_CAN_VERS_R_440_CM 9. 45. DISPLAY_IDENTIFIER C_CAN_VERS /end CHARACTERISTIC
/begin CHARACTERISTIC c_eng_typ_2 "Motorkodierung" VALUE 0x84fce9 _REC_VAL_20_u1 63. _CNV_A_R_LINEAR_____1_CM 0. 63. DISPLAY_IDENTIFIER C_ENG_TYP_2 FORMAT "%3.0" /end CHARACTERISTIC
/begin CHARACTERISTIC c_tqi_stnd "Standardisierungsmoment fuer CAN-Botschaften" VALUE 0x85007c _REC_VAL_20_u2 1023.96875 _CNV_A_R_LINEAR_____52_CM 0. 1023.96875 DISPLAY_IDENTIFIER C_TQI_STND FORMAT "%7.2" /end CHARACTERISTIC
/begin CHARACTERISTIC c_n_tqi_tol "Drehzahl bei max. Motormoment" VALUE 0x84fe32 _REC_VAL_20_u1 6300. _CNV_A_R_LINEAR_____441_CM 0. 6300. DISPLAY_IDENTIFIER C_N_TQI_TOL FORMAT "%4.0" /end CHARACTERISTIC
/begin CHARACTERISTIC c_tqi_tol "maximales Motormoment bei C_N_TQI_TOL" VALUE 0x85007e _REC_VAL_20_u1 630. _CNV_A_R_LINEAR_____442_CM 0. 630. DISPLAY_IDENTIFIER C_TQI_TOL FORMAT "%3.0" /end CHARACTERISTIC
/begin CHARACTERISTIC c_eng_typ "Motortyp" VALUE 0x84fce8 _REC_VAL_20_u1 3. _CNV_A_R_LINEAR_____1_CM 0. 3. DISPLAY_IDENTIFIER C_ENG_TYP FORMAT "%3.0" /end CHARACTERISTIC
/begin CHARACTERISTIC c_eg_typ_ems5 "Abgastyp" VALUE 0x84fccc _REC_VAL_20_u1 31. _CNV_A_R_LINEAR_____1_CM 0. 31. DISPLAY_IDENTIFIER C_EG_TYP_EMS5 FORMAT "%3.0" /end CHARACTERISTIC
/begin MEASUREMENT lv_toil_max_can "Logische Variable fuer Motortemperatur ueber Sollwert" UBYTE _CNV_S_2_RANGE__0___85_CM 1 0. 0. 1. DISPLAY_IDENTIFIER LV_TOIL_MAX_CAN ECU_ADDRESS 0x7fbd8f BIT_MASK 0x1 /end MEASUREMENT
/begin CHARACTERISTIC c_eng_pow "Motorleistung" VALUE 0x84fce6 _REC_VAL_20_u2 511. _CNV_A_R_LINEAR_____443_CM 0. 511. DISPLAY_IDENTIFIER C_ENG_POW FORMAT "%3.0" /end CHARACTERISTIC
/begin CHARACTERISTIC c_num_valve "Anzahl Ventile / Zylinder" VALUE 0x84feb0 _REC_VAL_20_u1 7. _CNV_A_R_LINEAR_____1_CM 0. 7. DISPLAY_IDENTIFIER C_NUM_VALVE FORMAT "%3.0" /end CHARACTERISTIC
/begin CHARACTERISTIC c_eng_vol "Hubraum" VALUE 0x84fcea _REC_VAL_20_u1 12.7 _CNV_A_R_LINEAR_____444_CM 0. 12.7 DISPLAY_IDENTIFIER C_ENG_VOL FORMAT "%4.1" /end CHARACTERISTIC
/begin CHARACTERISTIC c_oil_ofs_warn "Oelwarnschwelle Offset" VALUE 0x84feba _REC_VAL_20_u1 630. _CNV_A_R_LINEAR_____445_CM 0. 630. DISPLAY_IDENTIFIER C_OIL_OFS_WARN FORMAT "%3.0" /end CHARACTERISTIC
/begin CHARACTERISTIC c_oil_tol_warn "Oelwarnschwelle Tolerenz" VALUE 0x84febc _REC_VAL_20_u1 630. _CNV_A_R_LINEAR_____445_CM 0. 630. DISPLAY_IDENTIFIER C_OIL_TOL_WARN FORMAT "%3.0" /end CHARACTERISTIC
/begin CHARACTERISTIC c_km_min_asa "Minimale Kilometerzahl bis zum Service" VALUE 0x84fd6f _REC_VAL_20_u1 127000. _CNV_A_R_LINEAR_____446_CM 0. 127000. DISPLAY_IDENTIFIER C_KM_MIN_ASA FORMAT "%5.4" /end CHARACTERISTIC
/begin CHARACTERISTIC c_km_max_asa "Maximale Kilometerzahl bis zum Service" VALUE 0x84fd6e _REC_VAL_20_u1 127000. _CNV_A_R_LINEAR_____446_CM 0. 127000. DISPLAY_IDENTIFIER C_KM_MAX_ASA FORMAT "%5.4" /end CHARACTERISTIC
/begin CHARACTERISTIC c_ctr_min_oil "minimale geforderte Anzahl Mittlungen fuer Oelstandsdifferenzauswertung" VALUE 0x84fc05 _REC_VAL_20_u1 7500. _CNV_A_R_LINEAR_____447_CM 0. 7500. DISPLAY_IDENTIFIER C_CTR_MIN_OIL FORMAT "%4.0" /end CHARACTERISTIC
/begin CHARACTERISTIC c_t_min_asa "Minimales Zeitintervall bis zum Service" VALUE 0x84ffd2 _REC_VAL_20_u1 63. _CNV_A_R_LINEAR_____448_CM 0. 63. DISPLAY_IDENTIFIER C_T_MIN_ASA FORMAT "%2.0" /end CHARACTERISTIC
/begin CHARACTERISTIC c_t_max_asa "Maximales Zeitintervall bis zum Service" VALUE 0x84ffb9 _REC_VAL_20_u1 63. _CNV_A_R_LINEAR_____448_CM 0. 63. DISPLAY_IDENTIFIER C_T_MAX_ASA FORMAT "%2.0" /end CHARACTERISTIC
/begin CHARACTERISTIC c_km_min_oil "Minimal geforderte Strecke fuer Oelstandsauswertung" VALUE 0x84fd70 _REC_VAL_20_u1 375. _CNV_A_R_LINEAR_____449_CM 0. 375. DISPLAY_IDENTIFIER C_KM_MIN_OIL FORMAT "%4.0" /end CHARACTERISTIC
/begin CHARACTERISTIC c_oil_max_thd "Schwellwert fuer Maximum Oelstand" VALUE 0x84feb9 _REC_VAL_20_u1 3100. _CNV_A_R_LINEAR_____450_CM 0. 3100. DISPLAY_IDENTIFIER C_OIL_MAX_THD FORMAT "%5.0" /end CHARACTERISTIC
/begin CHARACTERISTIC c_oil_max_ofs "Maximum Offset" VALUE 0x84feb7 _REC_VAL_20_u1 750. _CNV_A_R_LINEAR_____451_CM 0. 750. DISPLAY_IDENTIFIER C_OIL_MAX_OFS FORMAT "%5.0" /end CHARACTERISTIC
/begin CHARACTERISTIC c_oil_max_over_hys "Ueberfuellungsschwellen Hysterese" VALUE 0x84feb8 _REC_VAL_20_u1 750. _CNV_A_R_LINEAR_____451_CM 0. 750. DISPLAY_IDENTIFIER C_OIL_MAX_OVER_HYS FORMAT "%5.0" /end CHARACTERISTIC
/begin CHARACTERISTIC c_oil_ctr_fast "Anz. Mittlung schneller Oelfuellstandmittelwert" VALUE 0x84feb4 _REC_VAL_20_u1 1500. _CNV_A_R_LINEAR_____452_CM 0. 1500. DISPLAY_IDENTIFIER C_OIL_CTR_FAST FORMAT "%5.0" /end CHARACTERISTIC
/begin CHARACTERISTIC lc_oil_max_det "Ueberfuellungserkennung aktiv" VALUE 0x850160 _REC_VAL_20_u1 1. _CNV_A_R_LINEAR_____1_CM 0. 1. DISPLAY_IDENTIFIER LC_OIL_MAX_DET FORMAT "%1.0" /end CHARACTERISTIC
/begin CHARACTERISTIC lc_n_ems_can_sel "Schalter fuer Drehzahlausgabe N_EMS1" VALUE 0x85015d _REC_VAL_20_u1 1. _CNV_A_R_LINEAR_____1_CM 0. 1. DISPLAY_IDENTIFIER LC_N_EMS_CAN_SEL FORMAT "%1.0" /end CHARACTERISTIC
/begin CHARACTERISTIC c_diam_whl "Durchmesser Reifen" VALUE 0x84fc08 _REC_VAL_20_u2 2.0475 _CNV_A_R_LINEAR_____453_CM 0. 2.0475 DISPLAY_IDENTIFIER C_DIAM_WHL FORMAT "%7.5" /end CHARACTERISTIC
/begin MEASUREMENT tqi_int_fb_tcu_intv "Rueckmeldung Momentenintegral Getriebeeingriff" UBYTE _CNV_A_R_LINEAR_____79_CM 1 0. 0. 99.609375 DISPLAY_IDENTIFIER TQI_INT_FB_TCU_INTV ECU_ADDRESS 0x7fbd8e FORMAT "%4.1" /end MEASUREMENT
/begin MEASUREMENT lv_frs_err_can "logische Variable fuer Fehlerstatus Tank" UBYTE _CNV_S_2_RANGE__0___85_CM 1 0. 0. 1. DISPLAY_IDENTIFIER LV_FRS_ERR_CAN ECU_ADDRESS 0x7fb739 BIT_MASK 0x1 /end MEASUREMENT
/begin MEASUREMENT lv_frs_can "Tankwarnung" UBYTE _CNV_S_2_RANGE__0___85_CM 1 0. 0. 1. DISPLAY_IDENTIFIER LV_FRS_CAN ECU_ADDRESS 0x7fb73a BIT_MASK 0x1 /end MEASUREMENT
/begin MEASUREMENT vs_icl1 "ermittelte Geschwindigkeit des Kombisteuergeraetes" UWORD _CNV_A_R_LINEAR_____71_CM 1 0. 0. 327.67 DISPLAY_IDENTIFIER VS_ICL1 ECU_ADDRESS 0x7f97f6 BYTE_ORDER MSB_LAST FORMAT "%6.2" /end MEASUREMENT
/begin MEASUREMENT lv_vs_icl1_vld "logische Variable fuer erkannte gueltige Geschwindigkeit" UBYTE _CNV_S_2_RANGE__0___85_CM 1 0. 0. 1. DISPLAY_IDENTIFIER LV_VS_ICL1_VLD ECU_ADDRESS 0x7fb73b BIT_MASK 0x1 /end MEASUREMENT
/begin MEASUREMENT lv_icl2_can_vld "logische Variable fuer erkannte gueltige Botschaft ICL2" UBYTE _CNV_S_2_RANGE__0___85_CM 1 0. 0. 1. DISPLAY_IDENTIFIER LV_ICL2_CAN_VLD ECU_ADDRESS 0x7fb742 BIT_MASK 0x1 /end MEASUREMENT
/begin MEASUREMENT lv_tam_err_can "logische Variable fuer Fehlerstatus Aussentemperatur" UBYTE _CNV_S_2_RANGE__0___85_CM 1 0. 0. 1. DISPLAY_IDENTIFIER LV_TAM_ERR_CAN ECU_ADDRESS 0x7fb73e BIT_MASK 0x1 /end MEASUREMENT
/begin MEASUREMENT tam_fil_can "Gefilterte Aussentemperatur" UBYTE _CNV_A_R_LINEAR_____257_CM 1 0. -48. 142.5 DISPLAY_IDENTIFIER TAM_FIL_CAN ECU_ADDRESS 0x7fb73c FORMAT "%6.2" /end MEASUREMENT
/begin MEASUREMENT tam_can "ungefilterte Aussentemperatur" UBYTE _CNV_A_R_LINEAR_____257_CM 1 0. -48. 142.5 DISPLAY_IDENTIFIER TAM_CAN ECU_ADDRESS 0x7fb73d FORMAT "%6.2" /end MEASUREMENT
/begin MEASUREMENT lv_icl3_can_vld "logische Variable fuer erkannte gueltige Botschaft ICL3" UBYTE _CNV_S_2_RANGE__0___85_CM 1 0. 0. 1. DISPLAY_IDENTIFIER LV_ICL3_CAN_VLD ECU_ADDRESS 0x7fb743 BIT_MASK 0x1 /end MEASUREMENT
/begin MEASUREMENT t_last_dc_can "Standzeit" UWORD _CNV_A_R_LINEAR_____454_CM 1 0. 0. 131068. DISPLAY_IDENTIFIER T_LAST_DC_CAN ECU_ADDRESS 0x7f97f8 BYTE_ORDER MSB_LAST FORMAT "%6.0" /end MEASUREMENT
/begin MEASUREMENT ctr_km_can "km-Zaehler" ULONG _CNV_A_R_LINEAR_____455_CM 1 0. 0. 1000000. DISPLAY_IDENTIFIER CTR_KM_CAN ECU_ADDRESS 0x7f8658 BYTE_ORDER MSB_LAST FORMAT "%7.0" /end MEASUREMENT
/begin MEASUREMENT lv_icl1_can_vld "logische Variable fuer erkannte gueltige Botschaft ICL1" UBYTE _CNV_S_2_RANGE__0___85_CM 1 0. 0. 1. DISPLAY_IDENTIFIER LV_ICL1_CAN_VLD ECU_ADDRESS 0x7fb741 BIT_MASK 0x1 /end MEASUREMENT
/begin MEASUREMENT lv_frs_wal_can "Tankwarnlampe" UBYTE _CNV_S_2_RANGE__0___85_CM 1 0. 0. 1. DISPLAY_IDENTIFIER LV_FRS_WAL_CAN ECU_ADDRESS 0x7fb745 BIT_MASK 0x1 /end MEASUREMENT
/begin MEASUREMENT lv_gll_fb_can "Rueckmeldeinformation der Vorgluehlampe" UBYTE _CNV_S_2_RANGE__0___85_CM 1 0. 0. 1. DISPLAY_IDENTIFIER LV_GLL_FB_CAN ECU_ADDRESS 0x7fb746 BIT_MASK 0x1 /end MEASUREMENT
/begin MEASUREMENT ftl_can "Tankinhalt" UBYTE _CNV_A_R_LINEAR_____0_CM 1 0. 0. 127. DISPLAY_IDENTIFIER FTL_CAN ECU_ADDRESS 0x7fb744 FORMAT "%3.0" /end MEASUREMENT
/begin MEASUREMENT lv_tog_act "logische Variable fuer TOG nicht verbaut (Roh-Information)" UBYTE _CNV_S_2_RANGE__0___85_CM 1 0. 0. 1. DISPLAY_IDENTIFIER LV_TOG_ACT ECU_ADDRESS 0x7fb73f BIT_MASK 0x1 /end MEASUREMENT
/begin MEASUREMENT lv_tog_pres "logische Variable fuer TOG verbaut" UBYTE _CNV_S_2_RANGE__0___85_CM 1 0. 0. 1. DISPLAY_IDENTIFIER LV_TOG_PRES ECU_ADDRESS 0x7fb740 BIT_MASK 0x1 /end MEASUREMENT
/begin MEASUREMENT lv_tcs1_can_vld "logische Variable fuer erkannte gueltige Botschaft TCS1" UBYTE _CNV_S_2_RANGE__0___85_CM 1 0. 0. 1. DISPLAY_IDENTIFIER LV_TCS1_CAN_VLD ECU_ADDRESS 0x7fb714 BIT_MASK 0x1 /end MEASUREMENT
/begin MEASUREMENT lv_asr_req "logische Variable fuer ASR-Anforderung" UBYTE _CNV_S_2_RANGE__0___85_CM 1 0. 0. 1. DISPLAY_IDENTIFIER LV_ASR_REQ ECU_ADDRESS 0x7fb715 BIT_MASK 0x1 /end MEASUREMENT
/begin MEASUREMENT lv_msr_req "logische Variable fuer MSR-Anforderung" UBYTE _CNV_S_2_RANGE__0___85_CM 1 0. 0. 1. DISPLAY_IDENTIFIER LV_MSR_REQ ECU_ADDRESS 0x7fb716 BIT_MASK 0x1 /end MEASUREMENT
/begin MEASUREMENT lv_abs_req "logische Variable fuer ABS-Bremsung" UBYTE _CNV_S_2_RANGE__0___85_CM 1 0. 0. 1. DISPLAY_IDENTIFIER LV_ABS_REQ ECU_ADDRESS 0x7fb717 BIT_MASK 0x1 /end MEASUREMENT
/begin MEASUREMENT lv_esp_req "logische Variable fuer EPS-Eingriff" UBYTE _CNV_S_2_RANGE__0___85_CM 1 0. 0. 1. DISPLAY_IDENTIFIER LV_ESP_REQ ECU_ADDRESS 0x7fb718 BIT_MASK 0x1 /end MEASUREMENT
/begin MEASUREMENT lv_bls_tcs "\"Fahrer bremst\" - Information" UBYTE _CNV_S_2_RANGE__0___85_CM 1 0. 0. 1. DISPLAY_IDENTIFIER LV_BLS_TCS ECU_ADDRESS 0x7fb719 BIT_MASK 0x1 /end MEASUREMENT
/begin MEASUREMENT lv_bkv_state_can "Status des aktiven Bremskraftverstaerkers" UBYTE _CNV_S_2_RANGE__0___85_CM 1 0. 0. 1. DISPLAY_IDENTIFIER LV_BKV_STATE_CAN ECU_ADDRESS 0x7fb71a BIT_MASK 0x1 /end MEASUREMENT
/begin MEASUREMENT lv_rr_can "Information fuer Schlechtwegausblendung" UBYTE _CNV_S_2_RANGE__0___85_CM 1 0. 0. 1. DISPLAY_IDENTIFIER LV_RR_CAN ECU_ADDRESS 0x7fb71b BIT_MASK 0x1 /end MEASUREMENT
/begin MEASUREMENT lv_rr_err_can "Fehlerstatus Schlechtwegausblendung" UBYTE _CNV_S_2_RANGE__0___85_CM 1 0. 0. 1. DISPLAY_IDENTIFIER LV_RR_ERR_CAN ECU_ADDRESS 0x7fb71c BIT_MASK 0x1 /end MEASUREMENT
/begin MEASUREMENT lv_esp_err_can "Fehlerstatus ESP" UBYTE _CNV_S_2_RANGE__0___85_CM 1 0. 0. 1. DISPLAY_IDENTIFIER LV_ESP_ERR_CAN ECU_ADDRESS 0x7fb723 BIT_MASK 0x1 /end MEASUREMENT
/begin MEASUREMENT lv_bkv_can "aktiver Bremskraftverstaerker" UBYTE _CNV_S_2_RANGE__0___85_CM 1 0. 0. 1. DISPLAY_IDENTIFIER LV_BKV_CAN ECU_ADDRESS 0x7fb71d BIT_MASK 0x1 /end MEASUREMENT
/begin MEASUREMENT vs_tcs1 "ermittelte Geschwindigkeit des ABS-Steuergeraetes" UWORD _CNV_A_R_LINEAR_____71_CM 1 0. 0. 327.67 DISPLAY_IDENTIFIER VS_TCS1 ECU_ADDRESS 0x7f97e2 BYTE_ORDER MSB_LAST FORMAT "%6.2" /end MEASUREMENT
/begin MEASUREMENT state_vs_tcs1 "Statusregister TCS-Geschwindigkeit" UBYTE _CNV_S_5_STATE_VS_T_456_CM 1 0. 0. 8. DISPLAY_IDENTIFIER STATE_VS_TCS1 ECU_ADDRESS 0x7fb724 /end MEASUREMENT
/begin MEASUREMENT tqi_asr_req_slow_can "ASR-Eingriffsmoment (langsamer Pfad, normiert auf C_TQI_STND)" UBYTE _CNV_A_R_LINEAR_____433_CM 1 0. 0. 99.45 DISPLAY_IDENTIFIER TQI_ASR_REQ_SLOW_CAN ECU_ADDRESS 0x7fb71e FORMAT "%4.1" /end MEASUREMENT
/begin MEASUREMENT tqi_asr_req_slow "ASR-Eingriffsmoment (langsamer Pfad)" UWORD _CNV_A_R_LINEAR_____52_CM 1 0. 0. 1023.96875 DISPLAY_IDENTIFIER TQI_ASR_REQ_SLOW ECU_ADDRESS 0x7f97e4 BYTE_ORDER MSB_LAST FORMAT "%7.2" /end MEASUREMENT
/begin MEASUREMENT tqi_asr_req_fast_can "ASR-Eingriffsmoment (schneller Pfad, normiert auf C_TQI_STND)" UBYTE _CNV_A_R_LINEAR_____433_CM 1 0. 0. 99.45 DISPLAY_IDENTIFIER TQI_ASR_REQ_FAST_CAN ECU_ADDRESS 0x7fb71f FORMAT "%4.1" /end MEASUREMENT
/begin MEASUREMENT tqi_asr_req_fast "ASR-Eingriffsmoment (schneller Pfad)" UWORD _CNV_A_R_LINEAR_____52_CM 1 0. 0. 1023.96875 DISPLAY_IDENTIFIER TQI_ASR_REQ_FAST ECU_ADDRESS 0x7f97e6 BYTE_ORDER MSB_LAST FORMAT "%7.2" /end MEASUREMENT
/begin MEASUREMENT tqi_msr_req_can "MSR-Eingriffsmoment (normiert auf C_TQI_STND)" UBYTE _CNV_A_R_LINEAR_____433_CM 1 0. 0. 99.45 DISPLAY_IDENTIFIER TQI_MSR_REQ_CAN ECU_ADDRESS 0x7fb720 FORMAT "%4.1" /end MEASUREMENT
/begin MEASUREMENT tqi_msr_req "MSR-Eingriffsmoment" UWORD _CNV_A_R_LINEAR_____52_CM 1 0. 0. 1023.96875 DISPLAY_IDENTIFIER TQI_MSR_REQ ECU_ADDRESS 0x7f97e8 BYTE_ORDER MSB_LAST FORMAT "%7.2" /end MEASUREMENT
/begin MEASUREMENT tcs1_msg_ctr "Botschaftszaehler" UBYTE _CNV_A_R_LINEAR_____1_CM 1 0. 0. 255. DISPLAY_IDENTIFIER TCS1_MSG_CTR ECU_ADDRESS 0x7fb721 FORMAT "%3.0" /end MEASUREMENT
/begin MEASUREMENT lv_sub_vs_tcs1 "logische Variable fuer Geschwindigkeit aus Ersatzwert" UBYTE _CNV_S_2_RANGE__0___85_CM 1 0. 0. 1. DISPLAY_IDENTIFIER LV_SUB_VS_TCS1 ECU_ADDRESS 0x7fb722 BIT_MASK 0x1 /end MEASUREMENT
/begin MEASUREMENT lv_err_ctr_msg_tcs1 "Fehlerbit Botschaftszaehler" UBYTE _CNV_S_2_RANGE__0___85_CM 1 0. 0. 1. DISPLAY_IDENTIFIER LV_ERR_CTR_MSG_TCS1 ECU_ADDRESS 0x7fb713 BIT_MASK 0x1 /end MEASUREMENT
/begin MEASUREMENT lv_tcs2_can_vld "Logische Variable fuer erkannte gueltige Botschaft TCS2" UBYTE _CNV_S_2_RANGE__0___85_CM 1 0. 0. 1. DISPLAY_IDENTIFIER LV_TCS2_CAN_VLD ECU_ADDRESS 0x7fb727 BIT_MASK 0x1 /end MEASUREMENT
/begin MEASUREMENT ac_trv_tcs2 "Querbeschleunigung" UBYTE _CNV_A_R_LINEAR_____457_CM 1 0. -12.7 12.8 DISPLAY_IDENTIFIER AC_TRV_TCS2 ECU_ADDRESS 0x7fb725 FORMAT "%5.1" /end MEASUREMENT
/begin MEASUREMENT lv_ac_trv_tcs2_act "Logische Variable fuer Uebertragung der Querbeschleunigung in Byte 0" UBYTE _CNV_S_2_RANGE__0___85_CM 1 0. 0. 1. DISPLAY_IDENTIFIER LV_AC_TRV_TCS2_ACT ECU_ADDRESS 0x7fb726 BIT_MASK 0x1 /end MEASUREMENT
/begin MEASUREMENT lv_tcs3_can_vld "Logische Variable fuer erkannte gueltige Botschaft TCS3" UBYTE _CNV_S_2_RANGE__0___85_CM 1 0. 0. 1. DISPLAY_IDENTIFIER LV_TCS3_CAN_VLD ECU_ADDRESS 0x7fb728 BIT_MASK 0x1 /end MEASUREMENT
/begin MEASUREMENT can_wheel_fn_ri "Radgeschwindigkeit vorne-rechts" UWORD _CNV_A_R_LINEAR_____71_CM 1 0. 0. 327.67 DISPLAY_IDENTIFIER CAN_WHEEL_FN_RI ECU_ADDRESS 0x7f97ea BYTE_ORDER MSB_LAST FORMAT "%6.2" /end MEASUREMENT
/begin MEASUREMENT can_wheel_fn_le "Radgeschwindigkeit vorne-links" UWORD _CNV_A_R_LINEAR_____71_CM 1 0. 0. 327.67 DISPLAY_IDENTIFIER CAN_WHEEL_FN_LE ECU_ADDRESS 0x7f97ec BYTE_ORDER MSB_LAST FORMAT "%6.2" /end MEASUREMENT
/begin MEASUREMENT can_wheel_re_ri "Radgeschwindigkeit hinten-rechts" UWORD _CNV_A_R_LINEAR_____71_CM 1 0. 0. 327.67 DISPLAY_IDENTIFIER CAN_WHEEL_RE_RI ECU_ADDRESS 0x7f97ee BYTE_ORDER MSB_LAST FORMAT "%6.2" /end MEASUREMENT
/begin MEASUREMENT can_wheel_re_le "Radgeschwindigkeit hinten-links" UWORD _CNV_A_R_LINEAR_____71_CM 1 0. 0. 327.67 DISPLAY_IDENTIFIER CAN_WHEEL_RE_LE ECU_ADDRESS 0x7f97f0 BYTE_ORDER MSB_LAST FORMAT "%6.2" /end MEASUREMENT
/begin MEASUREMENT lv_err_cks_tcs4_can_diag "Fehlerbit Checksummenfehler fuer CAN-Diagnose Irreversible" UBYTE _CNV_S_2_RANGE__0___85_CM 1 0. 0. 1. DISPLAY_IDENTIFIER LV_ERR_CKS_TCS4_CAN_DIAG ECU_ADDRESS 0x7fb72a BIT_MASK 0x1 /end MEASUREMENT
/begin MEASUREMENT state_thd_dep "Unterdruckschwellwert" UBYTE _CNV_S_4_STATE_THD__458_CM 1 0. 0. 3. DISPLAY_IDENTIFIER STATE_THD_DEP ECU_ADDRESS 0x7fb72f /end MEASUREMENT
/begin MEASUREMENT dep_abs "Bremskraftverstaerker Unterdruck" UBYTE _CNV_A_R_LINEAR_____459_CM 1 0. 0. 1020. DISPLAY_IDENTIFIER DEP_ABS ECU_ADDRESS 0x7fb730 FORMAT "%4.0" /end MEASUREMENT
/begin MEASUREMENT lv_tcs4_can_vld "Logische Variable fuer erkannte gueltige Botschaft TCS3" UBYTE _CNV_S_2_RANGE__0___85_CM 1 0. 0. 1. DISPLAY_IDENTIFIER LV_TCS4_CAN_VLD ECU_ADDRESS 0x7fb72e BIT_MASK 0x1 /end MEASUREMENT
/begin MEASUREMENT lv_err_ctr_msg_tcs4 "Fehlerbit Botschaftszaehler" UBYTE _CNV_S_2_RANGE__0___85_CM 1 0. 0. 1. DISPLAY_IDENTIFIER LV_ERR_CTR_MSG_TCS4 ECU_ADDRESS 0x7fb72c BIT_MASK 0x1 /end MEASUREMENT
/begin MEASUREMENT lv_var_bsup_ext_save "Fehlerbit Botschaftszaehler" UBYTE _CNV_S_2_RANGE__0___85_CM 1 0. 0. 1. DISPLAY_IDENTIFIER LV_VAR_BSUP_EXT_SAVE ECU_ADDRESS 0x7fb72d BIT_MASK 0x1 /end MEASUREMENT
/begin MEASUREMENT lv_err_cks_tcs4_can "Fehlerbit Checksummenfehler fuer CAN-Diagnose" UBYTE _CNV_S_2_RANGE__0___85_CM 1 0. 0. 1. DISPLAY_IDENTIFIER LV_ERR_CKS_TCS4_CAN ECU_ADDRESS 0x7fb72b BIT_MASK 0x1 /end MEASUREMENT
/begin MEASUREMENT lv_tcs8_can_vld "logische Variable fuer erkannte gueltige Botschaft TCS8" UBYTE _CNV_S_2_RANGE__0___85_CM 1 0. 0. 1. DISPLAY_IDENTIFIER LV_TCS8_CAN_VLD ECU_ADDRESS 0x7fb731 BIT_MASK 0x1 /end MEASUREMENT
/begin MEASUREMENT lv_err_ctr_msg_tcs8 "Fehlerbit Botschaftszaehler" UBYTE _CNV_S_2_RANGE__0___85_CM 1 0. 0. 1. DISPLAY_IDENTIFIER LV_ERR_CTR_MSG_TCS8 ECU_ADDRESS 0x7fb732 BIT_MASK 0x1 /end MEASUREMENT
/begin MEASUREMENT lv_err_cks_tcs8_can "Fehlerbit Checksummenfehler" UBYTE _CNV_S_2_RANGE__0___85_CM 1 0. 0. 1. DISPLAY_IDENTIFIER LV_ERR_CKS_TCS8_CAN ECU_ADDRESS 0x7fb733 BIT_MASK 0x1 /end MEASUREMENT
/begin MEASUREMENT lv_dcc_tcs_req_can "Bit ACC-Anforderung" UBYTE _CNV_S_2_RANGE__0___85_CM 1 0. 0. 1. DISPLAY_IDENTIFIER LV_DCC_TCS_REQ_CAN ECU_ADDRESS 0x7fb734 BIT_MASK 0x1 /end MEASUREMENT
/begin MEASUREMENT lv_brake_temp_max_can "Bit Bremsentemperatur zu hoch" UBYTE _CNV_S_2_RANGE__0___85_CM 1 0. 0. 1. DISPLAY_IDENTIFIER LV_BRAKE_TEMP_MAX_CAN ECU_ADDRESS 0x7fb735 BIT_MASK 0x1 /end MEASUREMENT
/begin MEASUREMENT lv_dcc_msg_not_ok "Bit ACC-Botschaft nicht konsistent" UBYTE _CNV_S_2_RANGE__0___85_CM 1 0. 0. 1. DISPLAY_IDENTIFIER LV_DCC_MSG_NOT_OK ECU_ADDRESS 0x7fb736 BIT_MASK 0x1 /end MEASUREMENT
/begin MEASUREMENT lv_dece_ctl_ems_err_can "Statusbit Verzoegerungsregler" UBYTE _CNV_S_2_RANGE__0___85_CM 1 0. 0. 1. DISPLAY_IDENTIFIER LV_DECE_CTL_EMS_ERR_CAN ECU_ADDRESS 0x7fb737 BIT_MASK 0x1 /end MEASUREMENT
/begin MEASUREMENT lv_err_cks_tcs8_can_diag "Fehlerbit Checksummenfehler Irreversible" UBYTE _CNV_S_2_RANGE__0___85_CM 1 0. 0. 1. DISPLAY_IDENTIFIER LV_ERR_CKS_TCS8_CAN_DIAG ECU_ADDRESS 0x7fb738 BIT_MASK 0x1 /end MEASUREMENT
/begin MEASUREMENT ac_lgt_tcs8_can "Laengsbeschleunigung" UWORD _CNV_A_R_LINEAR_____460_CM 1 0. -16. 15.96875 DISPLAY_IDENTIFIER AC_LGT_TCS8_CAN ECU_ADDRESS 0x7f97f4 BYTE_ORDER MSB_LAST FORMAT "%6.2" /end MEASUREMENT
/begin CHARACTERISTIC c_t_pas_can_tcs4 "Zeit nach Initialisierung, nach der die Auswertung der TCS4-Botschaft beginnt" VALUE 0x84ffde _REC_VAL_20_u1 2.55 _CNV_A_R_LINEAR_____111_CM 0. 2.55 DISPLAY_IDENTIFIER C_T_PAS_CAN_TCS4 FORMAT "%4.2" /end CHARACTERISTIC
/begin MEASUREMENT lv_tog1_can_vld "TOG-Botschaft gueltig" UBYTE _CNV_S_2_RANGE__0___85_CM 1 0. 0. 1. DISPLAY_IDENTIFIER LV_TOG1_CAN_VLD ECU_ADDRESS 0x7fb790 BIT_MASK 0x1 /end MEASUREMENT
/begin MEASUREMENT tog1_msg_ctr "Botschaftszaehler der TOG1- Botschaft fuer Lebenderkennung" UBYTE _CNV_A_R_LINEAR_____1_CM 1 0. 0. 255. DISPLAY_IDENTIFIER TOG1_MSG_CTR ECU_ADDRESS 0x7fb78f FORMAT "%3.0" /end MEASUREMENT
/begin MEASUREMENT t_oil_level1_can "Fuellstandszeit 1" UWORD _CNV_A_R_LINEAR_____295_CM 1 0. 100. 1123.5 DISPLAY_IDENTIFIER T_OIL_LEVEL1_CAN ECU_ADDRESS 0x7f9804 BYTE_ORDER MSB_LAST FORMAT "%6.4" /end MEASUREMENT
/begin MEASUREMENT t_oil_level2_can "Fuellstandszeit 2" UWORD _CNV_A_R_LINEAR_____295_CM 1 0. 100. 1123.5 DISPLAY_IDENTIFIER T_OIL_LEVEL2_CAN ECU_ADDRESS 0x7f9806 BYTE_ORDER MSB_LAST FORMAT "%6.4" /end MEASUREMENT
/begin MEASUREMENT t_oil_level3_can "Fuellstandszeit 3" UWORD _CNV_A_R_LINEAR_____295_CM 1 0. 100. 1123.5 DISPLAY_IDENTIFIER T_OIL_LEVEL3_CAN ECU_ADDRESS 0x7f9808 BYTE_ORDER MSB_LAST FORMAT "%6.4" /end MEASUREMENT
/begin MEASUREMENT t_oil_level4_can "Fuellstandszeit 4" UWORD _CNV_A_R_LINEAR_____295_CM 1 0. 100. 1123.5 DISPLAY_IDENTIFIER T_OIL_LEVEL4_CAN ECU_ADDRESS 0x7f980a BYTE_ORDER MSB_LAST FORMAT "%6.4" /end MEASUREMENT
/begin MEASUREMENT t_toil_can "Oeltemperaturzeit" UWORD _CNV_A_R_LINEAR_____305_CM 1 0. 0. 127.875 DISPLAY_IDENTIFIER T_TOIL_CAN ECU_ADDRESS 0x7f980c BYTE_ORDER MSB_LAST FORMAT "%7.3" /end MEASUREMENT
/begin MEASUREMENT lv_tog_err_can "Logische Variable fuer Sensorfehler TOG" UBYTE _CNV_S_2_RANGE__0___85_CM 1 0. 0. 1. DISPLAY_IDENTIFIER LV_TOG_ERR_CAN ECU_ADDRESS 0x7fb791 BIT_MASK 0x1 /end MEASUREMENT
/begin MEASUREMENT lv_oil_level_ofs_warn "Logische Variable fuer \"Oelwarnschwelle plus Offset ueberschritten\"" UBYTE _CNV_S_2_RANGE__0___85_CM 1 0. 0. 1. DISPLAY_IDENTIFIER LV_OIL_LEVEL_OFS_WARN ECU_ADDRESS 0x7fb792 BIT_MASK 0x1 /end MEASUREMENT
/begin MEASUREMENT lv_oil_level_tol_warn "Logische Variable fuer \"Oelwarnschwelle minus Toleranz unterschritten\"" UBYTE _CNV_S_2_RANGE__0___85_CM 1 0. 0. 1. DISPLAY_IDENTIFIER LV_OIL_LEVEL_TOL_WARN ECU_ADDRESS 0x7fb793 BIT_MASK 0x1 /end MEASUREMENT
/begin MEASUREMENT lv_oil_level_max_warn "Maximum Oelfuellstand ueberschritten" UBYTE _CNV_S_2_RANGE__0___85_CM 1 0. 0. 1. DISPLAY_IDENTIFIER LV_OIL_LEVEL_MAX_WARN ECU_ADDRESS 0x7fb795 BIT_MASK 0x1 /end MEASUREMENT
/begin MEASUREMENT lv_oil_level_max_tol_warn "Maximum Oelfuellstand plus Offset ueberschritten" UBYTE _CNV_S_2_RANGE__0___85_CM 1 0. 0. 1. DISPLAY_IDENTIFIER LV_OIL_LEVEL_MAX_TOL_WARN ECU_ADDRESS 0x7fb796 BIT_MASK 0x1 /end MEASUREMENT
/begin MEASUREMENT lv_oil_level_up_warn "Oelwarnschwelle ueberschritten" UBYTE _CNV_S_2_RANGE__0___85_CM 1 0. 0. 1. DISPLAY_IDENTIFIER LV_OIL_LEVEL_UP_WARN ECU_ADDRESS 0x7fb794 BIT_MASK 0x1 /end MEASUREMENT
/begin MEASUREMENT lv_err_ctr_msg_tog1 "Fehler Botschaftszaehler" UBYTE _CNV_S_2_RANGE__0___85_CM 1 0. 0. 1. DISPLAY_IDENTIFIER LV_ERR_CTR_MSG_TOG1 ECU_ADDRESS 0x7fb797 BIT_MASK 0x1 /end MEASUREMENT
/begin MEASUREMENT lv_vecu1_can_vld "logische Variable fuer erkannte gueltige Botschaft VECU1" UBYTE _CNV_S_2_RANGE__0___85_CM 1 0. 0. 1. DISPLAY_IDENTIFIER LV_VECU1_CAN_VLD ECU_ADDRESS 0x7fb769 BIT_MASK 0x1 /end MEASUREMENT
/begin MEASUREMENT lv_acc_off_can_vecu1 "logische Variable fuer Anforderung der Abschaltung Klimakompressor" UBYTE _CNV_S_2_RANGE__0___85_CM 1 0. 0. 1. DISPLAY_IDENTIFIER LV_ACC_OFF_CAN_VECU1 ECU_ADDRESS 0x7fb767 BIT_MASK 0x1 /end MEASUREMENT
/begin MEASUREMENT lv_n_sp_is_add_can_2 "logische Variable fuer aktive Forderung der Erhoehung der Leerlaufsolldrehzahl Stufe 2" UBYTE _CNV_S_2_RANGE__0___85_CM 1 0. 0. 1. DISPLAY_IDENTIFIER LV_N_SP_IS_ADD_CAN_2 ECU_ADDRESS 0x7fb766 BIT_MASK 0x1 /end MEASUREMENT
/begin MEASUREMENT lv_ecfpwm_max_vecu "logische Variable fuer aktive Forderung zur maximalen Ansteuerung der Kuehlerluefter" UBYTE _CNV_S_2_RANGE__0___85_CM 1 0. 0. 1. DISPLAY_IDENTIFIER LV_ECFPWM_MAX_VECU ECU_ADDRESS 0x7fb768 BIT_MASK 0x1 /end MEASUREMENT
/begin MEASUREMENT lv_igk_vecu_can "ZAS Klemme 15" UBYTE _CNV_S_2_RANGE__0___85_CM 1 0. 0. 1. DISPLAY_IDENTIFIER LV_IGK_VECU_CAN ECU_ADDRESS 0x7fb76a BIT_MASK 0x1 /end MEASUREMENT
/begin MEASUREMENT lv_igk_mot_vecu_can "Klemme 15 Motorraum" UBYTE _CNV_S_2_RANGE__0___85_CM 1 0. 0. 1. DISPLAY_IDENTIFIER LV_IGK_MOT_VECU_CAN ECU_ADDRESS 0x7fb76b BIT_MASK 0x1 /end MEASUREMENT
/begin MEASUREMENT lv_n_sp_is_add_can_1 "logische Variable fuer aktive Forderung der Erhoehung der Leerlaufsolldrehzahl Stufe 1" UBYTE _CNV_S_2_RANGE__0___85_CM 1 0. 0. 1. DISPLAY_IDENTIFIER LV_N_SP_IS_ADD_CAN_1 ECU_ADDRESS 0x7fb765 BIT_MASK 0x1 /end MEASUREMENT
/begin MEASUREMENT lv_bat_off_can "Batterie ab erkannt" UBYTE _CNV_S_2_RANGE__0___85_CM 1 0. 0. 1. DISPLAY_IDENTIFIER LV_BAT_OFF_CAN ECU_ADDRESS 0x7fb76c BIT_MASK 0x1 /end MEASUREMENT
/begin MEASUREMENT lv_airb1_can_vld "logische Variable fuer erkannte gueltige Botschaft AIRB1" UBYTE _CNV_S_2_RANGE__0___85_CM 1 0. 0. 1. DISPLAY_IDENTIFIER LV_AIRB1_CAN_VLD ECU_ADDRESS 0x7fb70e BIT_MASK 0x1 /end MEASUREMENT
/begin MEASUREMENT lv_crash_can "Zustandsvariable Crash" UBYTE _CNV_S_2_RANGE__0___85_CM 1 0. 0. 1. DISPLAY_IDENTIFIER LV_CRASH_CAN ECU_ADDRESS 0x7fb70d BIT_MASK 0x1 /end MEASUREMENT
/begin MEASUREMENT lv_err_ctr_msg_airb1 "logische Variable fuer Fehler Botschaftszaehler" UBYTE _CNV_S_2_RANGE__0___85_CM 1 0. 0. 1. DISPLAY_IDENTIFIER LV_ERR_CTR_MSG_AIRB1 ECU_ADDRESS 0x7fb710 BIT_MASK 0x1 /end MEASUREMENT
/begin MEASUREMENT crash_state_airb1 "Variable zur Darstellung der Crash-Intensitaet" UBYTE _CNV_A_R_LINEAR_____1_CM 1 0. 0. 255. DISPLAY_IDENTIFIER CRASH_STATE_AIRB1 ECU_ADDRESS 0x7fb712 FORMAT "%3.0" /end MEASUREMENT
/begin MEASUREMENT lv_err_cks_airb1_diag "logische Variable fuer Fehler Botschaftszaehler" UBYTE _CNV_S_2_RANGE__0___85_CM 1 0. 0. 1. DISPLAY_IDENTIFIER LV_ERR_CKS_AIRB1_DIAG ECU_ADDRESS 0x7fb711 BIT_MASK 0x1 /end MEASUREMENT
/begin MEASUREMENT lv_err_cks_airb1 "logische Variable fuer Fehler Botschaftszaehler" UBYTE _CNV_S_2_RANGE__0___85_CM 1 0. 0. 1. DISPLAY_IDENTIFIER LV_ERR_CKS_AIRB1 ECU_ADDRESS 0x7fb70f BIT_MASK 0x1 /end MEASUREMENT
/begin MEASUREMENT state_dcc_sys "DCC-Status" UBYTE _CNV_S_4_STATE_DCC__461_CM 1 0. 0. 3. DISPLAY_IDENTIFIER STATE_DCC_SYS ECU_ADDRESS 0x7fb7c8 /end MEASUREMENT
/begin MEASUREMENT lv_err_ctr_msg_dcc "Fehlerbit MSG-CNT" UBYTE _CNV_S_2_RANGE__0___85_CM 1 0. 0. 1. DISPLAY_IDENTIFIER LV_ERR_CTR_MSG_DCC ECU_ADDRESS 0x7fb7cc BIT_MASK 0x1 /end MEASUREMENT
/begin MEASUREMENT lv_err_cks_dcc_can "Fehlerbit Checksumme" UBYTE _CNV_S_2_RANGE__0___85_CM 1 0. 0. 1. DISPLAY_IDENTIFIER LV_ERR_CKS_DCC_CAN ECU_ADDRESS 0x7fb7cd BIT_MASK 0x1 /end MEASUREMENT
/begin MEASUREMENT lv_err_cks_dcc_can_diag "Fehlerbit Checksumme entprellt irreversibel" UBYTE _CNV_S_2_RANGE__0___85_CM 1 0. 0. 1. DISPLAY_IDENTIFIER LV_ERR_CKS_DCC_CAN_DIAG ECU_ADDRESS 0x7fb7ce BIT_MASK 0x1 /end MEASUREMENT
/begin MEASUREMENT lv_dcc_can_vld "Validbit DCC" UBYTE _CNV_S_2_RANGE__0___85_CM 1 0. 0. 1. DISPLAY_IDENTIFIER LV_DCC_CAN_VLD ECU_ADDRESS 0x7fb7cb BIT_MASK 0x1 /end MEASUREMENT
/begin MEASUREMENT lv_dcc_pu "Schub DCC" UBYTE _CNV_S_2_RANGE__0___85_CM 1 0. 0. 1. DISPLAY_IDENTIFIER LV_DCC_PU ECU_ADDRESS 0x7fb7cf BIT_MASK 0x1 /end MEASUREMENT
/begin MEASUREMENT lv_dcc_pu_off_vld "Verhinderung Schubabschaltung" UBYTE _CNV_S_2_RANGE__0___85_CM 1 0. 0. 1. DISPLAY_IDENTIFIER LV_DCC_PU_OFF_VLD ECU_ADDRESS 0x7fb7d0 BIT_MASK 0x1 /end MEASUREMENT
/begin MEASUREMENT state_driv_cdn "Fahrsituation" UBYTE _CNV_S_4_STATE_DRIV_462_CM 1 0. 0. 3. DISPLAY_IDENTIFIER STATE_DRIV_CDN ECU_ADDRESS 0x7fb7c9 /end MEASUREMENT
/begin MEASUREMENT lv_tqi_dcc_off "Verhinderung Momenteneingriff" UBYTE _CNV_S_2_RANGE__0___85_CM 1 0. 0. 1. DISPLAY_IDENTIFIER LV_TQI_DCC_OFF ECU_ADDRESS 0x7fb7d1 BIT_MASK 0x1 /end MEASUREMENT
/begin MEASUREMENT lv_gb_gear_down "Herunterschalten erwuenscht" UBYTE _CNV_S_2_RANGE__0___85_CM 1 0. 0. 1. DISPLAY_IDENTIFIER LV_GB_GEAR_DOWN ECU_ADDRESS 0x7fb7d2 BIT_MASK 0x1 /end MEASUREMENT
/begin MEASUREMENT lv_gb_intv_off "Verhinderung Schalteingriff" UBYTE _CNV_S_2_RANGE__0___85_CM 1 0. 0. 1. DISPLAY_IDENTIFIER LV_GB_INTV_OFF ECU_ADDRESS 0x7fb7d3 BIT_MASK 0x1 /end MEASUREMENT
/begin MEASUREMENT state_gear_req "Schaltaufforderung" UBYTE _CNV_S_4_STATE_GEAR_463_CM 1 0. 0. 3. DISPLAY_IDENTIFIER STATE_GEAR_REQ ECU_ADDRESS 0x7fb7ca /end MEASUREMENT
/begin MEASUREMENT lv_dcc_nom_ac_ena "Freigabe Sollbeschleunigung" UBYTE _CNV_S_2_RANGE__0___85_CM 1 0. 0. 1. DISPLAY_IDENTIFIER LV_DCC_NOM_AC_ENA ECU_ADDRESS 0x7fb7d4 BIT_MASK 0x1 /end MEASUREMENT
/begin MEASUREMENT dcc_ac "Sollbeschleunigung" UWORD _CNV_A_R_LINEAR_____464_CM 1 0. -7.22 3.015 DISPLAY_IDENTIFIER DCC_AC ECU_ADDRESS 0x7f9820 BYTE_ORDER MSB_LAST /end MEASUREMENT
/begin MEASUREMENT dcc_msg_ctr "Message Counter DCC" UBYTE _CNV_A_R_LINEAR_____1_CM 1 0. 0. 255. DISPLAY_IDENTIFIER DCC_MSG_CTR ECU_ADDRESS 0x7fbdc2 FORMAT "%3.0" /end MEASUREMENT
/begin COMPU_METHOD _CNV_A_R_LINEAR_____0_CM "" RAT_FUNC "%6.3" "[-]" COEFFS 0 1. 0. 0 0 1 /end COMPU_METHOD
/begin COMPU_METHOD _CNV_A_R_LINEAR_____1_CM "" RAT_FUNC "%6.3" "-" COEFFS 0 1. 0. 0 0 1 /end COMPU_METHOD
/begin COMPU_METHOD _CNV_A_R_LINEAR_____5_CM "" RAT_FUNC "%6.3" "[rpm]" COEFFS 0 1. 0. 0 0 1 /end COMPU_METHOD
/begin COMPU_METHOD _CNV_A_R_LINEAR_____8_CM "" RAT_FUNC "%6.3" "[%]" COEFFS 0 655.3599999999997 0. 0 0 1 /end COMPU_METHOD
/begin COMPU_METHOD _CNV_S_2_RANGE______11_CM "" TAB_VERB "%6.3" "[-]" COMPU_TAB_REF _CNV_S_2_RANGE______11 /end COMPU_METHOD
/begin COMPU_VTAB _CNV_S_2_RANGE______11 "" TAB_VERB 2 0 "0" 1 "1" /end COMPU_VTAB
/begin COMPU_METHOD _CNV_A_R_LINEAR_____12_CM "" RAT_FUNC "%6.3" "[%]" COEFFS 0 327.6800000003072 3.071909304708242e-008 0 0 1 /end COMPU_METHOD
/begin COMPU_METHOD _CNV_A_R_LINEAR_____14_CM "" RAT_FUNC "%6.3" "[-]" COEFFS 0 65535.99999999996 0. 0 0 1 /end COMPU_METHOD
/begin COMPU_METHOD _CNV_A_R_LINEAR_____16_CM "" RAT_FUNC "%6.3" "[s]" COEFFS 0 1. 0. 0 0 1 /end COMPU_METHOD
/begin COMPU_METHOD _CNV_A_R_LINEAR_____17_CM "" RAT_FUNC "%6.3" "[°C/s]" COEFFS 0 1. 0. 0 0 1 /end COMPU_METHOD
/begin COMPU_METHOD _CNV_A_R_LINEAR_____18_CM "" RAT_FUNC "%6.3" "[°C]" COEFFS 0 1. 50. 0 0 1 /end COMPU_METHOD
/begin COMPU_METHOD _CNV_A_R_LINEAR_____19_CM "" RAT_FUNC "%6.3" "[s]" COEFFS 0 10. 0. 0 0 1 /end COMPU_METHOD
/begin COMPU_METHOD _CNV_A_R_LINEAR_____28_CM "" RAT_FUNC "%6.3" "[V]" COEFFS 0 204.8 0. 0 0 1 /end COMPU_METHOD
/begin COMPU_METHOD _CNV_A_R_LINEAR_____29_CM "" RAT_FUNC "%6.3" "[-]" COEFFS 0 256. 0. 0 0 1 /end COMPU_METHOD
/begin COMPU_METHOD _CNV_A_R_LINEAR_____34_CM "" RAT_FUNC "%6.3" "[km/h]" COEFFS 0 1. 0. 0 0 1 /end COMPU_METHOD
/begin COMPU_METHOD _CNV_A_R_LINEAR_____39_CM "" RAT_FUNC "%6.3" "[%]" COEFFS 0 2.55 0. 0 0 1 /end COMPU_METHOD
/begin COMPU_METHOD _CNV_A_R_LINEAR_____45_CM "" RAT_FUNC "%6.3" "[hPa]" COEFFS 0 12.06017666543982 0. 0 0 1 /end COMPU_METHOD
/begin COMPU_METHOD _CNV_A_R_LINEAR_____47_CM "" RAT_FUNC "%6.3" "[V]" COEFFS 0 13107.20001587224 0. 0 0 1 /end COMPU_METHOD
/begin COMPU_METHOD _CNV_A_R_LINEAR_____51_CM "" RAT_FUNC "%6.3" "[°C]" COEFFS 0 63.9990234375 0. 0 0 1 /end COMPU_METHOD
/begin COMPU_METHOD _CNV_A_R_LINEAR_____52_CM "" RAT_FUNC "%6.3" "[Nm]" COEFFS 0 32. 0. 0 0 1 /end COMPU_METHOD
/begin COMPU_METHOD _CNV_A_R_LINEAR_____55_CM "" RAT_FUNC "%6.3" "[rpm]" COEFFS 0 3.125e-002 0. 0 0 1 /end COMPU_METHOD
/begin COMPU_METHOD _CNV_A_R_LINEAR_____56_CM "" RAT_FUNC "%6.3" "[s]" COEFFS 0 100. 0. 0 0 1 /end COMPU_METHOD
/begin COMPU_METHOD _CNV_A_R_LINEAR_____60_CM "" RAT_FUNC "%6.3" "[mg/stk]" COEFFS 0 47.18142548596112 0. 0 0 1 /end COMPU_METHOD
/begin COMPU_METHOD _CNV_A_R_LINEAR_____64_CM "" RAT_FUNC "%6.3" "[s]" COEFFS 0 15625. 0. 0 0 1 /end COMPU_METHOD
/begin COMPU_METHOD _CNV_A_R_LINEAR_____65_CM "" RAT_FUNC "%6.3" "°C" COEFFS 0 1. 40. 0 0 1 /end COMPU_METHOD
/begin COMPU_METHOD _CNV_A_R_LINEAR_____71_CM "" RAT_FUNC "%6.3" "[km/h]" COEFFS 0 100. 0. 0 0 1 /end COMPU_METHOD
/begin COMPU_METHOD _CNV_A_R_LINEAR_____78_CM "" RAT_FUNC "%6.3" "[%]" COEFFS 0 10.23 0. 0 0 1 /end COMPU_METHOD
/begin COMPU_METHOD _CNV_A_R_LINEAR_____79_CM "" RAT_FUNC "%6.3" "[%]" COEFFS 0 2.56 0. 0 0 1 /end COMPU_METHOD
/begin COMPU_METHOD _CNV_A_R_LINEAR_____81_CM "" RAT_FUNC "%6.3" "rpm" COEFFS 0 3.125e-002 0. 0 0 1 /end COMPU_METHOD
/begin COMPU_METHOD _CNV_S_2_RANGE__0___85_CM "" TAB_VERB "%6.3" "-" COMPU_TAB_REF _CNV_S_2_RANGE__0___85 /end COMPU_METHOD
/begin COMPU_VTAB _CNV_S_2_RANGE__0___85 "" TAB_VERB 2 0 "0" 1 "1" /end COMPU_VTAB
/begin COMPU_METHOD _CNV_A_R_LINEAR_____87_CM "" RAT_FUNC "%6.3" "[-]" COEFFS 0 65535.82575140447 0. 0 0 1 /end COMPU_METHOD
/begin COMPU_METHOD _CNV_A_R_LINEAR_____90_CM "" RAT_FUNC "%6.3" "[Nm]" COEFFS 0 4. 0. 0 0 1 /end COMPU_METHOD
/begin COMPU_METHOD _CNV_A_R_LINEAR_____95_CM "" RAT_FUNC "%6.3" "[-]" COEFFS 0 64. 0. 0 0 1 /end COMPU_METHOD
/begin COMPU_METHOD _CNV_A_R_LINEAR_____101_CM "" RAT_FUNC "%6.3" "[-]" COEFFS 0 128. 0. 0 0 1 /end COMPU_METHOD
/begin COMPU_METHOD _CNV_A_R_LINEAR_____110_CM "" RAT_FUNC "%6.3" "[kg/h]" COEFFS 0 64. 0. 0 0 1 /end COMPU_METHOD
/begin COMPU_METHOD _CNV_A_R_LINEAR_____111_CM "" RAT_FUNC "%6.3" "[-]" COEFFS 0 100. 0. 0 0 1 /end COMPU_METHOD
/begin COMPU_METHOD _CNV_A_R_LINEAR_____120_CM "" RAT_FUNC "%6.3" "[uF]" COEFFS 0 7.976539589442815 0. 0 0 1 /end COMPU_METHOD
/begin COMPU_METHOD _CNV_A_R_LINEAR_____121_CM "" RAT_FUNC "%6.3" "[V]" COEFFS 0 4.011764705882353 0. 0 0 1 /end COMPU_METHOD
/begin COMPU_METHOD _CNV_A_R_LINEAR_____122_CM "" RAT_FUNC "%6.3" "[uAs]" COEFFS 0 16. 0. 0 0 1 /end COMPU_METHOD
/begin COMPU_METHOD _CNV_A_R_LINEAR_____123_CM "" RAT_FUNC "%6.3" "[V]" COEFFS 0 6553.600246000245 0. 0 0 1 /end COMPU_METHOD
/begin COMPU_METHOD _CNV_A_R_LINEAR_____124_CM "" RAT_FUNC "%6.3" "[uAs/V]" COEFFS 0 64.06158357771261 0. 0 0 1 /end COMPU_METHOD
/begin COMPU_METHOD _CNV_A_R_LINEAR_____125_CM "" RAT_FUNC "%6.3" "[uAs/VV]" COEFFS 0 204.796875 0. 0 0 1 /end COMPU_METHOD
/begin COMPU_METHOD _CNV_A_R_LINEAR_____126_CM "" RAT_FUNC "%6.3" "V" COEFFS 0 4.011764705882353 0. 0 0 1 /end COMPU_METHOD
/begin COMPU_METHOD _CNV_A_R_A_127_CM "" RAT_FUNC "%6.3" "[A]" COEFFS 0 1. 0. 0 0 1 /end COMPU_METHOD
/begin COMPU_METHOD _CNV_A_R_LINEAR_____128_CM "" RAT_FUNC "%6.3" "[-]" COEFFS 0 655.35 0. 0 0 1 /end COMPU_METHOD
/begin COMPU_METHOD _CNV_A_R_LINEAR_____129_CM "" RAT_FUNC "%6.3" "[A/V]" COEFFS 0 6553.5 0. 0 0 1 /end COMPU_METHOD
/begin COMPU_METHOD _CNV_A_R_LINEAR_____130_CM "" RAT_FUNC "%6.3" "[-]" COEFFS 0 204.6 0. 0 0 1 /end COMPU_METHOD
/begin COMPU_METHOD _CNV_A_R_LINEAR_____134_CM "" RAT_FUNC "%6.3" "[%]" COEFFS 0 655.35 0. 0 0 1 /end COMPU_METHOD
/begin COMPU_METHOD _CNV_A_R_LINEAR_____135_CM "" RAT_FUNC "%6.3" "[°C/s]" COEFFS 0 256. 0. 0 0 1 /end COMPU_METHOD
/begin COMPU_METHOD _CNV_A_R_LINEAR_____137_CM "" RAT_FUNC "%6.3" "-" COEFFS 0 65535.99999999996 0. 0 0 1 /end COMPU_METHOD
/begin COMPU_METHOD _CNV_A_R_LINEAR_____154_CM "" RAT_FUNC "%6.3" "rpm" COEFFS 0 1. 0. 0 0 1 /end COMPU_METHOD
/begin COMPU_METHOD _CNV_A_R_LINEAR_____209_CM "" RAT_FUNC "%6.3" "[kPa]" COEFFS 0 8.225806451612903e-002 0. 0 0 1 /end COMPU_METHOD
/begin COMPU_METHOD _CNV_A_R_LINEAR_____210_CM "" RAT_FUNC "%6.3" "[Hz]" COEFFS 0 2.55 0. 0 0 1 /end COMPU_METHOD
/begin COMPU_METHOD _CNV_A_R_LINEAR_____226_CM "" RAT_FUNC "%6.3" "s" COEFFS 0 100. 0. 0 0 1 /end COMPU_METHOD
/begin COMPU_METHOD _CNV_A_R_LINEAR_____231_CM "" RAT_FUNC "%6.3" "grad" COEFFS 0 22.85714285714285 0. 0 0 1 /end COMPU_METHOD
/begin COMPU_METHOD _CNV_A_R_LINEAR_____232_CM "" RAT_FUNC "%6.3" "grad/s" COEFFS 0 22.85714285714285 0. 0 0 1 /end COMPU_METHOD
/begin COMPU_METHOD _CNV_A_R_LINEAR_____233_CM "" RAT_FUNC "%6.3" "[Nm]" COEFFS 0 2. 0. 0 0 1 /end COMPU_METHOD
/begin COMPU_METHOD _CNV_A_R_LINEAR_____234_CM "" RAT_FUNC "%6.3" "[W]" COEFFS 0 2.e-002 0. 0 0 1 /end COMPU_METHOD
/begin COMPU_METHOD _CNV_A_R_LINEAR_____239_CM "" RAT_FUNC "%6.3" "[-]" COEFFS 0 255. 0. 0 0 1 /end COMPU_METHOD
/begin COMPU_METHOD _CNV_A_R_LINEAR_____240_CM "" RAT_FUNC "%6.3" "s" COEFFS 0 10. 0. 0 0 1 /end COMPU_METHOD
/begin COMPU_METHOD _CNV_A_R_LINEAR_____241_CM "" RAT_FUNC "%6.3" "[\260C]" COEFFS 0 1.333333333333333 64. 0 0 1 /end COMPU_METHOD
/begin COMPU_METHOD _CNV_A_R_LINEAR_____245_CM "" RAT_FUNC "%6.3" "km/h" COEFFS 0 1. 0. 0 0 1 /end COMPU_METHOD
/begin COMPU_METHOD _CNV_A_R_LINEAR_____249_CM "" RAT_FUNC "%6.3" "[°C]" COEFFS 0 1.333333333333333 0. 0 0 1 /end COMPU_METHOD
/begin COMPU_METHOD _CNV_A_R_LINEAR_____254_CM "" RAT_FUNC "%6.3" "-" COEFFS 0 256. 0. 0 0 1 /end COMPU_METHOD
/begin COMPU_METHOD _CNV_A_R_LINEAR_____257_CM "" RAT_FUNC "%6.3" "°C" COEFFS 0 1.333333333333333 64. 0 0 1 /end COMPU_METHOD
/begin COMPU_METHOD _CNV_A_R_LINEAR_____260_CM "" RAT_FUNC "%6.3" "[C]" COEFFS 0 1.333333333333333 0. 0 0 1 /end COMPU_METHOD
/begin COMPU_METHOD _CNV_A_R_LINEAR_____263_CM "" RAT_FUNC "%6.3" "[-]" COEFFS 0 10. 0. 0 0 1 /end COMPU_METHOD
/begin COMPU_METHOD _CNV_A_R_LINEAR_____264_CM "" RAT_FUNC "%6.3" "[°CRK]" COEFFS 0 2.666666666666667 128. 0 0 1 /end COMPU_METHOD
/begin COMPU_METHOD _CNV_A_R_LINEAR_____265_CM "" RAT_FUNC "%6.3" "V" COEFFS 0 204.8 0. 0 0 1 /end COMPU_METHOD
/begin COMPU_METHOD _CNV_A_R_LINEAR_____266_CM "" RAT_FUNC "%6.3" "[%]" COEFFS 0 10.24024024024024 0. 0 0 1 /end COMPU_METHOD
/begin COMPU_METHOD _CNV_A_R_LINEAR_____268_CM "" RAT_FUNC "%6.3" "[%/10ms]" COEFFS 0 10.23 0. 0 0 1 /end COMPU_METHOD
/begin COMPU_METHOD _CNV_A_R_LINEAR_____295_CM "" RAT_FUNC "%6.3" "[ms]" COEFFS 0 2. -200. 0 0 1 /end COMPU_METHOD
/begin COMPU_METHOD _CNV_A_R_LINEAR_____305_CM "" RAT_FUNC "%6.3" "[ms]" COEFFS 0 8. 0. 0 0 1 /end COMPU_METHOD
/begin COMPU_METHOD _CNV_A_R_LINEAR_____332_CM "" RAT_FUNC "%6.3" "%" COEFFS 0 4.016064257028112 127. 0 0 1 /end COMPU_METHOD
/begin COMPU_METHOD _CNV_S_3_STATE_CRU__337_CM "" TAB_VERB "%6.3" "[-]" COMPU_TAB_REF _CNV_S_3_STATE_CRU__337 /end COMPU_METHOD
/begin COMPU_VTAB _CNV_S_3_STATE_CRU__337 "" TAB_VERB 3 0 "VECU" 1 "LSM(6Pos)" 3 "LSM(4Pos)" /end COMPU_VTAB
/begin COMPU_METHOD _CNV_A_R_LINEAR_____362_CM "" RAT_FUNC "%6.3" "[us]" COEFFS 0 1. 0. 0 0 1 /end COMPU_METHOD
/begin COMPU_METHOD _CNV_A_R_LINEAR_____368_CM "" RAT_FUNC "%6.3" "[V]" COEFFS 0 51.2 0. 0 0 1 /end COMPU_METHOD
/begin COMPU_METHOD _CNV_A_R_LINEAR_____369_CM "" RAT_FUNC "%6.3" "°C/s" COEFFS 0 1. 0. 0 0 1 /end COMPU_METHOD
/begin COMPU_METHOD _CNV_A_R_LINEAR_____370_CM "" RAT_FUNC "%6.3" "°C" COEFFS 0 255.9999997499962 32767.99996799951 0 0 1 /end COMPU_METHOD
/begin COMPU_METHOD _CNV_A_R_LINEAR_____371_CM "" RAT_FUNC "%6.3" "mg/stk" COEFFS 0 0.183585313174946 0. 0 0 1 /end COMPU_METHOD
/begin COMPU_METHOD _CNV_A_R_LINEAR_____381_CM "" RAT_FUNC "%6.3" "[°/oo]" COEFFS 0 65.408 0. 0 0 1 /end COMPU_METHOD
/begin COMPU_METHOD _CNV_A_R_LINEAR_____382_CM "" RAT_FUNC "%6.3" "[°/oo]" COEFFS 0 4194.300129486656 -8.782845907262527e-004 0 0 1 /end COMPU_METHOD
/begin COMPU_METHOD _CNV_A_R_LINEAR_____402_CM "" RAT_FUNC "%6.3" "[%]" COEFFS 0 163.8400026560406 5.312081193551421e-004 0 0 1 /end COMPU_METHOD
/begin COMPU_METHOD _CNV_A_R_LINEAR_____415_CM "" RAT_FUNC "%6.3" "[V]" COEFFS 0 204.7999649194707 0. 0 0 1 /end COMPU_METHOD
/begin COMPU_METHOD _CNV_S_4_STATE_CC_R_430_CM "" TAB_VERB "%6.3" "-" COMPU_TAB_REF _CNV_S_4_STATE_CC_R_430 /end COMPU_METHOD
/begin COMPU_VTAB _CNV_S_4_STATE_CC_R_430 "" TAB_VERB 4 0 "OPEN" 1 "CONTROL" 2 "CLOSED" 3 "ERROR" /end COMPU_VTAB
/begin COMPU_METHOD _CNV_S_12_GEAR_CAN_R_431_CM "" TAB_VERB "%6.3" "[-]" COMPU_TAB_REF _CNV_S_12_GEAR_CAN_R_431 /end COMPU_METHOD
/begin COMPU_VTAB _CNV_S_12_GEAR_CAN_R_431 "" TAB_VERB 12 0 "OPEN" 1 "GEAR 1" 2 "GEAR 2" 3 "GEAR 3" 4 "GEAR 4" 5 "GEAR 5" 6 "1m" 7 "R" 8 "GEAR 6" 9 "GEAR 7" 14 "NOT DEF" 15 "ERROR" /end COMPU_VTAB
/begin COMPU_METHOD _CNV_S_16_SEL_PSN_RA_432_CM "" TAB_VERB "%6.3" "[-]" COMPU_TAB_REF _CNV_S_16_SEL_PSN_RA_432 /end COMPU_METHOD
/begin COMPU_VTAB _CNV_S_16_SEL_PSN_RA_432 "" TAB_VERB 16 0 "INTER" 1 "Pos 1" 2 "Pos 2" 3 "Pos 3" 4 "Pos 4" 5 "D" 6 "N" 7 "R" 8 "P" 9 "RSP" 10 "Z1" 11 "Z2" 12 "S" 13 "L" 14 "TIP" 15 "ERROR" /end COMPU_VTAB
/begin COMPU_METHOD _CNV_A_R_LINEAR_____433_CM "" RAT_FUNC "%6.3" "%" COEFFS 0 2.564102564102564 0. 0 0 1 /end COMPU_METHOD
/begin COMPU_METHOD _CNV_S_4_STATE_MIL__434_CM "" TAB_VERB "%6.3" "-" COMPU_TAB_REF _CNV_S_4_STATE_MIL__434 /end COMPU_METHOD
/begin COMPU_VTAB _CNV_S_4_STATE_MIL__434 "" TAB_VERB 4 0 "OFF" 1 "ON" 2 "ON" 3 "ON" /end COMPU_VTAB
/begin COMPU_METHOD _CNV_A_R_LINEAR_____435_CM "" RAT_FUNC "%6.3" "[Nm/s]" COEFFS 0 0.1 0. 0 0 1 /end COMPU_METHOD
/begin COMPU_METHOD _CNV_A_R_LINEAR_____436_CM "" RAT_FUNC "%6.3" "[-]" COEFFS 0 4.e-002 0. 0 0 1 /end COMPU_METHOD
/begin COMPU_METHOD _CNV_A_R_LINEAR_____437_CM "" RAT_FUNC "%6.3" "ms" COEFFS 0 5.e-002 0. 0 0 1 /end COMPU_METHOD
/begin COMPU_METHOD _CNV_A_R_LINEAR_____438_CM "" RAT_FUNC "%6.3" "[bar]" COEFFS 0 5. 0. 0 0 1 /end COMPU_METHOD
/begin COMPU_METHOD _CNV_S_3_STATE_ICH__439_CM "" TAB_VERB "%6.3" "-" COMPU_TAB_REF _CNV_S_3_STATE_ICH__439 /end COMPU_METHOD
/begin COMPU_VTAB _CNV_S_3_STATE_ICH__439 "" TAB_VERB 3 0 "NO HEATING" 1 "INTERIEUR" 2 "ENGINE" /end COMPU_VTAB
/begin COMPU_METHOD _CNV_S_17_CAN_VERS_R_440_CM "" TAB_VERB "%6.3" "[-]" COMPU_TAB_REF _CNV_S_17_CAN_VERS_R_440 /end COMPU_METHOD
/begin COMPU_VTAB _CNV_S_17_CAN_VERS_R_440 "" TAB_VERB 17 9 "CAN 4.0.1" 10 "CAN 4.0.2" 11 "CAN 4.0.3" 12 "CAN 4.1.1" 13 "CAN 4.1.2" 14 "CAN 4.1.3" 18 "CAN 4.2.3" 19 "CAN 4.2.4" 20 "CAN 4.2.5" 25 "CAN 4.3.5" 26 "CAN 4.3.6" 31 "CAN 4.4.5" 37 "CAN 4.5.6" 38 "CAN 4.6.5" 39 "CAN 4.6.6" 44 "CAN 4.7.6" 45 "CAN 4.7.7" /end COMPU_VTAB
/begin COMPU_METHOD _CNV_A_R_LINEAR_____441_CM "" RAT_FUNC "%6.3" "[rpm]" COEFFS 0 1.e-002 0. 0 0 1 /end COMPU_METHOD
/begin COMPU_METHOD _CNV_A_R_LINEAR_____442_CM "" RAT_FUNC "%6.3" "[Nm]" COEFFS 0 0.1 0. 0 0 1 /end COMPU_METHOD
/begin COMPU_METHOD _CNV_A_R_LINEAR_____443_CM "" RAT_FUNC "%6.3" "[kW]" COEFFS 0 1. 0. 0 0 1 /end COMPU_METHOD
/begin COMPU_METHOD _CNV_A_R_LINEAR_____444_CM "" RAT_FUNC "%6.3" "[l]" COEFFS 0 10. 0. 0 0 1 /end COMPU_METHOD
/begin COMPU_METHOD _CNV_A_R_LINEAR_____445_CM "" RAT_FUNC "%6.3" "[ml]" COEFFS 0 0.1 0. 0 0 1 /end COMPU_METHOD
/begin COMPU_METHOD _CNV_A_R_LINEAR_____446_CM "" RAT_FUNC "%6.3" "[km]" COEFFS 0 1.e-003 0. 0 0 1 /end COMPU_METHOD
/begin COMPU_METHOD _CNV_A_R_LINEAR_____447_CM "" RAT_FUNC "%6.3" "[-]" COEFFS 0 2.e-003 0. 0 0 1 /end COMPU_METHOD
/begin COMPU_METHOD _CNV_A_R_LINEAR_____448_CM "" RAT_FUNC "%6.3" "Monat" COEFFS 0 1. 0. 0 0 1 /end COMPU_METHOD
/begin COMPU_METHOD _CNV_A_R_LINEAR_____449_CM "" RAT_FUNC "%6.3" "km" COEFFS 0 4.e-002 0. 0 0 1 /end COMPU_METHOD
/begin COMPU_METHOD _CNV_A_R_LINEAR_____450_CM "" RAT_FUNC "%6.3" "ml" COEFFS 0 1.e-002 0. 0 0 1 /end COMPU_METHOD
/begin COMPU_METHOD _CNV_A_R_LINEAR_____451_CM "" RAT_FUNC "%6.3" "ml" COEFFS 0 2.e-002 0. 0 0 1 /end COMPU_METHOD
/begin COMPU_METHOD _CNV_A_R_LINEAR_____452_CM "" RAT_FUNC "%6.3" "-" COEFFS 0 1.e-002 0. 0 0 1 /end COMPU_METHOD
/begin COMPU_METHOD _CNV_A_R_LINEAR_____453_CM "" RAT_FUNC "%6.3" "m" COEFFS 0 2000. 0. 0 0 1 /end COMPU_METHOD
/begin COMPU_METHOD _CNV_A_R_LINEAR_____454_CM "" RAT_FUNC "%6.3" "[s]" COEFFS 0 0.25 0. 0 0 1 /end COMPU_METHOD
/begin COMPU_METHOD _CNV_A_R_LINEAR_____455_CM "" RAT_FUNC "%6.3" "[km]" COEFFS 0 1. 0. 0 0 1 /end COMPU_METHOD
/begin COMPU_METHOD _CNV_S_5_STATE_VS_T_456_CM "" TAB_VERB "%6.3" "-" COMPU_TAB_REF _CNV_S_5_STATE_VS_T_456 /end COMPU_METHOD
/begin COMPU_VTAB _CNV_S_5_STATE_VS_T_456 "" TAB_VERB 5 0 "NOT VALID" 1 "VALID" 2 "INIT" 4 "USPG" 8 "ERROR" /end COMPU_VTAB
/begin COMPU_METHOD _CNV_A_R_LINEAR_____457_CM "" RAT_FUNC "%6.3" "m/s²" COEFFS 0 10. 127. 0 0 1 /end COMPU_METHOD
/begin COMPU_METHOD _CNV_S_4_STATE_THD__458_CM "" TAB_VERB "%6.3" "-" COMPU_TAB_REF _CNV_S_4_STATE_THD__458 /end COMPU_METHOD
/begin COMPU_VTAB _CNV_S_4_STATE_THD__458 "" TAB_VERB 4 0 "NO SIGNAL" 1 "Dep.>450 mbar" 2 "Dep.<=450 mbar" 3 "ERROR" /end COMPU_VTAB
/begin COMPU_METHOD _CNV_A_R_LINEAR_____459_CM "" RAT_FUNC "%6.3" "[hPa]" COEFFS 0 0.25 0. 0 0 1 /end COMPU_METHOD
/begin COMPU_METHOD _CNV_A_R_LINEAR_____460_CM "" RAT_FUNC "%6.3" "m/s²" COEFFS 0 32. 512. 0 0 1 /end COMPU_METHOD
/begin COMPU_METHOD _CNV_S_4_STATE_DCC__461_CM "" TAB_VERB "%6.3" "-" COMPU_TAB_REF _CNV_S_4_STATE_DCC__461 /end COMPU_METHOD
/begin COMPU_VTAB _CNV_S_4_STATE_DCC__461 "" TAB_VERB 4 0 "DCC_OFF" 1 "DCC_ACT" 2 "DCC_PAS" 3 "DCC_ERR" /end COMPU_VTAB
/begin COMPU_METHOD _CNV_S_4_STATE_DRIV_462_CM "" TAB_VERB "%6.3" "-" COMPU_TAB_REF _CNV_S_4_STATE_DRIV_462 /end COMPU_METHOD
/begin COMPU_VTAB _CNV_S_4_STATE_DRIV_462 "" TAB_VERB 4 0 "DCC_PRED" 1 "DCC_AC" 2 "DCC_DECE" 3 "DCC_CONST" /end COMPU_VTAB
/begin COMPU_METHOD _CNV_S_4_STATE_GEAR_463_CM "" TAB_VERB "%6.3" "-" COMPU_TAB_REF _CNV_S_4_STATE_GEAR_463 /end COMPU_METHOD
/begin COMPU_VTAB _CNV_S_4_STATE_GEAR_463 "" TAB_VERB 4 0 "DCC_GEAR_HOLD" 1 "DCC_GEAR_UP" 2 "DCC_GEAR_DOWN" 3 "DCC_AC_ACT" /end COMPU_VTAB
/begin COMPU_METHOD _CNV_A_R_LINEAR_____464_CM "" RAT_FUNC "%6.3" "m/s²" COEFFS 0 200. 1444. 0 0 1 /end COMPU_METHOD
/begin RECORD_LAYOUT _REC_VAL_20_u1 FNC_VALUES 1 UBYTE COLUMN_DIR DIRECT /end RECORD_LAYOUT
/begin RECORD_LAYOUT _REC_AXS_20_u2 NO_AXIS_PTS_X 1 UWORD AXIS_PTS_X 2 UWORD INDEX_INCR DIRECT /end RECORD_LAYOUT
/begin RECORD_LAYOUT _REC_VAL_20_u2 FNC_VALUES 1 UWORD COLUMN_DIR DIRECT /end RECORD_LAYOUT
/begin RECORD_LAYOUT _REC_VAL_20_s2 FNC_VALUES 1 SWORD COLUMN_DIR DIRECT /end RECORD_LAYOUT
/begin RECORD_LAYOUT _REC_AXS_20_u1 NO_AXIS_PTS_X 1 UBYTE AXIS_PTS_X 2 UBYTE INDEX_INCR DIRECT /end RECORD_LAYOUT
/begin RECORD_LAYOUT _REC_CUR_20_u2_u2 FNC_VALUES 1 UWORD COLUMN_DIR DIRECT /end RECORD_LAYOUT
/begin RECORD_LAYOUT _REC_CUR_20_u2_u1 FNC_VALUES 1 UWORD COLUMN_DIR DIRECT /end RECORD_LAYOUT
/begin RECORD_LAYOUT _REC_MAP_20_u2_u1_u1 FNC_VALUES 1 UWORD COLUMN_DIR DIRECT /end RECORD_LAYOUT
/begin RECORD_LAYOUT _REC_MAP_20_u2_u2_u1 FNC_VALUES 1 UWORD COLUMN_DIR DIRECT /end RECORD_LAYOUT
/begin RECORD_LAYOUT _REC_CUR_20_u1_u2 FNC_VALUES 1 UBYTE COLUMN_DIR DIRECT /end RECORD_LAYOUT
/begin RECORD_LAYOUT _REC_CUR_20_u1_u1 FNC_VALUES 1 UBYTE COLUMN_DIR DIRECT /end RECORD_LAYOUT
/begin RECORD_LAYOUT _REC_MAP_20_u1_u1_u1 FNC_VALUES 1 UBYTE COLUMN_DIR DIRECT /end RECORD_LAYOUT
/begin RECORD_LAYOUT _REC_MAP_20_u1_u1_u2 FNC_VALUES 1 UBYTE COLUMN_DIR DIRECT /end RECORD_LAYOUT
/begin FUNCTION BIO_Key_Position_Determination "" /begin OUT_MEASUREMENT t_sys t_igk /end OUT_MEASUREMENT /end FUNCTION
/begin FUNCTION C_4_SYS ""
 /begin SUB_FUNCTION SYS_CAN SYS_CAN_Messages_EMS SYS_Coolant_Temp_Setpoint SYS_Ambient_Air_Temperature SYS_AN_LIM_C SYS_AMAP SYS_ATBA SYS_ATIMER SYS_Oil_Temp SYS_CAN_Messages_EMS__AI SYS_AER SYS_AERINCI SYS_AMAF SYS_ATAC SYS_ATIA SYS_ATOILINCI /end SUB_FUNCTION
/end FUNCTION
/begin FUNCTION SYS_CAN "" /begin OUT_MEASUREMENT can_vs_abs lv_err_vs_can /end OUT_MEASUREMENT /end FUNCTION
/begin FUNCTION SYS_CAN_Messages_EMS ""
 /begin DEF_CHARACTERISTIC c_can_vers c_eng_typ_2 c_tqi_stnd c_n_tqi_tol c_tqi_tol c_eng_typ c_eg_typ_ems5 c_eng_pow c_num_valve c_eng_vol c_oil_ofs_warn c_oil_tol_warn c_km_min_asa c_km_max_asa c_ctr_min_oil c_t_min_asa c_t_max_asa c_km_min_oil c_oil_max_thd c_oil_max_ofs c_oil_max_over_hys c_oil_ctr_fast lc_oil_max_det lc_n_ems_can_sel c_diam_whl c_t_pas_can_tcs4 /end DEF_CHARACTERISTIC
 /begin OUT_MEASUREMENT lv_can_ena lv_slp_idc_update lv_stop_rcv_can_msg lv_dlc_tcs1_nvld lv_dlc_tcs2_nvld lv_dlc_tcs3_nvld lv_dlc_tcs8_nvld lv_dlc_tcu1_nvld lv_dlc_tcu2_nvld lv_dlc_airb1_nvld lv_dlc_imor_nvld lv_dlc_icl1_nvld lv_dlc_ac1_nvld lv_dlc_bem_nvld lv_dlc_cru_nvld lv_dlc_eilu1_nvld lv_dlc_vecu1_nvld lv_dlc_if_cft_1_nvld lv_dlc_icl2_nvld lv_dlc_icl3_nvld lv_dlc_tog1_nvld lv_dlc_whl_nvld lv_dlc_sys_info_nvld lv_slp_idc lv_dlc_nom_sys_nvld lv_pste_can_vld ang_pste ang_grd_pste lv_n_sp_is_bem_1 lv_n_sp_is_bem_2 lv_bem_can_vld gen_load_tq_can gen_load_pow_can cru_swi_pos cru_swi_pos_deb cru_swi_pos_can lv_cru_can_vld lv_err_cru_dvc_smls lv_cru_dcc_conf lv_err_cru_conf lv_err_ctr_msg_cru lv_err_cks_cru_can_diag lv_err_cks_cru_can cru_conf lv_cru_swi_main lv_tcu1_can_vld lv_gs_act lv_tqi_gs_fast_dec_inh lv_acc_off_can_tcu1 state_cc lv_n_sp_is_tcu_ena lv_gs_req gear_can sel_psn gear_ratio_tcu1 tqi_gs_req_can tqi_gs_req cool_req_tcu_can lv_mil_on_can lv_mil_on_tcu1 tq_loss_tcu1_can tq_loss_tcu1 tcu1_msg_ctr state_mil_on_tcu1 drg_tcu drg_tcu_can lv_err_ctr_msg_tcu1 lv_tcu2_can_vld lv_is_ad_inh_tcu2 lv_req_puc_deac_tcu2 tcu2_msg_ctr n_sp_is_tcu2 tq_dif_tra_max lv_n_tcu_req n_tcu_req n_tcu_req_ivs t_n_tcu_req lv_err_ctr_msg_tcu2 lv_tcu_cod_vld tcu_lih_can lv_ac1_can_vld lv_acin_can lv_accin_on_can acp_can tq_acc_can lv_ac_sw_can ecf_req_ac_can lv_ecf_req_ac_can_err state_ich lv_req_heat_can lv_st_req_can lv_eilu_can_vld lv_igk_can lv_toil_max_can tqi_int_fb_tcu_intv lv_frs_err_can lv_frs_can vs_icl1 lv_vs_icl1_vld lv_icl2_can_vld lv_tam_err_can tam_fil_can tam_can lv_icl3_can_vld t_last_dc_can ctr_km_can lv_icl1_can_vld lv_frs_wal_can lv_gll_fb_can ftl_can lv_tog_act lv_tog_pres lv_tcs1_can_vld lv_asr_req lv_msr_req lv_abs_req lv_esp_req lv_bls_tcs lv_bkv_state_can lv_rr_can lv_rr_err_can lv_esp_err_can lv_bkv_can vs_tcs1 state_vs_tcs1 tqi_asr_req_slow_can tqi_asr_req_slow tqi_asr_req_fast_can tqi_asr_req_fast tqi_msr_req_can tqi_msr_req tcs1_msg_ctr lv_sub_vs_tcs1 lv_err_ctr_msg_tcs1 lv_tcs2_can_vld ac_trv_tcs2 lv_ac_trv_tcs2_act lv_tcs3_can_vld can_wheel_fn_ri can_wheel_fn_le can_wheel_re_ri can_wheel_re_le lv_err_cks_tcs4_can_diag state_thd_dep dep_abs lv_tcs4_can_vld lv_err_ctr_msg_tcs4 lv_var_bsup_ext_save lv_err_cks_tcs4_can lv_tcs8_can_vld lv_err_ctr_msg_tcs8 lv_err_cks_tcs8_can lv_dcc_tcs_req_can lv_brake_temp_max_can lv_dcc_msg_not_ok lv_dece_ctl_ems_err_can lv_err_cks_tcs8_can_diag ac_lgt_tcs8_can lv_tog1_can_vld tog1_msg_ctr t_oil_level1_can t_oil_level2_can t_oil_level3_can t_oil_level4_can t_toil_can lv_tog_err_can lv_oil_level_ofs_warn lv_oil_level_tol_warn lv_oil_level_max_warn lv_oil_level_max_tol_warn lv_oil_level_up_warn lv_err_ctr_msg_tog1 lv_vecu1_can_vld lv_acc_off_can_vecu1 lv_n_sp_is_add_can_2 lv_ecfpwm_max_vecu lv_igk_vecu_can lv_igk_mot_vecu_can lv_n_sp_is_add_can_1 lv_bat_off_can lv_airb1_can_vld lv_crash_can lv_err_ctr_msg_airb1 crash_state_airb1 lv_err_cks_airb1_diag lv_err_cks_airb1 state_dcc_sys lv_err_ctr_msg_dcc lv_err_cks_dcc_can lv_err_cks_dcc_can_diag lv_dcc_can_vld lv_dcc_pu lv_dcc_pu_off_vld state_driv_cdn lv_tqi_dcc_off lv_gb_gear_down lv_gb_intv_off state_gear_req lv_dcc_nom_ac_ena dcc_ac dcc_msg_ctr /end OUT_MEASUREMENT
/end FUNCTION
/begin FUNCTION SYS_Coolant_Temp_Setpoint ""
 /begin DEF_CHARACTERISTIC lc_use_cool_req_tcu_can lc_use_tia_tco_sp c_tco_sp_tcu_sub c_tco_min_hvr_sub c_tco_max_hvr_sub c_tco_sp_sub c_crlc_tco_sp_down c_crlc_tco_sp_up ldp_n_32__tco_sp ldp_tqi_req_tra__tco_sp ip_tco_sp_1 ldp_iga_mv_knk__tco_sp ip_tco_sp_knk ldp_vs__tco_sp ldp_tia_tam__tco_sp ip_tco_sp_2 ldp_cool_req_tcu_can__tco_sp ip_tco_sp_tcu ldp_toil__tco_sp ip_tco_sp_toil ldpm_v_hvr__tco_hvr ip_tco_min_hvr ip_tco_max_hvr c_tco_sub_tco_dif /end DEF_CHARACTERISTIC
 /begin OUT_MEASUREMENT tco_sp tco_sp_1 tco_sp_2 tco_sp_knk tco_sp_tcu tco_sp_toil tco_sp_min_hvr tco_sp_max_hvr tco_sp_inter tco_sp_raw tco_sp_clc tco_dif tco_1_2 lv_ect_act /end OUT_MEASUREMENT
/end FUNCTION
/begin FUNCTION SYS_Ambient_Air_Temperature "" /begin DEF_CHARACTERISTIC c_tam_sub lc_tam_can_use /end DEF_CHARACTERISTIC /begin OUT_MEASUREMENT tam /end OUT_MEASUREMENT /end FUNCTION
/begin FUNCTION SYS_AN_LIM_C "Engine Speed Limit Coordination" /begin DEF_CHARACTERISTIC c_n_max c_n_max_mt c_n_max_mon c_n_max_tqi c_n_max_etc /end DEF_CHARACTERISTIC /begin OUT_MEASUREMENT n_max_thd /end OUT_MEASUREMENT /end FUNCTION
/begin FUNCTION SYS_AMAP "Manifold Air Pressure Variables"
 /begin DEF_CHARACTERISTIC ip_map_mes__v_map ldp_v_map_ip_map_mes c_map_sub_diag c_fac_map_fil /end DEF_CHARACTERISTIC
 /begin OUT_MEASUREMENT map_mes map map_mmv /end OUT_MEASUREMENT
/end FUNCTION
/begin FUNCTION SYS_ATBA "Charge Air Temperature Acquisition" /begin DEF_CHARACTERISTIC c_tba_sub_diag ip_tba_mes__v_tba ldp_v_tba_ip_tba_mes /end DEF_CHARACTERISTIC /begin OUT_MEASUREMENT tba v_tba tba_mes /end OUT_MEASUREMENT /end FUNCTION
/begin FUNCTION SYS_ATIMER "Engine Runtime and time after key on calculation" /begin OUT_MEASUREMENT trt t_on_ecu /end OUT_MEASUREMENT /end FUNCTION
/begin FUNCTION SYS_Oil_Temp "Oil Sensor Variables"
 /begin DEF_CHARACTERISTIC c_toil_grd_max_diag c_toil_sub_crlc c_tco_swi_cwp_toil c_tco_swi_toil_mdl_h c_toil_sub_h_crlc ip_toil_crlc_ofs__t_ast ldp_t_ast__toil_crlc_ofs ip_toil_ofs__toil_mdl_grd__n_32 ldp_toil_mdl_grd_toil_add_ofs ldpm_n_32_toil_sub ip_crlc_toil_mdl_3__n_32 ip_crlc_toil_mdl_2__tco ldp_tco_crlc_toil_mdl_2 ip_crlc_toil_mdl_1__vs__tia ldp_vs_crlc_toil_mdl_1 ldp_tia_crlc_toil_mdl_1 ip_crlc_toil_mdl_4__t_ast__tco ldp_t_ast_crlc_toil_mdl_4 ldp_tco_crlc_toil_mdl_4 ip_toil_sub__n_32__maf ldp_maf_toil_sub lc_var_toil_sens ldp_v_toil_10__toil ip_toil__v_toil c_toil_grd_max /end DEF_CHARACTERISTIC
 /begin OUT_MEASUREMENT toil toil_max toil_sens /end OUT_MEASUREMENT
/end FUNCTION
/begin FUNCTION SYS_CAN_Messages_EMS__AI ""
 /begin OUT_MEASUREMENT lv_if_cft_1_can_vld lv_stb_ack lv_trl_msg_ood_can lv_lamp_re_msg_ood_can lv_brake_lamp_le_err_can lv_brake_lamp_ri_err_can lv_brake_lamp_mid_err_can lv_trl_act_can lv_brake_lamp_trl_err_can lv_state_ctl_dece_err_can lv_state_ctl_dece_trlcu_err_can brake_lamp_msg_ctr lv_err_ctr_msg_brake_lamp trlcu_msg_ctr lv_err_ctr_msg_trlcu lv_ich_conf_can /end OUT_MEASUREMENT
/end FUNCTION
/begin FUNCTION SYS_AER "Engine Roughness Calculation"
 /begin DEF_CHARACTERISTIC c_crk_dif_max_er c_n_seg_t_ad_max_er c_n_seg_t_ad_min_er c_seg_t_ad_cor_drv1_max_er c_seg_t_ad_crlc_er c_seg_t_fast_ad_crlc_er c_t_seg_ad_dly ip_crlc_drv2_er_mt ip_fac_drv2_er_at ip_fac_drv2_er_mt ip_crlc_drv2_er_at /end DEF_CHARACTERISTIC
 /begin OUT_MEASUREMENT drv0_er drv2_mmv_er er[0] er[1] er[2] er_av er_rr lv_seg_ad_act_state lv_seg_ad_lim seg_ad_mmv[0] seg_ad_mmv[1] seg_ad_mmv[2] seg_nr_er seg_t_cor seg_t_cor_buf[0] seg_t_cor_buf[1] seg_t_cor_buf[2] seg_t_cor_buf[3] seg_t_cor_buf[4] seg_t_cor_buf[5] drv1_er /end OUT_MEASUREMENT
/end FUNCTION
/begin FUNCTION SYS_AERINCI "Application Incidences for Engine Roughness" /begin OUT_MEASUREMENT iv_off_er lv_inh_seg_ad lv_seg_ad_fdout /end OUT_MEASUREMENT /end FUNCTION
/begin FUNCTION SYS_AMAF "Mass Airflow Variables"
 /begin DEF_CHARACTERISTIC c_ctr_maf_kgh_puls c_n_32_max_puls c_maf_kgh_grd_max_puls c_maf_kgh_puls_hys c_thrpwm_max_puls c_t_thrpwm_max_puls ip_maf_kgh_puls_max__n_32 ldp_n_32_ip_maf_kgh_puls_max c_fac_maf_fil ip_fac_maf__n_32 ldp_n_32_ip_fac_maf lc_maf_frq /end DEF_CHARACTERISTIC
 /begin OUT_MEASUREMENT maf maf_kgh maf_kgh_mes maf_mmv v_maf v_maf_x v_maf_y lv_maf_0_puls maf_0 maf_0_kgh maf_0_kgh_grd maf_0_kgh_mes maf_0_kgh_puls maf_0_kgh_sub maf_0_mmv /end OUT_MEASUREMENT
/end FUNCTION
/begin FUNCTION SYS_ATAC "Exhaust Gas Temperature Coordination TAC" /begin DEF_CHARACTERISTIC c_tac_sub_diag ldp_tac_bas_ip_tac_mes ip_tac_mes__tac_bas /end DEF_CHARACTERISTIC /begin OUT_MEASUREMENT tac_mes v_tac tac /end OUT_MEASUREMENT /end FUNCTION
/begin FUNCTION SYS_ATIA "Intake Air Temperature" /begin OUT_MEASUREMENT tia /end OUT_MEASUREMENT /end FUNCTION
/begin FUNCTION SYS_ATOILINCI "Oil Temperature Acquisition" /begin OUT_MEASUREMENT v_toil /end OUT_MEASUREMENT /end FUNCTION
/begin FUNCTION C_4_SYS_VAR ""
 /begin SUB_FUNCTION SYS_VAR_ACS SYS_VAR_ABRAKE SYS_VAR_ATCO_SUB SYS_VAR_TCO SYS_VAR_IS SYS_VAR_IS_COR SYS_VAR_NIS SYS_VAR_AACP SYS_VAR_TIA SYS_VAR_APVS VAR_APPSCLC SYS_VAR_AALT SYS_VAR_BPAAQ SYS_VAR_EGRVAQ SYS_VAR_THRAQ SYS_VAR_AN SYS_VAR_AN_IS_SP SYS_VAR_AN_IS_SP_I SYS_VAR_ATEGPC VAR_ADIP_PF SYS_VAR_ATFU /end SUB_FUNCTION
/end FUNCTION
/begin FUNCTION SYS_VAR_ACS "" /begin DEF_CHARACTERISTIC c_vs_cs c_t_max_cs_fil lc_conf_cs c_cs_sub_diag /end DEF_CHARACTERISTIC /begin OUT_MEASUREMENT lv_cs lv_get_cs lv_cs_raw lv_cs_fil t_cs_fil sf_clu /end OUT_MEASUREMENT /end FUNCTION
/begin FUNCTION SYS_VAR_ABRAKE "" /begin DEF_CHARACTERISTIC lc_bts_det_on lc_bls_can /end DEF_CHARACTERISTIC /begin OUT_MEASUREMENT lv_bls lv_get_bls lv_get_bts lv_bts /end OUT_MEASUREMENT /end FUNCTION
/begin FUNCTION SYS_VAR_ATCO_SUB "" /begin DEF_CHARACTERISTIC c_tco_sub_ini c_tco_sub_grd c_tco_sub_tol c_tco_2_dif_sub /end DEF_CHARACTERISTIC /begin OUT_MEASUREMENT tco_sub tco_1_sub tco_2_sub /end OUT_MEASUREMENT /end FUNCTION
/begin FUNCTION SYS_VAR_TCO ""
 /begin DEF_CHARACTERISTIC c_tco_grd_max ip_tco_1_mes__v_tco_1 ip_tco_2_mes__v_tco_2 ldpm_v_tco__ip_tco_1_mes ldpm_v_tco__ip_tco_2_mes /end DEF_CHARACTERISTIC
 /begin OUT_MEASUREMENT tco tco_mes tco_st tco_1 tco_2 tco_1_mes tco_2_mes v_tco_1 v_tco_2 /end OUT_MEASUREMENT
/end FUNCTION
/begin FUNCTION SYS_VAR_IS "" /end FUNCTION
/begin FUNCTION SYS_VAR_IS_COR "" /begin DEF_CHARACTERISTIC c_n_sp_is_add_acin c_n_sp_is_min_heat c_n_sp_is_min /end DEF_CHARACTERISTIC /begin OUT_MEASUREMENT n_sp_is_add_comp lv_req_n_sp_is_min n_sp_is_min /end OUT_MEASUREMENT /end FUNCTION
/begin FUNCTION SYS_VAR_NIS "" /end FUNCTION
/begin FUNCTION SYS_VAR_AACP ""
 /begin DEF_CHARACTERISTIC lc_tq_acc_can_use ip_acp_mes__ducy_acp_pwm ldp_ducy_acp_pwm_ip_acp_mes c_acp_sub_diag /end DEF_CHARACTERISTIC
 /begin OUT_MEASUREMENT ducy_acp_pwm acp acp_mes tq_loss_acc_inp lv_acp_orng lv_tq_loss_acc_inp_orng /end OUT_MEASUREMENT
/end FUNCTION
/begin FUNCTION SYS_VAR_TIA "" /begin DEF_CHARACTERISTIC lc_tia_sub_mdl /end DEF_CHARACTERISTIC /end FUNCTION
/begin FUNCTION SYS_VAR_APVS "Determination of accelerator pedal value (PVS)"
 /begin DEF_CHARACTERISTIC c_v_pvs_hys_fil c_v_pvs_thd_is_l_1 c_v_pvs_sp_fl_1 c_v_pvs_thd_is_h_1 c_v_pvs_thd_is_l_2 c_v_pvs_thd_is_h_2 c_v_pvs_sp_fl_2 c_v_pvs_thd_kd_1 c_v_pvs_thd_kd_2 c_ctr_max_pvs_is_rng_h c_ctr_max_pvs_is_rng_l c_pv_grd_lih_max c_pv_lih_max c_pvs_bls_bts_plaus_lgrd_neg c_pvs_bls_bts_plaus_lgrd_pos c_v_pvs_sp_max_1 c_v_pvs_sp_max_2 c_v_pvs_thd_grd_1 c_v_pvs_thd_grd_2 /end DEF_CHARACTERISTIC
 /begin OUT_MEASUREMENT pv_av lv_kd pv_av_1 pv_av_2 lv_pvs_kd v_pvs_fil_1 v_pvs_fil_2 pv_av_grd pv_av_sel /end OUT_MEASUREMENT
/end FUNCTION
/begin FUNCTION VAR_APPSCLC ""
 /begin DEF_CHARACTERISTIC c_fac_cha_cal_0 c_fac_cha_cal_1 c_v_cha_cal1 c_v_cha_cal0 c_fac_v_inj_burst_0 c_fac_cur_inj_burst_0 c_ofs_v_inj_burst_0 c_ofs_cur_inj_burst_0 c_fac_v_inj_burst_1 c_fac_cur_inj_burst_1 c_ofs_v_inj_burst_1 c_ofs_cur_inj_burst_1 c_burst_inj_mode c_burst_mes_soi_eoi /end DEF_CHARACTERISTIC
 /begin OUT_MEASUREMENT capa_inj_seq1_[0] capa_inj_seq1_[1] capa_inj_seq1_[2] capa_inj_seq1_[3] capa_inj_seq1 v_inj_beg_main1_[0] v_inj_beg_main1_[1] v_inj_beg_main1_[2] v_inj_beg_main1_[3] v_inj_beg_main1 v_inj_beg_prev1 q_inj_seq1_[0] q_inj_seq1_[1] q_inj_seq1_[2] q_inj_seq1_[3] q_inj_seq1 v_ofs_cha_cal_0 fac_slop_cha_cal_0 v_inj_beg_prev1_[0] v_inj_beg_prev1_[1] v_inj_beg_prev1_[2] v_inj_beg_prev1_[3] v_inj_burst_soi_[0] v_inj_burst_soi_[1] v_inj_burst_soi_[2] v_inj_burst_soi_[3] v_inj_burst_soi_[4] v_inj_burst_soi_[5] v_inj_burst_soi_[6] v_inj_burst_soi_[7] v_inj_burst_soi_[8] v_inj_burst_soi_[9] v_inj_burst_soi_[10] v_inj_burst_soi_[11] v_inj_burst_soi_[12] v_inj_burst_soi_[13] v_inj_burst_soi_[14] v_inj_burst_soi_[15] v_inj_burst_soi_[16] v_inj_burst_soi_[17] v_inj_burst_soi_[18] v_inj_burst_soi_[19] v_inj_burst_soi_[20] v_inj_burst_soi_[21] v_inj_burst_soi_[22] v_inj_burst_soi_[23] v_inj_burst_soi_[24] v_inj_burst_soi_[25] v_inj_burst_soi_[26] v_inj_burst_soi_[27] v_inj_burst_soi_[28] v_inj_burst_soi_[29] v_inj_burst_soi_[30] v_inj_burst_soi_[31] v_inj_burst_soi_[32] v_inj_burst_soi_[33] v_inj_burst_soi_[34] v_inj_burst_soi_[35] v_inj_burst_soi_[36] v_inj_burst_soi_[37] v_inj_burst_soi_[38] v_inj_burst_soi_[39] v_inj_burst_eoi_[0] v_inj_burst_eoi_[1] v_inj_burst_eoi_[2] v_inj_burst_eoi_[3] v_inj_burst_eoi_[4] v_inj_burst_eoi_[5] v_inj_burst_eoi_[6] v_inj_burst_eoi_[7] v_inj_burst_eoi_[8] v_inj_burst_eoi_[9] v_inj_burst_eoi_[10] v_inj_burst_eoi_[11] v_inj_burst_eoi_[12] v_inj_burst_eoi_[13] v_inj_burst_eoi_[14] v_inj_burst_eoi_[15] v_inj_burst_eoi_[16] v_inj_burst_eoi_[17] v_inj_burst_eoi_[18] v_inj_burst_eoi_[19] v_inj_burst_eoi_[20] v_inj_burst_eoi_[21] v_inj_burst_eoi_[22] v_inj_burst_eoi_[23] v_inj_burst_eoi_[24] v_inj_burst_eoi_[25] v_inj_burst_eoi_[26] v_inj_burst_eoi_[27] v_inj_burst_eoi_[28] v_inj_burst_eoi_[29] v_inj_burst_eoi_[30] v_inj_burst_eoi_[31] v_inj_burst_eoi_[32] v_inj_burst_eoi_[33] v_inj_burst_eoi_[34] v_inj_burst_eoi_[35] v_inj_burst_eoi_[36] v_inj_burst_eoi_[37] v_inj_burst_eoi_[38] v_inj_burst_eoi_[39] q_inj_burst_soi_[0] q_inj_burst_soi_[1] q_inj_burst_soi_[2] q_inj_burst_soi_[3] q_inj_burst_soi_[4] q_inj_burst_soi_[5] q_inj_burst_soi_[6] q_inj_burst_soi_[7] q_inj_burst_soi_[8] q_inj_burst_soi_[9] q_inj_burst_soi_[10] q_inj_burst_soi_[11] q_inj_burst_soi_[12] q_inj_burst_soi_[13] q_inj_burst_soi_[14] q_inj_burst_soi_[15] q_inj_burst_soi_[16] q_inj_burst_soi_[17] q_inj_burst_soi_[18] q_inj_burst_soi_[19] cur_inj_burst_[0] lf_burst_prev1_act lf_burst_main1_act lf_burst_norm_act lf_pps_mes_vld v_cha_cal0 v_cha_cal1 q_inj_beg_prev1_[0] q_inj_beg_prev1_[1] q_inj_beg_prev1_[2] q_inj_beg_prev1_[3] q_inj_beg_prev1 q_inj_beg_main1_[0] q_inj_beg_main1_[1] q_inj_beg_main1_[2] q_inj_beg_main1_[3] q_inj_beg_main1 v_inj_frze_prev1_[0] v_inj_frze_prev1_[1] v_inj_frze_prev1_[2] v_inj_frze_prev1_[3] v_inj_toze_prev1_[0] v_inj_toze_prev1_[1] v_inj_toze_prev1_[2] v_inj_toze_prev1_[3] v_inj_frze_main1_[0] v_inj_frze_main1_[1] v_inj_frze_main1_[2] v_inj_frze_main1_[3] v_inj_toze_main1_[0] v_inj_toze_main1_[1] v_inj_toze_main1_[2] v_inj_toze_main1_[3] /end OUT_MEASUREMENT
/end FUNCTION
/begin FUNCTION SYS_VAR_AALT "Generator load signal acquisition" /begin DEF_CHARACTERISTIC c_fac_altpwm_ducy_alter_pwm c_altpwm_sub /end DEF_CHARACTERISTIC /begin OUT_MEASUREMENT altpwm /end OUT_MEASUREMENT /end FUNCTION
/begin FUNCTION SYS_VAR_BPAAQ "Acquisition of the BPA- position"
 /begin DEF_CHARACTERISTIC lc_v_bpa_bol_man[0] c_v_bpa_bol_man[0] c_ang_bpa_tol[0] c_ang_bpa_bol[0] lc_v_bpa_dif_bol_tol_man[0] c_v_bpa_dif_bol_tol_man[0] c_v_bpa_sub_diag /end DEF_CHARACTERISTIC
 /begin OUT_MEASUREMENT ang_bpa[0] v_bpa[0] v_bpa_mes[0] /end OUT_MEASUREMENT
/end FUNCTION
/begin FUNCTION SYS_VAR_EGRVAQ "Acquisition of the EGR- valve position"
 /begin DEF_CHARACTERISTIC lc_v_egrv_bol_man[0] c_v_egrv_bol_man[0] c_v_egrv_dif_bol_tol_man[0] lc_v_egrv_dif_bol_tol_man[0] c_ang_egrv_tol[0] c_ang_egrv_bol[0] c_v_egrv_sub_diag /end DEF_CHARACTERISTIC
 /begin OUT_MEASUREMENT ang_egrv[0] v_egrv[0] v_egrv_mes[0] /end OUT_MEASUREMENT
/end FUNCTION
/end MODULE
/end PROJECT
