ASAP2_VERSION 1 41
/begin PROJECT SN0 "SIMOS PPD"
/begin HEADER "_default_HeaderComment" PROJECT_NO PRJ_NUM /end HEADER
/begin MODULE _default_ModuleName "_default_ModuleLongIdentifier"
/begin MOD_COMMON "_default_ModCommonComment" DEPOSIT ABSOLUTE BYTE_ORDER MSB_FIRST ALIGNMENT_BYTE 1 ALIGNMENT_WORD 2 ALIGNMENT_LONG 4 ALIGNMENT_FLOAT32_IEEE 4 ALIGNMENT_FLOAT64_IEEE 8 /end MOD_COMMON
/begin CHARACTERISTIC c_lshpwm_min_lsh_down "Minimum permitted heater effective voltage PWM for downstream LSH OBDII diagnosis " VALUE 0x840e41 _REC_VAL_20_u1 99.609375 _CNV_A_R_LINEAR_____486_CM 0. 99.609375 DISPLAY_IDENTIFIER C_LSHPWM_MIN_LSH_DOWN FORMAT "%9.6" /end CHARACTERISTIC
/begin CHARACTERISTIC c_lshpwm_max_lsh_down "Maximum permitted heater effective voltage PWM for downstream LSH OBDII diagnosis " VALUE 0x840e3d _REC_VAL_20_u1 99.609375 _CNV_A_R_LINEAR_____486_CM 0. 99.609375 DISPLAY_IDENTIFIER C_LSHPWM_MAX_LSH_DOWN FORMAT "%9.6" /end CHARACTERISTIC
/begin CHARACTERISTIC c_teg_cat_down_max_obd_lsh_down "Temperature threshold under which downstream LSH OBDII diagnosis activated" VALUE 0x840f08 _REC_VAL_20_u2 2047. _CNV_A_R_EGCP_LINEA_468_CM 0. 2047. DISPLAY_IDENTIFIER C_TEG_CAT_DOWN_MAX_OBD_LSH_DOWN FORMAT "%9.4" /end CHARACTERISTIC
/begin CHARACTERISTIC c_temp_sp_obd_lsh_down "Set temperature for downstream LSH operation used to generate power integral" VALUE 0x840f20 _REC_VAL_20_u2 2047. _CNV_A_R_EGCP_LINEA_468_CM 0. 2047. DISPLAY_IDENTIFIER C_TEMP_SP_OBD_LSH_DOWN FORMAT "%9.4" /end CHARACTERISTIC
/begin AXIS_PTS ldp_r_it_ls_down_new_lsh_down "" 0x8408c8 online_dummy _REC_AXS_20_u2 65535. _CNV_A_R_LINEAR_____487_CM 4 0. 65535. FORMAT "%5.0" /end AXIS_PTS
/begin CHARACTERISTIC c_t_dly_obd_lsh_down "Minimum delay prior to checking status of OBDI heater / signal faults" VALUE 0x840eb0 _REC_VAL_20_u1 255. _CNV_A_R_LINEAR_____27_CM 0. 255. DISPLAY_IDENTIFIER C_T_DLY_OBD_LSH_DOWN FORMAT "%3.0" /end CHARACTERISTIC
/begin CHARACTERISTIC ip_fac_maf_obd_lsh_down "Factor reflecting forced convection influence of cooling area, gas velocity and heat transfer coefficient" CURVE 0x840b18 _REC_CUR_20_u1_u2 15.9375 _CNV_A_R_EGCP_LINEA_488_CM 0. 15.9375 DISPLAY_IDENTIFIER IP_FAC_MAF_OBD_LSH_DOWN
 /begin AXIS_DESCR COM_AXIS maf_kgh _CNV_A_R_LINEAR_____479_CM 6 0. 2047.96875 FORMAT "%10.5" AXIS_PTS_REF ldpm_maf_kgh_3_egcp /end AXIS_DESCR
/end CHARACTERISTIC
/begin CHARACTERISTIC c_tcc_thd_err_obd_lsh_down "Fault detection threshold, when exceeded, heater is determined to be defective during driving cycle" VALUE 0x840efa _REC_VAL_20_u2 1023. _CNV_A_R_LINEAR_____1_CM 0. 1023. DISPLAY_IDENTIFIER C_TCC_THD_ERR_OBD_LSH_DOWN FORMAT "%4.0" /end CHARACTERISTIC
/begin CHARACTERISTIC c_tcc_thd_obd_lsh_down "Number of valid downstream LSH OBDII diagnosis cycles over which statistic evaluation to be carried out" VALUE 0x840efe _REC_VAL_20_u2 1023. _CNV_A_R_LINEAR_____1_CM 0. 1023. DISPLAY_IDENTIFIER C_TCC_THD_OBD_LSH_DOWN FORMAT "%4.0" /end CHARACTERISTIC
/begin CHARACTERISTIC c_pow_int_min_obd_lsh_down "Measure of minimum required cooling energy required at downstream sensor prior to checking Ri threshold" VALUE 0x840e7e _REC_VAL_20_u2 65535. _CNV_A_R_LINEAR_____489_CM 0. 65535. DISPLAY_IDENTIFIER C_POW_INT_MIN_OBD_LSH_DOWN FORMAT "%5.0" /end CHARACTERISTIC
/begin CHARACTERISTIC ip_r_it_thd_obd_lsh_down "Internal resistance threshold, when exceeded, heater is determined to be defective for current diagnosis cycle" CURVE 0x840c6e _REC_CUR_20_u2_u2 65535. _CNV_A_R_LINEAR_____487_CM 0. 65535. DISPLAY_IDENTIFIER IP_R_IT_THD_OBD_LSH_DOWN FORMAT "%5.0"
 /begin AXIS_DESCR COM_AXIS online_dummy _CNV_A_R_LINEAR_____487_CM 4 0. 65535. FORMAT "%5.0" AXIS_PTS_REF ldp_r_it_ls_down_new_lsh_down /end AXIS_DESCR
/end CHARACTERISTIC
/begin MEASUREMENT lv_err_obd_lsh_down_1 "Boolean flag indicating that diagnosis has been completed" UBYTE _CNV_S_2_RANGE__0___85_CM 1 0. 0. 1. DISPLAY_IDENTIFIER LV_ERR_OBD_LSH_DOWN_1_ ECU_ADDRESS 0x7fb950 BIT_MASK 0x1 /end MEASUREMENT
/begin CHARACTERISTIC c_lshpwm_min_lsh_up "Minimum permitted heater effective voltage PWM for upstream LSH OBD2 diagnosis" VALUE 0x840e42 _REC_VAL_20_u1 99.609375 _CNV_A_R_LINEAR_____486_CM 0. 99.609375 DISPLAY_IDENTIFIER C_LSHPWM_MIN_LSH_UP FORMAT "%9.6" /end CHARACTERISTIC
/begin CHARACTERISTIC c_ttip_min_obd_lsh_up "Lower diagnosis threshold for oxygen sensor ceramic temperature" VALUE 0x840f2c _REC_VAL_20_s2 4095.9375 _CNV_A_R_EGCP_LINEA_468_CM -2048. 2047.9375 DISPLAY_IDENTIFIER C_TTIP_MIN_OBD_LSH_UP FORMAT "%10.4" /end CHARACTERISTIC
/begin CHARACTERISTIC c_ttip_max_obd_lsh_up "Upper diagnosis threshold for oxygen sensor ceramic temperature" VALUE 0x840f26 _REC_VAL_20_s2 4095.9375 _CNV_A_R_EGCP_LINEA_468_CM -2048. 2047.9375 DISPLAY_IDENTIFIER C_TTIP_MAX_OBD_LSH_UP FORMAT "%10.4" /end CHARACTERISTIC
/begin CHARACTERISTIC c_tcc_thd_obd_lsh_up "Number of valid LSH OBD2 diagnosis cycles over which statistic evaluation to be carried out" VALUE 0x840f00 _REC_VAL_20_u2 65535. _CNV_A_R_LINEAR_____1_CM 0. 65535. DISPLAY_IDENTIFIER C_TCC_THD_OBD_LSH_UP FORMAT "%5.0" /end CHARACTERISTIC
/begin CHARACTERISTIC c_tcc_thd_err_obd_lsh_up "Fault detection threshold, when exceeded, heater is determined to be defective during driving cycle" VALUE 0x840efc _REC_VAL_20_u2 65535. _CNV_A_R_LINEAR_____1_CM 0. 65535. DISPLAY_IDENTIFIER C_TCC_THD_ERR_OBD_LSH_UP FORMAT "%5.0" /end CHARACTERISTIC
/begin CHARACTERISTIC lc_obd_rep_lsh_up "Logical constant permitting dignosis to be repeated within onde driving cycle" VALUE 0x840fb4 _REC_VAL_20_u1 1. _CNV_A_R_LINEAR_____1_CM 0. 1. DISPLAY_IDENTIFIER LC_OBD_REP_LSH_UP FORMAT "%1.0" /end CHARACTERISTIC
/begin CHARACTERISTIC ip_t_dly_ls_up_ready_raw_lsh_up "Time after heater management start to exaggerated forced stimulation, if no raw readiness observed" CURVE 0x840cc2 _REC_CUR_20_u2_u2 6553.5 _CNV_A_R_LINEAR_____240_CM 0. 6553.5 DISPLAY_IDENTIFIER IP_T_DLY_LS_UP_READY_RAW_LSH_UP FORMAT "%6.1"
 /begin AXIS_DESCR COM_AXIS online_dummy _CNV_A_R_EGCP_LINEA_469_CM 6 -2048. 2047.9375 FORMAT "%10.4" AXIS_PTS_REF ldpm_temp_ini_ls_up_1_egcp /end AXIS_DESCR
/end CHARACTERISTIC
/begin CHARACTERISTIC ip_t_dly_ls_up_ready_obd_lsh_up "Time threshold after heater management start where fault detected, if no full operative readiness observed" CURVE 0x840cb6 _REC_CUR_20_u2_u2 6553.5 _CNV_A_R_LINEAR_____240_CM 0. 6553.5 DISPLAY_IDENTIFIER IP_T_DLY_LS_UP_READY_OBD_LSH_UP FORMAT "%6.1"
 /begin AXIS_DESCR COM_AXIS online_dummy _CNV_A_R_EGCP_LINEA_469_CM 6 -2048. 2047.9375 FORMAT "%10.4" AXIS_PTS_REF ldpm_temp_ini_ls_up_1_egcp /end AXIS_DESCR
/end CHARACTERISTIC
/begin CHARACTERISTIC lc_obd_lsh_up "Logical constant permitting dignosis to be carried out" VALUE 0x840fb3 _REC_VAL_20_u1 1. _CNV_A_R_LINEAR_____1_CM 0. 1. DISPLAY_IDENTIFIER LC_OBD_LSH_UP FORMAT "%1.0" /end CHARACTERISTIC
/begin CHARACTERISTIC c_t_dly_pow_ctl_obd_lsh_up "Minimum delay prior to checking status of OBD1 heater /signal faults" VALUE 0x840eb3 _REC_VAL_20_u1 255. _CNV_A_R_LINEAR_____27_CM 0. 255. DISPLAY_IDENTIFIER C_T_DLY_POW_CTL_OBD_LSH_UP FORMAT "%3.0" /end CHARACTERISTIC
/begin CHARACTERISTIC c_t_dly_ttip_mes_obd_lsh_up "Time delay after TTIP_ERR_MES symptom valid to set error flag" VALUE 0x840eb6 _REC_VAL_20_u1 255. _CNV_A_R_LINEAR_____27_CM 0. 255. DISPLAY_IDENTIFIER C_T_DLY_TTIP_MES_OBD_LSH_UP FORMAT "%3.0" /end CHARACTERISTIC
/begin CHARACTERISTIC c_t_dly_ttip_res_obd_lsh_up "Time delay to reset TTIP_ERR_MES timer" VALUE 0x840eb7 _REC_VAL_20_u1 255. _CNV_A_R_LINEAR_____27_CM 0. 255. DISPLAY_IDENTIFIER C_T_DLY_TTIP_RES_OBD_LSH_UP FORMAT "%3.0" /end CHARACTERISTIC
/begin MEASUREMENT egcp[0].egcp_struct_outdglshi0.lv_inh_diag_lsh_up "Inhibit flag for upstream oxygen sensor heater OBDI diagnosis" UBYTE _CNV_S_2_RANGE__0___85_CM 1 0. 0. 1. DISPLAY_IDENTIFIER LV_INH_DIAG_LSH_UP_1_ ECU_ADDRESS 0x7f95f5 BIT_MASK 0x1 /end MEASUREMENT
/begin MEASUREMENT egcp[0].egcp_struct_outdglshdi0.lv_inh_diag_lsh_down "Inhibit flag for downstream oxygen sensor heater OBDI diagnosis" UBYTE _CNV_S_2_RANGE__0___85_CM 1 0. 0. 1. DISPLAY_IDENTIFIER LV_INH_DIAG_LSH_DOWN_1_ ECU_ADDRESS 0x7f95f8 BIT_MASK 0x1 /end MEASUREMENT
/begin MEASUREMENT egcp[0].egcp_struct_pladgspii0.lv_inh_diag_lsl_up_if "Inhibit diagnosis" UBYTE _CNV_S_2_RANGE__0___85_CM 1 0. 0. 1. DISPLAY_IDENTIFIER LV_INH_DIAG_LSL_UP_IF_1_ ECU_ADDRESS 0x7f95fc BIT_MASK 0x1 /end MEASUREMENT
/begin MEASUREMENT egcp[0].egcp_struct_sigcvridi0.lv_inh_r_it_ls_down "Boolean flag indicating that downstream sensor internal resistance determination shall be inhibited when set" UBYTE _CNV_S_2_RANGE__0___85_CM 1 0. 0. 1. DISPLAY_IDENTIFIER LV_INH_R_IT_LS_DOWN_1_ ECU_ADDRESS 0x7f9656 BIT_MASK 0x1 /end MEASUREMENT
/begin MEASUREMENT egcp[0].egcp_struct_sigdglsdi1.lv_inh_diag_oc_ls_down "Boolean flag indicating project specific application conditions for downstream open line diagnosis not met" UBYTE _CNV_S_2_RANGE__0___85_CM 1 0. 0. 1. DISPLAY_IDENTIFIER LV_INH_DIAG_OC_LS_DOWN_1_ ECU_ADDRESS 0x7f9692 BIT_MASK 0x1 /end MEASUREMENT
/begin MEASUREMENT egcp[0].egcp_struct_sigdglsdi1.lv_inh_diag_puc_ls_down "Boolean flag indicating project specific application conditions for downstream PUC diagnosis not met" UBYTE _CNV_S_2_RANGE__0___85_CM 1 0. 0. 1. DISPLAY_IDENTIFIER LV_INH_DIAG_PUC_LS_DOWN_1_ ECU_ADDRESS 0x7f9693 BIT_MASK 0x1 /end MEASUREMENT
/begin MEASUREMENT egcp[0].egcp_struct_sigdglsdi1.lv_inh_diag_fl_ls_down "Boolean flag indicating project specific application conditions for downstream FL diagnosis not met" UBYTE _CNV_S_2_RANGE__0___85_CM 1 0. 0. 1. DISPLAY_IDENTIFIER LV_INH_DIAG_FL_LS_DOWN_1_ ECU_ADDRESS 0x7f9694 BIT_MASK 0x1 /end MEASUREMENT
/begin MEASUREMENT egcp[0].egcp_struct_sigdglsdi1.lv_inh_diag_scg_ls_down "Boolean flag indicating project specific application conditions for downstream SCG diagnosis not met" UBYTE _CNV_S_2_RANGE__0___85_CM 1 0. 0. 1. DISPLAY_IDENTIFIER LV_INH_DIAG_SCG_LS_DOWN_1_ ECU_ADDRESS 0x7f9695 BIT_MASK 0x1 /end MEASUREMENT
/begin MEASUREMENT egcp[0].egcp_struct_sigdglsdi1.lv_inh_diag_scp_ls_down "Boolean flag indicating project specific application conditions for downstream short to plus diagnosis not met" UBYTE _CNV_S_2_RANGE__0___85_CM 1 0. 0. 1. DISPLAY_IDENTIFIER LV_INH_DIAG_SCP_LS_DOWN_1_ ECU_ADDRESS 0x7f9696 BIT_MASK 0x1 /end MEASUREMENT
/begin MEASUREMENT egcp[0].egcp_struct_sigdglslai0.lv_inh_diag_el_lsl_up "Deactivation of \"HW-Based Diagnosis with the CJ120\"" UBYTE _CNV_S_2_RANGE__0___85_CM 1 0. 0. 1. DISPLAY_IDENTIFIER LV_INH_DIAG_EL_LSL_UP_1_ ECU_ADDRESS 0x7f96a6 BIT_MASK 0x1 /end MEASUREMENT
/begin MEASUREMENT egcp[0].egcp_struct_sigdglslai0.lv_inh_diag_oc_lsl_up "Deactivation of \"Open Circuit Diagnosis\"" UBYTE _CNV_S_2_RANGE__0___85_CM 1 0. 0. 1. DISPLAY_IDENTIFIER LV_INH_DIAG_OC_LSL_UP_1_ ECU_ADDRESS 0x7f96a7 BIT_MASK 0x1 /end MEASUREMENT
/begin MEASUREMENT egcp[0].egcp_struct_sigdglslai0.lv_iplsl_diag_inh_lsl_up "Deactivation of \"HW-Based Diagnosis with the CJ120\"" UBYTE _CNV_S_2_RANGE__0___85_CM 1 0. 0. 1. DISPLAY_IDENTIFIER LV_IPLSL_DIAG_INH_LSL_UP_1_ ECU_ADDRESS 0x7f96a8 BIT_MASK 0x1 /end MEASUREMENT
/begin MEASUREMENT egcp[0].egcp_struct_pladgft0.lamb_delta_i_save_diag "I-share from trim controller  - to be transmitted to the Scan Tool mode06" SWORD _CNV_A_R_LINEAR_____506_CM 1 0. -0.125 0.125 DISPLAY_IDENTIFIER LAMB_DELTA_I_SAVE_DIAG_1_ ECU_ADDRESS 0x7f96aa BYTE_ORDER MSB_LAST FORMAT "%8.5" /end MEASUREMENT
/begin MEASUREMENT egcp[0].egcp_struct_pladgft0.lam_mmv_vls_dif_dly_ldc "Floating mean value for limited lambda deviation" SWORD _CNV_A_R_LINEAR_____515_CM 1 0. -50. 49.9984741210938 DISPLAY_IDENTIFIER LAM_MMV_VLS_DIF_DLY_LDC_1_ ECU_ADDRESS 0x7f96ac BYTE_ORDER MSB_LAST FORMAT "%7.3" /end MEASUREMENT
/begin MEASUREMENT egcp[0].egcp_struct_pladgft0.maf_int_vls_dif_dly_min "MAF integral for lower VLS_DIF_DLY deviation" UWORD _CNV_A_R_LINEAR_____482_CM 1 0. 0. 1820.42 DISPLAY_IDENTIFIER MAF_INT_VLS_DIF_DLY_MIN_1_ ECU_ADDRESS 0x7f96ae BYTE_ORDER MSB_LAST FORMAT "%7.2" /end MEASUREMENT
/begin MEASUREMENT egcp[0].egcp_struct_pladgft0.maf_int_vls_dif_dly_max "MAF integral for upper VLS_DIF_DLY deviation" UWORD _CNV_A_R_LINEAR_____482_CM 1 0. 0. 1820.42 DISPLAY_IDENTIFIER MAF_INT_VLS_DIF_DLY_MAX_1_ ECU_ADDRESS 0x7f96b0 BYTE_ORDER MSB_LAST FORMAT "%7.2" /end MEASUREMENT
/begin MEASUREMENT egcp[0].egcp_struct_pladgft0.maf_int_vls_dif_dly_ldc "Integral of mass air flow since limited dynamic conditions fulfilled" UWORD _CNV_A_R_EGCP_LINEA_516_CM 1 0. 0. 1389. DISPLAY_IDENTIFIER MAF_INT_VLS_DIF_DLY_LDC_1_ ECU_ADDRESS 0x7f96b2 BYTE_ORDER MSB_LAST FORMAT "%7.2" /end MEASUREMENT
/begin MEASUREMENT egcp[0].egcp_struct_pladgft0.t_sum_max_diag_lam_adj "Total duration over C_LAMB_DELTA_I_MAX_DIAG" UWORD _CNV_A_R_LINEAR_____27_CM 1 0. 0. 65535. DISPLAY_IDENTIFIER T_SUM_MAX_DIAG_LAM_ADJ_1_ ECU_ADDRESS 0x7f96b4 BYTE_ORDER MSB_LAST FORMAT "%5.0" /end MEASUREMENT
/begin MEASUREMENT egcp[0].egcp_struct_pladgft0.t_sum_min_diag_lam_adj "Total duration over C_LAMB_DELTA_I_MIN_DIAG" UWORD _CNV_A_R_LINEAR_____27_CM 1 0. 0. 65535. DISPLAY_IDENTIFIER T_SUM_MIN_DIAG_LAM_ADJ_1_ ECU_ADDRESS 0x7f96b6 BYTE_ORDER MSB_LAST FORMAT "%5.0" /end MEASUREMENT
/begin MEASUREMENT egcp[0].egcp_struct_pladgft0.t_rst_sum_diag_lam_adj "Time counter to reset T_SUM_MIN_DIAG_LAM_ADJ[NC_CBK_EX_NR] and T_SUM_MAX_DIAG_LAM_ADJ[NC_CBK_EX_NR]" UWORD _CNV_A_R_LINEAR_____27_CM 1 0. 0. 65535. DISPLAY_IDENTIFIER T_RST_SUM_DIAG_LAM_ADJ_1_ ECU_ADDRESS 0x7f96b8 BYTE_ORDER MSB_LAST FORMAT "%5.0" /end MEASUREMENT
/begin MEASUREMENT egcp[0].egcp_struct_pladgft0.t_vls_down_dif_end_diag "Time counter to set T_VLS_DOWN_DIF_END_DIAG[NC_CBK_EX_NR]" UWORD _CNV_A_R_LINEAR_____27_CM 1 0. 0. 65535. DISPLAY_IDENTIFIER T_VLS_DOWN_DIF_END_DIAG_1_ ECU_ADDRESS 0x7f96ba BYTE_ORDER MSB_LAST FORMAT "%5.0" /end MEASUREMENT
/begin MEASUREMENT egcp[0].egcp_struct_pladgft0.t_vls_down_dif_sum_rst_diag "Time counter to reset T_VLS_DOWN_DIF_SUM_MIN_DIAG[NC_CBK_EX_NR] and T_VLS_DOWN_DIF_SUM_MAX_DIAG[NC_CBK_EX_NR]" UWORD _CNV_A_R_LINEAR_____27_CM 1 0. 0. 65535. DISPLAY_IDENTIFIER T_VLS_DOWN_DIF_SUM_RST_DIAG_1_ ECU_ADDRESS 0x7f96bc BYTE_ORDER MSB_LAST FORMAT "%5.0" /end MEASUREMENT
/begin MEASUREMENT egcp[0].egcp_struct_pladgft0.t_end_diag_lam_adj "Time counter to set T_END_DIAG_LAM_ADJ[i]" UWORD _CNV_A_R_LINEAR_____27_CM 1 0. 0. 65535. DISPLAY_IDENTIFIER T_END_DIAG_LAM_ADJ_1_ ECU_ADDRESS 0x7f96be BYTE_ORDER MSB_LAST FORMAT "%5.0" /end MEASUREMENT
/begin MEASUREMENT egcp[0].egcp_struct_pladgft0.state_err_vls_down_dif "Symptoms of trim control errors" UBYTE _CNV_S_3_EGCP_RANGE_517_CM 1 0. 0. 2. DISPLAY_IDENTIFIER STATE_ERR_VLS_DOWN_DIF_1_ ECU_ADDRESS 0x7f96c0 /end MEASUREMENT
/begin MEASUREMENT egcp[0].egcp_struct_pladgft0.state_err_delta_i_lam_adj "Symptoms of the lambda trim control errors" UBYTE _CNV_S_3_EGCP_RANGE_512_CM 1 0. 0. 2. DISPLAY_IDENTIFIER STATE_ERR_DELTA_I_LAM_ADJ_1_ ECU_ADDRESS 0x7f96c1 /end MEASUREMENT
/begin MEASUREMENT egcp[0].egcp_struct_pladgft0.lv_vls_down_dif_end_diag "Trim controller deviation diagnostic available" UBYTE _CNV_S_2_RANGE__0___85_CM 1 0. 0. 1. DISPLAY_IDENTIFIER LV_VLS_DOWN_DIF_END_DIAG_1_ ECU_ADDRESS 0x7f96c2 BIT_MASK 0x1 /end MEASUREMENT
/begin MEASUREMENT egcp[0].egcp_struct_pladgft0.lv_vls_down_dif_cdn_diag "Condition to activate trim controller deviation diagnosis" UBYTE _CNV_S_2_RANGE__0___85_CM 1 0. 0. 1. DISPLAY_IDENTIFIER LV_VLS_DOWN_DIF_CDN_DIAG_1_ ECU_ADDRESS 0x7f96c3 BIT_MASK 0x1 /end MEASUREMENT
/begin MEASUREMENT egcp[0].egcp_struct_pladgft0.lv_vls_down_dif_sym_diag "Symptom detected (VLS_DIF_DLY deviation)" UBYTE _CNV_S_2_RANGE__0___85_CM 1 0. 0. 1. DISPLAY_IDENTIFIER LV_VLS_DOWN_DIF_SYM_DIAG_1_ ECU_ADDRESS 0x7f96c4 BIT_MASK 0x1 /end MEASUREMENT
/begin MEASUREMENT egcp[0].egcp_struct_pladgft0.lv_delta_i_lam_adj_cdn_diag "Diagnosis condition of lambda trim control" UBYTE _CNV_S_2_RANGE__0___85_CM 1 0. 0. 1. DISPLAY_IDENTIFIER LV_DELTA_I_LAM_ADJ_CDN_DIAG_1_ ECU_ADDRESS 0x7f96c5 BIT_MASK 0x1 /end MEASUREMENT
/begin MEASUREMENT egcp[0].egcp_struct_pladgft0.lv_delta_i_lam_adj_sym_diag "Status diagnostic result of lambda trim control" UBYTE _CNV_S_2_RANGE__0___85_CM 1 0. 0. 1. DISPLAY_IDENTIFIER LV_DELTA_I_LAM_ADJ_SYM_DIAG_1_ ECU_ADDRESS 0x7f96c6 BIT_MASK 0x1 /end MEASUREMENT
/begin MEASUREMENT egcp[0].egcp_struct_pladgft0.lv_delta_i_lam_adj_end_diag "Diagnostic cycle for lambda trim control complete" UBYTE _CNV_S_2_RANGE__0___85_CM 1 0. 0. 1. DISPLAY_IDENTIFIER LV_DELTA_I_LAM_ADJ_END_DIAG_1_ ECU_ADDRESS 0x7f96c7 BIT_MASK 0x1 /end MEASUREMENT
/begin MEASUREMENT egcp[0].egcp_struct_pladgft0.lv_vls_dif_dly_ldc "Status limited dynamic for the function \"Monitoring Trim Controller Deviation\"" UBYTE _CNV_S_2_RANGE__0___85_CM 1 0. 0. 1. DISPLAY_IDENTIFIER LV_VLS_DIF_DLY_LDC_1_ ECU_ADDRESS 0x7f96c8 BIT_MASK 0x1 /end MEASUREMENT
/begin MEASUREMENT egcp[0].egcp_struct_pladgft0.lv_vls_dif_dly_ldc_lam_mv "Status limited dynamic FAC_LAM_MV[i]" UBYTE _CNV_S_2_RANGE__0___85_CM 1 0. 0. 1. DISPLAY_IDENTIFIER LV_VLS_DIF_DLY_LDC_LAM_MV_1_ ECU_ADDRESS 0x7f96c9 BIT_MASK 0x1 /end MEASUREMENT
/begin MEASUREMENT egcp[0].egcp_struct_pladgfti0.lv_inh_diag_dly_lam "Inhibition condition for the dynamic fuel trim diagnosis" UBYTE _CNV_S_2_RANGE__0___85_CM 1 0. 0. 1. DISPLAY_IDENTIFIER LV_INH_DIAG_DLY_LAM_1_ ECU_ADDRESS 0x7f96ca BIT_MASK 0x1 /end MEASUREMENT
/begin MEASUREMENT egcp[0].egcp_struct_fctdglslh0.ttip_mes_ls_up_obd_lsh_up "Most current oxygen sensor temperature (Mode 6 information)" SWORD _CNV_A_R_EGCP_LINEA_468_CM 1 0. -2048. 2047.9375 DISPLAY_IDENTIFIER TTIP_MES_LS_UP_OBD_LSH_UP_1_ ECU_ADDRESS 0x7f96cc BYTE_ORDER MSB_LAST FORMAT "%10.4" /end MEASUREMENT
/begin MEASUREMENT egcp[0].egcp_struct_fctdglslh0.tcc_vld_obd_lsh_up "Number of completed diagnosis cycles" UWORD _CNV_A_R_LINEAR_____1_CM 1 0. 0. 65535. DISPLAY_IDENTIFIER TCC_VLD_OBD_LSH_UP_1_ ECU_ADDRESS 0x7f96ce BYTE_ORDER MSB_LAST FORMAT "%5.0" /end MEASUREMENT
/begin MEASUREMENT egcp[0].egcp_struct_fctdglslh0.tcc_err_obd_lsh_up "Number of diagnosis cycles in which temperature deviation exceeding limits present" UWORD _CNV_A_R_LINEAR_____1_CM 1 0. 0. 65535. DISPLAY_IDENTIFIER TCC_ERR_OBD_LSH_UP_1_ ECU_ADDRESS 0x7f96d0 BYTE_ORDER MSB_LAST FORMAT "%5.0" /end MEASUREMENT
/begin MEASUREMENT egcp[0].egcp_struct_fctdglslh0.state_sym_obd_lsl_lsh_up "Variable indicating status of each symptom, updated each recurrence & at diagnosis completion" UBYTE _CNV_S_4_EGCP_RANGE_518_CM 1 0. 0. 4. DISPLAY_IDENTIFIER STATE_SYM_OBD_LSL_LSH_UP_1_ ECU_ADDRESS 0x7f96d2 /end MEASUREMENT
/begin MEASUREMENT egcp[0].egcp_struct_fctdglslh0.lv_lamb_pls_req_diag_lsh_up "Boolean flag requesting exaggerated forced stimulation" UBYTE _CNV_S_2_RANGE__0___85_CM 1 0. 0. 1. DISPLAY_IDENTIFIER LV_LAMB_PLS_REQ_DIAG_LSH_UP_1_ ECU_ADDRESS 0x7f96d3 BIT_MASK 0x1 /end MEASUREMENT
/begin MEASUREMENT egcp[0].egcp_struct_fctdglslh0.lv_diag_obd_cdn_lsh_up "Boolean flag indicating that conditions for diagnosis met" UBYTE _CNV_S_2_RANGE__0___85_CM 1 0. 0. 1. DISPLAY_IDENTIFIER LV_DIAG_OBD_CDN_LSH_UP_1_ ECU_ADDRESS 0x7f96d4 BIT_MASK 0x1 /end MEASUREMENT
/begin MEASUREMENT egcp[0].egcp_struct_fctdglslh0.lv_diag_obd_sym_lsh_up "Boolean flag indicating that fault is present and has been debounced" UBYTE _CNV_S_2_RANGE__0___85_CM 1 0. 0. 1. DISPLAY_IDENTIFIER LV_DIAG_OBD_SYM_LSH_UP_1_ ECU_ADDRESS 0x7f96d5 BIT_MASK 0x1 /end MEASUREMENT
/begin MEASUREMENT egcp[0].egcp_struct_fctdglslh0.lv_diag_obd_end_lsh_up "Boolean flag indicating that diagnosis has been completed" UBYTE _CNV_S_2_RANGE__0___85_CM 1 0. 0. 1. DISPLAY_IDENTIFIER LV_DIAG_OBD_END_LSH_UP_1_ ECU_ADDRESS 0x7f96d6 BIT_MASK 0x1 /end MEASUREMENT
/begin MEASUREMENT egcp[0].egcp_struct_fctdglshd1.r_it_thd_obd_lsh_down "Threshold for most current downstream oxygen sensor internal resistance used for diagnosis cycle, Mode 6 information" UWORD _CNV_A_R_LINEAR_____1_CM 1 0. 0. 65535. DISPLAY_IDENTIFIER R_IT_THD_OBD_LSH_DOWN_1_ ECU_ADDRESS 0x7f96d8 BYTE_ORDER MSB_LAST FORMAT "%5.0" /end MEASUREMENT
/begin MEASUREMENT egcp[0].egcp_struct_fctdglshd1.r_it_obd_lsh_down "Most current downstream oxygen sensor internal resistance used for diagnosis cycle, Mode 6 information" UWORD _CNV_A_R_LINEAR_____1_CM 1 0. 0. 65535. DISPLAY_IDENTIFIER R_IT_OBD_LSH_DOWN_1_ ECU_ADDRESS 0x7f96da BYTE_ORDER MSB_LAST FORMAT "%5.0" /end MEASUREMENT
/begin MEASUREMENT egcp[0].egcp_struct_fctdglshd1.temp_dif_obd_lsh_down "Indicates difference in temperature between set operating temperature & exhaust gas at sensor location" UWORD _CNV_A_R_EGCP_LINEA_519_CM 1 0. 0. 2047. DISPLAY_IDENTIFIER TEMP_DIF_OBD_LSH_DOWN_1_ ECU_ADDRESS 0x7f96dc BYTE_ORDER MSB_LAST FORMAT "%4.0" /end MEASUREMENT
/begin MEASUREMENT egcp[0].egcp_struct_fctdglshd1.pow_int_obd_lsh_down "Integral indicates measure of cooling energy of exhaust gas at sensor location" UWORD _CNV_A_R_LINEAR_____489_CM 1 0. 0. 65535. DISPLAY_IDENTIFIER POW_INT_OBD_LSH_DOWN_1_ ECU_ADDRESS 0x7f96de BYTE_ORDER MSB_LAST FORMAT "%5.0" /end MEASUREMENT
/begin MEASUREMENT egcp[0].egcp_struct_fctdglshd1.tcc_vld_obd_lsh_down "Number of completed valid diagnosis cycles" UWORD _CNV_A_R_LINEAR_____1_CM 1 0. 0. 1023. DISPLAY_IDENTIFIER TCC_VLD_OBD_LSH_DOWN_1_ ECU_ADDRESS 0x7f96e0 BYTE_ORDER MSB_LAST FORMAT "%4.0" /end MEASUREMENT
/begin MEASUREMENT egcp[0].egcp_struct_fctdglshd1.tcc_err_obd_lsh_down "Number of faults detected during valid diagnosis cycles" UWORD _CNV_A_R_LINEAR_____1_CM 1 0. 0. 1023. DISPLAY_IDENTIFIER TCC_ERR_OBD_LSH_DOWN_1_ ECU_ADDRESS 0x7f96e2 BYTE_ORDER MSB_LAST FORMAT "%4.0" /end MEASUREMENT
/begin MEASUREMENT egcp[0].egcp_struct_fctdglshd1.ctr_cycnr_r_it_obd_ls_down "Value of handshake counter for last valid resistance value used for diagnosis" UWORD _CNV_A_R_LINEAR_____1_CM 1 0. 0. 65535. DISPLAY_IDENTIFIER CTR_CYCNR_R_IT_OBD_LS_DOWN_1_ ECU_ADDRESS 0x7f96e4 BYTE_ORDER MSB_LAST FORMAT "%5.0" /end MEASUREMENT
/begin MEASUREMENT egcp[0].egcp_struct_fctdglshd1.state_obd_lsh_down "Indicates current phase of oxygen sensor heater OBDII diagnosis" UBYTE _CNV_S_9_EGCP_RANGE_520_CM 1 0. 0. 8. DISPLAY_IDENTIFIER STATE_OBD_LSH_DOWN_1_ ECU_ADDRESS 0x7f96e6 /end MEASUREMENT
/begin MEASUREMENT egcp[0].egcp_struct_fctdglshdi1.lv_inh_diag_obd_lsh_down "Boolean inhibit flag for O2 sensor heater OBDII monitoring" UBYTE _CNV_S_2_RANGE__0___85_CM 1 0. 0. 1. DISPLAY_IDENTIFIER LV_INH_DIAG_OBD_LSH_DOWN_1_ ECU_ADDRESS 0x7f96e8 BIT_MASK 0x1 /end MEASUREMENT
/begin MEASUREMENT egcp[0].egcp_struct_sigdglsd2.vls_dif_diag_rgn_nt_ls_down "Difference of VLS_DOWN_i values from the beginning to the end of the MAF_INT_RGN_NT_END calculation" SWORD _CNV_A_R_LINEAR_____521_CM 1 0. -5.00000000000182 4.99511718999747 DISPLAY_IDENTIFIER VLS_DIF_DIAG_RGN_NT_LS_DOWN_1_ ECU_ADDRESS 0x7f96ea BYTE_ORDER MSB_LAST /end MEASUREMENT
/begin MEASUREMENT egcp[0].egcp_struct_sigdglsd2.vls_down_tran_puc "Monitor sensor voltage on activating the trailing throttle fuel cut-off, Bank i" UWORD _CNV_A_R_LINEAR_____265_CM 1 0. 0. 4.9951171875 DISPLAY_IDENTIFIER VLS_DOWN_TRAN_PUC_1_ ECU_ADDRESS 0x7f96ec BYTE_ORDER MSB_LAST FORMAT "%5.3" /end MEASUREMENT
/begin MEASUREMENT egcp[0].egcp_struct_sigdglsd2.vls_down_pue "Monitor sensor voltage at the time of leaving PUC, Bank i (i=1.2)" UWORD _CNV_A_R_LINEAR_____265_CM 1 0. 0. 4.9951171875 DISPLAY_IDENTIFIER VLS_DOWN_PUE_1_ ECU_ADDRESS 0x7f96ee BYTE_ORDER MSB_LAST FORMAT "%5.3" /end MEASUREMENT
/begin MEASUREMENT egcp[0].egcp_struct_sigdglsd2.vls_dif_diag_pue_ls_down "difference of VLS_DOWN_i values from the beginning to the end of the MAF_INT_PUE calculation" UWORD _CNV_A_R_LINEAR_____265_CM 1 0. 0. 4.9951171875 DISPLAY_IDENTIFIER VLS_DIF_DIAG_PUE_LS_DOWN_1_ ECU_ADDRESS 0x7f96f0 BYTE_ORDER MSB_LAST FORMAT "%5.3" /end MEASUREMENT
/begin MEASUREMENT egcp[0].egcp_struct_sigdglsd2.vls_dif_save_diag_ls_down "Difference of VLS_DOWN_i values from the beginning to the end of the MAF_INT_PUE calculation for scantool" UWORD _CNV_A_R_LINEAR_____265_CM 1 0. 0. 4.9951171875 DISPLAY_IDENTIFIER VLS_DIF_SAVE_DIAG_LS_DOWN_1_ ECU_ADDRESS 0x7f96f2 BYTE_ORDER MSB_LAST FORMAT "%5.3" /end MEASUREMENT
/begin MEASUREMENT egcp[0].egcp_struct_sigdglsd2.vls_down_rgn_nt_end "Monitor sensor voltage at the time of leaving regeneration phase of NOx trap, Bank i (i=1.2)" UWORD _CNV_A_R_LINEAR_____265_CM 1 0. 0. 4.9951171875 DISPLAY_IDENTIFIER VLS_DOWN_RGN_NT_END_1_ ECU_ADDRESS 0x7f96f4 BYTE_ORDER MSB_LAST FORMAT "%5.3" /end MEASUREMENT
/begin MEASUREMENT egcp[0].egcp_struct_sigdglsd2.ctr_end_diag_pue_ls_down "Counter to set LV_END_DIAG_VLS_DOWN_PUE_i" UWORD _CNV_A_R_LINEAR_____1_CM 1 0. 0. 65535. DISPLAY_IDENTIFIER CTR_END_DIAG_PUE_LS_DOWN_1_ ECU_ADDRESS 0x7f96f6 BYTE_ORDER MSB_LAST FORMAT "%5.0" /end MEASUREMENT
/begin MEASUREMENT egcp[0].egcp_struct_sigdglsd2.ctr_quo_sum_swt_ls_down "Sum of weighted CTR_SWT_ACT_LS_DOWN[NC_CBK_EX_NR], Bank i" UWORD _CNV_A_R_LINEAR_____254_CM 1 0. 0. 255.99609375 DISPLAY_IDENTIFIER CTR_QUO_SUM_SWT_LS_DOWN_1_ ECU_ADDRESS 0x7f96f8 BYTE_ORDER MSB_LAST FORMAT "%10.6" /end MEASUREMENT
/begin MEASUREMENT egcp[0].egcp_struct_sigdglsd2.ctr_quo_swt_ls_down "Weighted value CTR_SWT_ACT_LS_DOWN[NC_CBK_EX_NR ]" UWORD _CNV_A_R_LINEAR_____254_CM 1 0. 0. 255.99609375 DISPLAY_IDENTIFIER CTR_QUO_SWT_LS_DOWN_1_ ECU_ADDRESS 0x7f96fa BYTE_ORDER MSB_LAST FORMAT "%10.6" /end MEASUREMENT
/begin MEASUREMENT egcp[0].egcp_struct_sigdglsd2.ctr_swt_act_ls_down "Cycle counter for switching time determination, Bank i" UBYTE _CNV_A_R_LINEAR_____437_CM 1 0. 0. 5100. DISPLAY_IDENTIFIER CTR_SWT_ACT_LS_DOWN_1_ ECU_ADDRESS 0x7f96fc FORMAT "%4.0" /end MEASUREMENT
/begin MEASUREMENT egcp[0].egcp_struct_sigdglsd2.ctr_swt_ls_down "Number of valid switching times from rich to lean" UBYTE _CNV_A_R_LINEAR_____1_CM 1 0. 0. 255. DISPLAY_IDENTIFIER CTR_SWT_LS_DOWN_1_ ECU_ADDRESS 0x7f96fd FORMAT "%3.0" /end MEASUREMENT
/begin MEASUREMENT egcp[0].egcp_struct_sigdglsd2.ctr_cycnr_swt_ls_down "Sum of weighted CTR_SWT_ACT_LS_DOWN[NC_CBK_EX_NR], Bank i" UBYTE _CNV_A_R_LINEAR_____246_CM 1 0. 0. 1.9921875 DISPLAY_IDENTIFIER CTR_CYCNR_SWT_LS_DOWN_1_ ECU_ADDRESS 0x7f96fe FORMAT "%8.6" /end MEASUREMENT
/begin MEASUREMENT egcp[0].egcp_struct_sigdglsd2.ctr_save_swt_ls_down "Mean value of the ratio between the monitor sensor switching time and the threshold value for scantool" UBYTE _CNV_A_R_LINEAR_____246_CM 1 0. 0. 1.9921875 DISPLAY_IDENTIFIER CTR_SAVE_SWT_LS_DOWN_1_ ECU_ADDRESS 0x7f96ff FORMAT "%8.6" /end MEASUREMENT
/begin MEASUREMENT egcp[0].egcp_struct_sigdglsd2.ctr_sym_diag_pue_ls_down "Counter for anti-bounce of LS_DOWN_PUE diagnosis" UBYTE _CNV_A_R_LINEAR_____1_CM 1 0. 0. 255. DISPLAY_IDENTIFIER CTR_SYM_DIAG_PUE_LS_DOWN_1_ ECU_ADDRESS 0x7f9700 FORMAT "%3.0" /end MEASUREMENT
/begin MEASUREMENT egcp[0].egcp_struct_sigdglsd2.lv_diag_pue_vld_ls_down "Debounced diagnosis result of pull end plausibility" UBYTE _CNV_S_2_RANGE__0___85_CM 1 0. 0. 1. DISPLAY_IDENTIFIER LV_DIAG_PUE_VLD_LS_DOWN_1_ ECU_ADDRESS 0x7f9701 BIT_MASK 0x1 /end MEASUREMENT
/begin MEASUREMENT egcp[0].egcp_struct_sigdglsd2.lv_diag_mpl_cdn_ls_down "Status of permission for diagnosis" UBYTE _CNV_S_2_RANGE__0___85_CM 1 0. 0. 1. DISPLAY_IDENTIFIER LV_DIAG_MPL_CDN_LS_DOWN_1_ ECU_ADDRESS 0x7f9702 BIT_MASK 0x1 /end MEASUREMENT
/begin MEASUREMENT egcp[0].egcp_struct_sigdglsd2.lv_diag_mpl_end_ls_down "Bit to indicate end of complete monitor sensor diagnosis" UBYTE _CNV_S_2_RANGE__0___85_CM 1 0. 0. 1. DISPLAY_IDENTIFIER LV_DIAG_MPL_END_LS_DOWN_1_ ECU_ADDRESS 0x7f9703 BIT_MASK 0x1 /end MEASUREMENT
/begin MEASUREMENT egcp[0].egcp_struct_sigdglsd2.lv_swt_diag_vld_ls_down "Validity bit of the current switching time check" UBYTE _CNV_S_2_RANGE__0___85_CM 1 0. 0. 1. DISPLAY_IDENTIFIER LV_SWT_DIAG_VLD_LS_DOWN_1_ ECU_ADDRESS 0x7f9704 BIT_MASK 0x1 /end MEASUREMENT
/begin MEASUREMENT egcp[0].egcp_struct_sigdglsl1.lv_err_ls_up "Final diagnostic of the upstream oxygen sensor" UBYTE _CNV_S_2_RANGE__0___85_CM 1 0. 0. 1. DISPLAY_IDENTIFIER LV_ERR_LS_UP_1_ ECU_ADDRESS 0x7f9706 BIT_MASK 0x1 /end MEASUREMENT
/begin MEASUREMENT egcp[0].egcp_struct_sigdglsl1.lv_err_ls_down "Final diagnostic of the downstream oxygen sensor" UBYTE _CNV_S_2_RANGE__0___85_CM 1 0. 0. 1. DISPLAY_IDENTIFIER LV_ERR_LS_DOWN_1_ ECU_ADDRESS 0x7f9707 BIT_MASK 0x1 /end MEASUREMENT
/begin MEASUREMENT egcp[0].egcp_struct_pladglsl1.lamb_sp_delta_ls_up_down "Increment of lambda setpoint" SWORD _CNV_A_R_EGCP_LINEA_522_CM 1 0. -32. 31.999023 DISPLAY_IDENTIFIER LAMB_SP_DELTA_LS_UP_DOWN_1_ ECU_ADDRESS 0x7f9708 BYTE_ORDER MSB_LAST FORMAT "%9.6" /end MEASUREMENT
/begin MEASUREMENT egcp[0].egcp_struct_pladglsl1.maf_int_diag_ls_up_down "Integral of air mass flow  while check is active" UWORD _CNV_A_R_LINEAR_____482_CM 1 0. 0. 1820.42 DISPLAY_IDENTIFIER MAF_INT_DIAG_LS_UP_DOWN_1_ ECU_ADDRESS 0x7f970a BYTE_ORDER MSB_LAST FORMAT "%7.2" /end MEASUREMENT
/begin MEASUREMENT egcp[0].egcp_struct_pladglsl1.lamb_sp_beg_diag_ls_up_down "Inicial value of lambda set point " UWORD _CNV_A_R_LINEAR_____465_CM 1 0. 0. 31.9990234375 DISPLAY_IDENTIFIER LAMB_SP_BEG_DIAG_LS_UP_DOWN_1_ ECU_ADDRESS 0x7f970c BYTE_ORDER MSB_LAST FORMAT "%7.4" /end MEASUREMENT
/begin MEASUREMENT egcp[0].egcp_struct_pladglsl1.t_diag_act_afr_ls_up_down "Timer for plauisibility test under rich AF conditions" UWORD _CNV_A_R_LINEAR_____240_CM 1 0. 0. 6553.5 DISPLAY_IDENTIFIER T_DIAG_ACT_AFR_LS_UP_DOWN_1_ ECU_ADDRESS 0x7f970e BYTE_ORDER MSB_LAST FORMAT "%6.1" /end MEASUREMENT
/begin MEASUREMENT egcp[0].egcp_struct_pladglsl1.t_diag_act_afl_ls_up_down "Timer for plauisibility test under lean AF conditions" UWORD _CNV_A_R_LINEAR_____240_CM 1 0. 0. 6553.5 DISPLAY_IDENTIFIER T_DIAG_ACT_AFL_LS_UP_DOWN_1_ ECU_ADDRESS 0x7f9710 BYTE_ORDER MSB_LAST FORMAT "%6.1" /end MEASUREMENT
/begin MEASUREMENT egcp[0].egcp_struct_pladglsl1.lamb_sp_diag_ls_up_down "Lambda set point for active plausibility test" UWORD _CNV_A_R_LINEAR_____465_CM 1 0. 0. 31.9990234375 DISPLAY_IDENTIFIER LAMB_SP_DIAG_LS_UP_DOWN_1_ ECU_ADDRESS 0x7f9712 BYTE_ORDER MSB_LAST FORMAT "%7.4" /end MEASUREMENT
/begin MEASUREMENT egcp[0].egcp_struct_pladglsl1.ctr_sum_rst_afr_chk_lsl_up "Reset counter for the rich active test" UWORD _CNV_A_R_LINEAR_____1_CM 1 0. 0. 65535. DISPLAY_IDENTIFIER CTR_SUM_RST_AFR_CHK_LSL_UP_1_ ECU_ADDRESS 0x7f9714 BYTE_ORDER MSB_LAST FORMAT "%5.0" /end MEASUREMENT
/begin MEASUREMENT egcp[0].egcp_struct_pladglsl1.ctr_sum_rst_afl_chk_lsl_up "Reset counter for the rich active test" UWORD _CNV_A_R_LINEAR_____1_CM 1 0. 0. 65535. DISPLAY_IDENTIFIER CTR_SUM_RST_AFL_CHK_LSL_UP_1_ ECU_ADDRESS 0x7f9716 BYTE_ORDER MSB_LAST FORMAT "%5.0" /end MEASUREMENT
/begin MEASUREMENT egcp[0].egcp_struct_pladglsl1.ctr_afr_chk_lsl_up "Debounce counter for the rich test" UWORD _CNV_A_R_LINEAR_____1_CM 1 0. 0. 65535. DISPLAY_IDENTIFIER CTR_AFR_CHK_LSL_UP_1_ ECU_ADDRESS 0x7f9718 BYTE_ORDER MSB_LAST FORMAT "%5.0" /end MEASUREMENT
/begin MEASUREMENT egcp[0].egcp_struct_pladglsl1.ctr_afl_chk_lsl_up "Debounce counter for the lean test" UWORD _CNV_A_R_LINEAR_____1_CM 1 0. 0. 65535. DISPLAY_IDENTIFIER CTR_AFL_CHK_LSL_UP_1_ ECU_ADDRESS 0x7f971a BYTE_ORDER MSB_LAST FORMAT "%5.0" /end MEASUREMENT
/begin MEASUREMENT egcp[0].egcp_struct_pladglsl1.state_diag_act_ls_up_down "State of check of downstream oxygen sensor signal for lambda sensor error manager" UBYTE _CNV_S_4_EGCP_RANGE_523_CM 1 0. 0. 3. DISPLAY_IDENTIFIER STATE_DIAG_ACT_LS_UP_DOWN_1_ ECU_ADDRESS 0x7f971c /end MEASUREMENT
/begin MEASUREMENT egcp[0].egcp_struct_pladglsl1.lv_diag_afl_cdn_ls_up_down "Boolean flag, condition to execute AFL active check of the oxygen sensors" UBYTE _CNV_S_2_RANGE__0___85_CM 1 0. 0. 1. DISPLAY_IDENTIFIER LV_DIAG_AFL_CDN_LS_UP_DOWN_1_ ECU_ADDRESS 0x7f971d BIT_MASK 0x1 /end MEASUREMENT
/begin MEASUREMENT egcp[0].egcp_struct_pladglsl1.lv_diag_afr_cdn_ls_up_down "Boolean flag, condition to execute AFR active check of the oxygen sensors" UBYTE _CNV_S_2_RANGE__0___85_CM 1 0. 0. 1. DISPLAY_IDENTIFIER LV_DIAG_AFR_CDN_LS_UP_DOWN_1_ ECU_ADDRESS 0x7f971e BIT_MASK 0x1 /end MEASUREMENT
/begin MEASUREMENT egcp[0].egcp_struct_pladglsl1.lv_diag_act_end_ls_up_down "Boolean flag, end of active check of the oxygen sensors" UBYTE _CNV_S_2_RANGE__0___85_CM 1 0. 0. 1. DISPLAY_IDENTIFIER LV_DIAG_ACT_END_LS_UP_DOWN_1_ ECU_ADDRESS 0x7f971f BIT_MASK 0x1 /end MEASUREMENT
/begin MEASUREMENT egcp[0].egcp_struct_pladglsl1.lv_lamb_sp_afr_req_diag_act "Trigger function to change lambda set point for AFR active plauisibility test" UBYTE _CNV_S_2_RANGE__0___85_CM 1 0. 0. 1. DISPLAY_IDENTIFIER LV_LAMB_SP_AFR_REQ_DIAG_ACT_1_ ECU_ADDRESS 0x7f9720 BIT_MASK 0x1 /end MEASUREMENT
/begin MEASUREMENT egcp[0].egcp_struct_pladglsl1.lv_lamb_sp_afl_req_diag_act "Trigger function to change lambda set point for AFL active plauisibility test" UBYTE _CNV_S_2_RANGE__0___85_CM 1 0. 0. 1. DISPLAY_IDENTIFIER LV_LAMB_SP_AFL_REQ_DIAG_ACT_1_ ECU_ADDRESS 0x7f9721 BIT_MASK 0x1 /end MEASUREMENT
/begin MEASUREMENT egcp[0].egcp_struct_pladglsl1.lv_lamb_sp_req_diag_act "Lambda coordination request to change set point for active plausibility test" UBYTE _CNV_S_2_RANGE__0___85_CM 1 0. 0. 1. DISPLAY_IDENTIFIER LV_LAMB_SP_REQ_DIAG_ACT_1_ ECU_ADDRESS 0x7f9722 BIT_MASK 0x1 /end MEASUREMENT
/begin MEASUREMENT egcp[0].egcp_struct_pladglsl1.lv_diag_cyc_end_ls_down "End of cycle of active test of downstream sensor" UBYTE _CNV_S_2_RANGE__0___85_CM 1 0. 0. 1. DISPLAY_IDENTIFIER LV_DIAG_CYC_END_LS_DOWN_1_ ECU_ADDRESS 0x7f9723 BIT_MASK 0x1 /end MEASUREMENT
/begin MEASUREMENT egcp[0].egcp_struct_pladglsl1.lv_lam_di_req "Request disable close loop operation of the lambda controller" UBYTE _CNV_S_2_RANGE__0___85_CM 1 0. 0. 1. DISPLAY_IDENTIFIER LV_LAM_DI_REQ_1_ ECU_ADDRESS 0x7f9724 BIT_MASK 0x1 /end MEASUREMENT
/begin MEASUREMENT egcp[0].egcp_struct_pladglsl1.lv_diag_afr_end_ls_up_down "Boolean flag indicating the end of RICH active check" UBYTE _CNV_S_2_RANGE__0___85_CM 1 0. 0. 1. DISPLAY_IDENTIFIER LV_DIAG_AFR_END_LS_UP_DOWN_1_ ECU_ADDRESS 0x7f9725 BIT_MASK 0x1 /end MEASUREMENT
/begin MEASUREMENT egcp[0].egcp_struct_pladglsl1.lv_diag_afl_end_ls_up_down "Boolean flag indicating the end of LEAN active check" UBYTE _CNV_S_2_RANGE__0___85_CM 1 0. 0. 1. DISPLAY_IDENTIFIER LV_DIAG_AFL_END_LS_UP_DOWN_1_ ECU_ADDRESS 0x7f9726 BIT_MASK 0x1 /end MEASUREMENT
/begin MEASUREMENT egcp[0].egcp_struct_pladglsl1.lv_diag_afr_chk_sym_lsl_up "Debounced failure in the upstream sensor during the RICH active check " UBYTE _CNV_S_2_RANGE__0___85_CM 1 0. 0. 1. DISPLAY_IDENTIFIER LV_DIAG_AFR_CHK_SYM_LSL_UP_1_ ECU_ADDRESS 0x7f9727 BIT_MASK 0x1 /end MEASUREMENT
/begin MEASUREMENT egcp[0].egcp_struct_pladglsl1.lv_diag_afl_chk_sym_lsl_up "Debounced failure in the upstream sensor during the LEAN active check" UBYTE _CNV_S_2_RANGE__0___85_CM 1 0. 0. 1. DISPLAY_IDENTIFIER LV_DIAG_AFL_CHK_SYM_LSL_UP_1_ ECU_ADDRESS 0x7f9728 BIT_MASK 0x1 /end MEASUREMENT
/begin MEASUREMENT egcp[0].egcp_struct_pladglsl1.lv_diag_act_chk_cdn_lsl_up "Conditions to run active test of upstream sensor fulfilled" UBYTE _CNV_S_2_RANGE__0___85_CM 1 0. 0. 1. DISPLAY_IDENTIFIER LV_DIAG_ACT_CHK_CDN_LSL_UP_1_ ECU_ADDRESS 0x7f9729 BIT_MASK 0x1 /end MEASUREMENT
/begin MEASUREMENT egcp[0].egcp_struct_pladglsl1.lv_diag_act_chk_end_lsl_up "End active test of upstream sensor" UBYTE _CNV_S_2_RANGE__0___85_CM 1 0. 0. 1. DISPLAY_IDENTIFIER LV_DIAG_ACT_CHK_END_LSL_UP_1_ ECU_ADDRESS 0x7f972a BIT_MASK 0x1 /end MEASUREMENT
/begin MEASUREMENT egcp[0].egcp_struct_pladgtipa0.v_ofs_mes_r_it_obd_ls_up "Offset voltage of internal resistance determination circuit in measurement mode (Mode 6 information)" UWORD _CNV_A_R_EGCP_LINEA_509_CM 1 0. 0. 4.995 DISPLAY_IDENTIFIER V_OFS_MES_R_IT_OBD_LS_UP_1_ ECU_ADDRESS 0x7f972c BYTE_ORDER MSB_LAST FORMAT "%5.3" /end MEASUREMENT
/begin MEASUREMENT egcp[0].egcp_struct_pladgtipa0.v_ofs_adj_r_it_obd_ls_up "Offset voltage of internal resistance determination circuit in adjust mode (Mode 6 information)" UWORD _CNV_A_R_EGCP_LINEA_509_CM 1 0. 0. 4.995 DISPLAY_IDENTIFIER V_OFS_ADJ_R_IT_OBD_LS_UP_1_ ECU_ADDRESS 0x7f972e BYTE_ORDER MSB_LAST FORMAT "%5.3" /end MEASUREMENT
/begin MEASUREMENT egcp[0].egcp_struct_pladgtipa0.fac_gain_h_r_it_obd_ls_up "High gain of oxygen sensor internal resistance determination circuit (Mode 6 information)" UWORD _CNV_A_R_EGCP_LINEA_510_CM 1 0. 0. 23.999634 DISPLAY_IDENTIFIER FAC_GAIN_H_R_IT_OBD_LS_UP_1_ ECU_ADDRESS 0x7f9730 BYTE_ORDER MSB_LAST FORMAT "%7.4" /end MEASUREMENT
/begin MEASUREMENT egcp[0].egcp_struct_pladgtipa0.fac_gain_l_r_it_obd_ls_up "Low gain of oxygen sensor internal resistance determination circuit (Mode 6 information)" UWORD _CNV_A_R_EGCP_LINEA_510_CM 1 0. 0. 23.999634 DISPLAY_IDENTIFIER FAC_GAIN_L_R_IT_OBD_LS_UP_1_ ECU_ADDRESS 0x7f9732 BYTE_ORDER MSB_LAST FORMAT "%7.4" /end MEASUREMENT
/begin MEASUREMENT egcp[0].egcp_struct_pladgtipa0.lv_ttip_obd_rep_ls_up "Boolean flag interface to ceramic temperature function to reset counters, indicates diagnosis complete" UBYTE _CNV_S_2_RANGE__0___85_CM 1 0. 0. 1. DISPLAY_IDENTIFIER LV_TTIP_OBD_REP_LS_UP_1_ ECU_ADDRESS 0x7f9734 BIT_MASK 0x1 /end MEASUREMENT
/begin MEASUREMENT egcp[0].egcp_struct_sigdglsdi2.lv_diag_mpl_inh_ls_down "OBD II function dowmstream sensor: application incidences for inhibition" UBYTE _CNV_S_2_RANGE__0___85_CM 1 0. 0. 1. DISPLAY_IDENTIFIER LV_DIAG_MPL_INH_LS_DOWN_1_ ECU_ADDRESS 0x7f9736 BIT_MASK 0x1 /end MEASUREMENT
/begin MEASUREMENT egcp[0].egcp_struct_fctdglslhi0.lv_inh_diag_obd_lsh_up "Boolean inhibit flag for O2 sensor heater OBDII monitoring" UBYTE _CNV_S_2_RANGE__0___85_CM 1 0. 0. 1. DISPLAY_IDENTIFIER LV_INH_DIAG_OBD_LSH_UP_1_ ECU_ADDRESS 0x7f9737 BIT_MASK 0x1 /end MEASUREMENT
/begin MEASUREMENT egcp[0].egcp_struct_sigdglsl2.t_on_thd_lsh_diag_st_lsl_up "Timer how long the recovery process is active" UWORD _CNV_A_R_LINEAR_____240_CM 1 0. 0. 6553.5 DISPLAY_IDENTIFIER T_ON_THD_LSH_DIAG_ST_LSL_UP_1_ ECU_ADDRESS 0x7f9738 BYTE_ORDER MSB_LAST FORMAT "%6.1" /end MEASUREMENT
/begin MEASUREMENT egcp[0].egcp_struct_sigdglsl2.vls_up_save_diag_puc_lsl_up "Upstream sensor voltage - value used during the diagnosis and transmitted to the Scan Tool in mode06" UWORD _CNV_A_R_LINEAR_____265_CM 1 0. 0. 4.9951171875 DISPLAY_IDENTIFIER VLS_UP_SAVE_DIAG_PUC_LSL_UP_1_ ECU_ADDRESS 0x7f973a BYTE_ORDER MSB_LAST FORMAT "%5.3" /end MEASUREMENT
/begin MEASUREMENT egcp[0].egcp_struct_sigdglsl2.t_sym_diag_air_lsl_up "Timer to debounce an error" UWORD _CNV_A_R_LINEAR_____240_CM 1 0. 0. 6553.5 DISPLAY_IDENTIFIER T_SYM_DIAG_AIR_LSL_UP_1_ ECU_ADDRESS 0x7f973c BYTE_ORDER MSB_LAST FORMAT "%6.1" /end MEASUREMENT
/begin MEASUREMENT egcp[0].egcp_struct_sigdglsl2.t_end_diag_air_lsl_up "Timer to have a diagnostic available" UWORD _CNV_A_R_LINEAR_____240_CM 1 0. 0. 6553.5 DISPLAY_IDENTIFIER T_END_DIAG_AIR_LSL_UP_1_ ECU_ADDRESS 0x7f973e BYTE_ORDER MSB_LAST FORMAT "%6.1" /end MEASUREMENT
/begin MEASUREMENT egcp[0].egcp_struct_sigdglsl2.t_end_diag_plaus_lsl_up "Timer to have a diagnostic available" UWORD _CNV_A_R_LINEAR_____240_CM 1 0. 0. 6553.5 DISPLAY_IDENTIFIER T_END_DIAG_PLAUS_LSL_UP_1_ ECU_ADDRESS 0x7f9740 BYTE_ORDER MSB_LAST FORMAT "%6.1" /end MEASUREMENT
/begin MEASUREMENT egcp[0].egcp_struct_sigdglsl2.t_diag_end_puc_lsl_up "Timer to have a diagnostic available" UWORD _CNV_A_R_LINEAR_____240_CM 1 0. 0. 6553.5 DISPLAY_IDENTIFIER T_DIAG_END_PUC_LSL_UP_1_ ECU_ADDRESS 0x7f9742 BYTE_ORDER MSB_LAST FORMAT "%6.1" /end MEASUREMENT
/begin MEASUREMENT egcp[0].egcp_struct_sigdglsl2.t_dly_diag_puc_lsl_up "Delay Time to activate the diagnosis" UWORD _CNV_A_R_LINEAR_____240_CM 1 0. 0. 6553.5 DISPLAY_IDENTIFIER T_DLY_DIAG_PUC_LSL_UP_1_ ECU_ADDRESS 0x7f9744 BYTE_ORDER MSB_LAST FORMAT "%6.1" /end MEASUREMENT
/begin MEASUREMENT egcp[0].egcp_struct_sigdglsl2.t_diag_sym_puc_lsl_up "Symptom debouncer timer" UWORD _CNV_A_R_LINEAR_____240_CM 1 0. 0. 6553.5 DISPLAY_IDENTIFIER T_DIAG_SYM_PUC_LSL_UP_1_ ECU_ADDRESS 0x7f9746 BYTE_ORDER MSB_LAST FORMAT "%6.1" /end MEASUREMENT
/begin MEASUREMENT egcp[0].egcp_struct_sigdglsl2.t_sym_diag_plaus_lsl_up "Time for the plausibility symptom (compensation of the catalyst delay)" UWORD _CNV_A_R_LINEAR_____240_CM 1 0. 0. 6553.5 DISPLAY_IDENTIFIER T_SYM_DIAG_PLAUS_LSL_UP_1_ ECU_ADDRESS 0x7f9748 BYTE_ORDER MSB_LAST FORMAT "%6.1" /end MEASUREMENT
/begin MEASUREMENT egcp[0].egcp_struct_sigdglsl2.lamb_min_diag_dyn_lsl_up "Minimum value of the lambda sensor signal (per sample period)" UWORD _CNV_A_R_LINEAR_____465_CM 1 0. 0. 31.9990234375 DISPLAY_IDENTIFIER LAMB_MIN_DIAG_DYN_LSL_UP_1_ ECU_ADDRESS 0x7f974a BYTE_ORDER MSB_LAST FORMAT "%7.4" /end MEASUREMENT
/begin MEASUREMENT egcp[0].egcp_struct_sigdglsl2.lamb_max_diag_dyn_lsl_up "Maximum value of the lambda sensor signal (per sample period)" UWORD _CNV_A_R_LINEAR_____465_CM 1 0. 0. 31.9990234375 DISPLAY_IDENTIFIER LAMB_MAX_DIAG_DYN_LSL_UP_1_ ECU_ADDRESS 0x7f974c BYTE_ORDER MSB_LAST FORMAT "%7.4" /end MEASUREMENT
/begin MEASUREMENT egcp[0].egcp_struct_sigdglsl2.lamb_ampl_int_diag_dyn_lsl_up "Integral over carried out single sensor signal amplitude measurement" UWORD _CNV_A_R_LINEAR_____465_CM 1 0. 0. 31.9990234375 DISPLAY_IDENTIFIER LAMB_AMPL_INT_DIAG_DYN_LSL_UP_1_ ECU_ADDRESS 0x7f974e BYTE_ORDER MSB_LAST FORMAT "%7.4" /end MEASUREMENT
/begin MEASUREMENT egcp[0].egcp_struct_sigdglsl2.fac_value_diag_dyn_lsl_up "Normalized single sensor signal amplitude" UWORD _CNV_A_R_LINEAR_____465_CM 1 0. 0. 31.9990234375 DISPLAY_IDENTIFIER FAC_VALUE_DIAG_DYN_LSL_UP_1_ ECU_ADDRESS 0x7f9750 BYTE_ORDER MSB_LAST FORMAT "%7.4" /end MEASUREMENT
/begin MEASUREMENT egcp[0].egcp_struct_sigdglsl2.fac_sum_diag_dyn_lsl_up "Summation over all normalized single sensor signal amplitude" UWORD _CNV_A_R_EGCP_LINEA_483_CM 1 0. 0. 63.99886 DISPLAY_IDENTIFIER FAC_SUM_DIAG_DYN_LSL_UP_1_ ECU_ADDRESS 0x7f9752 BYTE_ORDER MSB_LAST FORMAT "%7.4" /end MEASUREMENT
/begin MEASUREMENT egcp[0].egcp_struct_sigdglsl2.fac_ad_min_diag_dyn_lsl_up "Lowest admissible adaption factor to the modeled sensor time constant" UWORD _CNV_A_R_LINEAR_____465_CM 1 0. 0. 31.9990234375 DISPLAY_IDENTIFIER FAC_AD_MIN_DIAG_DYN_LSL_UP_1_ ECU_ADDRESS 0x7f9754 BYTE_ORDER MSB_LAST FORMAT "%7.4" /end MEASUREMENT
/begin MEASUREMENT egcp[0].egcp_struct_sigdglsl2.fac_mv_diag_dyn_lsl_up "Mean value of normalized single sensor signal amplitude" UWORD _CNV_A_R_LINEAR_____465_CM 1 0. 0. 31.9990234375 DISPLAY_IDENTIFIER FAC_MV_DIAG_DYN_LSL_UP_1_ ECU_ADDRESS 0x7f9756 BYTE_ORDER MSB_LAST FORMAT "%7.4" /end MEASUREMENT
/begin MEASUREMENT egcp[0].egcp_struct_sigdglsl2.fac_ad_max_diag_dyn_lsl_up "Highest admissible adaption factor to the modeled sensor time constant" UWORD _CNV_A_R_LINEAR_____465_CM 1 0. 0. 31.9990234375 DISPLAY_IDENTIFIER FAC_AD_MAX_DIAG_DYN_LSL_UP_1_ ECU_ADDRESS 0x7f9758 BYTE_ORDER MSB_LAST FORMAT "%7.4" /end MEASUREMENT
/begin MEASUREMENT egcp[0].egcp_struct_sigdglsl2.fac_diag_dyn_lsl_up "Adaption factor to the modeled sensor time constant" UWORD _CNV_A_R_LINEAR_____465_CM 1 0. 0. 1. DISPLAY_IDENTIFIER FAC_DIAG_DYN_LSL_UP_1_ ECU_ADDRESS 0x7f975a BYTE_ORDER MSB_LAST FORMAT "%6.4" /end MEASUREMENT
/begin MEASUREMENT egcp[0].egcp_struct_sigdglsl2.t_eng_st_diag_st_lsl_up "Starting time of the engine" UBYTE _CNV_A_R_LINEAR_____240_CM 1 0. 0. 25.5 DISPLAY_IDENTIFIER T_ENG_ST_DIAG_ST_LSL_UP_1_ ECU_ADDRESS 0x7f975c FORMAT "%4.1" /end MEASUREMENT
/begin MEASUREMENT egcp[0].egcp_struct_sigdglsl2.ctr_err_diag_st_lsl_up "Remaining heating cycle counter to purify the reference air as a result of the engines false start" UBYTE _CNV_A_R_LINEAR_____1_CM 1 0. 0. 255. DISPLAY_IDENTIFIER CTR_ERR_DIAG_ST_LSL_UP_1_ ECU_ADDRESS 0x7f975d FORMAT "%3.0" /end MEASUREMENT
/begin MEASUREMENT egcp[0].egcp_struct_sigdglsl2.t_lam_lim_diag_st_lsl_up "Time, how long the lambda controller must be in limitation" UBYTE _CNV_A_R_LINEAR_____240_CM 1 0. 0. 25.5 DISPLAY_IDENTIFIER T_LAM_LIM_DIAG_ST_LSL_UP_1_ ECU_ADDRESS 0x7f975e FORMAT "%4.1" /end MEASUREMENT
/begin MEASUREMENT egcp[0].egcp_struct_sigdglsl2.ctr_diag_plaus_lsl_up "Debounce counter" UBYTE _CNV_A_R_LINEAR_____1_CM 1 0. 0. 255. DISPLAY_IDENTIFIER CTR_DIAG_PLAUS_LSL_UP_1_ ECU_ADDRESS 0x7f975f FORMAT "%3.0" /end MEASUREMENT
/begin MEASUREMENT egcp[0].egcp_struct_sigdglsl2.lamb_ampl_diag_dyn_lsl_up "Carried out single sensor signal amplitude measurement" UBYTE _CNV_A_R_EGCP_LINEA_524_CM 1 0. 0. 0.124968 DISPLAY_IDENTIFIER LAMB_AMPL_DIAG_DYN_LSL_UP_1_ ECU_ADDRESS 0x7f9760 FORMAT "%8.6" /end MEASUREMENT
/begin MEASUREMENT egcp[0].egcp_struct_sigdglsl2.lamb_ampl_min_diag_dyn_lsl_up "Minimun acceptable carried out single sensor signal amplitude measurement" UBYTE _CNV_A_R_EGCP_LINEA_524_CM 1 0. 0. 0.124968 DISPLAY_IDENTIFIER LAMB_AMPL_MIN_DIAG_DYN_LSL_UP_1_ ECU_ADDRESS 0x7f9761 FORMAT "%8.6" /end MEASUREMENT
/begin MEASUREMENT egcp[0].egcp_struct_sigdglsl2.lamb_ampl_max_diag_dyn_lsl_up "Maximun acceptable carried out single sensor signal amplitude measurement" UBYTE _CNV_A_R_EGCP_LINEA_524_CM 1 0. 0. 0.124968 DISPLAY_IDENTIFIER LAMB_AMPL_MAX_DIAG_DYN_LSL_UP_1_ ECU_ADDRESS 0x7f9762 FORMAT "%8.6" /end MEASUREMENT
/begin MEASUREMENT egcp[0].egcp_struct_sigdglsl2.lamb_ampl_mv_diag_dyn_lsl_up "Sensor signal amplitude mean value" UBYTE _CNV_A_R_EGCP_LINEA_524_CM 1 0. 0. 0.124968 DISPLAY_IDENTIFIER LAMB_AMPL_MV_DIAG_DYN_LSL_UP_1_ ECU_ADDRESS 0x7f9763 FORMAT "%8.6" /end MEASUREMENT
/begin MEASUREMENT egcp[0].egcp_struct_sigdglsl2.ctr_diag_dyn_lsl_up "Number of  carried out single valid amplitude measurements" UBYTE _CNV_A_R_LINEAR_____1_CM 1 0. 0. 255. DISPLAY_IDENTIFIER CTR_DIAG_DYN_LSL_UP_1_ ECU_ADDRESS 0x7f9764 FORMAT "%3.0" /end MEASUREMENT
/begin MEASUREMENT egcp[0].egcp_struct_sigdglsl2.ctr_wait_diag_dyn_lsl_up "Number of forced stimulation periods before carrying out amplitude measurements" UBYTE _CNV_A_R_LINEAR_____1_CM 1 0. 0. 255. DISPLAY_IDENTIFIER CTR_WAIT_DIAG_DYN_LSL_UP_1_ ECU_ADDRESS 0x7f9765 FORMAT "%3.0" /end MEASUREMENT
/begin MEASUREMENT egcp[0].egcp_struct_sigdglsl2.cycnr_diag_dyn_lsl_up "Number of cycles necessary to finish the diagnosis" UBYTE _CNV_A_R_LINEAR_____1_CM 1 0. 0. 255. DISPLAY_IDENTIFIER CYCNR_DIAG_DYN_LSL_UP_1_ ECU_ADDRESS 0x7f9766 FORMAT "%3.0" /end MEASUREMENT
/begin MEASUREMENT egcp[0].egcp_struct_sigdglsl2.state_sym_diag_plaus_lsl_up "Symptom of of the heater coupling diagnosis" UBYTE _CNV_S_4_EGCP_RANGE_525_CM 1 0. 0. 4. DISPLAY_IDENTIFIER STATE_SYM_DIAG_PLAUS_LSL_UP_1_ ECU_ADDRESS 0x7f9767 /end MEASUREMENT
/begin MEASUREMENT egcp[0].egcp_struct_sigdglsl2.state_sym_diag_puc_lsl_up "Symptom of of the signal plausibility from the upstraem sensor during PUC" UBYTE _CNV_S_3_EGCP_RANGE_526_CM 1 0. 0. 2. DISPLAY_IDENTIFIER STATE_SYM_DIAG_PUC_LSL_UP_1_ ECU_ADDRESS 0x7f9768 /end MEASUREMENT
/begin MEASUREMENT egcp[0].egcp_struct_sigdglsl2.state_sym_diag_st_lsl_up "Symptom of the false start identification without consideration abnormal lambda regulation behaviour" UBYTE _CNV_S_2_EGCP_RANGE_527_CM 1 0. 0. 1. DISPLAY_IDENTIFIER STATE_SYM_DIAG_ST_LSL_UP_1_ ECU_ADDRESS 0x7f9769 /end MEASUREMENT
/begin MEASUREMENT egcp[0].egcp_struct_sigdglsl2.state_dyn_diag "State shows the condition of the forced stimulation " UBYTE _CNV_S_4_EGCP_RANGE_528_CM 1 0. 0. 3. DISPLAY_IDENTIFIER STATE_DYN_DIAG_1_ ECU_ADDRESS 0x7f976a /end MEASUREMENT
/begin MEASUREMENT egcp[0].egcp_struct_sigdglsl2.lv_diag_plaus_sym_lsl_up "Debounced diagnosis result of the signal plausibility for the wide range A/F sensor" UBYTE _CNV_S_2_RANGE__0___85_CM 1 0. 0. 1. DISPLAY_IDENTIFIER LV_DIAG_PLAUS_SYM_LSL_UP_1_ ECU_ADDRESS 0x7f976b BIT_MASK 0x1 /end MEASUREMENT
/begin MEASUREMENT egcp[0].egcp_struct_sigdglsl2.lv_diag_cdn_plaus_lsl_up "Diagnosis condition" UBYTE _CNV_S_2_RANGE__0___85_CM 1 0. 0. 1. DISPLAY_IDENTIFIER LV_DIAG_CDN_PLAUS_LSL_UP_1_ ECU_ADDRESS 0x7f976c BIT_MASK 0x1 /end MEASUREMENT
/begin MEASUREMENT egcp[0].egcp_struct_sigdglsl2.lv_diag_plaus_end_lsl_up "Result of diagnosis exists" UBYTE _CNV_S_2_RANGE__0___85_CM 1 0. 0. 1. DISPLAY_IDENTIFIER LV_DIAG_PLAUS_END_LSL_UP_1_ ECU_ADDRESS 0x7f976d BIT_MASK 0x1 /end MEASUREMENT
/begin MEASUREMENT egcp[0].egcp_struct_sigdglsl2.lv_diag_dyn_sym_lsl_up "Debounce diagnosis value of the sensor dynamics" UBYTE _CNV_S_2_RANGE__0___85_CM 1 0. 0. 1. DISPLAY_IDENTIFIER LV_DIAG_DYN_SYM_LSL_UP_1_ ECU_ADDRESS 0x7f976e BIT_MASK 0x1 /end MEASUREMENT
/begin MEASUREMENT egcp[0].egcp_struct_sigdglsl2.lv_diag_dyn_end_lsl_up "Result of diagnosis exists" UBYTE _CNV_S_2_RANGE__0___85_CM 1 0. 0. 1. DISPLAY_IDENTIFIER LV_DIAG_DYN_END_LSL_UP_1_ ECU_ADDRESS 0x7f976f BIT_MASK 0x1 /end MEASUREMENT
/begin MEASUREMENT egcp[0].egcp_struct_sigdglsl2.lv_diag_dyn_cdn_lsl_up "Diagnosis condition" UBYTE _CNV_S_2_RANGE__0___85_CM 1 0. 0. 1. DISPLAY_IDENTIFIER LV_DIAG_DYN_CDN_LSL_UP_1_ ECU_ADDRESS 0x7f9770 BIT_MASK 0x1 /end MEASUREMENT
/begin MEASUREMENT egcp[0].egcp_struct_sigdglsl2.lv_diag_puc_sym_lsl_up "Debounced diagnosis result of the signal plausibility from the upstream sensor during PUC" UBYTE _CNV_S_2_RANGE__0___85_CM 1 0. 0. 1. DISPLAY_IDENTIFIER LV_DIAG_PUC_SYM_LSL_UP_1_ ECU_ADDRESS 0x7f9771 BIT_MASK 0x1 /end MEASUREMENT
/begin MEASUREMENT egcp[0].egcp_struct_sigdglsl2.lv_diag_cdn_puc_lsl_up "Diagnosis condition" UBYTE _CNV_S_2_RANGE__0___85_CM 1 0. 0. 1. DISPLAY_IDENTIFIER LV_DIAG_CDN_PUC_LSL_UP_1_ ECU_ADDRESS 0x7f9772 BIT_MASK 0x1 /end MEASUREMENT
/begin MEASUREMENT egcp[0].egcp_struct_sigdglsl2.lv_diag_puc_end_lsl_up "Result of diagnosis exists" UBYTE _CNV_S_2_RANGE__0___85_CM 1 0. 0. 1. DISPLAY_IDENTIFIER LV_DIAG_PUC_END_LSL_UP_1_ ECU_ADDRESS 0x7f9773 BIT_MASK 0x1 /end MEASUREMENT
/begin MEASUREMENT egcp[0].egcp_struct_sigdglsl2.lv_diag_st_sym_lsl_up "False start affecting to the sensor behaviour recognised" UBYTE _CNV_S_2_RANGE__0___85_CM 1 0. 0. 1. DISPLAY_IDENTIFIER LV_DIAG_ST_SYM_LSL_UP_1_ ECU_ADDRESS 0x7f9774 BIT_MASK 0x1 /end MEASUREMENT
/begin MEASUREMENT egcp[0].egcp_struct_sigdglsl2.lv_diag_cdn_st_lsl_up "Diagnosis condition" UBYTE _CNV_S_2_RANGE__0___85_CM 1 0. 0. 1. DISPLAY_IDENTIFIER LV_DIAG_CDN_ST_LSL_UP_1_ ECU_ADDRESS 0x7f9775 BIT_MASK 0x1 /end MEASUREMENT
/begin MEASUREMENT egcp[0].egcp_struct_sigdglsl2.lv_diag_st_end_lsl_up "Result of diagnosis exist" UBYTE _CNV_S_2_RANGE__0___85_CM 1 0. 0. 1. DISPLAY_IDENTIFIER LV_DIAG_ST_END_LSL_UP_1_ ECU_ADDRESS 0x7f9776 BIT_MASK 0x1 /end MEASUREMENT
/begin MEASUREMENT egcp[0].egcp_struct_sigdglsl2.lv_lamb_pls_req_diag_dyn_lsl_up "Request forced stimulation parameters specific for the WRAF sensor dynamic" UBYTE _CNV_S_2_RANGE__0___85_CM 1 0. 0. 1. DISPLAY_IDENTIFIER LV_LAMB_PLS_REQ_DIAG_DYN_LSL_UP_1_ ECU_ADDRESS 0x7f9777 BIT_MASK 0x1 /end MEASUREMENT
/begin MEASUREMENT egcp[0].egcp_struct_sigdglsl2.lv_lam_adj_req_diag_dyn_lsl_up "Request dynamic trim controller parameters specific for the WRAF sensor dynamic" UBYTE _CNV_S_2_RANGE__0___85_CM 1 0. 0. 1. DISPLAY_IDENTIFIER LV_LAM_ADJ_REQ_DIAG_DYN_LSL_UP_1_ ECU_ADDRESS 0x7f9778 BIT_MASK 0x1 /end MEASUREMENT
/begin MEASUREMENT egcp[0].egcp_struct_sigdglsli2.lv_inh_diag_st_lsl_up "Inhibition of false start recognition  diagnosis" UBYTE _CNV_S_2_RANGE__0___85_CM 1 0. 0. 1. DISPLAY_IDENTIFIER LV_INH_DIAG_ST_LSL_UP_1_ ECU_ADDRESS 0x7f977a BIT_MASK 0x1 /end MEASUREMENT
/begin MEASUREMENT egcp[0].egcp_struct_sigdglsli2.lv_diag_plaus_inh_lsl_up "Deactivation of \"Plausibility check of the sensor signal\"" UBYTE _CNV_S_2_RANGE__0___85_CM 1 0. 0. 1. DISPLAY_IDENTIFIER LV_DIAG_PLAUS_INH_LSL_UP_1_ ECU_ADDRESS 0x7f977b BIT_MASK 0x1 /end MEASUREMENT
/begin MEASUREMENT egcp[0].egcp_struct_sigdglsli2.lv_diag_dyn_inh_lsl_up "Deactivation of \"Diagnosis of the WRAF Sensor Dynamic\"" UBYTE _CNV_S_2_RANGE__0___85_CM 1 0. 0. 1. DISPLAY_IDENTIFIER LV_DIAG_DYN_INH_LSL_UP_1_ ECU_ADDRESS 0x7f977c BIT_MASK 0x1 /end MEASUREMENT
/begin MEASUREMENT egcp[0].egcp_struct_sigdglsli2.lv_inh_diag_air_lsl_up "Deactivation of \"Monitoring Upstream Sensor Signal \"" UBYTE _CNV_S_2_RANGE__0___85_CM 1 0. 0. 1. DISPLAY_IDENTIFIER LV_INH_DIAG_AIR_LSL_UP_1_ ECU_ADDRESS 0x7f977d BIT_MASK 0x1 /end MEASUREMENT
/begin MEASUREMENT egcp[0].egcp_struct_sigdglsli2.lv_inh_diag_puc_lsl_up "Deactivation of \"Monitoring Upstream Sensor Signal during PUC\"" UBYTE _CNV_S_2_RANGE__0___85_CM 1 0. 0. 1. DISPLAY_IDENTIFIER LV_INH_DIAG_PUC_LSL_UP_1_ ECU_ADDRESS 0x7f977e BIT_MASK 0x1 /end MEASUREMENT
/begin MEASUREMENT egcp[0].egcp_struct_sigdglsli2.lv_diag_eol_dyn_ls_up "Status variable for activaton of lambda sensor diagnosis function via short trip" UBYTE _CNV_S_2_RANGE__0___85_CM 1 0. 0. 1. DISPLAY_IDENTIFIER LV_DIAG_EOL_DYN_LS_UP_1_ ECU_ADDRESS 0x7f977f BIT_MASK 0x1 /end MEASUREMENT
/begin MEASUREMENT egcp[0].egcp_struct_pladgtipai0.lv_inh_diag_ttip_obd_ls_up "Boolean inhibit flag for O2 sensor temperature OBDII monitoring" UBYTE _CNV_S_2_RANGE__0___85_CM 1 0. 0. 1. DISPLAY_IDENTIFIER LV_INH_DIAG_TTIP_OBD_LS_UP_1_ ECU_ADDRESS 0x7f9780 BIT_MASK 0x1 /end MEASUREMENT
/begin MEASUREMENT egcp[0].egcp_struct_pladglsli1.lv_diag_act_inh_ls_up_down "Inhibit sensor signal plausibility active test" UBYTE _CNV_S_2_RANGE__0___85_CM 1 0. 0. 1. DISPLAY_IDENTIFIER LV_DIAG_ACT_INH_LS_UP_DOWN_1_ ECU_ADDRESS 0x7f9781 BIT_MASK 0x1 /end MEASUREMENT
/begin MEASUREMENT egcp[0].egcp_struct_pladglsli1.lv_diag_afr_inh_ls_up_down "Inhibit sensor signal plausibility active test under air-fuel rich conditons" UBYTE _CNV_S_2_RANGE__0___85_CM 1 0. 0. 1. DISPLAY_IDENTIFIER LV_DIAG_AFR_INH_LS_UP_DOWN_1_ ECU_ADDRESS 0x7f9782 BIT_MASK 0x1 /end MEASUREMENT
/begin MEASUREMENT egcp[0].egcp_struct_pladglsli1.lv_diag_afl_inh_ls_up_down "Inhibit sensor signal plausibility active test under air-fuel lean conditons" UBYTE _CNV_S_2_RANGE__0___85_CM 1 0. 0. 1. DISPLAY_IDENTIFIER LV_DIAG_AFL_INH_LS_UP_DOWN_1_ ECU_ADDRESS 0x7f9783 BIT_MASK 0x1 /end MEASUREMENT
/begin MEASUREMENT egcp[0].egcp_struct_pladglsli1.lv_diag_eol_req_ls_up_down "Status variable for activaton of lambda sensor diagnosis function via short trip" UBYTE _CNV_S_2_RANGE__0___85_CM 1 0. 0. 1. DISPLAY_IDENTIFIER LV_DIAG_EOL_REQ_LS_UP_DOWN_1_ ECU_ADDRESS 0x7f9784 BIT_MASK 0x1 /end MEASUREMENT
/begin MEASUREMENT egcp[0].egcp_struct_sigdglsl3.lamb_delta_rise_lpf "Calculated value for heater coupling (rising value)" SWORD _CNV_A_R_LINEAR_____506_CM 1 0. -2. 1.99993896484375 DISPLAY_IDENTIFIER LAMB_DELTA_RISE_LPF_1_ ECU_ADDRESS 0x7f9786 BYTE_ORDER MSB_LAST FORMAT "%8.5" /end MEASUREMENT
/begin MEASUREMENT egcp[0].egcp_struct_sigdglsl3.lamb_delta_fall_lpf "Calculated value for heater coupling (falling value)" SWORD _CNV_A_R_LINEAR_____506_CM 1 0. -2. 1.99993896484375 DISPLAY_IDENTIFIER LAMB_DELTA_FALL_LPF_1_ ECU_ADDRESS 0x7f9788 BYTE_ORDER MSB_LAST FORMAT "%8.5" /end MEASUREMENT
/begin MEASUREMENT egcp[0].egcp_struct_sigdglsl3.lamb_syn_lshpwm_fall "Lambda value just after lshpwm signal falls" UWORD _CNV_A_R_LINEAR_____506_CM 1 0. 0. 1.99993896484375 DISPLAY_IDENTIFIER LAMB_SYN_LSHPWM_FALL_1_ ECU_ADDRESS 0x7f978a BYTE_ORDER MSB_LAST FORMAT "%7.5" /end MEASUREMENT
/begin MEASUREMENT egcp[0].egcp_struct_sigdglsl3.lamb_syn_lshpwm_rise "Lambda value just after lshpwm signal rises" UWORD _CNV_A_R_LINEAR_____506_CM 1 0. 0. 1.99993896484375 DISPLAY_IDENTIFIER LAMB_SYN_LSHPWM_RISE_1_ ECU_ADDRESS 0x7f978c BYTE_ORDER MSB_LAST FORMAT "%7.5" /end MEASUREMENT
/begin MEASUREMENT egcp[0].egcp_struct_sigdglsl3.lamb_delta_rise "Variation of lambda value before and after lshpwm signal rises" SWORD _CNV_A_R_LINEAR_____506_CM 1 0. -2. 1.99993896484375 DISPLAY_IDENTIFIER LAMB_DELTA_RISE_1_ ECU_ADDRESS 0x7f978e BYTE_ORDER MSB_LAST FORMAT "%8.5" /end MEASUREMENT
/begin MEASUREMENT egcp[0].egcp_struct_sigdglsl3.lamb_delta_fall "Variation of lambda value before and after lshpwm signal falls" SWORD _CNV_A_R_LINEAR_____506_CM 1 0. -2. 1.99993896484375 DISPLAY_IDENTIFIER LAMB_DELTA_FALL_1_ ECU_ADDRESS 0x7f9790 BYTE_ORDER MSB_LAST FORMAT "%8.5" /end MEASUREMENT
/begin MEASUREMENT egcp[0].egcp_struct_sigdglsl3.ctr_sym_diag_lsh_lsl_up "Number of met diagnosis conditions" UBYTE _CNV_A_R_LINEAR_____1_CM 1 0. 0. 255. DISPLAY_IDENTIFIER CTR_SYM_DIAG_LSH_LSL_UP_1_ ECU_ADDRESS 0x7f9792 FORMAT "%3.0" /end MEASUREMENT
/begin MEASUREMENT egcp[0].egcp_struct_sigdglsl3.cycnr_diag_lsh_lsl_up "Cycle counter of successfully carried out functions" UBYTE _CNV_A_R_LINEAR_____1_CM 1 0. 0. 255. DISPLAY_IDENTIFIER CYCNR_DIAG_LSH_LSL_UP_1_ ECU_ADDRESS 0x7f9793 FORMAT "%3.0" /end MEASUREMENT
/begin MEASUREMENT egcp[0].egcp_struct_sigdglsl3.t_dly_trig_lsh_up "Time delay to trigger oxygen sensor signal and lambda model" UBYTE _CNV_A_R_EGCP_LINEA_529_CM 1 0. 0. 0.255 DISPLAY_IDENTIFIER T_DLY_TRIG_LSH_UP_1_ ECU_ADDRESS 0x7f9794 FORMAT "%5.3" /end MEASUREMENT
/begin MEASUREMENT egcp[0].egcp_struct_sigdglsli3.lv_inh_diag_lsh_lsl_up "Deactivation of \"Diagnosis of the Heater Coupling in the Sensor Signal\"" UBYTE _CNV_S_2_RANGE__0___85_CM 1 0. 0. 1. DISPLAY_IDENTIFIER LV_INH_DIAG_LSH_LSL_UP_1_ ECU_ADDRESS 0x7f9796 BIT_MASK 0x1 /end MEASUREMENT
/begin CHARACTERISTIC c_abc_inc_diag_lsh_down "Anti-bounce counter increment for downstream O2-sensor heater signal diagnosis." VALUE 0x840d6b _REC_VAL_20_u1 255. _CNV_A_R_LINEAR_____1_CM 0. 255. DISPLAY_IDENTIFIER C_ABC_INC_DIAG_LSH_DOWN FORMAT "%3.0" /end CHARACTERISTIC
/begin CHARACTERISTIC c_abc_max_diag_lsh_down "Maximum value of the anti-bounce counter for downstream O2-sensor heater command signal diagnosis." VALUE 0x840d77 _REC_VAL_20_u1 254. _CNV_A_R_LINEAR_____1_CM 1. 255. DISPLAY_IDENTIFIER C_ABC_MAX_DIAG_LSH_DOWN FORMAT "%3.0" /end CHARACTERISTIC
/begin CHARACTERISTIC c_abc_inc_diag_lsh_up "Anti-bounce counter increment for upstream O2-sensor heater diagnosis." VALUE 0x840d6c _REC_VAL_20_u1 255. _CNV_A_R_LINEAR_____1_CM 0. 255. DISPLAY_IDENTIFIER C_ABC_INC_DIAG_LSH_UP FORMAT "%3.0" /end CHARACTERISTIC
/begin CHARACTERISTIC c_abc_max_diag_lsh_up "Maximum value of the anti-bounce counter for upstream O2-sensor heater diagnosis." VALUE 0x840d78 _REC_VAL_20_u1 254. _CNV_A_R_LINEAR_____1_CM 1. 255. DISPLAY_IDENTIFIER C_ABC_MAX_DIAG_LSH_UP FORMAT "%3.0" /end CHARACTERISTIC
/begin CHARACTERISTIC c_lamb_delta_i_max_diag "Maximum limit of LAMB_DELTA_I" VALUE 0x840e0c _REC_VAL_20_s2 0.25 _CNV_A_R_LINEAR_____506_CM -0.125 0.125 DISPLAY_IDENTIFIER C_LAMB_DELTA_I_MAX_DIAG FORMAT "%8.5" /end CHARACTERISTIC
/begin CHARACTERISTIC c_lamb_delta_i_min_diag "Minimum limit of LAMB_DELTA_I" VALUE 0x840e0e _REC_VAL_20_s2 0.25 _CNV_A_R_LINEAR_____506_CM -0.125 0.125 DISPLAY_IDENTIFIER C_LAMB_DELTA_I_MIN_DIAG FORMAT "%8.5" /end CHARACTERISTIC
/begin CHARACTERISTIC c_t_sum_max_diag_lam_adj "Total duration over T_SUM_MAX_DIAG_LAM_ADJ[NC_CBK_EX_NR]" VALUE 0x840ee6 _REC_VAL_20_u2 65535. _CNV_A_R_LINEAR_____27_CM 0. 65535. DISPLAY_IDENTIFIER C_T_SUM_MAX_DIAG_LAM_ADJ FORMAT "%5.0" /end CHARACTERISTIC
/begin CHARACTERISTIC c_t_sum_min_diag_lam_adj "Total duration over T_SUM_MIN_DIAG_LAM_ADJ[NC_CBK_EX_NR]" VALUE 0x840ee8 _REC_VAL_20_u2 65535. _CNV_A_R_LINEAR_____27_CM 0. 65535. DISPLAY_IDENTIFIER C_T_SUM_MIN_DIAG_LAM_ADJ FORMAT "%5.0" /end CHARACTERISTIC
/begin CHARACTERISTIC c_t_end_diag_lam_adj "Time counter to set T_END_DIAG_LAM_ADJ[NC_CBK_EX_NR]" VALUE 0x840ebe _REC_VAL_20_u2 65535. _CNV_A_R_LINEAR_____27_CM 0. 65535. DISPLAY_IDENTIFIER C_T_END_DIAG_LAM_ADJ FORMAT "%5.0" /end CHARACTERISTIC
/begin CHARACTERISTIC c_vls_dif_max_diag "Maximum threshold for VLS_DIF_DLY deviation" VALUE 0x840f5c _REC_VAL_20_s2 9.99511718999929 _CNV_A_R_LINEAR_____521_CM -5.00000000000182 4.99511718999747 DISPLAY_IDENTIFIER C_VLS_DIF_MAX_DIAG /end CHARACTERISTIC
/begin CHARACTERISTIC c_vls_dif_min_diag "Minimum threshold for VLS_DIF_DLY deviation" VALUE 0x840f5e _REC_VAL_20_s2 9.99511718999929 _CNV_A_R_LINEAR_____521_CM -5.00000000000182 4.99511718999747 DISPLAY_IDENTIFIER C_VLS_DIF_MIN_DIAG /end CHARACTERISTIC
/begin CHARACTERISTIC c_t_rst_sum_diag_lam_adj "Time counter to reset T_SUM_MIN_DIAG_LAM_ADJ[NC_CBK_EX_NR] and T_SUM_MAX_DIAG_LAM_ADJ[NC_CBK_EX_NR]" VALUE 0x840ee4 _REC_VAL_20_u2 65535. _CNV_A_R_LINEAR_____27_CM 0. 65535. DISPLAY_IDENTIFIER C_T_RST_SUM_DIAG_LAM_ADJ FORMAT "%5.0" /end CHARACTERISTIC
/begin CHARACTERISTIC c_t_vls_down_dif_end_diag "Time counter to set T_VLS_DOWN_DIF_END_DIAG[NC_CBK_EX_NR]" VALUE 0x840eec _REC_VAL_20_u2 65535. _CNV_A_R_LINEAR_____27_CM 0. 65535. DISPLAY_IDENTIFIER C_T_VLS_DOWN_DIF_END_DIAG FORMAT "%5.0" /end CHARACTERISTIC
/begin CHARACTERISTIC c_t_vls_down_dif_rst_sum_diag "Time counter to set T_VLS_DOWN_DIF_SUM_RST_DIAG[NC_CBK_EX_NR]" VALUE 0x840eee _REC_VAL_20_u2 65535. _CNV_A_R_LINEAR_____27_CM 0. 65535. DISPLAY_IDENTIFIER C_T_VLS_DOWN_DIF_RST_SUM_DIAG FORMAT "%5.0" /end CHARACTERISTIC
/begin MEASUREMENT lv_err_lam_adj_1 "Status diagnostic result of lambda trim control" UBYTE _CNV_S_2_RANGE__0___85_CM 1 0. 0. 1. DISPLAY_IDENTIFIER LV_ERR_LAM_ADJ_1_ ECU_ADDRESS 0x7fb951 BIT_MASK 0x1 /end MEASUREMENT
/begin CHARACTERISTIC c_maf_int_vls_dif_dly_min "Maximum MAF integral of VLS_DIF_DLY deviation (rich side)" VALUE 0x840e64 _REC_VAL_20_u2 1820.42 _CNV_A_R_LINEAR_____482_CM 0. 1820.42 DISPLAY_IDENTIFIER C_MAF_INT_VLS_DIF_DLY_MIN FORMAT "%7.2" /end CHARACTERISTIC
/begin CHARACTERISTIC c_maf_int_vls_dif_dly_max "Maximum MAF integral of VLS_DIF_DLY deviation (lean side)" VALUE 0x840e62 _REC_VAL_20_u2 1820.42 _CNV_A_R_LINEAR_____482_CM 0. 1820.42 DISPLAY_IDENTIFIER C_MAF_INT_VLS_DIF_DLY_MAX FORMAT "%7.2" /end CHARACTERISTIC
/begin MEASUREMENT lv_vls_dif_dly_ldc_n "Status limited dynamic N" UBYTE _CNV_S_2_RANGE__0___85_CM 1 0. 0. 1. DISPLAY_IDENTIFIER LV_VLS_DIF_DLY_LDC_N ECU_ADDRESS 0x7fb697 BIT_MASK 0x1 /end MEASUREMENT
/begin MEASUREMENT lv_vls_dif_dly_ldc_maf "Status limited dynamic MAF" UBYTE _CNV_S_2_RANGE__0___85_CM 1 0. 0. 1. DISPLAY_IDENTIFIER LV_VLS_DIF_DLY_LDC_MAF ECU_ADDRESS 0x7fb696 BIT_MASK 0x1 /end MEASUREMENT
/begin MEASUREMENT n_mmv_vls_dif_dly_ldc "Floating mean value for limited engine speed" UWORD _CNV_A_R_LINEAR_____154_CM 1 0. 0. 8160. DISPLAY_IDENTIFIER N_MMV_VLS_DIF_DLY_LDC ECU_ADDRESS 0x7f97a0 BYTE_ORDER MSB_LAST FORMAT "%4.0" /end MEASUREMENT
/begin MEASUREMENT maf_mmv_vls_dif_dly_ldc "Floating mean value for limited MAF" UWORD _CNV_A_R_LINEAR_____490_CM 1 0. 0. 1389. DISPLAY_IDENTIFIER MAF_MMV_VLS_DIF_DLY_LDC ECU_ADDRESS 0x7f979e BYTE_ORDER MSB_LAST FORMAT "%7.2" /end MEASUREMENT
/begin CHARACTERISTIC c_n_ldc_vls_dif_dly "Threshold limited dynamic engine speed" VALUE 0x840e78 _REC_VAL_20_u2 8160. _CNV_A_R_LINEAR_____154_CM 0. 8160. DISPLAY_IDENTIFIER C_N_LDC_VLS_DIF_DLY FORMAT "%4.0" /end CHARACTERISTIC
/begin CHARACTERISTIC c_maf_ldc_vls_dif_dly "Threshold limited dynamic engine MAF " VALUE 0x840e6e _REC_VAL_20_u2 1389. _CNV_A_R_LINEAR_____490_CM 0. 1389. DISPLAY_IDENTIFIER C_MAF_LDC_VLS_DIF_DLY FORMAT "%7.2" /end CHARACTERISTIC
/begin CHARACTERISTIC c_lam_mv_ldc_vls_dif_dly "Threshold limited dynamic lambda " VALUE 0x840df6 _REC_VAL_20_u2 99.99847412109381 _CNV_A_R_LINEAR_____258_CM 0. 99.99847412109381 DISPLAY_IDENTIFIER C_LAM_MV_LDC_VLS_DIF_DLY /end CHARACTERISTIC
/begin CHARACTERISTIC c_n_crlc_ldc_vls_dif_dly "Correlation constant floating mean value calculation engine speed" VALUE 0x840e76 _REC_VAL_20_u2 0.9999847412109381 _CNV_A_R_LINEAR_____137_CM 0. 0.9999847412109381 DISPLAY_IDENTIFIER C_N_CRLC_LDC_VLS_DIF_DLY FORMAT "%7.5" /end CHARACTERISTIC
/begin CHARACTERISTIC c_maf_crlc_ldc_vls_dif_dly "Correlation constant floating mean value calculation MAF" VALUE 0x840e44 _REC_VAL_20_u2 0.9999847412109381 _CNV_A_R_LINEAR_____137_CM 0. 0.9999847412109381 DISPLAY_IDENTIFIER C_MAF_CRLC_LDC_VLS_DIF_DLY FORMAT "%7.5" /end CHARACTERISTIC
/begin CHARACTERISTIC c_lam_mv_crlc_ldc_vls_dif_dly "Correlation constant floating mean value calculation lambda" VALUE 0x840df4 _REC_VAL_20_u2 0.9999847412109381 _CNV_A_R_LINEAR_____137_CM 0. 0.9999847412109381 DISPLAY_IDENTIFIER C_LAM_MV_CRLC_LDC_VLS_DIF_DLY FORMAT "%7.5" /end CHARACTERISTIC
/begin CHARACTERISTIC c_maf_int_min_vls_dif_dly_ldc "Maximum value of the mass air flow integral after limited dynamic conditions were fulfilled" VALUE 0x840e5a _REC_VAL_20_u2 1389. _CNV_A_R_EGCP_LINEA_516_CM 0. 1389. DISPLAY_IDENTIFIER C_MAF_INT_MIN_VLS_DIF_DLY_LDC FORMAT "%7.2" /end CHARACTERISTIC
/begin MEASUREMENT lv_err_chg_ls_up "Debounced error: upstream sensor of banks 1and 2 interchanged" UBYTE _CNV_S_2_RANGE__0___85_CM 1 0. 0. 1. DISPLAY_IDENTIFIER LV_ERR_CHG_LS_UP ECU_ADDRESS 0x7fb962 BIT_MASK 0x1 /end MEASUREMENT
/begin MEASUREMENT lv_err_chg_ls_down "Debounced error: downstream sensor of banks 1and 2 interchanged" UBYTE _CNV_S_2_RANGE__0___85_CM 1 0. 0. 1. DISPLAY_IDENTIFIER LV_ERR_CHG_LS_DOWN ECU_ADDRESS 0x7fb963 BIT_MASK 0x1 /end MEASUREMENT
/begin MEASUREMENT maf_int_diag_chg_ls_up "MAF integral value when  ERR_SYM_... ¹  \"NO_SYM\"" UWORD _CNV_A_R_LINEAR_____482_CM 1 0. 0. 1820.42 DISPLAY_IDENTIFIER MAF_INT_DIAG_CHG_LS_UP ECU_ADDRESS 0x7fa5b2 BYTE_ORDER MSB_LAST FORMAT "%7.2" /end MEASUREMENT
/begin MEASUREMENT maf_int_diag_chg_ls_down "MAF integral value when  ERR_SYM_... ¹  \"NO_SYM\"" UWORD _CNV_A_R_LINEAR_____482_CM 1 0. 0. 1820.42 DISPLAY_IDENTIFIER MAF_INT_DIAG_CHG_LS_DOWN ECU_ADDRESS 0x7fa5b0 BYTE_ORDER MSB_LAST FORMAT "%7.2" /end MEASUREMENT
/begin MEASUREMENT t_end_diag_chg_ls_up "Timer to set LV_END_... = 1" UWORD _CNV_A_R_LINEAR_____240_CM 1 0. 0. 6553.5 DISPLAY_IDENTIFIER T_END_DIAG_CHG_LS_UP ECU_ADDRESS 0x7fa5ba BYTE_ORDER MSB_LAST FORMAT "%6.1" /end MEASUREMENT
/begin MEASUREMENT t_end_diag_chg_ls_down "Timer to set LV_END_... = 1" UWORD _CNV_A_R_LINEAR_____240_CM 1 0. 0. 6553.5 DISPLAY_IDENTIFIER T_END_DIAG_CHG_LS_DOWN ECU_ADDRESS 0x7fa5b8 BYTE_ORDER MSB_LAST FORMAT "%6.1" /end MEASUREMENT
/begin CHARACTERISTIC c_t_end_diag_chg_ls_up "Max. time to set LV_END_... = 1" VALUE 0x840ebc _REC_VAL_20_u2 6553.5 _CNV_A_R_LINEAR_____240_CM 0. 6553.5 DISPLAY_IDENTIFIER C_T_END_DIAG_CHG_LS_UP FORMAT "%6.1" /end CHARACTERISTIC
/begin CHARACTERISTIC c_t_end_diag_chg_ls_down "Max. time to set LV_END_... = 1" VALUE 0x840eba _REC_VAL_20_u2 6553.5 _CNV_A_R_LINEAR_____240_CM 0. 6553.5 DISPLAY_IDENTIFIER C_T_END_DIAG_CHG_LS_DOWN FORMAT "%6.1" /end CHARACTERISTIC
/begin CHARACTERISTIC c_maf_int_diag_chg_ls_up "Max. MAF integral value when  ERR_SYM_... ¹  \"NO_SYM\" " VALUE 0x840e48 _REC_VAL_20_u2 1820.42 _CNV_A_R_LINEAR_____482_CM 0. 1820.42 DISPLAY_IDENTIFIER C_MAF_INT_DIAG_CHG_LS_UP FORMAT "%7.2" /end CHARACTERISTIC
/begin CHARACTERISTIC c_maf_int_diag_chg_ls_down "Max. MAF integral value when  ERR_SYM_... ¹  \"NO_SYM\" " VALUE 0x840e46 _REC_VAL_20_u2 1820.42 _CNV_A_R_LINEAR_____482_CM 0. 1820.42 DISPLAY_IDENTIFIER C_MAF_INT_DIAG_CHG_LS_DOWN FORMAT "%7.2" /end CHARACTERISTIC
/begin CHARACTERISTIC c_fac_lam_lim_max_chg_ls_up "Max. Threshold to detect a interchanged sensor" VALUE 0x840dd0 _REC_VAL_20_s2 99.99847412109381 _CNV_A_R_LINEAR_____515_CM -50. 49.9984741210938 DISPLAY_IDENTIFIER C_FAC_LAM_LIM_MAX_CHG_LS_UP FORMAT "%7.3" /end CHARACTERISTIC
/begin CHARACTERISTIC c_fac_lam_lim_min_chg_ls_up "Min. Threshold to detect a interchanged sensor" VALUE 0x840dd2 _REC_VAL_20_s2 99.99847412109381 _CNV_A_R_LINEAR_____515_CM -50. 49.9984741210938 DISPLAY_IDENTIFIER C_FAC_LAM_LIM_MIN_CHG_LS_UP FORMAT "%7.3" /end CHARACTERISTIC
/begin CHARACTERISTIC c_fac_int_chg_ls_up "Gain factor for the MAF integral" VALUE 0x840dcd _REC_VAL_20_u1 1.9921875 _CNV_A_R_LINEAR_____246_CM 0. 1.9921875 DISPLAY_IDENTIFIER C_FAC_INT_CHG_LS_UP FORMAT "%8.6" /end CHARACTERISTIC
/begin CHARACTERISTIC c_vls_down_max_chg_ls_down "Max. Threshold to detect a interchanged sensor" VALUE 0x840f6e _REC_VAL_20_u2 4.9951171875 _CNV_A_R_LINEAR_____265_CM 0. 4.9951171875 DISPLAY_IDENTIFIER C_VLS_DOWN_MAX_CHG_LS_DOWN FORMAT "%5.3" /end CHARACTERISTIC
/begin CHARACTERISTIC c_vls_down_min_chg_ls_down "Min. Threshold to detect a interchanged sensor" VALUE 0x840f72 _REC_VAL_20_u2 4.9951171875 _CNV_A_R_LINEAR_____265_CM 0. 4.9951171875 DISPLAY_IDENTIFIER C_VLS_DOWN_MIN_CHG_LS_DOWN FORMAT "%5.3" /end CHARACTERISTIC
/begin CHARACTERISTIC c_fac_int_chg_ls_down "Gain factor for the MAF integral" VALUE 0x840dcc _REC_VAL_20_u1 1.9921875 _CNV_A_R_LINEAR_____246_CM 0. 1.9921875 DISPLAY_IDENTIFIER C_FAC_INT_CHG_LS_DOWN FORMAT "%8.6" /end CHARACTERISTIC
/begin MEASUREMENT lv_inh_diag_chg_ls_up "Inhibit diagnosis interchanged upstream sensors" UBYTE _CNV_S_2_RANGE__0___85_CM 1 0. 0. 1. DISPLAY_IDENTIFIER LV_INH_DIAG_CHG_LS_UP ECU_ADDRESS 0x7fb693 BIT_MASK 0x1 /end MEASUREMENT
/begin MEASUREMENT lv_inh_diag_chg_ls_down "Inhibit diagnosis interchanged upstream sensors" UBYTE _CNV_S_2_RANGE__0___85_CM 1 0. 0. 1. DISPLAY_IDENTIFIER LV_INH_DIAG_CHG_LS_DOWN ECU_ADDRESS 0x7fb692 BIT_MASK 0x1 /end MEASUREMENT
/begin CHARACTERISTIC c_maf_int_diag_ls_up_down "Minimum threshold for MAF integral required to start active test" VALUE 0x840e4a _REC_VAL_20_u2 1820.42 _CNV_A_R_LINEAR_____482_CM 0. 1820.42 DISPLAY_IDENTIFIER C_MAF_INT_DIAG_LS_UP_DOWN FORMAT "%7.2" /end CHARACTERISTIC
/begin CHARACTERISTIC c_t_max_diag_afr_ls_up_down "Timer threshold for plausibility test under rich AF conditions" VALUE 0x840eca _REC_VAL_20_u2 6553.5 _CNV_A_R_LINEAR_____240_CM 0. 6553.5 DISPLAY_IDENTIFIER C_T_MAX_DIAG_AFR_LS_UP_DOWN FORMAT "%6.1" /end CHARACTERISTIC
/begin CHARACTERISTIC c_t_max_diag_afl_ls_up_down "Timer threshold for plausibility test under lean AF conditions" VALUE 0x840ec8 _REC_VAL_20_u2 6553.5 _CNV_A_R_LINEAR_____240_CM 0. 6553.5 DISPLAY_IDENTIFIER C_T_MAX_DIAG_AFL_LS_UP_DOWN FORMAT "%6.1" /end CHARACTERISTIC
/begin CHARACTERISTIC c_t_diag_eol_ls_up_down "Initialization of timer in case EOL to reduce the required minimum activity test time" VALUE 0x840e9a _REC_VAL_20_u2 6553.5 _CNV_A_R_LINEAR_____240_CM 0. 6553.5 DISPLAY_IDENTIFIER C_T_DIAG_EOL_LS_UP_DOWN FORMAT "%6.1" /end CHARACTERISTIC
/begin CHARACTERISTIC c_maf_int_eol_diag_ls_up_down "Initialization of MAF integral to reduce required minimum MAF value to start active test" VALUE 0x840e50 _REC_VAL_20_u2 1820.42 _CNV_A_R_LINEAR_____482_CM 0. 1820.42 DISPLAY_IDENTIFIER C_MAF_INT_EOL_DIAG_LS_UP_DOWN FORMAT "%7.2" /end CHARACTERISTIC
/begin CHARACTERISTIC c_lamb_afl_min_diag_ls_up_down "Min. lambda set point for lean fault detection " VALUE 0x840dfc _REC_VAL_20_u2 31.9990234375 _CNV_A_R_LINEAR_____465_CM 0. 31.9990234375 DISPLAY_IDENTIFIER C_LAMB_AFL_MIN_DIAG_LS_UP_DOWN FORMAT "%7.4" /end CHARACTERISTIC
/begin CHARACTERISTIC c_lamb_afl_max_diag_ls_up_down "Max. lambda set point for lean fault detection " VALUE 0x840dfa _REC_VAL_20_u2 31.9990234375 _CNV_A_R_LINEAR_____465_CM 0. 31.9990234375 DISPLAY_IDENTIFIER C_LAMB_AFL_MAX_DIAG_LS_UP_DOWN FORMAT "%7.4" /end CHARACTERISTIC
/begin CHARACTERISTIC c_lamb_afr_min_diag_ls_up_down "Min. lambda set point for rich fault detection " VALUE 0x840e04 _REC_VAL_20_u2 31.9990234375 _CNV_A_R_LINEAR_____465_CM 0. 31.9990234375 DISPLAY_IDENTIFIER C_LAMB_AFR_MIN_DIAG_LS_UP_DOWN FORMAT "%7.4" /end CHARACTERISTIC
/begin CHARACTERISTIC c_lamb_afr_max_diag_ls_up_down "Max. lambda set point for rich fault detection " VALUE 0x840e02 _REC_VAL_20_u2 31.9990234375 _CNV_A_R_LINEAR_____465_CM 0. 31.9990234375 DISPLAY_IDENTIFIER C_LAMB_AFR_MAX_DIAG_LS_UP_DOWN FORMAT "%7.4" /end CHARACTERISTIC
/begin CHARACTERISTIC c_abc_max_chk_ls_down "Maximum value for debounce algorithmus" VALUE 0x840d73 _REC_VAL_20_u1 254. _CNV_A_R_LINEAR_____1_CM 1. 255. DISPLAY_IDENTIFIER C_ABC_MAX_CHK_LS_DOWN FORMAT "%3.0" /end CHARACTERISTIC
/begin CHARACTERISTIC c_vls_afr_thd_diag_act_ls_down "VLS voltage threshold for rich fault detection (downstream sensor)" VALUE 0x840f58 _REC_VAL_20_u2 4.9951171875 _CNV_A_R_LINEAR_____265_CM 0. 4.9951171875 DISPLAY_IDENTIFIER C_VLS_AFR_THD_DIAG_ACT_LS_DOWN FORMAT "%5.3" /end CHARACTERISTIC
/begin CHARACTERISTIC c_vls_afl_thd_diag_act_ls_down "VLS voltage threshold for lean fault detection (downstream sensor)" VALUE 0x840f52 _REC_VAL_20_u2 4.9951171875 _CNV_A_R_LINEAR_____265_CM 0. 4.9951171875 DISPLAY_IDENTIFIER C_VLS_AFL_THD_DIAG_ACT_LS_DOWN FORMAT "%5.3" /end CHARACTERISTIC
/begin CHARACTERISTIC c_lamb_sp_afr_diag_ls_up_down "Lambda set point for rich fault detection " VALUE 0x840e22 _REC_VAL_20_u2 31.9990234375 _CNV_A_R_LINEAR_____465_CM 0. 31.9990234375 DISPLAY_IDENTIFIER C_LAMB_SP_AFR_DIAG_LS_UP_DOWN FORMAT "%7.4" /end CHARACTERISTIC
/begin CHARACTERISTIC c_lamb_sp_afl_diag_ls_up_down "Lambda set point for lean fault detection " VALUE 0x840e1e _REC_VAL_20_u2 31.9990234375 _CNV_A_R_LINEAR_____465_CM 0. 31.9990234375 DISPLAY_IDENTIFIER C_LAMB_SP_AFL_DIAG_LS_UP_DOWN FORMAT "%7.4" /end CHARACTERISTIC
/begin CHARACTERISTIC c_abc_inc_chk_ls_down "Increment for debounce algorithmus" VALUE 0x840d68 _REC_VAL_20_u1 255. _CNV_A_R_LINEAR_____1_CM 0. 255. DISPLAY_IDENTIFIER C_ABC_INC_CHK_LS_DOWN FORMAT "%3.0" /end CHARACTERISTIC
/begin CHARACTERISTIC c_lamb_sp_step_diag_ls_up_down "Number of recurrences to achieve the desired lambda set point" VALUE 0x840e2c _REC_VAL_20_u1 254. _CNV_A_R_LINEAR_____1_CM 1. 255. DISPLAY_IDENTIFIER C_LAMB_SP_STEP_DIAG_LS_UP_DOWN FORMAT "%3.0" /end CHARACTERISTIC
/begin MEASUREMENT lv_err_chk_ls_down_1 "Debounced failure in the downstream sensor " UBYTE _CNV_S_2_RANGE__0___85_CM 1 0. 0. 1. DISPLAY_IDENTIFIER LV_ERR_CHK_LS_DOWN_1_ ECU_ADDRESS 0x7fb952 BIT_MASK 0x1 /end MEASUREMENT
/begin CHARACTERISTIC lc_diag_auth_chk_ls_up_down "Boolean switch allowing the active test" VALUE 0x840f9f _REC_VAL_20_u1 1. _CNV_A_R_LINEAR_____1_CM 0. 1. DISPLAY_IDENTIFIER LC_DIAG_AUTH_CHK_LS_UP_DOWN FORMAT "%1.0" /end CHARACTERISTIC
/begin CHARACTERISTIC c_abc_inc_chk_lsl_up "Increment for debounce algorithmus" VALUE 0x840d69 _REC_VAL_20_u1 255. _CNV_A_R_LINEAR_____1_CM 0. 255. DISPLAY_IDENTIFIER C_ABC_INC_CHK_LSL_UP FORMAT "%3.0" /end CHARACTERISTIC
/begin CHARACTERISTIC c_lamb_afr_thd_diag_act_lsl_up "Lambda value threshold for rich fault detection (upstream sensor)" VALUE 0x840e06 _REC_VAL_20_u2 31.9990234375 _CNV_A_R_LINEAR_____465_CM 0. 31.9990234375 DISPLAY_IDENTIFIER C_LAMB_AFR_THD_DIAG_ACT_LSL_UP FORMAT "%7.4" /end CHARACTERISTIC
/begin CHARACTERISTIC c_lamb_afl_thd_diag_act_lsl_up "Lambda value threshold for lean fault detection (upstream sensor)" VALUE 0x840dfe _REC_VAL_20_u2 31.9990234375 _CNV_A_R_LINEAR_____465_CM 0. 31.9990234375 DISPLAY_IDENTIFIER C_LAMB_AFL_THD_DIAG_ACT_LSL_UP FORMAT "%7.4" /end CHARACTERISTIC
/begin CHARACTERISTIC c_ctr_sum_rst_afr_chk_lsl_up "Reset debounce counter for Richt test" VALUE 0x840dac _REC_VAL_20_u2 65535. _CNV_A_R_LINEAR_____1_CM 0. 65535. DISPLAY_IDENTIFIER C_CTR_SUM_RST_AFR_CHK_LSL_UP FORMAT "%5.0" /end CHARACTERISTIC
/begin CHARACTERISTIC c_ctr_sum_rst_afl_chk_lsl_up "Reset debounce counter for Lean test" VALUE 0x840daa _REC_VAL_20_u2 65535. _CNV_A_R_LINEAR_____1_CM 0. 65535. DISPLAY_IDENTIFIER C_CTR_SUM_RST_AFL_CHK_LSL_UP FORMAT "%5.0" /end CHARACTERISTIC
/begin CHARACTERISTIC c_abc_max_chk_lsl_up "Maximum value for debounce algorithmus" VALUE 0x840d74 _REC_VAL_20_u2 65535. _CNV_A_R_LINEAR_____1_CM 0. 65535. DISPLAY_IDENTIFIER C_ABC_MAX_CHK_LSL_UP FORMAT "%5.0" /end CHARACTERISTIC
/begin CHARACTERISTIC c_tcc_fac_gain_max_ttip_ls_up "Number of valid diagnosis cycles over which statistical evaluation to be carried out" VALUE 0x840ef8 _REC_VAL_20_u2 65535. _CNV_A_R_LINEAR_____1_CM 0. 65535. DISPLAY_IDENTIFIER C_TCC_FAC_GAIN_MAX_TTIP_LS_UP FORMAT "%5.0" /end CHARACTERISTIC
/begin CHARACTERISTIC c_tcc_err_max_ttip_obd_ls_up "Fault detection threshold, when exceeded, ceramic temperature determined to be defective" VALUE 0x840ef6 _REC_VAL_20_u2 65535. _CNV_A_R_LINEAR_____1_CM 0. 65535. DISPLAY_IDENTIFIER C_TCC_ERR_MAX_TTIP_OBD_LS_UP FORMAT "%5.0" /end CHARACTERISTIC
/begin CHARACTERISTIC lc_ttip_obd_rep_ls_up "Logical constant permitting diagnosis to be repeated within one driving cycle" VALUE 0x840fba _REC_VAL_20_u1 1. _CNV_A_R_LINEAR_____1_CM 0. 1. DISPLAY_IDENTIFIER LC_TTIP_OBD_REP_LS_UP FORMAT "%1.0" /end CHARACTERISTIC
/begin CHARACTERISTIC lc_ttip_obd_ls_up "Logical constant permitting diagnosis to be carried out" VALUE 0x840fb9 _REC_VAL_20_u1 1. _CNV_A_R_LINEAR_____1_CM 0. 1. DISPLAY_IDENTIFIER LC_TTIP_OBD_LS_UP FORMAT "%1.0" /end CHARACTERISTIC
/begin MEASUREMENT lv_err_ttip_obd_ls_up_1 "" UBYTE _CNV_S_2_RANGE__0___85_CM 1 0. 0. 1. DISPLAY_IDENTIFIER LV_ERR_TTIP_OBD_LS_UP_1_ ECU_ADDRESS 0x7fb959 BIT_MASK 0x1 /end MEASUREMENT
/begin CHARACTERISTIC c_tco_min_diag_mpl_ls_down "Minimum coolant temperature for diagnosis of the monitor sensors" VALUE 0x840f02 _REC_VAL_20_u1 190.5 _CNV_A_R_LINEAR_____257_CM -48. 142.5 DISPLAY_IDENTIFIER C_TCO_MIN_DIAG_MPL_LS_DOWN FORMAT "%6.2" /end CHARACTERISTIC
/begin CHARACTERISTIC c_vs_min_diag_mpl_ls_down "Minimum vehicle speed for diagnosis of the monitor sensors" VALUE 0x840f9e _REC_VAL_20_u1 255. _CNV_A_R_LINEAR_____245_CM 0. 255. DISPLAY_IDENTIFIER C_VS_MIN_DIAG_MPL_LS_DOWN FORMAT "%3.0" /end CHARACTERISTIC
/begin CHARACTERISTIC c_vs_max_diag_mpl_ls_down "Maximum vehicle speed for diagnosis of the monitor sensors" VALUE 0x840f9d _REC_VAL_20_u1 255. _CNV_A_R_LINEAR_____245_CM 0. 255. DISPLAY_IDENTIFIER C_VS_MAX_DIAG_MPL_LS_DOWN FORMAT "%3.0" /end CHARACTERISTIC
/begin CHARACTERISTIC c_temp_cat_min_diag_mpl_ls_down "Catalyst temperature threshold for diagnosis of the monitor sensors" VALUE 0x840f1a _REC_VAL_20_u1 1020. _CNV_A_R_EGCP_LINEA_533_CM -33. 987. DISPLAY_IDENTIFIER C_TEMP_CAT_MIN_DIAG_MPL_LS_DOWN FORMAT "%3.0" /end CHARACTERISTIC
/begin MEASUREMENT maf_kgh_min_puc "Minimum value of MAF_KGH while switching time calculation" UWORD _CNV_A_R_LINEAR_____479_CM 1 0. 0. 2047.96875 DISPLAY_IDENTIFIER MAF_KGH_MIN_PUC ECU_ADDRESS 0x7fa5b6 BYTE_ORDER MSB_LAST FORMAT "%10.5" /end MEASUREMENT
/begin AXIS_PTS ldp_maf_kgh_ip_fac_ls_down "" 0x840876 maf_kgh _REC_AXS_20_u2 2047.96875 _CNV_A_R_LINEAR_____479_CM 8 0. 2047.96875 FORMAT "%10.5" /end AXIS_PTS
/begin CHARACTERISTIC ip_fac_cycnr_max_ls_down_act "Weighting factor for CTR_SWT_ACT_LS_DOWN[NC_CBK_EX_NR]" CURVE 0x840b10 _REC_CUR_20_u1_u2 5100. _CNV_A_R_LINEAR_____437_CM 0. 5100. DISPLAY_IDENTIFIER IP_FAC_CYCNR_MAX_LS_DOWN_ACT FORMAT "%4.0"
 /begin AXIS_DESCR COM_AXIS maf_kgh _CNV_A_R_LINEAR_____479_CM 8 0. 2047.96875 FORMAT "%10.5" AXIS_PTS_REF ldp_maf_kgh_ip_fac_ls_down /end AXIS_DESCR
/end CHARACTERISTIC
/begin CHARACTERISTIC c_maf_int_puc_diag_pue_ls_down "Threshold for activation of the diagnosis" VALUE 0x840e5c _REC_VAL_20_u2 1820.42 _CNV_A_R_LINEAR_____482_CM 0. 1820.42 DISPLAY_IDENTIFIER C_MAF_INT_PUC_DIAG_PUE_LS_DOWN FORMAT "%7.2" /end CHARACTERISTIC
/begin CHARACTERISTIC c_maf_int_diag_pue_ls_down "Threshold for start of the diagnosis" VALUE 0x840e4e _REC_VAL_20_u2 1820.42 _CNV_A_R_LINEAR_____482_CM 0. 1820.42 DISPLAY_IDENTIFIER C_MAF_INT_DIAG_PUE_LS_DOWN FORMAT "%7.2" /end CHARACTERISTIC
/begin CHARACTERISTIC c_ctr_swt_diag_ls_down "Condition for the start of the lambda sensor switching time check" VALUE 0x840dae _REC_VAL_20_u1 255. _CNV_A_R_LINEAR_____1_CM 0. 255. DISPLAY_IDENTIFIER C_CTR_SWT_DIAG_LS_DOWN FORMAT "%3.0" /end CHARACTERISTIC
/begin CHARACTERISTIC c_ctr_sym_inc_diag_pue_ls_down "Counter increment for PUE_VLS_DOWN diagnosis" VALUE 0x840db1 _REC_VAL_20_u1 255. _CNV_A_R_LINEAR_____1_CM 0. 255. DISPLAY_IDENTIFIER C_CTR_SYM_INC_DIAG_PUE_LS_DOWN FORMAT "%3.0" /end CHARACTERISTIC
/begin CHARACTERISTIC c_ctr_sym_max_diag_pue_ls_down "Maximum value of  counter for PUE_VLS_DOWN diagnosis" VALUE 0x840db2 _REC_VAL_20_u1 255. _CNV_A_R_LINEAR_____1_CM 0. 255. DISPLAY_IDENTIFIER C_CTR_SYM_MAX_DIAG_PUE_LS_DOWN FORMAT "%3.0" /end CHARACTERISTIC
/begin CHARACTERISTIC c_vls_dif_min_diag_pue_ls_down "Threshold for VLS_DIF_DIAG_PUE_LS_DOWN[NC_CBK_EX_NR]" VALUE 0x840f60 _REC_VAL_20_u2 4.9951171875 _CNV_A_R_LINEAR_____265_CM 0. 4.9951171875 DISPLAY_IDENTIFIER C_VLS_DIF_MIN_DIAG_PUE_LS_DOWN FORMAT "%5.3" /end CHARACTERISTIC
/begin CHARACTERISTIC c_ctr_swt_ls_down "Diagnostic threshold for CTR_CYCNR_SWT_LS_DOWN[NC_CBK_EX_NR]" VALUE 0x840daf _REC_VAL_20_u1 1.9921875 _CNV_A_R_LINEAR_____246_CM 0. 1.9921875 DISPLAY_IDENTIFIER C_CTR_SWT_LS_DOWN FORMAT "%8.6" /end CHARACTERISTIC
/begin CHARACTERISTIC c_maf_puc_max_diag_swt_ls_down "Mass air flow threshold for diagnosis of the switching times" VALUE 0x840e70 _REC_VAL_20_u2 2047.96875 _CNV_A_R_LINEAR_____479_CM 0. 2047.96875 DISPLAY_IDENTIFIER C_MAF_PUC_MAX_DIAG_SWT_LS_DOWN FORMAT "%10.5" /end CHARACTERISTIC
/begin CHARACTERISTIC c_maf_puc_min_diag_swt_ls_down "Mass air flow threshold for diagnosis of the switching times" VALUE 0x840e72 _REC_VAL_20_u2 2047.96875 _CNV_A_R_LINEAR_____479_CM 0. 2047.96875 DISPLAY_IDENTIFIER C_MAF_PUC_MIN_DIAG_SWT_LS_DOWN FORMAT "%10.5" /end CHARACTERISTIC
/begin CHARACTERISTIC c_fac_vls_max_diag_swt_ls_down "Reduction factor for start of switching time determination" VALUE 0x840de3 _REC_VAL_20_u1 0.99609375 _CNV_A_R_LINEAR_____254_CM 0. 0.99609375 DISPLAY_IDENTIFIER C_FAC_VLS_MAX_DIAG_SWT_LS_DOWN FORMAT "%5.3" /end CHARACTERISTIC
/begin CHARACTERISTIC c_vls_hys_diag_swt_ls_down "Monitor sensor voltage hysteresis" VALUE 0x840f82 _REC_VAL_20_u2 4.9951171875 _CNV_A_R_LINEAR_____265_CM 0. 4.9951171875 DISPLAY_IDENTIFIER C_VLS_HYS_DIAG_SWT_LS_DOWN FORMAT "%5.3" /end CHARACTERISTIC
/begin CHARACTERISTIC c_vls_puc_min_diag_swt_ls_down "Voltage threshold for monitor sensor diagnosis" VALUE 0x840f8e _REC_VAL_20_u2 4.9951171875 _CNV_A_R_LINEAR_____265_CM 0. 4.9951171875 DISPLAY_IDENTIFIER C_VLS_PUC_MIN_DIAG_SWT_LS_DOWN FORMAT "%5.3" /end CHARACTERISTIC
/begin CHARACTERISTIC c_fac_vls_min_diag_swt_ls_down "Reduction factor for end of switching time determination" VALUE 0x840de4 _REC_VAL_20_u1 0.99609375 _CNV_A_R_LINEAR_____254_CM 0. 0.99609375 DISPLAY_IDENTIFIER C_FAC_VLS_MIN_DIAG_SWT_LS_DOWN FORMAT "%5.3" /end CHARACTERISTIC
/begin CHARACTERISTIC c_ctr_end_diag_pue_ls_down "Counter threshold for CTR_END_DIAG_PUE_LS_DOWN[NC_CBK_EX_NR]" VALUE 0x840d98 _REC_VAL_20_u2 65535. _CNV_A_R_LINEAR_____1_CM 0. 65535. DISPLAY_IDENTIFIER C_CTR_END_DIAG_PUE_LS_DOWN FORMAT "%5.0" /end CHARACTERISTIC
/begin MEASUREMENT lv_err_pue_ls_down_1 "Debounced diagnosis result of pull end plausibility" UBYTE _CNV_S_2_RANGE__0___85_CM 1 0. 0. 1. DISPLAY_IDENTIFIER LV_ERR_PUE_LS_DOWN_1_ ECU_ADDRESS 0x7fb961 BIT_MASK 0x1 /end MEASUREMENT
/begin MEASUREMENT lv_err_swt_ls_down_1 "Error bit of the switching time diagnosis" UBYTE _CNV_S_2_RANGE__0___85_CM 1 0. 0. 1. DISPLAY_IDENTIFIER LV_ERR_SWT_LS_DOWN_1_ ECU_ADDRESS 0x7fb960 BIT_MASK 0x1 /end MEASUREMENT
/begin CHARACTERISTIC c_abc_max_scg_ls_down "Debounce counter maximum for short to ground electrical check" VALUE 0x840d7d _REC_VAL_20_u1 255. _CNV_A_R_LINEAR_____1_CM 0. 255. DISPLAY_IDENTIFIER C_ABC_MAX_SCG_LS_DOWN FORMAT "%3.0" /end CHARACTERISTIC
/begin CHARACTERISTIC c_abc_inc_scg_ls_down "Debounce counter increment for short to ground electrical check" VALUE 0x840d71 _REC_VAL_20_u1 255. _CNV_A_R_LINEAR_____1_CM 0. 255. DISPLAY_IDENTIFIER C_ABC_INC_SCG_LS_DOWN FORMAT "%3.0" /end CHARACTERISTIC
/begin CHARACTERISTIC c_abc_inc_oc_ls_down "Debounce counter increment for open line electrical check" VALUE 0x840d6e _REC_VAL_20_u1 255. _CNV_A_R_LINEAR_____1_CM 0. 255. DISPLAY_IDENTIFIER C_ABC_INC_OC_LS_DOWN FORMAT "%3.0" /end CHARACTERISTIC
/begin CHARACTERISTIC c_abc_max_oc_ls_down "Debounce counter maximum for open line electrical check" VALUE 0x840d7a _REC_VAL_20_u1 255. _CNV_A_R_LINEAR_____1_CM 0. 255. DISPLAY_IDENTIFIER C_ABC_MAX_OC_LS_DOWN FORMAT "%3.0" /end CHARACTERISTIC
/begin CHARACTERISTIC c_abc_max_scp_ls_down "Debounce counter increment for short to plus electrical check" VALUE 0x840d7e _REC_VAL_20_u1 255. _CNV_A_R_LINEAR_____1_CM 0. 255. DISPLAY_IDENTIFIER C_ABC_MAX_SCP_LS_DOWN FORMAT "%3.0" /end CHARACTERISTIC
/begin CHARACTERISTIC c_abc_inc_scp_ls_down "Debounce counter maximum for short to plus electrical check" VALUE 0x840d72 _REC_VAL_20_u1 255. _CNV_A_R_LINEAR_____1_CM 0. 255. DISPLAY_IDENTIFIER C_ABC_INC_SCP_LS_DOWN FORMAT "%3.0" /end CHARACTERISTIC
/begin CHARACTERISTIC c_abc_inc_puc_ls_down "Debounce counter increment for PUC plausibility" VALUE 0x840d6f _REC_VAL_20_u1 255. _CNV_A_R_LINEAR_____1_CM 0. 255. DISPLAY_IDENTIFIER C_ABC_INC_PUC_LS_DOWN FORMAT "%3.0" /end CHARACTERISTIC
/begin CHARACTERISTIC c_abc_inc_fl_ls_down "Debounce counter increment for FL plausibility" VALUE 0x840d6d _REC_VAL_20_u1 255. _CNV_A_R_LINEAR_____1_CM 0. 255. DISPLAY_IDENTIFIER C_ABC_INC_FL_LS_DOWN FORMAT "%3.0" /end CHARACTERISTIC
/begin CHARACTERISTIC c_abc_max_puc_ls_down "Debounce counter maximum for PUC plausibility" VALUE 0x840d7b _REC_VAL_20_u1 255. _CNV_A_R_LINEAR_____1_CM 0. 255. DISPLAY_IDENTIFIER C_ABC_MAX_PUC_LS_DOWN FORMAT "%3.0" /end CHARACTERISTIC
/begin CHARACTERISTIC c_abc_max_fl_ls_down "Debounce counter maximum for FL plausibility" VALUE 0x840d79 _REC_VAL_20_u1 255. _CNV_A_R_LINEAR_____1_CM 0. 255. DISPLAY_IDENTIFIER C_ABC_MAX_FL_LS_DOWN FORMAT "%3.0" /end CHARACTERISTIC
/begin CHARACTERISTIC c_abc_inc_rgn_nt_ls_down "Anti-bounce counter increment for VLS_DOWN_RGN_NT diagnosis" VALUE 0x840d70 _REC_VAL_20_u1 255. _CNV_A_R_LINEAR_____1_CM 0. 255. DISPLAY_IDENTIFIER C_ABC_INC_RGN_NT_LS_DOWN FORMAT "%3.0" /end CHARACTERISTIC
/begin CHARACTERISTIC c_abc_max_rgn_nt_ls_down "Maximum value of anti-bounce counter for VLS_DOWN_RGN_NT diagnosis" VALUE 0x840d7c _REC_VAL_20_u1 254. _CNV_A_R_LINEAR_____1_CM 1. 255. DISPLAY_IDENTIFIER C_ABC_MAX_RGN_NT_LS_DOWN FORMAT "%3.0" /end CHARACTERISTIC
/begin MEASUREMENT lv_err_obd_vld_lsh_up_1 "Boolean flag indicating the validation of correspondent symptom (transmitted to the error management)" UBYTE _CNV_S_2_RANGE__0___85_CM 1 0. 0. 1. DISPLAY_IDENTIFIER LV_ERR_OBD_VLD_LSH_UP_1_ ECU_ADDRESS 0x7fb95c BIT_MASK 0x1 /end MEASUREMENT
/begin MEASUREMENT lv_err_puc_vld_ls_up_1 "Boolean flag indicating the validation of correspondent symptom (transmitted to the error management)" UBYTE _CNV_S_2_RANGE__0___85_CM 1 0. 0. 1. DISPLAY_IDENTIFIER LV_ERR_PUC_VLD_LS_UP_1_ ECU_ADDRESS 0x7fb95b BIT_MASK 0x1 /end MEASUREMENT
/begin CHARACTERISTIC lc_err_dyn_vld_ls_up "Allow Sensor Dynamic Fault to be considered as Sensor Failure (stops closed loop AF control)" VALUE 0x840fa1 _REC_VAL_20_u1 1. _CNV_A_R_LINEAR_____1_CM 0. 1. DISPLAY_IDENTIFIER LC_ERR_DYN_VLD_LS_UP FORMAT "%1.0" /end CHARACTERISTIC
/begin MEASUREMENT lv_err_dyn_vld_ls_up_1 "Boolean flag indicating the validation of correspondent symptom (transmitted to the error management)" UBYTE _CNV_S_2_RANGE__0___85_CM 1 0. 0. 1. DISPLAY_IDENTIFIER LV_ERR_DYN_VLD_LS_UP_1_ ECU_ADDRESS 0x7fb95a BIT_MASK 0x1 /end MEASUREMENT
/begin MEASUREMENT lv_err_shift_afl_lsl_up_1 "WRAF Sensor characteristic line shift to lean ERROR detected" UBYTE _CNV_S_2_RANGE__0___85_CM 1 0. 0. 1. DISPLAY_IDENTIFIER LV_ERR_SHIFT_AFL_LSL_UP_1_ ECU_ADDRESS 0x7fb95d BIT_MASK 0x1 /end MEASUREMENT
/begin MEASUREMENT lv_err_shift_afr_lsl_up_1 "WRAF Sensor characteristic line shift to rich ERROR detected" UBYTE _CNV_S_2_RANGE__0___85_CM 1 0. 0. 1. DISPLAY_IDENTIFIER LV_ERR_SHIFT_AFR_LSL_UP_1_ ECU_ADDRESS 0x7fb95e BIT_MASK 0x1 /end MEASUREMENT
/begin CHARACTERISTIC c_t_on_thd_lsh_diag_st_lsl_up "Minimum duration of heater activation after starting time exceeded" VALUE 0x840ede _REC_VAL_20_u2 6553.5 _CNV_A_R_LINEAR_____240_CM 0. 6553.5 DISPLAY_IDENTIFIER C_T_ON_THD_LSH_DIAG_ST_LSL_UP FORMAT "%6.1" /end CHARACTERISTIC
/begin CHARACTERISTIC c_t_lam_lim_diag_st_lsl_up "Minimum duration of the lambda controller manipulated value limitation to assure false start recognition" VALUE 0x840ec4 _REC_VAL_20_u1 25.5 _CNV_A_R_LINEAR_____240_CM 0. 25.5 DISPLAY_IDENTIFIER C_T_LAM_LIM_DIAG_ST_LSL_UP FORMAT "%4.1" /end CHARACTERISTIC
/begin AXIS_PTS ldp_tco_ip_t_max_diag_st_lsl_up "" 0x840922 tco_st _REC_AXS_20_u1 190.5 _CNV_A_R_LINEAR_____257_CM 4 -48. 142.5 FORMAT "%6.2" /end AXIS_PTS
/begin CHARACTERISTIC ip_t_max_diag_st_lsl_up "Maximum value of the starting time for a normal start" CURVE 0x840cd6 _REC_CUR_20_u1_u1 25.5 _CNV_A_R_LINEAR_____240_CM 0. 25.5 DISPLAY_IDENTIFIER IP_T_MAX_DIAG_ST_LSL_UP FORMAT "%4.1"
 /begin AXIS_DESCR COM_AXIS tco_st _CNV_A_R_LINEAR_____257_CM 4 -48. 142.5 FORMAT "%6.2" AXIS_PTS_REF ldp_tco_ip_t_max_diag_st_lsl_up /end AXIS_DESCR
/end CHARACTERISTIC
/begin CHARACTERISTIC c_vls_down_min_plaus_lsl_up "Minimum voltage of the oxygen sensor to carry out the plausibility" VALUE 0x840f74 _REC_VAL_20_u2 4.9951171875 _CNV_A_R_LINEAR_____265_CM 0. 4.9951171875 DISPLAY_IDENTIFIER C_VLS_DOWN_MIN_PLAUS_LSL_UP FORMAT "%5.3" /end CHARACTERISTIC
/begin CHARACTERISTIC c_vls_down_max_plaus_lsl_up "Maximum voltage of the oxygen sensor to carry out the plausibility" VALUE 0x840f70 _REC_VAL_20_u2 4.9951171875 _CNV_A_R_LINEAR_____265_CM 0. 4.9951171875 DISPLAY_IDENTIFIER C_VLS_DOWN_MAX_PLAUS_LSL_UP FORMAT "%5.3" /end CHARACTERISTIC
/begin CHARACTERISTIC c_temp_cat_min_plaus_lsl_up "Minimum temperature of the catalyst to carry out the plausibility" VALUE 0x840f1c _REC_VAL_20_u2 1023.984375 _CNV_A_R_LINEAR_____530_CM -33. 990.984375 DISPLAY_IDENTIFIER C_TEMP_CAT_MIN_PLAUS_LSL_UP FORMAT "%10.6" /end CHARACTERISTIC
/begin CHARACTERISTIC c_temp_cat_max_plaus_lsl_up "Maximum temperature of the catalyst to carry out the plausibility" VALUE 0x840f18 _REC_VAL_20_u2 1023.984375 _CNV_A_R_LINEAR_____530_CM -33. 990.984375 DISPLAY_IDENTIFIER C_TEMP_CAT_MAX_PLAUS_LSL_UP FORMAT "%10.6" /end CHARACTERISTIC
/begin CHARACTERISTIC c_maf_kgh_min_diag_plaus_lsl_up "Minimum mass air flow to carry out the plausibility" VALUE 0x840e6a _REC_VAL_20_u2 2047.96875 _CNV_A_R_LINEAR_____479_CM 0. 2047.96875 DISPLAY_IDENTIFIER C_MAF_KGH_MIN_DIAG_PLAUS_LSL_UP FORMAT "%10.5" /end CHARACTERISTIC
/begin CHARACTERISTIC c_maf_kgh_max_diag_plaus_lsl_up "Maximum mass air flow to carry out the plausibility" VALUE 0x840e66 _REC_VAL_20_u2 2047.96875 _CNV_A_R_LINEAR_____479_CM 0. 2047.96875 DISPLAY_IDENTIFIER C_MAF_KGH_MAX_DIAG_PLAUS_LSL_UP FORMAT "%10.5" /end CHARACTERISTIC
/begin CHARACTERISTIC c_eff_cat_diag_plaus_lsl_up "Maximum value of the catalyst efficiency diagnosis to carry out the plausibility" VALUE 0x840db8 _REC_VAL_20_u1 1.9921875 _CNV_A_R_LINEAR_____246_CM 0. 1.9921875 DISPLAY_IDENTIFIER C_EFF_CAT_DIAG_PLAUS_LSL_UP FORMAT "%8.6" /end CHARACTERISTIC
/begin CHARACTERISTIC c_vls_down_afl_plaus_lsl_up "Lean-mixture threshold of the downstream sensor voltage" VALUE 0x840f62 _REC_VAL_20_u2 4.9951171875 _CNV_A_R_LINEAR_____265_CM 0. 4.9951171875 DISPLAY_IDENTIFIER C_VLS_DOWN_AFL_PLAUS_LSL_UP FORMAT "%5.3" /end CHARACTERISTIC
/begin CHARACTERISTIC c_vls_down_afr_plaus_lsl_up "Rich-mixture threshold of the downstream sensor voltage" VALUE 0x840f66 _REC_VAL_20_u2 4.9951171875 _CNV_A_R_LINEAR_____265_CM 0. 4.9951171875 DISPLAY_IDENTIFIER C_VLS_DOWN_AFR_PLAUS_LSL_UP FORMAT "%5.3" /end CHARACTERISTIC
/begin CHARACTERISTIC c_lamb_afl_diag_plaus_lsl_up "Lean-mixture threshold of the upstream sensor voltage" VALUE 0x840df8 _REC_VAL_20_u2 31.9990234375 _CNV_A_R_LINEAR_____465_CM 0. 31.9990234375 DISPLAY_IDENTIFIER C_LAMB_AFL_DIAG_PLAUS_LSL_UP FORMAT "%7.4" /end CHARACTERISTIC
/begin CHARACTERISTIC c_lamb_afr_diag_plaus_lsl_up "Rich-mixture threshold of the upstream sensor voltage" VALUE 0x840e00 _REC_VAL_20_u2 31.9990234375 _CNV_A_R_LINEAR_____465_CM 0. 31.9990234375 DISPLAY_IDENTIFIER C_LAMB_AFR_DIAG_PLAUS_LSL_UP FORMAT "%7.4" /end CHARACTERISTIC
/begin CHARACTERISTIC c_lamb_min_diag_plaus_lsl_up "Minimum threshold of the upstream sensor to carry out a signal plausibility" VALUE 0x840e1c _REC_VAL_20_u2 31.9990234375 _CNV_A_R_LINEAR_____465_CM 0. 31.9990234375 DISPLAY_IDENTIFIER C_LAMB_MIN_DIAG_PLAUS_LSL_UP FORMAT "%7.4" /end CHARACTERISTIC
/begin CHARACTERISTIC c_lamb_max_diag_plaus_lsl_up "Maximum threshold of the upstream sensor to carry out a signal plausibility" VALUE 0x840e18 _REC_VAL_20_u2 31.9990234375 _CNV_A_R_LINEAR_____465_CM 0. 31.9990234375 DISPLAY_IDENTIFIER C_LAMB_MAX_DIAG_PLAUS_LSL_UP FORMAT "%7.4" /end CHARACTERISTIC
/begin CHARACTERISTIC c_tco_min_diag_plaus_lsl_up "Minimum threshold of the cooling-water temperature to activate the function" VALUE 0x840f03 _REC_VAL_20_u1 190.5 _CNV_A_R_LINEAR_____257_CM -48. 142.5 DISPLAY_IDENTIFIER C_TCO_MIN_DIAG_PLAUS_LSL_UP FORMAT "%6.2" /end CHARACTERISTIC
/begin AXIS_PTS ldp_maf_kgh_ip_t_diag_lsl_up "" 0x840888 maf_kgh _REC_AXS_20_u2 2047.96875 _CNV_A_R_LINEAR_____479_CM 4 0. 2047.96875 FORMAT "%10.5" /end AXIS_PTS
/begin CHARACTERISTIC ip_t_sym_diag_plaus_lsl_up "First anti-bounce filter: Time to debounce a plausibility error (compensation of the catalyst delay)" CURVE 0x840cda _REC_CUR_20_u2_u2 6553.5 _CNV_A_R_LINEAR_____240_CM 0. 6553.5 DISPLAY_IDENTIFIER IP_T_SYM_DIAG_PLAUS_LSL_UP FORMAT "%6.1"
 /begin AXIS_DESCR COM_AXIS maf_kgh _CNV_A_R_LINEAR_____479_CM 4 0. 2047.96875 FORMAT "%10.5" AXIS_PTS_REF ldp_maf_kgh_ip_t_diag_lsl_up /end AXIS_DESCR
/end CHARACTERISTIC
/begin CHARACTERISTIC c_t_end_diag_plaus_lsl_up "Time to have a diagnostic available" VALUE 0x840fbc _REC_VAL_20_u2 6553.5 _CNV_A_R_LINEAR_____240_CM 0. 6553.5 DISPLAY_IDENTIFIER C_T_END_DIAG_PLAUS_LSL_UP FORMAT "%6.1" /end CHARACTERISTIC
/begin CHARACTERISTIC c_ctr_err_ini_diag_st_lsl_up "Initial value in case of a false start" VALUE 0x840d9a _REC_VAL_20_u1 255. _CNV_A_R_LINEAR_____1_CM 0. 255. DISPLAY_IDENTIFIER C_CTR_ERR_INI_DIAG_ST_LSL_UP FORMAT "%3.0" /end CHARACTERISTIC
/begin CHARACTERISTIC c_ctr_inc_diag_plaus_lsl_up "Second anti-bounce filter: counter increment" VALUE 0x840da0 _REC_VAL_20_u1 255. _CNV_A_R_LINEAR_____1_CM 0. 255. DISPLAY_IDENTIFIER C_CTR_INC_DIAG_PLAUS_LSL_UP FORMAT "%3.0" /end CHARACTERISTIC
/begin CHARACTERISTIC c_ctr_dec_diag_plaus_lsl_up "Second anti-bounce filter: counter decrement" VALUE 0x840d96 _REC_VAL_20_u1 255. _CNV_A_R_LINEAR_____1_CM 0. 255. DISPLAY_IDENTIFIER C_CTR_DEC_DIAG_PLAUS_LSL_UP FORMAT "%3.0" /end CHARACTERISTIC
/begin CHARACTERISTIC c_ctr_thd_diag_plaus_lsl_up "Second anti-bounce filter: max. counter threshold" VALUE 0x840db3 _REC_VAL_20_u1 255. _CNV_A_R_LINEAR_____1_CM 0. 255. DISPLAY_IDENTIFIER C_CTR_THD_DIAG_PLAUS_LSL_UP FORMAT "%3.0" /end CHARACTERISTIC
/begin CHARACTERISTIC c_vls_up_max_diag_air_lsl_up "Upstream sensor signal max. threshold during engine operation (PUC excepted)" VALUE 0x840f94 _REC_VAL_20_u2 4.9951171875 _CNV_A_R_LINEAR_____265_CM 0. 4.9951171875 DISPLAY_IDENTIFIER C_VLS_UP_MAX_DIAG_AIR_LSL_UP FORMAT "%5.3" /end CHARACTERISTIC
/begin CHARACTERISTIC c_t_sym_diag_air_lsl_up "Time filter to detect a symptom" VALUE 0x840eea _REC_VAL_20_u2 6553.5 _CNV_A_R_LINEAR_____240_CM 0. 6553.5 DISPLAY_IDENTIFIER C_T_SYM_DIAG_AIR_LSL_UP FORMAT "%6.1" /end CHARACTERISTIC
/begin CHARACTERISTIC c_t_end_diag_air_lsl_up "Time to have a diagnostic available" VALUE 0x840eb8 _REC_VAL_20_u2 6553.5 _CNV_A_R_LINEAR_____240_CM 0. 6553.5 DISPLAY_IDENTIFIER C_T_END_DIAG_AIR_LSL_UP FORMAT "%6.1" /end CHARACTERISTIC
/begin CHARACTERISTIC c_t_diag_sym_puc_lsl_up "Time filter to detect a symptom" VALUE 0x840e9c _REC_VAL_20_u2 6553.5 _CNV_A_R_LINEAR_____240_CM 0. 6553.5 DISPLAY_IDENTIFIER C_T_DIAG_SYM_PUC_LSL_UP FORMAT "%6.1" /end CHARACTERISTIC
/begin CHARACTERISTIC c_t_dly_diag_puc_lsl_up "Waiting time after beginning of PUC to test sensor signal " VALUE 0x840ea4 _REC_VAL_20_u2 6553.5 _CNV_A_R_LINEAR_____240_CM 0. 6553.5 DISPLAY_IDENTIFIER C_T_DLY_DIAG_PUC_LSL_UP FORMAT "%6.1" /end CHARACTERISTIC
/begin CHARACTERISTIC c_vls_up_min_diag_puc_lsl_up "Minimum admissible upstream sensor output voltage in PUC" VALUE 0x840f9a _REC_VAL_20_u2 4.9951171875 _CNV_A_R_LINEAR_____265_CM 0. 4.9951171875 DISPLAY_IDENTIFIER C_VLS_UP_MIN_DIAG_PUC_LSL_UP FORMAT "%5.3" /end CHARACTERISTIC
/begin CHARACTERISTIC c_vls_up_max_diag_puc_lsl_up "Maximum admissible upstream sensor output voltage in PUC" VALUE 0x840f96 _REC_VAL_20_u2 4.9951171875 _CNV_A_R_LINEAR_____265_CM 0. 4.9951171875 DISPLAY_IDENTIFIER C_VLS_UP_MAX_DIAG_PUC_LSL_UP FORMAT "%5.3" /end CHARACTERISTIC
/begin CHARACTERISTIC c_teg_dyn_min_diag_puc_ls_up "Minimum admissible exhaust gas temperature in PUC" VALUE 0x840f16 _REC_VAL_20_u2 2047.9375 _CNV_A_R_EGCP_LINEA_468_CM 0. 2047.9375 DISPLAY_IDENTIFIER C_TEG_DYN_MIN_DIAG_PUC_LS_UP FORMAT "%7.2" /end CHARACTERISTIC
/begin CHARACTERISTIC c_t_diag_end_puc_lsl_up "Time to have a diagnostic available" VALUE 0x840e98 _REC_VAL_20_u2 6553.5 _CNV_A_R_LINEAR_____240_CM 0. 6553.5 DISPLAY_IDENTIFIER C_T_DIAG_END_PUC_LSL_UP FORMAT "%6.1" /end CHARACTERISTIC
/begin MEASUREMENT lv_err_air_lsl_up_1 "Debounced diagnosis result of upstream sensor signal monitoring" UBYTE _CNV_S_2_RANGE__0___85_CM 1 0. 0. 1. DISPLAY_IDENTIFIER LV_ERR_AIR_LSL_UP_1_ ECU_ADDRESS 0x7fb958 BIT_MASK 0x1 /end MEASUREMENT
/begin CHARACTERISTIC c_ctr_min_diag_dyn_lsl_up "Number of  single functions until to the calculation of the mean diagnosis value" VALUE 0x840da7 _REC_VAL_20_u1 255. _CNV_A_R_LINEAR_____1_CM 0. 255. DISPLAY_IDENTIFIER C_CTR_MIN_DIAG_DYN_LSL_UP FORMAT "%3.0" /end CHARACTERISTIC
/begin CHARACTERISTIC c_ctr_min_diag_eol_dyn_lsl_up "Number of  single functions until to the calculation of the mean diagnosis value (at the short test)" VALUE 0x840da8 _REC_VAL_20_u1 255. _CNV_A_R_LINEAR_____1_CM 0. 255. DISPLAY_IDENTIFIER C_CTR_MIN_DIAG_EOL_DYN_LSL_UP FORMAT "%3.0" /end CHARACTERISTIC
/begin CHARACTERISTIC c_ctr_wait_diag_dyn_lsl_up "Number of  forced stimulation cycles to wait until begin calculation of sensor signal amplitude" VALUE 0x840db4 _REC_VAL_20_u1 255. _CNV_A_R_LINEAR_____1_CM 0. 255. DISPLAY_IDENTIFIER C_CTR_WAIT_DIAG_DYN_LSL_UP FORMAT "%3.0" /end CHARACTERISTIC
/begin CHARACTERISTIC c_cycnr_ls_up_dyn_min "Minimun number of cycles necessary to finish the diagnosis" VALUE 0x840db5 _REC_VAL_20_u1 255. _CNV_A_R_LINEAR_____1_CM 0. 255. DISPLAY_IDENTIFIER C_CYCNR_LS_UP_DYN_MIN FORMAT "%3.0" /end CHARACTERISTIC
/begin CHARACTERISTIC c_cycnr_ls_up_dyn_min_ext_req "Minimun number of cycles necessary to finish the diagnosis for teh short test" VALUE 0x840db6 _REC_VAL_20_u1 255. _CNV_A_R_LINEAR_____1_CM 0. 255. DISPLAY_IDENTIFIER C_CYCNR_LS_UP_DYN_MIN_EXT_REQ FORMAT "%3.0" /end CHARACTERISTIC
/begin CHARACTERISTIC c_n_min_ls_dyn "Minimum number of revolutions to activate the diagnosis" VALUE 0x840e7b _REC_VAL_20_u1 8160. _CNV_A_R_LINEAR_____81_CM 0. 8160. DISPLAY_IDENTIFIER C_N_MIN_LS_DYN FORMAT "%4.0" /end CHARACTERISTIC
/begin CHARACTERISTIC c_n_max_ls_dyn "Maximum number of revolutions to activate the diagnosis" VALUE 0x840e7a _REC_VAL_20_u1 8160. _CNV_A_R_LINEAR_____81_CM 0. 8160. DISPLAY_IDENTIFIER C_N_MAX_LS_DYN FORMAT "%4.0" /end CHARACTERISTIC
/begin CHARACTERISTIC c_ls_dyn_diag_maf_max "Maximum mass flow to activate the diagnosis function" VALUE 0x840e36 _REC_VAL_20_u2 1389. _CNV_A_R_LINEAR_____490_CM 0. 1389. DISPLAY_IDENTIFIER C_LS_DYN_DIAG_MAF_MAX FORMAT "%7.2" /end CHARACTERISTIC
/begin CHARACTERISTIC c_ls_dyn_diag_maf_min "Minimum mass flow to activate the diagnosis function" VALUE 0x840e38 _REC_VAL_20_u2 1389. _CNV_A_R_LINEAR_____490_CM 0. 1389. DISPLAY_IDENTIFIER C_LS_DYN_DIAG_MAF_MIN FORMAT "%7.2" /end CHARACTERISTIC
/begin CHARACTERISTIC c_lamb_min_diag_dyn_lsl_up "Lowest allowed sensor signal min value" VALUE 0x840e1a _REC_VAL_20_u2 31.9990234375 _CNV_A_R_LINEAR_____465_CM 0. 31.9990234375 DISPLAY_IDENTIFIER C_LAMB_MIN_DIAG_DYN_LSL_UP FORMAT "%7.4" /end CHARACTERISTIC
/begin CHARACTERISTIC c_lamb_max_diag_dyn_lsl_up "Highest allowed sensor signal max value" VALUE 0x840e16 _REC_VAL_20_u2 31.9990234375 _CNV_A_R_LINEAR_____465_CM 0. 31.9990234375 DISPLAY_IDENTIFIER C_LAMB_MAX_DIAG_DYN_LSL_UP FORMAT "%7.4" /end CHARACTERISTIC
/begin CHARACTERISTIC c_fac_mv_thd_dyn_ls_up "Limited diagnosis value for the error diagnosis" VALUE 0x840dda _REC_VAL_20_u2 31.9990234375 _CNV_A_R_LINEAR_____465_CM 0. 31.9990234375 DISPLAY_IDENTIFIER C_FAC_MV_THD_DYN_LS_UP FORMAT "%7.4" /end CHARACTERISTIC
/begin CHARACTERISTIC c_fac_ad_thd_dyn_ls_up "Diagnosis value threshold for begin adaption of sensor time constant model" VALUE 0x840dbe _REC_VAL_20_u2 31.9990234375 _CNV_A_R_LINEAR_____465_CM 0. 31.9990234375 DISPLAY_IDENTIFIER C_FAC_AD_THD_DYN_LS_UP FORMAT "%7.4" /end CHARACTERISTIC
/begin CHARACTERISTIC c_fac_ad_delta_ls_up_dyn "Diagnosis value window allowed" VALUE 0x840dba _REC_VAL_20_u2 31.9990234375 _CNV_A_R_LINEAR_____465_CM 0. 31.9990234375 DISPLAY_IDENTIFIER C_FAC_AD_DELTA_LS_UP_DYN FORMAT "%7.4" /end CHARACTERISTIC
/begin CHARACTERISTIC c_fac_ad_lpf_dyn_ls_up "Low pass filter coeficient to calculate diagnosis mean value " VALUE 0x840dbc _REC_VAL_20_u1 0.99609375 _CNV_A_R_LINEAR_____254_CM 0. 0.99609375 DISPLAY_IDENTIFIER C_FAC_AD_LPF_DYN_LS_UP FORMAT "%5.3" /end CHARACTERISTIC
/begin CHARACTERISTIC lc_diag_dyn_lsl_up_cat_syn "Synchronize sensor dynamic diagnosis with the catalyst efficiency diagnosis" VALUE 0x840fa0 _REC_VAL_20_u1 1. _CNV_A_R_LINEAR_____1_CM 0. 1. DISPLAY_IDENTIFIER LC_DIAG_DYN_LSL_UP_CAT_SYN FORMAT "%1.0" /end CHARACTERISTIC
/begin CHARACTERISTIC lc_t1_ad_diag_dyn_lsl_up "Allow adaption of modeled sensor time constant T1_LAMB" VALUE 0x840fb8 _REC_VAL_20_u1 1. _CNV_A_R_LINEAR_____1_CM 0. 1. DISPLAY_IDENTIFIER LC_T1_AD_DIAG_DYN_LSL_UP FORMAT "%1.0" /end CHARACTERISTIC
/begin CHARACTERISTIC c_lamb_ampl_max_dyn_lsl_up "Calibration data for adjust the expected amplitude:  high range" VALUE 0x840e08 _REC_VAL_20_u1 0.124968 _CNV_A_R_EGCP_LINEA_524_CM 0. 0.124968 DISPLAY_IDENTIFIER C_LAMB_AMPL_MAX_DYN_LSL_UP FORMAT "%8.6" /end CHARACTERISTIC
/begin CHARACTERISTIC c_lamb_ampl_min_dyn_lsl_up "Calibration data for adjust the expected amplitude:  low range" VALUE 0x840e09 _REC_VAL_20_u1 0.124968 _CNV_A_R_EGCP_LINEA_524_CM 0. 0.124968 DISPLAY_IDENTIFIER C_LAMB_AMPL_MIN_DYN_LSL_UP FORMAT "%8.6" /end CHARACTERISTIC
/begin CHARACTERISTIC ip_lamb_ampl_max_dyn_lsl_up "Ampitude of nominal sensor by forced stimulation" MAP 0x840bca _REC_MAP_20_u1_u1_u1 0.124968 _CNV_A_R_EGCP_LINEA_524_CM 0. 0.124968 DISPLAY_IDENTIFIER IP_LAMB_AMPL_MAX_DYN_LSL_UP FORMAT "%8.6"
 /begin AXIS_DESCR COM_AXIS n_32 _CNV_A_R_LINEAR_____81_CM 8 0. 8160. FORMAT "%4.0" AXIS_PTS_REF ldpm_n_32_ls_up_dyn /end AXIS_DESCR
 /begin AXIS_DESCR COM_AXIS maf_hb _CNV_A_R_LINEAR_____371_CM 8 0. 1389. FORMAT "%4.0" AXIS_PTS_REF ldpm_maf_hb_ls_up_dyn /end AXIS_DESCR
/end CHARACTERISTIC
/begin CHARACTERISTIC ip_lamb_ampl_min_dyn_lsl_up "Ampitude of dynamic limit sensor by forced stimulation" MAP 0x840c0a _REC_MAP_20_u1_u1_u1 0.124968 _CNV_A_R_EGCP_LINEA_524_CM 0. 0.124968 DISPLAY_IDENTIFIER IP_LAMB_AMPL_MIN_DYN_LSL_UP FORMAT "%8.6"
 /begin AXIS_DESCR COM_AXIS n_32 _CNV_A_R_LINEAR_____81_CM 8 0. 8160. FORMAT "%4.0" AXIS_PTS_REF ldpm_n_32_ls_up_dyn /end AXIS_DESCR
 /begin AXIS_DESCR COM_AXIS maf_hb _CNV_A_R_LINEAR_____371_CM 8 0. 1389. FORMAT "%4.0" AXIS_PTS_REF ldpm_maf_hb_ls_up_dyn /end AXIS_DESCR
/end CHARACTERISTIC
/begin MEASUREMENT ctr_min_diag_dyn_lsl_up "Minimum number of  carried out single valid amplitude measurements" UBYTE _CNV_A_R_LINEAR_____1_CM 1 0. 0. 255. DISPLAY_IDENTIFIER CTR_MIN_DIAG_DYN_LSL_UP ECU_ADDRESS 0x7fbd18 FORMAT "%3.0" /end MEASUREMENT
/begin MEASUREMENT maf_int_diag_lsh_lsl_up "Integral of the air flow, for the activation of the heater coupling diagnosis" UWORD _CNV_A_R_LINEAR_____482_CM 1 0. 0. 1820.42 DISPLAY_IDENTIFIER MAF_INT_DIAG_LSH_LSL_UP ECU_ADDRESS 0x7fa5b4 BYTE_ORDER MSB_LAST FORMAT "%7.2" /end MEASUREMENT
/begin CHARACTERISTIC c_lamb_delta_lpf_thd "Threshold for the maximum transition of the sensor signal" VALUE 0x840e10 _REC_VAL_20_u2 1.99993896484375 _CNV_A_R_LINEAR_____506_CM 0. 1.99993896484375 DISPLAY_IDENTIFIER C_LAMB_DELTA_LPF_THD FORMAT "%7.5" /end CHARACTERISTIC
/begin CHARACTERISTIC c_cycnr_max_diag_lsh_lsl_up "Quantity of valid diagnosis values in one function cycle" VALUE 0x840db7 _REC_VAL_20_u1 255. _CNV_A_R_LINEAR_____1_CM 0. 255. DISPLAY_IDENTIFIER C_CYCNR_MAX_DIAG_LSH_LSL_UP FORMAT "%3.0" /end CHARACTERISTIC
/begin CHARACTERISTIC c_ctr_sym_diag_lsh_lsl_up "Limit value of the diagnosis results to diagnose the heater coupling" VALUE 0x840db0 _REC_VAL_20_u1 255. _CNV_A_R_LINEAR_____1_CM 0. 255. DISPLAY_IDENTIFIER C_CTR_SYM_DIAG_LSH_LSL_UP FORMAT "%3.0" /end CHARACTERISTIC
/begin CHARACTERISTIC c_lamb_sp_de_diag_lsh_lsl_up "Maximum value of the forced excitation amplitude to activate the diagnosis" VALUE 0x840e26 _REC_VAL_20_u1 0.124968 _CNV_A_R_EGCP_LINEA_524_CM 0. 0.124968 DISPLAY_IDENTIFIER C_LAMB_SP_DE_DIAG_LSH_LSL_UP FORMAT "%8.6" /end CHARACTERISTIC
/begin CHARACTERISTIC c_teg_dyn_min_diag_lsh_lsl_up "Minimum value of the exhaust temperature to activate  the function" VALUE 0x840f12 _REC_VAL_20_u2 2047.9375 _CNV_A_R_EGCP_LINEA_468_CM 0. 2047.9375 DISPLAY_IDENTIFIER C_TEG_DYN_MIN_DIAG_LSH_LSL_UP FORMAT "%7.2" /end CHARACTERISTIC
/begin CHARACTERISTIC c_maf_int_diag_lsh_lsl_up "Threshold for the activation of the MAF-Integral" VALUE 0x840e4c _REC_VAL_20_u2 1820.42 _CNV_A_R_LINEAR_____482_CM 0. 1820.42 DISPLAY_IDENTIFIER C_MAF_INT_DIAG_LSH_LSL_UP FORMAT "%7.2" /end CHARACTERISTIC
/begin CHARACTERISTIC c_t_per_lamb_de_diag_lsh_lsl_up "Threshold of the MAF-Integral to activate the heater-coupling diagnosis" VALUE 0x840ee0 _REC_VAL_20_u2 655.35 _CNV_A_R_LINEAR_____226_CM 0. 655.35 DISPLAY_IDENTIFIER C_T_PER_LAMB_DE_DIAG_LSH_LSL_UP FORMAT "%6.2" /end CHARACTERISTIC
/begin CHARACTERISTIC c_crlc_lpf_fall_diag_lsh_lsl_up "Filter constant for Fall" VALUE 0x840d89 _REC_VAL_20_u1 0.99609375 _CNV_A_R_LINEAR_____254_CM 0. 0.99609375 DISPLAY_IDENTIFIER C_CRLC_LPF_FALL_DIAG_LSH_LSL_UP FORMAT "%5.3" /end CHARACTERISTIC
/begin CHARACTERISTIC c_crlc_lpf_rise_diag_lsh_lsl_up "Filter constant for Rise" VALUE 0x840d8a _REC_VAL_20_u1 0.99609375 _CNV_A_R_LINEAR_____254_CM 0. 0.99609375 DISPLAY_IDENTIFIER C_CRLC_LPF_RISE_DIAG_LSH_LSL_UP FORMAT "%5.3" /end CHARACTERISTIC
/begin CHARACTERISTIC c_lshpwm_min_diag_lsh_lsl_up "Minimum heater PWM value allowed to carry out the heater coupling diagnosis" VALUE 0x840e3f _REC_VAL_20_u1 99.609375 _CNV_A_R_LINEAR_____486_CM 0. 99.609375 DISPLAY_IDENTIFIER C_LSHPWM_MIN_DIAG_LSH_LSL_UP FORMAT "%9.6" /end CHARACTERISTIC
/begin CHARACTERISTIC c_lshpwm_max_diag_lsh_lsl_up "Maximum heater PWM value allowed to carry out the heater coupling diagnosis" VALUE 0x840e3b _REC_VAL_20_u1 99.609375 _CNV_A_R_LINEAR_____486_CM 0. 99.609375 DISPLAY_IDENTIFIER C_LSHPWM_MAX_DIAG_LSH_LSL_UP FORMAT "%9.6" /end CHARACTERISTIC
/begin MEASUREMENT lv_err_lsh_lsl_up_1 "Debounced heater coupling diagnosis value" UBYTE _CNV_S_2_RANGE__0___85_CM 1 0. 0. 1. DISPLAY_IDENTIFIER LV_ERR_LSH_LSL_UP_1_ ECU_ADDRESS 0x7fb95f BIT_MASK 0x1 /end MEASUREMENT
/begin AXIS_PTS ldp_lshpwm_up_ip_t_dly_acq_vls "" 0x840852 online_dummy _REC_AXS_20_u1 99.609375 _CNV_A_R_LINEAR_____486_CM 8 0. 99.609375 FORMAT "%9.6" /end AXIS_PTS
/begin CHARACTERISTIC ip_t_dly_trig_lsh_up "Time delay to trigger oxygen sensor signal and lambda model" CURVE 0x840cce _REC_CUR_20_u1_u1 0.255 _CNV_A_R_EGCP_LINEA_529_CM 0. 0.255 DISPLAY_IDENTIFIER IP_T_DLY_TRIG_LSH_UP FORMAT "%5.3"
 /begin AXIS_DESCR COM_AXIS online_dummy _CNV_A_R_LINEAR_____486_CM 8 0. 99.609375 FORMAT "%9.6" AXIS_PTS_REF ldp_lshpwm_up_ip_t_dly_acq_vls /end AXIS_DESCR
/end CHARACTERISTIC
/begin CHARACTERISTIC c_abc_inc_diag_el_lsl_up "Increment of OBD-I Diagnosis debouncer counter" VALUE 0x840d6a _REC_VAL_20_u1 255. _CNV_A_R_LINEAR_____1_CM 0. 255. DISPLAY_IDENTIFIER C_ABC_INC_DIAG_EL_LSL_UP FORMAT "%3.0" /end CHARACTERISTIC
/begin CHARACTERISTIC c_abc_max_diag_el_lsl_up "Maximum threshold of OBD-I Diagnosis debouncer counter" VALUE 0x840d76 _REC_VAL_20_u1 254. _CNV_A_R_LINEAR_____1_CM 1. 255. DISPLAY_IDENTIFIER C_ABC_MAX_DIAG_EL_LSL_UP FORMAT "%3.0" /end CHARACTERISTIC
/begin MEASUREMENT lv_inh_diag_ls_up_dyn_cp "Canister Purge Load too high" UBYTE _CNV_S_2_RANGE__0___85_CM 1 0. 0. 1. DISPLAY_IDENTIFIER LV_INH_DIAG_LS_UP_DYN_CP ECU_ADDRESS 0x7fb694 BIT_MASK 0x1 /end MEASUREMENT
/begin CHARACTERISTIC c_cl_mmv_ls_up_diag_max "Maximum degree of saturation of the evaporative canister to activate the function" VALUE 0x840d82 _REC_VAL_20_u2 1.99996948242188 _CNV_A_R_LINEAR_____476_CM 0. 1.99996948242188 DISPLAY_IDENTIFIER C_CL_MMV_LS_UP_DIAG_MAX FORMAT "%7.5" /end CHARACTERISTIC
/begin AXIS_PTS ldpm_temp_ini_ls_up_1_egcp "" 0x840a30 online_dummy _REC_AXS_20_u2 4095.9375 _CNV_A_R_EGCP_LINEA_469_CM 6 -2048. 2047.9375 FORMAT "%10.4" /end AXIS_PTS
/begin AXIS_PTS ldpm_maf_kgh_3_egcp "" 0x8409c8 maf_kgh _REC_AXS_20_u2 2047.96875 _CNV_A_R_LINEAR_____479_CM 6 0. 2047.96875 FORMAT "%10.5" /end AXIS_PTS
/begin AXIS_PTS ldpm_n_32_ls_up_dyn "" 0x8409ed n_32 _REC_AXS_20_u1 8160. _CNV_A_R_LINEAR_____81_CM 8 0. 8160. FORMAT "%4.0" /end AXIS_PTS
/begin AXIS_PTS ldpm_maf_hb_ls_up_dyn "" 0x8409ac maf_hb _REC_AXS_20_u1 1389. _CNV_A_R_LINEAR_____371_CM 8 0. 1389. FORMAT "%4.0" /end AXIS_PTS
/begin MEASUREMENT t_iv_close_[0] "injector valve closing time (cylinder individual)" UWORD _CNV_A_R_LINEAR_____540_CM 1 0. 0. 0.512 DISPLAY_IDENTIFIER T_IV_CLOSE__0_ ECU_ADDRESS 0x7f9fce BYTE_ORDER MSB_LAST FORMAT "%4.3" /end MEASUREMENT
/begin MEASUREMENT t_iv_close_[1] "injector valve closing time (cylinder individual)" UWORD _CNV_A_R_LINEAR_____540_CM 1 0. 0. 0.512 DISPLAY_IDENTIFIER T_IV_CLOSE__1_ ECU_ADDRESS 0x7f9fd0 BYTE_ORDER MSB_LAST FORMAT "%4.3" /end MEASUREMENT
/begin MEASUREMENT t_iv_close_[2] "injector valve closing time (cylinder individual)" UWORD _CNV_A_R_LINEAR_____540_CM 1 0. 0. 0.512 DISPLAY_IDENTIFIER T_IV_CLOSE__2_ ECU_ADDRESS 0x7f9fd2 BYTE_ORDER MSB_LAST FORMAT "%4.3" /end MEASUREMENT
/begin MEASUREMENT t_iv_close_[3] "injector valve closing time (cylinder individual)" UWORD _CNV_A_R_LINEAR_____540_CM 1 0. 0. 0.512 DISPLAY_IDENTIFIER T_IV_CLOSE__3_ ECU_ADDRESS 0x7f9fd4 BYTE_ORDER MSB_LAST FORMAT "%4.3" /end MEASUREMENT
/begin MEASUREMENT v_delta_iv_foc_[0] "difference of injector voltage at detection point and last point (cylinder individual)" UWORD _CNV_A_R_LINEAR_____121_CM 1 0. 0. 255. DISPLAY_IDENTIFIER V_DELTA_IV_FOC__0_ ECU_ADDRESS 0x7f9fd6 BYTE_ORDER MSB_LAST FORMAT "%4.1" /end MEASUREMENT
/begin MEASUREMENT v_delta_iv_foc_[1] "difference of injector voltage at detection point and last point (cylinder individual)" UWORD _CNV_A_R_LINEAR_____121_CM 1 0. 0. 255. DISPLAY_IDENTIFIER V_DELTA_IV_FOC__1_ ECU_ADDRESS 0x7f9fd8 BYTE_ORDER MSB_LAST FORMAT "%4.1" /end MEASUREMENT
/begin MEASUREMENT v_delta_iv_foc_[2] "difference of injector voltage at detection point and last point (cylinder individual)" UWORD _CNV_A_R_LINEAR_____121_CM 1 0. 0. 255. DISPLAY_IDENTIFIER V_DELTA_IV_FOC__2_ ECU_ADDRESS 0x7f9fda BYTE_ORDER MSB_LAST FORMAT "%4.1" /end MEASUREMENT
/begin MEASUREMENT v_delta_iv_foc_[3] "difference of injector voltage at detection point and last point (cylinder individual)" UWORD _CNV_A_R_LINEAR_____121_CM 1 0. 0. 255. DISPLAY_IDENTIFIER V_DELTA_IV_FOC__3_ ECU_ADDRESS 0x7f9fdc BYTE_ORDER MSB_LAST FORMAT "%4.1" /end MEASUREMENT
/begin MEASUREMENT v_delta_iv_foc_rel_[0] "difference of injector voltage at detection point and last point divided by voltage at detection point (cyl. individual)" UWORD _CNV_A_R_LINEAR_____364_CM 1 0. 0. 255. DISPLAY_IDENTIFIER V_DELTA_IV_FOC_REL__0_ ECU_ADDRESS 0x7f9fde BYTE_ORDER MSB_LAST /end MEASUREMENT
/begin MEASUREMENT v_delta_iv_foc_rel_[1] "difference of injector voltage at detection point and last point divided by voltage at detection point (cyl. individual)" UWORD _CNV_A_R_LINEAR_____364_CM 1 0. 0. 255. DISPLAY_IDENTIFIER V_DELTA_IV_FOC_REL__1_ ECU_ADDRESS 0x7f9fe0 BYTE_ORDER MSB_LAST /end MEASUREMENT
/begin MEASUREMENT v_delta_iv_foc_rel_[2] "difference of injector voltage at detection point and last point divided by voltage at detection point (cyl. individual)" UWORD _CNV_A_R_LINEAR_____364_CM 1 0. 0. 255. DISPLAY_IDENTIFIER V_DELTA_IV_FOC_REL__2_ ECU_ADDRESS 0x7f9fe2 BYTE_ORDER MSB_LAST /end MEASUREMENT
/begin MEASUREMENT v_delta_iv_foc_rel_[3] "difference of injector voltage at detection point and last point divided by voltage at detection point (cyl. individual)" UWORD _CNV_A_R_LINEAR_____364_CM 1 0. 0. 255. DISPLAY_IDENTIFIER V_DELTA_IV_FOC_REL__3_ ECU_ADDRESS 0x7f9fe4 BYTE_ORDER MSB_LAST /end MEASUREMENT
/begin MEASUREMENT egy_inj_det_dif_fil_[0] "injector energy between last and detection point (filtered, cylinder individual)" UWORD _CNV_A_R_LINEAR_____541_CM 1 0. 0. 522.7750632 DISPLAY_IDENTIFIER EGY_INJ_DET_DIF_FIL__0_ ECU_ADDRESS 0x7fabae BYTE_ORDER MSB_LAST /end MEASUREMENT
/begin MEASUREMENT egy_inj_det_dif_fil_[1] "injector energy between last and detection point (filtered, cylinder individual)" UWORD _CNV_A_R_LINEAR_____541_CM 1 0. 0. 522.7750632 DISPLAY_IDENTIFIER EGY_INJ_DET_DIF_FIL__1_ ECU_ADDRESS 0x7fabb0 BYTE_ORDER MSB_LAST /end MEASUREMENT
/begin MEASUREMENT egy_inj_det_dif_fil_[2] "injector energy between last and detection point (filtered, cylinder individual)" UWORD _CNV_A_R_LINEAR_____541_CM 1 0. 0. 522.7750632 DISPLAY_IDENTIFIER EGY_INJ_DET_DIF_FIL__2_ ECU_ADDRESS 0x7fabb2 BYTE_ORDER MSB_LAST /end MEASUREMENT
/begin MEASUREMENT egy_inj_det_dif_fil_[3] "injector energy between last and detection point (filtered, cylinder individual)" UWORD _CNV_A_R_LINEAR_____541_CM 1 0. 0. 522.7750632 DISPLAY_IDENTIFIER EGY_INJ_DET_DIF_FIL__3_ ECU_ADDRESS 0x7fabb4 BYTE_ORDER MSB_LAST /end MEASUREMENT
/begin MEASUREMENT egy_inj_det_dif_[0] "injector energy between last and detection point (cylinder individual)" UWORD _CNV_A_R_LINEAR_____541_CM 1 0. 0. 522.7750632 DISPLAY_IDENTIFIER EGY_INJ_DET_DIF__0_ ECU_ADDRESS 0x7fabb6 BYTE_ORDER MSB_LAST /end MEASUREMENT
/begin MEASUREMENT egy_inj_det_dif_[1] "injector energy between last and detection point (cylinder individual)" UWORD _CNV_A_R_LINEAR_____541_CM 1 0. 0. 522.7750632 DISPLAY_IDENTIFIER EGY_INJ_DET_DIF__1_ ECU_ADDRESS 0x7fabb8 BYTE_ORDER MSB_LAST /end MEASUREMENT
/begin MEASUREMENT egy_inj_det_dif_[2] "injector energy between last and detection point (cylinder individual)" UWORD _CNV_A_R_LINEAR_____541_CM 1 0. 0. 522.7750632 DISPLAY_IDENTIFIER EGY_INJ_DET_DIF__2_ ECU_ADDRESS 0x7fabba BYTE_ORDER MSB_LAST /end MEASUREMENT
/begin MEASUREMENT egy_inj_det_dif_[3] "injector energy between last and detection point (cylinder individual)" UWORD _CNV_A_R_LINEAR_____541_CM 1 0. 0. 522.7750632 DISPLAY_IDENTIFIER EGY_INJ_DET_DIF__3_ ECU_ADDRESS 0x7fabbc BYTE_ORDER MSB_LAST /end MEASUREMENT
/begin MEASUREMENT egy_inj_det_fil_[0] "injector energy at detection point (filtered, cylinder individual)" UWORD _CNV_A_R_LINEAR_____541_CM 1 0. 0. 522.7750632 DISPLAY_IDENTIFIER EGY_INJ_DET_FIL__0_ ECU_ADDRESS 0x7fabbe BYTE_ORDER MSB_LAST /end MEASUREMENT
/begin MEASUREMENT egy_inj_det_fil_[1] "injector energy at detection point (filtered, cylinder individual)" UWORD _CNV_A_R_LINEAR_____541_CM 1 0. 0. 522.7750632 DISPLAY_IDENTIFIER EGY_INJ_DET_FIL__1_ ECU_ADDRESS 0x7fabc0 BYTE_ORDER MSB_LAST /end MEASUREMENT
/begin MEASUREMENT egy_inj_det_fil_[2] "injector energy at detection point (filtered, cylinder individual)" UWORD _CNV_A_R_LINEAR_____541_CM 1 0. 0. 522.7750632 DISPLAY_IDENTIFIER EGY_INJ_DET_FIL__2_ ECU_ADDRESS 0x7fabc2 BYTE_ORDER MSB_LAST /end MEASUREMENT
/begin MEASUREMENT egy_inj_det_fil_[3] "injector energy at detection point (filtered, cylinder individual)" UWORD _CNV_A_R_LINEAR_____541_CM 1 0. 0. 522.7750632 DISPLAY_IDENTIFIER EGY_INJ_DET_FIL__3_ ECU_ADDRESS 0x7fabc4 BYTE_ORDER MSB_LAST /end MEASUREMENT
/begin MEASUREMENT egy_inj_det_[0] "injector energy at detection point (cylinder individual)" UWORD _CNV_A_R_LINEAR_____541_CM 1 0. 0. 522.7750632 DISPLAY_IDENTIFIER EGY_INJ_DET__0_ ECU_ADDRESS 0x7fabc6 BYTE_ORDER MSB_LAST /end MEASUREMENT
/begin MEASUREMENT egy_inj_det_[1] "injector energy at detection point (cylinder individual)" UWORD _CNV_A_R_LINEAR_____541_CM 1 0. 0. 522.7750632 DISPLAY_IDENTIFIER EGY_INJ_DET__1_ ECU_ADDRESS 0x7fabc8 BYTE_ORDER MSB_LAST /end MEASUREMENT
/begin MEASUREMENT egy_inj_det_[2] "injector energy at detection point (cylinder individual)" UWORD _CNV_A_R_LINEAR_____541_CM 1 0. 0. 522.7750632 DISPLAY_IDENTIFIER EGY_INJ_DET__2_ ECU_ADDRESS 0x7fabca BYTE_ORDER MSB_LAST /end MEASUREMENT
/begin MEASUREMENT egy_inj_det_[3] "injector energy at detection point (cylinder individual)" UWORD _CNV_A_R_LINEAR_____541_CM 1 0. 0. 522.7750632 DISPLAY_IDENTIFIER EGY_INJ_DET__3_ ECU_ADDRESS 0x7fabcc BYTE_ORDER MSB_LAST /end MEASUREMENT
/begin MEASUREMENT egy_inj_lst_[0] "injector energy at last point (cylinder individual)" UWORD _CNV_A_R_LINEAR_____541_CM 1 0. 0. 522.7750632 DISPLAY_IDENTIFIER EGY_INJ_LST__0_ ECU_ADDRESS 0x7fabce BYTE_ORDER MSB_LAST /end MEASUREMENT
/begin MEASUREMENT egy_inj_lst_[1] "injector energy at last point (cylinder individual)" UWORD _CNV_A_R_LINEAR_____541_CM 1 0. 0. 522.7750632 DISPLAY_IDENTIFIER EGY_INJ_LST__1_ ECU_ADDRESS 0x7fabd0 BYTE_ORDER MSB_LAST /end MEASUREMENT
/begin MEASUREMENT egy_inj_lst_[2] "injector energy at last point (cylinder individual)" UWORD _CNV_A_R_LINEAR_____541_CM 1 0. 0. 522.7750632 DISPLAY_IDENTIFIER EGY_INJ_LST__2_ ECU_ADDRESS 0x7fabd2 BYTE_ORDER MSB_LAST /end MEASUREMENT
/begin MEASUREMENT egy_inj_lst_[3] "injector energy at last point (cylinder individual)" UWORD _CNV_A_R_LINEAR_____541_CM 1 0. 0. 522.7750632 DISPLAY_IDENTIFIER EGY_INJ_LST__3_ ECU_ADDRESS 0x7fabd4 BYTE_ORDER MSB_LAST /end MEASUREMENT
/begin MEASUREMENT nr_v_inj_dif_det_values_[0] "positions of maximal risings in voltage burst signal" UBYTE _CNV_A_R_LINEAR_____0_CM 1 0. 0. 255. DISPLAY_IDENTIFIER NR_V_INJ_DIF_DET_VALUES__0_ ECU_ADDRESS 0x7fbf16 FORMAT "%3.0" /end MEASUREMENT
/begin MEASUREMENT nr_v_inj_dif_det_values_[1] "positions of maximal risings in voltage burst signal" UBYTE _CNV_A_R_LINEAR_____0_CM 1 0. 0. 255. DISPLAY_IDENTIFIER NR_V_INJ_DIF_DET_VALUES__1_ ECU_ADDRESS 0x7fbf17 FORMAT "%3.0" /end MEASUREMENT
/begin MEASUREMENT nr_v_inj_dif_det_values_[2] "positions of maximal risings in voltage burst signal" UBYTE _CNV_A_R_LINEAR_____0_CM 1 0. 0. 255. DISPLAY_IDENTIFIER NR_V_INJ_DIF_DET_VALUES__2_ ECU_ADDRESS 0x7fbf18 FORMAT "%3.0" /end MEASUREMENT
/begin MEASUREMENT nr_v_inj_dif_det_values_[3] "positions of maximal risings in voltage burst signal" UBYTE _CNV_A_R_LINEAR_____0_CM 1 0. 0. 255. DISPLAY_IDENTIFIER NR_V_INJ_DIF_DET_VALUES__3_ ECU_ADDRESS 0x7fbf19 FORMAT "%3.0" /end MEASUREMENT
/begin MEASUREMENT nr_v_inj_dif_det_values_[4] "positions of maximal risings in voltage burst signal" UBYTE _CNV_A_R_LINEAR_____0_CM 1 0. 0. 255. DISPLAY_IDENTIFIER NR_V_INJ_DIF_DET_VALUES__4_ ECU_ADDRESS 0x7fbf1a FORMAT "%3.0" /end MEASUREMENT
/begin MEASUREMENT nr_v_inj_dif_det_values_[5] "positions of maximal risings in voltage burst signal" UBYTE _CNV_A_R_LINEAR_____0_CM 1 0. 0. 255. DISPLAY_IDENTIFIER NR_V_INJ_DIF_DET_VALUES__5_ ECU_ADDRESS 0x7fbf1b FORMAT "%3.0" /end MEASUREMENT
/begin MEASUREMENT nr_v_inj_dif_det_value_[0] "detection point of maximum injection voltage derivation (cylinder individual)" UBYTE _CNV_A_R_LINEAR_____0_CM 1 0. 0. 255. DISPLAY_IDENTIFIER NR_V_INJ_DIF_DET_VALUE__0_ ECU_ADDRESS 0x7fbf1c FORMAT "%3.0" /end MEASUREMENT
/begin MEASUREMENT nr_v_inj_dif_det_value_[1] "detection point of maximum injection voltage derivation (cylinder individual)" UBYTE _CNV_A_R_LINEAR_____0_CM 1 0. 0. 255. DISPLAY_IDENTIFIER NR_V_INJ_DIF_DET_VALUE__1_ ECU_ADDRESS 0x7fbf1d FORMAT "%3.0" /end MEASUREMENT
/begin MEASUREMENT nr_v_inj_dif_det_value_[2] "detection point of maximum injection voltage derivation (cylinder individual)" UBYTE _CNV_A_R_LINEAR_____0_CM 1 0. 0. 255. DISPLAY_IDENTIFIER NR_V_INJ_DIF_DET_VALUE__2_ ECU_ADDRESS 0x7fbf1e FORMAT "%3.0" /end MEASUREMENT
/begin MEASUREMENT nr_v_inj_dif_det_value_[3] "detection point of maximum injection voltage derivation (cylinder individual)" UBYTE _CNV_A_R_LINEAR_____0_CM 1 0. 0. 255. DISPLAY_IDENTIFIER NR_V_INJ_DIF_DET_VALUE__3_ ECU_ADDRESS 0x7fbf1f FORMAT "%3.0" /end MEASUREMENT
/begin MEASUREMENT q_inj_burst_act_[0] "charge burst signal (prepared for detection)" UWORD _CNV_A_R_LINEAR_____122_CM 1 0. 0. 4095.9375 DISPLAY_IDENTIFIER Q_INJ_BURST_ACT__0_ ECU_ADDRESS 0x7fabd6 BYTE_ORDER MSB_LAST FORMAT "%6.2" /end MEASUREMENT
/begin MEASUREMENT q_inj_burst_act_[1] "charge burst signal (prepared for detection)" UWORD _CNV_A_R_LINEAR_____122_CM 1 0. 0. 4095.9375 DISPLAY_IDENTIFIER Q_INJ_BURST_ACT__1_ ECU_ADDRESS 0x7fabd8 BYTE_ORDER MSB_LAST FORMAT "%6.2" /end MEASUREMENT
/begin MEASUREMENT q_inj_burst_act_[2] "charge burst signal (prepared for detection)" UWORD _CNV_A_R_LINEAR_____122_CM 1 0. 0. 4095.9375 DISPLAY_IDENTIFIER Q_INJ_BURST_ACT__2_ ECU_ADDRESS 0x7fabda BYTE_ORDER MSB_LAST FORMAT "%6.2" /end MEASUREMENT
/begin MEASUREMENT q_inj_burst_act_[3] "charge burst signal (prepared for detection)" UWORD _CNV_A_R_LINEAR_____122_CM 1 0. 0. 4095.9375 DISPLAY_IDENTIFIER Q_INJ_BURST_ACT__3_ ECU_ADDRESS 0x7fabdc BYTE_ORDER MSB_LAST FORMAT "%6.2" /end MEASUREMENT
/begin MEASUREMENT q_inj_burst_act_[4] "charge burst signal (prepared for detection)" UWORD _CNV_A_R_LINEAR_____122_CM 1 0. 0. 4095.9375 DISPLAY_IDENTIFIER Q_INJ_BURST_ACT__4_ ECU_ADDRESS 0x7fabde BYTE_ORDER MSB_LAST FORMAT "%6.2" /end MEASUREMENT
/begin MEASUREMENT q_inj_burst_act_[5] "charge burst signal (prepared for detection)" UWORD _CNV_A_R_LINEAR_____122_CM 1 0. 0. 4095.9375 DISPLAY_IDENTIFIER Q_INJ_BURST_ACT__5_ ECU_ADDRESS 0x7fabe0 BYTE_ORDER MSB_LAST FORMAT "%6.2" /end MEASUREMENT
/begin MEASUREMENT q_inj_burst_act_[6] "charge burst signal (prepared for detection)" UWORD _CNV_A_R_LINEAR_____122_CM 1 0. 0. 4095.9375 DISPLAY_IDENTIFIER Q_INJ_BURST_ACT__6_ ECU_ADDRESS 0x7fabe2 BYTE_ORDER MSB_LAST FORMAT "%6.2" /end MEASUREMENT
/begin MEASUREMENT q_inj_burst_act_[7] "charge burst signal (prepared for detection)" UWORD _CNV_A_R_LINEAR_____122_CM 1 0. 0. 4095.9375 DISPLAY_IDENTIFIER Q_INJ_BURST_ACT__7_ ECU_ADDRESS 0x7fabe4 BYTE_ORDER MSB_LAST FORMAT "%6.2" /end MEASUREMENT
/begin MEASUREMENT q_inj_burst_act_[8] "charge burst signal (prepared for detection)" UWORD _CNV_A_R_LINEAR_____122_CM 1 0. 0. 4095.9375 DISPLAY_IDENTIFIER Q_INJ_BURST_ACT__8_ ECU_ADDRESS 0x7fabe6 BYTE_ORDER MSB_LAST FORMAT "%6.2" /end MEASUREMENT
/begin MEASUREMENT q_inj_burst_act_[9] "charge burst signal (prepared for detection)" UWORD _CNV_A_R_LINEAR_____122_CM 1 0. 0. 4095.9375 DISPLAY_IDENTIFIER Q_INJ_BURST_ACT__9_ ECU_ADDRESS 0x7fabe8 BYTE_ORDER MSB_LAST FORMAT "%6.2" /end MEASUREMENT
/begin MEASUREMENT q_inj_burst_act_[10] "charge burst signal (prepared for detection)" UWORD _CNV_A_R_LINEAR_____122_CM 1 0. 0. 4095.9375 DISPLAY_IDENTIFIER Q_INJ_BURST_ACT__10_ ECU_ADDRESS 0x7fabea BYTE_ORDER MSB_LAST FORMAT "%6.2" /end MEASUREMENT
/begin MEASUREMENT q_inj_burst_act_[11] "charge burst signal (prepared for detection)" UWORD _CNV_A_R_LINEAR_____122_CM 1 0. 0. 4095.9375 DISPLAY_IDENTIFIER Q_INJ_BURST_ACT__11_ ECU_ADDRESS 0x7fabec BYTE_ORDER MSB_LAST FORMAT "%6.2" /end MEASUREMENT
/begin MEASUREMENT q_inj_burst_act_[12] "charge burst signal (prepared for detection)" UWORD _CNV_A_R_LINEAR_____122_CM 1 0. 0. 4095.9375 DISPLAY_IDENTIFIER Q_INJ_BURST_ACT__12_ ECU_ADDRESS 0x7fabee BYTE_ORDER MSB_LAST FORMAT "%6.2" /end MEASUREMENT
/begin MEASUREMENT q_inj_burst_act_[13] "charge burst signal (prepared for detection)" UWORD _CNV_A_R_LINEAR_____122_CM 1 0. 0. 4095.9375 DISPLAY_IDENTIFIER Q_INJ_BURST_ACT__13_ ECU_ADDRESS 0x7fabf0 BYTE_ORDER MSB_LAST FORMAT "%6.2" /end MEASUREMENT
/begin MEASUREMENT q_inj_burst_act_[14] "charge burst signal (prepared for detection)" UWORD _CNV_A_R_LINEAR_____122_CM 1 0. 0. 4095.9375 DISPLAY_IDENTIFIER Q_INJ_BURST_ACT__14_ ECU_ADDRESS 0x7fabf2 BYTE_ORDER MSB_LAST FORMAT "%6.2" /end MEASUREMENT
/begin MEASUREMENT q_inj_burst_act_[15] "charge burst signal (prepared for detection)" UWORD _CNV_A_R_LINEAR_____122_CM 1 0. 0. 4095.9375 DISPLAY_IDENTIFIER Q_INJ_BURST_ACT__15_ ECU_ADDRESS 0x7fabf4 BYTE_ORDER MSB_LAST FORMAT "%6.2" /end MEASUREMENT
/begin MEASUREMENT q_inj_burst_act_[16] "charge burst signal (prepared for detection)" UWORD _CNV_A_R_LINEAR_____122_CM 1 0. 0. 4095.9375 DISPLAY_IDENTIFIER Q_INJ_BURST_ACT__16_ ECU_ADDRESS 0x7fabf6 BYTE_ORDER MSB_LAST FORMAT "%6.2" /end MEASUREMENT
/begin MEASUREMENT q_inj_burst_act_[17] "charge burst signal (prepared for detection)" UWORD _CNV_A_R_LINEAR_____122_CM 1 0. 0. 4095.9375 DISPLAY_IDENTIFIER Q_INJ_BURST_ACT__17_ ECU_ADDRESS 0x7fabf8 BYTE_ORDER MSB_LAST FORMAT "%6.2" /end MEASUREMENT
/begin MEASUREMENT q_inj_burst_act_[18] "charge burst signal (prepared for detection)" UWORD _CNV_A_R_LINEAR_____122_CM 1 0. 0. 4095.9375 DISPLAY_IDENTIFIER Q_INJ_BURST_ACT__18_ ECU_ADDRESS 0x7fabfa BYTE_ORDER MSB_LAST FORMAT "%6.2" /end MEASUREMENT
/begin MEASUREMENT q_inj_burst_act_[19] "charge burst signal (prepared for detection)" UWORD _CNV_A_R_LINEAR_____122_CM 1 0. 0. 4095.9375 DISPLAY_IDENTIFIER Q_INJ_BURST_ACT__19_ ECU_ADDRESS 0x7fabfc BYTE_ORDER MSB_LAST FORMAT "%6.2" /end MEASUREMENT
/begin MEASUREMENT q_inj_burst_act_[20] "charge burst signal (prepared for detection)" UWORD _CNV_A_R_LINEAR_____122_CM 1 0. 0. 4095.9375 DISPLAY_IDENTIFIER Q_INJ_BURST_ACT__20_ ECU_ADDRESS 0x7fabfe BYTE_ORDER MSB_LAST FORMAT "%6.2" /end MEASUREMENT
/begin MEASUREMENT q_inj_burst_act_[21] "charge burst signal (prepared for detection)" UWORD _CNV_A_R_LINEAR_____122_CM 1 0. 0. 4095.9375 DISPLAY_IDENTIFIER Q_INJ_BURST_ACT__21_ ECU_ADDRESS 0x7fac00 BYTE_ORDER MSB_LAST FORMAT "%6.2" /end MEASUREMENT
/begin MEASUREMENT q_inj_burst_act_[22] "charge burst signal (prepared for detection)" UWORD _CNV_A_R_LINEAR_____122_CM 1 0. 0. 4095.9375 DISPLAY_IDENTIFIER Q_INJ_BURST_ACT__22_ ECU_ADDRESS 0x7fac02 BYTE_ORDER MSB_LAST FORMAT "%6.2" /end MEASUREMENT
/begin MEASUREMENT q_inj_burst_act_[23] "charge burst signal (prepared for detection)" UWORD _CNV_A_R_LINEAR_____122_CM 1 0. 0. 4095.9375 DISPLAY_IDENTIFIER Q_INJ_BURST_ACT__23_ ECU_ADDRESS 0x7fac04 BYTE_ORDER MSB_LAST FORMAT "%6.2" /end MEASUREMENT
/begin MEASUREMENT q_inj_burst_act_[24] "charge burst signal (prepared for detection)" UWORD _CNV_A_R_LINEAR_____122_CM 1 0. 0. 4095.9375 DISPLAY_IDENTIFIER Q_INJ_BURST_ACT__24_ ECU_ADDRESS 0x7fac06 BYTE_ORDER MSB_LAST FORMAT "%6.2" /end MEASUREMENT
/begin MEASUREMENT q_inj_burst_act_[25] "charge burst signal (prepared for detection)" UWORD _CNV_A_R_LINEAR_____122_CM 1 0. 0. 4095.9375 DISPLAY_IDENTIFIER Q_INJ_BURST_ACT__25_ ECU_ADDRESS 0x7fac08 BYTE_ORDER MSB_LAST FORMAT "%6.2" /end MEASUREMENT
/begin MEASUREMENT q_inj_burst_act_[26] "charge burst signal (prepared for detection)" UWORD _CNV_A_R_LINEAR_____122_CM 1 0. 0. 4095.9375 DISPLAY_IDENTIFIER Q_INJ_BURST_ACT__26_ ECU_ADDRESS 0x7fac0a BYTE_ORDER MSB_LAST FORMAT "%6.2" /end MEASUREMENT
/begin MEASUREMENT q_inj_burst_act_[27] "charge burst signal (prepared for detection)" UWORD _CNV_A_R_LINEAR_____122_CM 1 0. 0. 4095.9375 DISPLAY_IDENTIFIER Q_INJ_BURST_ACT__27_ ECU_ADDRESS 0x7fac0c BYTE_ORDER MSB_LAST FORMAT "%6.2" /end MEASUREMENT
/begin MEASUREMENT q_inj_burst_act_[28] "charge burst signal (prepared for detection)" UWORD _CNV_A_R_LINEAR_____122_CM 1 0. 0. 4095.9375 DISPLAY_IDENTIFIER Q_INJ_BURST_ACT__28_ ECU_ADDRESS 0x7fac0e BYTE_ORDER MSB_LAST FORMAT "%6.2" /end MEASUREMENT
/begin MEASUREMENT q_inj_burst_act_[29] "charge burst signal (prepared for detection)" UWORD _CNV_A_R_LINEAR_____122_CM 1 0. 0. 4095.9375 DISPLAY_IDENTIFIER Q_INJ_BURST_ACT__29_ ECU_ADDRESS 0x7fac10 BYTE_ORDER MSB_LAST FORMAT "%6.2" /end MEASUREMENT
/begin MEASUREMENT q_inj_burst_act_[30] "charge burst signal (prepared for detection)" UWORD _CNV_A_R_LINEAR_____122_CM 1 0. 0. 4095.9375 DISPLAY_IDENTIFIER Q_INJ_BURST_ACT__30_ ECU_ADDRESS 0x7fac12 BYTE_ORDER MSB_LAST FORMAT "%6.2" /end MEASUREMENT
/begin MEASUREMENT q_inj_burst_act_[31] "charge burst signal (prepared for detection)" UWORD _CNV_A_R_LINEAR_____122_CM 1 0. 0. 4095.9375 DISPLAY_IDENTIFIER Q_INJ_BURST_ACT__31_ ECU_ADDRESS 0x7fac14 BYTE_ORDER MSB_LAST FORMAT "%6.2" /end MEASUREMENT
/begin MEASUREMENT q_inj_burst_act_[32] "charge burst signal (prepared for detection)" UWORD _CNV_A_R_LINEAR_____122_CM 1 0. 0. 4095.9375 DISPLAY_IDENTIFIER Q_INJ_BURST_ACT__32_ ECU_ADDRESS 0x7fac16 BYTE_ORDER MSB_LAST FORMAT "%6.2" /end MEASUREMENT
/begin MEASUREMENT q_inj_burst_act_[33] "charge burst signal (prepared for detection)" UWORD _CNV_A_R_LINEAR_____122_CM 1 0. 0. 4095.9375 DISPLAY_IDENTIFIER Q_INJ_BURST_ACT__33_ ECU_ADDRESS 0x7fac18 BYTE_ORDER MSB_LAST FORMAT "%6.2" /end MEASUREMENT
/begin MEASUREMENT q_inj_burst_act_[34] "charge burst signal (prepared for detection)" UWORD _CNV_A_R_LINEAR_____122_CM 1 0. 0. 4095.9375 DISPLAY_IDENTIFIER Q_INJ_BURST_ACT__34_ ECU_ADDRESS 0x7fac1a BYTE_ORDER MSB_LAST FORMAT "%6.2" /end MEASUREMENT
/begin MEASUREMENT q_inj_burst_act_[35] "charge burst signal (prepared for detection)" UWORD _CNV_A_R_LINEAR_____122_CM 1 0. 0. 4095.9375 DISPLAY_IDENTIFIER Q_INJ_BURST_ACT__35_ ECU_ADDRESS 0x7fac1c BYTE_ORDER MSB_LAST FORMAT "%6.2" /end MEASUREMENT
/begin MEASUREMENT q_inj_burst_act_[36] "charge burst signal (prepared for detection)" UWORD _CNV_A_R_LINEAR_____122_CM 1 0. 0. 4095.9375 DISPLAY_IDENTIFIER Q_INJ_BURST_ACT__36_ ECU_ADDRESS 0x7fac1e BYTE_ORDER MSB_LAST FORMAT "%6.2" /end MEASUREMENT
/begin MEASUREMENT q_inj_burst_act_[37] "charge burst signal (prepared for detection)" UWORD _CNV_A_R_LINEAR_____122_CM 1 0. 0. 4095.9375 DISPLAY_IDENTIFIER Q_INJ_BURST_ACT__37_ ECU_ADDRESS 0x7fac20 BYTE_ORDER MSB_LAST FORMAT "%6.2" /end MEASUREMENT
/begin MEASUREMENT q_inj_burst_act_[38] "charge burst signal (prepared for detection)" UWORD _CNV_A_R_LINEAR_____122_CM 1 0. 0. 4095.9375 DISPLAY_IDENTIFIER Q_INJ_BURST_ACT__38_ ECU_ADDRESS 0x7fac22 BYTE_ORDER MSB_LAST FORMAT "%6.2" /end MEASUREMENT
/begin MEASUREMENT q_inj_burst_act_[39] "charge burst signal (prepared for detection)" UWORD _CNV_A_R_LINEAR_____122_CM 1 0. 0. 4095.9375 DISPLAY_IDENTIFIER Q_INJ_BURST_ACT__39_ ECU_ADDRESS 0x7fac24 BYTE_ORDER MSB_LAST FORMAT "%6.2" /end MEASUREMENT
/begin MEASUREMENT q_inj_burst_act_[40] "charge burst signal (prepared for detection)" UWORD _CNV_A_R_LINEAR_____122_CM 1 0. 0. 4095.9375 DISPLAY_IDENTIFIER Q_INJ_BURST_ACT__40_ ECU_ADDRESS 0x7fac26 BYTE_ORDER MSB_LAST FORMAT "%6.2" /end MEASUREMENT
/begin MEASUREMENT q_inj_burst_act_[41] "charge burst signal (prepared for detection)" UWORD _CNV_A_R_LINEAR_____122_CM 1 0. 0. 4095.9375 DISPLAY_IDENTIFIER Q_INJ_BURST_ACT__41_ ECU_ADDRESS 0x7fac28 BYTE_ORDER MSB_LAST FORMAT "%6.2" /end MEASUREMENT
/begin MEASUREMENT q_inj_burst_act_[42] "charge burst signal (prepared for detection)" UWORD _CNV_A_R_LINEAR_____122_CM 1 0. 0. 4095.9375 DISPLAY_IDENTIFIER Q_INJ_BURST_ACT__42_ ECU_ADDRESS 0x7fac2a BYTE_ORDER MSB_LAST FORMAT "%6.2" /end MEASUREMENT
/begin MEASUREMENT q_inj_burst_act_[43] "charge burst signal (prepared for detection)" UWORD _CNV_A_R_LINEAR_____122_CM 1 0. 0. 4095.9375 DISPLAY_IDENTIFIER Q_INJ_BURST_ACT__43_ ECU_ADDRESS 0x7fac2c BYTE_ORDER MSB_LAST FORMAT "%6.2" /end MEASUREMENT
/begin MEASUREMENT q_inj_burst_act_[44] "charge burst signal (prepared for detection)" UWORD _CNV_A_R_LINEAR_____122_CM 1 0. 0. 4095.9375 DISPLAY_IDENTIFIER Q_INJ_BURST_ACT__44_ ECU_ADDRESS 0x7fac2e BYTE_ORDER MSB_LAST FORMAT "%6.2" /end MEASUREMENT
/begin MEASUREMENT q_inj_burst_act_[45] "charge burst signal (prepared for detection)" UWORD _CNV_A_R_LINEAR_____122_CM 1 0. 0. 4095.9375 DISPLAY_IDENTIFIER Q_INJ_BURST_ACT__45_ ECU_ADDRESS 0x7fac30 BYTE_ORDER MSB_LAST FORMAT "%6.2" /end MEASUREMENT
/begin MEASUREMENT q_inj_burst_act_[46] "charge burst signal (prepared for detection)" UWORD _CNV_A_R_LINEAR_____122_CM 1 0. 0. 4095.9375 DISPLAY_IDENTIFIER Q_INJ_BURST_ACT__46_ ECU_ADDRESS 0x7fac32 BYTE_ORDER MSB_LAST FORMAT "%6.2" /end MEASUREMENT
/begin MEASUREMENT q_inj_burst_act_[47] "charge burst signal (prepared for detection)" UWORD _CNV_A_R_LINEAR_____122_CM 1 0. 0. 4095.9375 DISPLAY_IDENTIFIER Q_INJ_BURST_ACT__47_ ECU_ADDRESS 0x7fac34 BYTE_ORDER MSB_LAST FORMAT "%6.2" /end MEASUREMENT
/begin MEASUREMENT q_inj_burst_exp_[0] "charge burst signal (expanded)" UWORD _CNV_A_R_LINEAR_____122_CM 1 0. 0. 4095.9375 DISPLAY_IDENTIFIER Q_INJ_BURST_EXP__0_ ECU_ADDRESS 0x7fac86 BYTE_ORDER MSB_LAST FORMAT "%6.2" /end MEASUREMENT
/begin MEASUREMENT q_inj_burst_exp_[1] "charge burst signal (expanded)" UWORD _CNV_A_R_LINEAR_____122_CM 1 0. 0. 4095.9375 DISPLAY_IDENTIFIER Q_INJ_BURST_EXP__1_ ECU_ADDRESS 0x7fac88 BYTE_ORDER MSB_LAST FORMAT "%6.2" /end MEASUREMENT
/begin MEASUREMENT q_inj_burst_exp_[2] "charge burst signal (expanded)" UWORD _CNV_A_R_LINEAR_____122_CM 1 0. 0. 4095.9375 DISPLAY_IDENTIFIER Q_INJ_BURST_EXP__2_ ECU_ADDRESS 0x7fac8a BYTE_ORDER MSB_LAST FORMAT "%6.2" /end MEASUREMENT
/begin MEASUREMENT q_inj_burst_exp_[3] "charge burst signal (expanded)" UWORD _CNV_A_R_LINEAR_____122_CM 1 0. 0. 4095.9375 DISPLAY_IDENTIFIER Q_INJ_BURST_EXP__3_ ECU_ADDRESS 0x7fac8c BYTE_ORDER MSB_LAST FORMAT "%6.2" /end MEASUREMENT
/begin MEASUREMENT q_inj_burst_exp_[4] "charge burst signal (expanded)" UWORD _CNV_A_R_LINEAR_____122_CM 1 0. 0. 4095.9375 DISPLAY_IDENTIFIER Q_INJ_BURST_EXP__4_ ECU_ADDRESS 0x7fac8e BYTE_ORDER MSB_LAST FORMAT "%6.2" /end MEASUREMENT
/begin MEASUREMENT q_inj_burst_exp_[5] "charge burst signal (expanded)" UWORD _CNV_A_R_LINEAR_____122_CM 1 0. 0. 4095.9375 DISPLAY_IDENTIFIER Q_INJ_BURST_EXP__5_ ECU_ADDRESS 0x7fac90 BYTE_ORDER MSB_LAST FORMAT "%6.2" /end MEASUREMENT
/begin MEASUREMENT q_inj_burst_exp_[6] "charge burst signal (expanded)" UWORD _CNV_A_R_LINEAR_____122_CM 1 0. 0. 4095.9375 DISPLAY_IDENTIFIER Q_INJ_BURST_EXP__6_ ECU_ADDRESS 0x7fac92 BYTE_ORDER MSB_LAST FORMAT "%6.2" /end MEASUREMENT
/begin MEASUREMENT q_inj_burst_exp_[7] "charge burst signal (expanded)" UWORD _CNV_A_R_LINEAR_____122_CM 1 0. 0. 4095.9375 DISPLAY_IDENTIFIER Q_INJ_BURST_EXP__7_ ECU_ADDRESS 0x7fac94 BYTE_ORDER MSB_LAST FORMAT "%6.2" /end MEASUREMENT
/begin MEASUREMENT q_inj_burst_exp_[8] "charge burst signal (expanded)" UWORD _CNV_A_R_LINEAR_____122_CM 1 0. 0. 4095.9375 DISPLAY_IDENTIFIER Q_INJ_BURST_EXP__8_ ECU_ADDRESS 0x7fac96 BYTE_ORDER MSB_LAST FORMAT "%6.2" /end MEASUREMENT
/begin MEASUREMENT q_inj_burst_exp_[9] "charge burst signal (expanded)" UWORD _CNV_A_R_LINEAR_____122_CM 1 0. 0. 4095.9375 DISPLAY_IDENTIFIER Q_INJ_BURST_EXP__9_ ECU_ADDRESS 0x7fac98 BYTE_ORDER MSB_LAST FORMAT "%6.2" /end MEASUREMENT
/begin MEASUREMENT q_inj_burst_exp_[10] "charge burst signal (expanded)" UWORD _CNV_A_R_LINEAR_____122_CM 1 0. 0. 4095.9375 DISPLAY_IDENTIFIER Q_INJ_BURST_EXP__10_ ECU_ADDRESS 0x7fac9a BYTE_ORDER MSB_LAST FORMAT "%6.2" /end MEASUREMENT
/begin MEASUREMENT q_inj_burst_exp_[11] "charge burst signal (expanded)" UWORD _CNV_A_R_LINEAR_____122_CM 1 0. 0. 4095.9375 DISPLAY_IDENTIFIER Q_INJ_BURST_EXP__11_ ECU_ADDRESS 0x7fac9c BYTE_ORDER MSB_LAST FORMAT "%6.2" /end MEASUREMENT
/begin MEASUREMENT q_inj_burst_exp_[12] "charge burst signal (expanded)" UWORD _CNV_A_R_LINEAR_____122_CM 1 0. 0. 4095.9375 DISPLAY_IDENTIFIER Q_INJ_BURST_EXP__12_ ECU_ADDRESS 0x7fac9e BYTE_ORDER MSB_LAST FORMAT "%6.2" /end MEASUREMENT
/begin MEASUREMENT q_inj_burst_exp_[13] "charge burst signal (expanded)" UWORD _CNV_A_R_LINEAR_____122_CM 1 0. 0. 4095.9375 DISPLAY_IDENTIFIER Q_INJ_BURST_EXP__13_ ECU_ADDRESS 0x7faca0 BYTE_ORDER MSB_LAST FORMAT "%6.2" /end MEASUREMENT
/begin MEASUREMENT q_inj_burst_exp_[14] "charge burst signal (expanded)" UWORD _CNV_A_R_LINEAR_____122_CM 1 0. 0. 4095.9375 DISPLAY_IDENTIFIER Q_INJ_BURST_EXP__14_ ECU_ADDRESS 0x7faca2 BYTE_ORDER MSB_LAST FORMAT "%6.2" /end MEASUREMENT
/begin MEASUREMENT q_inj_burst_exp_[15] "charge burst signal (expanded)" UWORD _CNV_A_R_LINEAR_____122_CM 1 0. 0. 4095.9375 DISPLAY_IDENTIFIER Q_INJ_BURST_EXP__15_ ECU_ADDRESS 0x7faca4 BYTE_ORDER MSB_LAST FORMAT "%6.2" /end MEASUREMENT
/begin MEASUREMENT q_inj_burst_exp_[16] "charge burst signal (expanded)" UWORD _CNV_A_R_LINEAR_____122_CM 1 0. 0. 4095.9375 DISPLAY_IDENTIFIER Q_INJ_BURST_EXP__16_ ECU_ADDRESS 0x7faca6 BYTE_ORDER MSB_LAST FORMAT "%6.2" /end MEASUREMENT
/begin MEASUREMENT q_inj_burst_exp_[17] "charge burst signal (expanded)" UWORD _CNV_A_R_LINEAR_____122_CM 1 0. 0. 4095.9375 DISPLAY_IDENTIFIER Q_INJ_BURST_EXP__17_ ECU_ADDRESS 0x7faca8 BYTE_ORDER MSB_LAST FORMAT "%6.2" /end MEASUREMENT
/begin MEASUREMENT q_inj_burst_exp_[18] "charge burst signal (expanded)" UWORD _CNV_A_R_LINEAR_____122_CM 1 0. 0. 4095.9375 DISPLAY_IDENTIFIER Q_INJ_BURST_EXP__18_ ECU_ADDRESS 0x7facaa BYTE_ORDER MSB_LAST FORMAT "%6.2" /end MEASUREMENT
/begin MEASUREMENT q_inj_burst_exp_[19] "charge burst signal (expanded)" UWORD _CNV_A_R_LINEAR_____122_CM 1 0. 0. 4095.9375 DISPLAY_IDENTIFIER Q_INJ_BURST_EXP__19_ ECU_ADDRESS 0x7facac BYTE_ORDER MSB_LAST FORMAT "%6.2" /end MEASUREMENT
/begin MEASUREMENT q_inj_burst_exp_[20] "charge burst signal (expanded)" UWORD _CNV_A_R_LINEAR_____122_CM 1 0. 0. 4095.9375 DISPLAY_IDENTIFIER Q_INJ_BURST_EXP__20_ ECU_ADDRESS 0x7facae BYTE_ORDER MSB_LAST FORMAT "%6.2" /end MEASUREMENT
/begin MEASUREMENT q_inj_burst_exp_[21] "charge burst signal (expanded)" UWORD _CNV_A_R_LINEAR_____122_CM 1 0. 0. 4095.9375 DISPLAY_IDENTIFIER Q_INJ_BURST_EXP__21_ ECU_ADDRESS 0x7facb0 BYTE_ORDER MSB_LAST FORMAT "%6.2" /end MEASUREMENT
/begin MEASUREMENT q_inj_burst_exp_[22] "charge burst signal (expanded)" UWORD _CNV_A_R_LINEAR_____122_CM 1 0. 0. 4095.9375 DISPLAY_IDENTIFIER Q_INJ_BURST_EXP__22_ ECU_ADDRESS 0x7facb2 BYTE_ORDER MSB_LAST FORMAT "%6.2" /end MEASUREMENT
/begin MEASUREMENT q_inj_burst_exp_[23] "charge burst signal (expanded)" UWORD _CNV_A_R_LINEAR_____122_CM 1 0. 0. 4095.9375 DISPLAY_IDENTIFIER Q_INJ_BURST_EXP__23_ ECU_ADDRESS 0x7facb4 BYTE_ORDER MSB_LAST FORMAT "%6.2" /end MEASUREMENT
/begin MEASUREMENT q_inj_burst_exp_[24] "charge burst signal (expanded)" UWORD _CNV_A_R_LINEAR_____122_CM 1 0. 0. 4095.9375 DISPLAY_IDENTIFIER Q_INJ_BURST_EXP__24_ ECU_ADDRESS 0x7facb6 BYTE_ORDER MSB_LAST FORMAT "%6.2" /end MEASUREMENT
/begin MEASUREMENT q_inj_burst_exp_[25] "charge burst signal (expanded)" UWORD _CNV_A_R_LINEAR_____122_CM 1 0. 0. 4095.9375 DISPLAY_IDENTIFIER Q_INJ_BURST_EXP__25_ ECU_ADDRESS 0x7facb8 BYTE_ORDER MSB_LAST FORMAT "%6.2" /end MEASUREMENT
/begin MEASUREMENT q_inj_burst_exp_[26] "charge burst signal (expanded)" UWORD _CNV_A_R_LINEAR_____122_CM 1 0. 0. 4095.9375 DISPLAY_IDENTIFIER Q_INJ_BURST_EXP__26_ ECU_ADDRESS 0x7facba BYTE_ORDER MSB_LAST FORMAT "%6.2" /end MEASUREMENT
/begin MEASUREMENT q_inj_burst_exp_[27] "charge burst signal (expanded)" UWORD _CNV_A_R_LINEAR_____122_CM 1 0. 0. 4095.9375 DISPLAY_IDENTIFIER Q_INJ_BURST_EXP__27_ ECU_ADDRESS 0x7facbc BYTE_ORDER MSB_LAST FORMAT "%6.2" /end MEASUREMENT
/begin MEASUREMENT q_inj_burst_exp_[28] "charge burst signal (expanded)" UWORD _CNV_A_R_LINEAR_____122_CM 1 0. 0. 4095.9375 DISPLAY_IDENTIFIER Q_INJ_BURST_EXP__28_ ECU_ADDRESS 0x7facbe BYTE_ORDER MSB_LAST FORMAT "%6.2" /end MEASUREMENT
/begin MEASUREMENT q_inj_burst_exp_[29] "charge burst signal (expanded)" UWORD _CNV_A_R_LINEAR_____122_CM 1 0. 0. 4095.9375 DISPLAY_IDENTIFIER Q_INJ_BURST_EXP__29_ ECU_ADDRESS 0x7facc0 BYTE_ORDER MSB_LAST FORMAT "%6.2" /end MEASUREMENT
/begin MEASUREMENT q_inj_burst_exp_[30] "charge burst signal (expanded)" UWORD _CNV_A_R_LINEAR_____122_CM 1 0. 0. 4095.9375 DISPLAY_IDENTIFIER Q_INJ_BURST_EXP__30_ ECU_ADDRESS 0x7facc2 BYTE_ORDER MSB_LAST FORMAT "%6.2" /end MEASUREMENT
/begin MEASUREMENT q_inj_burst_exp_[31] "charge burst signal (expanded)" UWORD _CNV_A_R_LINEAR_____122_CM 1 0. 0. 4095.9375 DISPLAY_IDENTIFIER Q_INJ_BURST_EXP__31_ ECU_ADDRESS 0x7facc4 BYTE_ORDER MSB_LAST FORMAT "%6.2" /end MEASUREMENT
/begin MEASUREMENT q_inj_burst_exp_[32] "charge burst signal (expanded)" UWORD _CNV_A_R_LINEAR_____122_CM 1 0. 0. 4095.9375 DISPLAY_IDENTIFIER Q_INJ_BURST_EXP__32_ ECU_ADDRESS 0x7facc6 BYTE_ORDER MSB_LAST FORMAT "%6.2" /end MEASUREMENT
/begin MEASUREMENT q_inj_burst_exp_[33] "charge burst signal (expanded)" UWORD _CNV_A_R_LINEAR_____122_CM 1 0. 0. 4095.9375 DISPLAY_IDENTIFIER Q_INJ_BURST_EXP__33_ ECU_ADDRESS 0x7facc8 BYTE_ORDER MSB_LAST FORMAT "%6.2" /end MEASUREMENT
/begin MEASUREMENT q_inj_burst_exp_[34] "charge burst signal (expanded)" UWORD _CNV_A_R_LINEAR_____122_CM 1 0. 0. 4095.9375 DISPLAY_IDENTIFIER Q_INJ_BURST_EXP__34_ ECU_ADDRESS 0x7facca BYTE_ORDER MSB_LAST FORMAT "%6.2" /end MEASUREMENT
/begin MEASUREMENT q_inj_burst_exp_[35] "charge burst signal (expanded)" UWORD _CNV_A_R_LINEAR_____122_CM 1 0. 0. 4095.9375 DISPLAY_IDENTIFIER Q_INJ_BURST_EXP__35_ ECU_ADDRESS 0x7faccc BYTE_ORDER MSB_LAST FORMAT "%6.2" /end MEASUREMENT
/begin MEASUREMENT q_inj_burst_exp_[36] "charge burst signal (expanded)" UWORD _CNV_A_R_LINEAR_____122_CM 1 0. 0. 4095.9375 DISPLAY_IDENTIFIER Q_INJ_BURST_EXP__36_ ECU_ADDRESS 0x7facce BYTE_ORDER MSB_LAST FORMAT "%6.2" /end MEASUREMENT
/begin MEASUREMENT q_inj_burst_exp_[37] "charge burst signal (expanded)" UWORD _CNV_A_R_LINEAR_____122_CM 1 0. 0. 4095.9375 DISPLAY_IDENTIFIER Q_INJ_BURST_EXP__37_ ECU_ADDRESS 0x7facd0 BYTE_ORDER MSB_LAST FORMAT "%6.2" /end MEASUREMENT
/begin MEASUREMENT q_inj_burst_exp_[38] "charge burst signal (expanded)" UWORD _CNV_A_R_LINEAR_____122_CM 1 0. 0. 4095.9375 DISPLAY_IDENTIFIER Q_INJ_BURST_EXP__38_ ECU_ADDRESS 0x7facd2 BYTE_ORDER MSB_LAST FORMAT "%6.2" /end MEASUREMENT
/begin MEASUREMENT q_inj_burst_exp_[39] "charge burst signal (expanded)" UWORD _CNV_A_R_LINEAR_____122_CM 1 0. 0. 4095.9375 DISPLAY_IDENTIFIER Q_INJ_BURST_EXP__39_ ECU_ADDRESS 0x7facd4 BYTE_ORDER MSB_LAST FORMAT "%6.2" /end MEASUREMENT
/begin MEASUREMENT q_inj_burst_exp_[40] "charge burst signal (expanded)" UWORD _CNV_A_R_LINEAR_____122_CM 1 0. 0. 4095.9375 DISPLAY_IDENTIFIER Q_INJ_BURST_EXP__40_ ECU_ADDRESS 0x7facd6 BYTE_ORDER MSB_LAST FORMAT "%6.2" /end MEASUREMENT
/begin MEASUREMENT q_inj_burst_exp_[41] "charge burst signal (expanded)" UWORD _CNV_A_R_LINEAR_____122_CM 1 0. 0. 4095.9375 DISPLAY_IDENTIFIER Q_INJ_BURST_EXP__41_ ECU_ADDRESS 0x7facd8 BYTE_ORDER MSB_LAST FORMAT "%6.2" /end MEASUREMENT
/begin MEASUREMENT q_inj_burst_exp_[42] "charge burst signal (expanded)" UWORD _CNV_A_R_LINEAR_____122_CM 1 0. 0. 4095.9375 DISPLAY_IDENTIFIER Q_INJ_BURST_EXP__42_ ECU_ADDRESS 0x7facda BYTE_ORDER MSB_LAST FORMAT "%6.2" /end MEASUREMENT
/begin MEASUREMENT q_inj_burst_exp_[43] "charge burst signal (expanded)" UWORD _CNV_A_R_LINEAR_____122_CM 1 0. 0. 4095.9375 DISPLAY_IDENTIFIER Q_INJ_BURST_EXP__43_ ECU_ADDRESS 0x7facdc BYTE_ORDER MSB_LAST FORMAT "%6.2" /end MEASUREMENT
/begin MEASUREMENT q_inj_burst_exp_[44] "charge burst signal (expanded)" UWORD _CNV_A_R_LINEAR_____122_CM 1 0. 0. 4095.9375 DISPLAY_IDENTIFIER Q_INJ_BURST_EXP__44_ ECU_ADDRESS 0x7facde BYTE_ORDER MSB_LAST FORMAT "%6.2" /end MEASUREMENT
/begin MEASUREMENT q_inj_burst_exp_[45] "charge burst signal (expanded)" UWORD _CNV_A_R_LINEAR_____122_CM 1 0. 0. 4095.9375 DISPLAY_IDENTIFIER Q_INJ_BURST_EXP__45_ ECU_ADDRESS 0x7face0 BYTE_ORDER MSB_LAST FORMAT "%6.2" /end MEASUREMENT
/begin MEASUREMENT q_inj_burst_exp_[46] "charge burst signal (expanded)" UWORD _CNV_A_R_LINEAR_____122_CM 1 0. 0. 4095.9375 DISPLAY_IDENTIFIER Q_INJ_BURST_EXP__46_ ECU_ADDRESS 0x7face2 BYTE_ORDER MSB_LAST FORMAT "%6.2" /end MEASUREMENT
/begin MEASUREMENT q_inj_burst_exp_[47] "charge burst signal (expanded)" UWORD _CNV_A_R_LINEAR_____122_CM 1 0. 0. 4095.9375 DISPLAY_IDENTIFIER Q_INJ_BURST_EXP__47_ ECU_ADDRESS 0x7face4 BYTE_ORDER MSB_LAST FORMAT "%6.2" /end MEASUREMENT
/begin MEASUREMENT q_inj_burst_intp_[0] "charge burst signal (interpolated)" UWORD _CNV_A_R_LINEAR_____122_CM 1 0. 0. 4095.9375 DISPLAY_IDENTIFIER Q_INJ_BURST_INTP__0_ ECU_ADDRESS 0x7fad36 BYTE_ORDER MSB_LAST FORMAT "%6.2" /end MEASUREMENT
/begin MEASUREMENT q_inj_burst_intp_[1] "charge burst signal (interpolated)" UWORD _CNV_A_R_LINEAR_____122_CM 1 0. 0. 4095.9375 DISPLAY_IDENTIFIER Q_INJ_BURST_INTP__1_ ECU_ADDRESS 0x7fad38 BYTE_ORDER MSB_LAST FORMAT "%6.2" /end MEASUREMENT
/begin MEASUREMENT q_inj_burst_intp_[2] "charge burst signal (interpolated)" UWORD _CNV_A_R_LINEAR_____122_CM 1 0. 0. 4095.9375 DISPLAY_IDENTIFIER Q_INJ_BURST_INTP__2_ ECU_ADDRESS 0x7fad3a BYTE_ORDER MSB_LAST FORMAT "%6.2" /end MEASUREMENT
/begin MEASUREMENT q_inj_burst_intp_[3] "charge burst signal (interpolated)" UWORD _CNV_A_R_LINEAR_____122_CM 1 0. 0. 4095.9375 DISPLAY_IDENTIFIER Q_INJ_BURST_INTP__3_ ECU_ADDRESS 0x7fad3c BYTE_ORDER MSB_LAST FORMAT "%6.2" /end MEASUREMENT
/begin MEASUREMENT q_inj_burst_intp_[4] "charge burst signal (interpolated)" UWORD _CNV_A_R_LINEAR_____122_CM 1 0. 0. 4095.9375 DISPLAY_IDENTIFIER Q_INJ_BURST_INTP__4_ ECU_ADDRESS 0x7fad3e BYTE_ORDER MSB_LAST FORMAT "%6.2" /end MEASUREMENT
/begin MEASUREMENT q_inj_burst_intp_[5] "charge burst signal (interpolated)" UWORD _CNV_A_R_LINEAR_____122_CM 1 0. 0. 4095.9375 DISPLAY_IDENTIFIER Q_INJ_BURST_INTP__5_ ECU_ADDRESS 0x7fad40 BYTE_ORDER MSB_LAST FORMAT "%6.2" /end MEASUREMENT
/begin MEASUREMENT q_inj_burst_intp_[6] "charge burst signal (interpolated)" UWORD _CNV_A_R_LINEAR_____122_CM 1 0. 0. 4095.9375 DISPLAY_IDENTIFIER Q_INJ_BURST_INTP__6_ ECU_ADDRESS 0x7fad42 BYTE_ORDER MSB_LAST FORMAT "%6.2" /end MEASUREMENT
/begin MEASUREMENT q_inj_burst_intp_[7] "charge burst signal (interpolated)" UWORD _CNV_A_R_LINEAR_____122_CM 1 0. 0. 4095.9375 DISPLAY_IDENTIFIER Q_INJ_BURST_INTP__7_ ECU_ADDRESS 0x7fad44 BYTE_ORDER MSB_LAST FORMAT "%6.2" /end MEASUREMENT
/begin MEASUREMENT q_inj_burst_intp_[8] "charge burst signal (interpolated)" UWORD _CNV_A_R_LINEAR_____122_CM 1 0. 0. 4095.9375 DISPLAY_IDENTIFIER Q_INJ_BURST_INTP__8_ ECU_ADDRESS 0x7fad46 BYTE_ORDER MSB_LAST FORMAT "%6.2" /end MEASUREMENT
/begin MEASUREMENT q_inj_burst_intp_[9] "charge burst signal (interpolated)" UWORD _CNV_A_R_LINEAR_____122_CM 1 0. 0. 4095.9375 DISPLAY_IDENTIFIER Q_INJ_BURST_INTP__9_ ECU_ADDRESS 0x7fad48 BYTE_ORDER MSB_LAST FORMAT "%6.2" /end MEASUREMENT
/begin MEASUREMENT q_inj_burst_intp_[10] "charge burst signal (interpolated)" UWORD _CNV_A_R_LINEAR_____122_CM 1 0. 0. 4095.9375 DISPLAY_IDENTIFIER Q_INJ_BURST_INTP__10_ ECU_ADDRESS 0x7fad4a BYTE_ORDER MSB_LAST FORMAT "%6.2" /end MEASUREMENT
/begin MEASUREMENT q_inj_burst_intp_[11] "charge burst signal (interpolated)" UWORD _CNV_A_R_LINEAR_____122_CM 1 0. 0. 4095.9375 DISPLAY_IDENTIFIER Q_INJ_BURST_INTP__11_ ECU_ADDRESS 0x7fad4c BYTE_ORDER MSB_LAST FORMAT "%6.2" /end MEASUREMENT
/begin MEASUREMENT q_inj_burst_intp_[12] "charge burst signal (interpolated)" UWORD _CNV_A_R_LINEAR_____122_CM 1 0. 0. 4095.9375 DISPLAY_IDENTIFIER Q_INJ_BURST_INTP__12_ ECU_ADDRESS 0x7fad4e BYTE_ORDER MSB_LAST FORMAT "%6.2" /end MEASUREMENT
/begin MEASUREMENT q_inj_burst_intp_[13] "charge burst signal (interpolated)" UWORD _CNV_A_R_LINEAR_____122_CM 1 0. 0. 4095.9375 DISPLAY_IDENTIFIER Q_INJ_BURST_INTP__13_ ECU_ADDRESS 0x7fad50 BYTE_ORDER MSB_LAST FORMAT "%6.2" /end MEASUREMENT
/begin MEASUREMENT q_inj_burst_intp_[14] "charge burst signal (interpolated)" UWORD _CNV_A_R_LINEAR_____122_CM 1 0. 0. 4095.9375 DISPLAY_IDENTIFIER Q_INJ_BURST_INTP__14_ ECU_ADDRESS 0x7fad52 BYTE_ORDER MSB_LAST FORMAT "%6.2" /end MEASUREMENT
/begin MEASUREMENT q_inj_burst_intp_[15] "charge burst signal (interpolated)" UWORD _CNV_A_R_LINEAR_____122_CM 1 0. 0. 4095.9375 DISPLAY_IDENTIFIER Q_INJ_BURST_INTP__15_ ECU_ADDRESS 0x7fad54 BYTE_ORDER MSB_LAST FORMAT "%6.2" /end MEASUREMENT
/begin MEASUREMENT q_inj_burst_intp_[16] "charge burst signal (interpolated)" UWORD _CNV_A_R_LINEAR_____122_CM 1 0. 0. 4095.9375 DISPLAY_IDENTIFIER Q_INJ_BURST_INTP__16_ ECU_ADDRESS 0x7fad56 BYTE_ORDER MSB_LAST FORMAT "%6.2" /end MEASUREMENT
/begin MEASUREMENT q_inj_burst_intp_[17] "charge burst signal (interpolated)" UWORD _CNV_A_R_LINEAR_____122_CM 1 0. 0. 4095.9375 DISPLAY_IDENTIFIER Q_INJ_BURST_INTP__17_ ECU_ADDRESS 0x7fad58 BYTE_ORDER MSB_LAST FORMAT "%6.2" /end MEASUREMENT
/begin MEASUREMENT q_inj_burst_intp_[18] "charge burst signal (interpolated)" UWORD _CNV_A_R_LINEAR_____122_CM 1 0. 0. 4095.9375 DISPLAY_IDENTIFIER Q_INJ_BURST_INTP__18_ ECU_ADDRESS 0x7fad5a BYTE_ORDER MSB_LAST FORMAT "%6.2" /end MEASUREMENT
/begin MEASUREMENT q_inj_burst_intp_[19] "charge burst signal (interpolated)" UWORD _CNV_A_R_LINEAR_____122_CM 1 0. 0. 4095.9375 DISPLAY_IDENTIFIER Q_INJ_BURST_INTP__19_ ECU_ADDRESS 0x7fad5c BYTE_ORDER MSB_LAST FORMAT "%6.2" /end MEASUREMENT
/begin MEASUREMENT q_inj_burst_intp_[20] "charge burst signal (interpolated)" UWORD _CNV_A_R_LINEAR_____122_CM 1 0. 0. 4095.9375 DISPLAY_IDENTIFIER Q_INJ_BURST_INTP__20_ ECU_ADDRESS 0x7fad5e BYTE_ORDER MSB_LAST FORMAT "%6.2" /end MEASUREMENT
/begin MEASUREMENT q_inj_burst_intp_[21] "charge burst signal (interpolated)" UWORD _CNV_A_R_LINEAR_____122_CM 1 0. 0. 4095.9375 DISPLAY_IDENTIFIER Q_INJ_BURST_INTP__21_ ECU_ADDRESS 0x7fad60 BYTE_ORDER MSB_LAST FORMAT "%6.2" /end MEASUREMENT
/begin MEASUREMENT q_inj_burst_intp_[22] "charge burst signal (interpolated)" UWORD _CNV_A_R_LINEAR_____122_CM 1 0. 0. 4095.9375 DISPLAY_IDENTIFIER Q_INJ_BURST_INTP__22_ ECU_ADDRESS 0x7fad62 BYTE_ORDER MSB_LAST FORMAT "%6.2" /end MEASUREMENT
/begin MEASUREMENT q_inj_burst_intp_[23] "charge burst signal (interpolated)" UWORD _CNV_A_R_LINEAR_____122_CM 1 0. 0. 4095.9375 DISPLAY_IDENTIFIER Q_INJ_BURST_INTP__23_ ECU_ADDRESS 0x7fad64 BYTE_ORDER MSB_LAST FORMAT "%6.2" /end MEASUREMENT
/begin MEASUREMENT q_inj_burst_intp_[24] "charge burst signal (interpolated)" UWORD _CNV_A_R_LINEAR_____122_CM 1 0. 0. 4095.9375 DISPLAY_IDENTIFIER Q_INJ_BURST_INTP__24_ ECU_ADDRESS 0x7fad66 BYTE_ORDER MSB_LAST FORMAT "%6.2" /end MEASUREMENT
/begin MEASUREMENT q_inj_burst_intp_[25] "charge burst signal (interpolated)" UWORD _CNV_A_R_LINEAR_____122_CM 1 0. 0. 4095.9375 DISPLAY_IDENTIFIER Q_INJ_BURST_INTP__25_ ECU_ADDRESS 0x7fad68 BYTE_ORDER MSB_LAST FORMAT "%6.2" /end MEASUREMENT
/begin MEASUREMENT q_inj_burst_intp_[26] "charge burst signal (interpolated)" UWORD _CNV_A_R_LINEAR_____122_CM 1 0. 0. 4095.9375 DISPLAY_IDENTIFIER Q_INJ_BURST_INTP__26_ ECU_ADDRESS 0x7fad6a BYTE_ORDER MSB_LAST FORMAT "%6.2" /end MEASUREMENT
/begin MEASUREMENT q_inj_burst_intp_[27] "charge burst signal (interpolated)" UWORD _CNV_A_R_LINEAR_____122_CM 1 0. 0. 4095.9375 DISPLAY_IDENTIFIER Q_INJ_BURST_INTP__27_ ECU_ADDRESS 0x7fad6c BYTE_ORDER MSB_LAST FORMAT "%6.2" /end MEASUREMENT
/begin MEASUREMENT q_inj_burst_intp_[28] "charge burst signal (interpolated)" UWORD _CNV_A_R_LINEAR_____122_CM 1 0. 0. 4095.9375 DISPLAY_IDENTIFIER Q_INJ_BURST_INTP__28_ ECU_ADDRESS 0x7fad6e BYTE_ORDER MSB_LAST FORMAT "%6.2" /end MEASUREMENT
/begin MEASUREMENT q_inj_burst_intp_[29] "charge burst signal (interpolated)" UWORD _CNV_A_R_LINEAR_____122_CM 1 0. 0. 4095.9375 DISPLAY_IDENTIFIER Q_INJ_BURST_INTP__29_ ECU_ADDRESS 0x7fad70 BYTE_ORDER MSB_LAST FORMAT "%6.2" /end MEASUREMENT
/begin MEASUREMENT q_inj_burst_intp_[30] "charge burst signal (interpolated)" UWORD _CNV_A_R_LINEAR_____122_CM 1 0. 0. 4095.9375 DISPLAY_IDENTIFIER Q_INJ_BURST_INTP__30_ ECU_ADDRESS 0x7fad72 BYTE_ORDER MSB_LAST FORMAT "%6.2" /end MEASUREMENT
/begin MEASUREMENT q_inj_burst_intp_[31] "charge burst signal (interpolated)" UWORD _CNV_A_R_LINEAR_____122_CM 1 0. 0. 4095.9375 DISPLAY_IDENTIFIER Q_INJ_BURST_INTP__31_ ECU_ADDRESS 0x7fad74 BYTE_ORDER MSB_LAST FORMAT "%6.2" /end MEASUREMENT
/begin MEASUREMENT q_inj_burst_intp_[32] "charge burst signal (interpolated)" UWORD _CNV_A_R_LINEAR_____122_CM 1 0. 0. 4095.9375 DISPLAY_IDENTIFIER Q_INJ_BURST_INTP__32_ ECU_ADDRESS 0x7fad76 BYTE_ORDER MSB_LAST FORMAT "%6.2" /end MEASUREMENT
/begin MEASUREMENT q_inj_burst_intp_[33] "charge burst signal (interpolated)" UWORD _CNV_A_R_LINEAR_____122_CM 1 0. 0. 4095.9375 DISPLAY_IDENTIFIER Q_INJ_BURST_INTP__33_ ECU_ADDRESS 0x7fad78 BYTE_ORDER MSB_LAST FORMAT "%6.2" /end MEASUREMENT
/begin MEASUREMENT q_inj_burst_intp_[34] "charge burst signal (interpolated)" UWORD _CNV_A_R_LINEAR_____122_CM 1 0. 0. 4095.9375 DISPLAY_IDENTIFIER Q_INJ_BURST_INTP__34_ ECU_ADDRESS 0x7fad7a BYTE_ORDER MSB_LAST FORMAT "%6.2" /end MEASUREMENT
/begin MEASUREMENT q_inj_burst_intp_[35] "charge burst signal (interpolated)" UWORD _CNV_A_R_LINEAR_____122_CM 1 0. 0. 4095.9375 DISPLAY_IDENTIFIER Q_INJ_BURST_INTP__35_ ECU_ADDRESS 0x7fad7c BYTE_ORDER MSB_LAST FORMAT "%6.2" /end MEASUREMENT
/begin MEASUREMENT q_inj_burst_intp_[36] "charge burst signal (interpolated)" UWORD _CNV_A_R_LINEAR_____122_CM 1 0. 0. 4095.9375 DISPLAY_IDENTIFIER Q_INJ_BURST_INTP__36_ ECU_ADDRESS 0x7fad7e BYTE_ORDER MSB_LAST FORMAT "%6.2" /end MEASUREMENT
/begin MEASUREMENT q_inj_burst_intp_[37] "charge burst signal (interpolated)" UWORD _CNV_A_R_LINEAR_____122_CM 1 0. 0. 4095.9375 DISPLAY_IDENTIFIER Q_INJ_BURST_INTP__37_ ECU_ADDRESS 0x7fad80 BYTE_ORDER MSB_LAST FORMAT "%6.2" /end MEASUREMENT
/begin MEASUREMENT q_inj_burst_intp_[38] "charge burst signal (interpolated)" UWORD _CNV_A_R_LINEAR_____122_CM 1 0. 0. 4095.9375 DISPLAY_IDENTIFIER Q_INJ_BURST_INTP__38_ ECU_ADDRESS 0x7fad82 BYTE_ORDER MSB_LAST FORMAT "%6.2" /end MEASUREMENT
/begin MEASUREMENT q_inj_burst_intp_[39] "charge burst signal (interpolated)" UWORD _CNV_A_R_LINEAR_____122_CM 1 0. 0. 4095.9375 DISPLAY_IDENTIFIER Q_INJ_BURST_INTP__39_ ECU_ADDRESS 0x7fad84 BYTE_ORDER MSB_LAST FORMAT "%6.2" /end MEASUREMENT
/begin MEASUREMENT q_inj_burst_intp_[40] "charge burst signal (interpolated)" UWORD _CNV_A_R_LINEAR_____122_CM 1 0. 0. 4095.9375 DISPLAY_IDENTIFIER Q_INJ_BURST_INTP__40_ ECU_ADDRESS 0x7fad86 BYTE_ORDER MSB_LAST FORMAT "%6.2" /end MEASUREMENT
/begin MEASUREMENT q_inj_burst_intp_[41] "charge burst signal (interpolated)" UWORD _CNV_A_R_LINEAR_____122_CM 1 0. 0. 4095.9375 DISPLAY_IDENTIFIER Q_INJ_BURST_INTP__41_ ECU_ADDRESS 0x7fad88 BYTE_ORDER MSB_LAST FORMAT "%6.2" /end MEASUREMENT
/begin MEASUREMENT q_inj_burst_intp_[42] "charge burst signal (interpolated)" UWORD _CNV_A_R_LINEAR_____122_CM 1 0. 0. 4095.9375 DISPLAY_IDENTIFIER Q_INJ_BURST_INTP__42_ ECU_ADDRESS 0x7fad8a BYTE_ORDER MSB_LAST FORMAT "%6.2" /end MEASUREMENT
/begin MEASUREMENT q_inj_burst_intp_[43] "charge burst signal (interpolated)" UWORD _CNV_A_R_LINEAR_____122_CM 1 0. 0. 4095.9375 DISPLAY_IDENTIFIER Q_INJ_BURST_INTP__43_ ECU_ADDRESS 0x7fad8c BYTE_ORDER MSB_LAST FORMAT "%6.2" /end MEASUREMENT
/begin MEASUREMENT q_inj_burst_intp_[44] "charge burst signal (interpolated)" UWORD _CNV_A_R_LINEAR_____122_CM 1 0. 0. 4095.9375 DISPLAY_IDENTIFIER Q_INJ_BURST_INTP__44_ ECU_ADDRESS 0x7fad8e BYTE_ORDER MSB_LAST FORMAT "%6.2" /end MEASUREMENT
/begin MEASUREMENT q_inj_burst_intp_[45] "charge burst signal (interpolated)" UWORD _CNV_A_R_LINEAR_____122_CM 1 0. 0. 4095.9375 DISPLAY_IDENTIFIER Q_INJ_BURST_INTP__45_ ECU_ADDRESS 0x7fad90 BYTE_ORDER MSB_LAST FORMAT "%6.2" /end MEASUREMENT
/begin MEASUREMENT q_inj_burst_intp_[46] "charge burst signal (interpolated)" UWORD _CNV_A_R_LINEAR_____122_CM 1 0. 0. 4095.9375 DISPLAY_IDENTIFIER Q_INJ_BURST_INTP__46_ ECU_ADDRESS 0x7fad92 BYTE_ORDER MSB_LAST FORMAT "%6.2" /end MEASUREMENT
/begin MEASUREMENT q_inj_burst_intp_[47] "charge burst signal (interpolated)" UWORD _CNV_A_R_LINEAR_____122_CM 1 0. 0. 4095.9375 DISPLAY_IDENTIFIER Q_INJ_BURST_INTP__47_ ECU_ADDRESS 0x7fad94 BYTE_ORDER MSB_LAST FORMAT "%6.2" /end MEASUREMENT
/begin MEASUREMENT q_inj_det_[0] "injector charge at detection point (cylinder individual)" UWORD _CNV_A_R_LINEAR_____122_CM 1 0. 0. 4095.9375 DISPLAY_IDENTIFIER Q_INJ_DET__0_ ECU_ADDRESS 0x7fade6 BYTE_ORDER MSB_LAST FORMAT "%6.2" /end MEASUREMENT
/begin MEASUREMENT q_inj_det_[1] "injector charge at detection point (cylinder individual)" UWORD _CNV_A_R_LINEAR_____122_CM 1 0. 0. 4095.9375 DISPLAY_IDENTIFIER Q_INJ_DET__1_ ECU_ADDRESS 0x7fade8 BYTE_ORDER MSB_LAST FORMAT "%6.2" /end MEASUREMENT
/begin MEASUREMENT q_inj_det_[2] "injector charge at detection point (cylinder individual)" UWORD _CNV_A_R_LINEAR_____122_CM 1 0. 0. 4095.9375 DISPLAY_IDENTIFIER Q_INJ_DET__2_ ECU_ADDRESS 0x7fadea BYTE_ORDER MSB_LAST FORMAT "%6.2" /end MEASUREMENT
/begin MEASUREMENT q_inj_det_[3] "injector charge at detection point (cylinder individual)" UWORD _CNV_A_R_LINEAR_____122_CM 1 0. 0. 4095.9375 DISPLAY_IDENTIFIER Q_INJ_DET__3_ ECU_ADDRESS 0x7fadec BYTE_ORDER MSB_LAST FORMAT "%6.2" /end MEASUREMENT
/begin MEASUREMENT seg_nr_pui_acq "actual segment number of PECO data acquisition" UBYTE _CNV_A_R_LINEAR_____0_CM 1 0. 0. 15. DISPLAY_IDENTIFIER SEG_NR_PUI_ACQ ECU_ADDRESS 0x7fbf20 FORMAT "%2.0" /end MEASUREMENT
/begin MEASUREMENT v_inj_burst_act_max_[0] "injector voltage at last point (cylinder individual)" UWORD _CNV_A_R_LINEAR_____121_CM 1 0. 0. 255. DISPLAY_IDENTIFIER V_INJ_BURST_ACT_MAX__0_ ECU_ADDRESS 0x7fadee BYTE_ORDER MSB_LAST FORMAT "%4.1" /end MEASUREMENT
/begin MEASUREMENT sf_mes_egy_inj_vld "energy measurement active" UWORD _CNV_A_R_LINEAR_____0_CM 1 0. 0. 65535. DISPLAY_IDENTIFIER SF_MES_EGY_INJ_VLD ECU_ADDRESS 0x7f9f2c BYTE_ORDER MSB_LAST FORMAT "%5.0" /end MEASUREMENT
/begin MEASUREMENT egy_inj_seq1_[0] "energy of injection sequence 1 (cylinder individual)" UWORD _CNV_A_R_LINEAR_____541_CM 1 0. 0. 522.7750632 DISPLAY_IDENTIFIER EGY_INJ_SEQ1__0_ ECU_ADDRESS 0x7f9f2e BYTE_ORDER MSB_LAST /end MEASUREMENT
/begin MEASUREMENT egy_inj_seq1_[1] "energy of injection sequence 1 (cylinder individual)" UWORD _CNV_A_R_LINEAR_____541_CM 1 0. 0. 522.7750632 DISPLAY_IDENTIFIER EGY_INJ_SEQ1__1_ ECU_ADDRESS 0x7f9f30 BYTE_ORDER MSB_LAST /end MEASUREMENT
/begin MEASUREMENT egy_inj_seq1_[2] "energy of injection sequence 1 (cylinder individual)" UWORD _CNV_A_R_LINEAR_____541_CM 1 0. 0. 522.7750632 DISPLAY_IDENTIFIER EGY_INJ_SEQ1__2_ ECU_ADDRESS 0x7f9f32 BYTE_ORDER MSB_LAST /end MEASUREMENT
/begin MEASUREMENT egy_inj_seq1_[3] "energy of injection sequence 1 (cylinder individual)" UWORD _CNV_A_R_LINEAR_____541_CM 1 0. 0. 522.7750632 DISPLAY_IDENTIFIER EGY_INJ_SEQ1__3_ ECU_ADDRESS 0x7f9f34 BYTE_ORDER MSB_LAST /end MEASUREMENT
/begin MEASUREMENT seg_nr_egy_mes "actual segment number of energy measurement" UBYTE _CNV_A_R_LINEAR_____0_CM 1 0. 0. 15. DISPLAY_IDENTIFIER SEG_NR_EGY_MES ECU_ADDRESS 0x7fbf01 FORMAT "%2.0" /end MEASUREMENT
/begin COMPU_METHOD _CNV_A_R_LINEAR_____0_CM "" RAT_FUNC "%6.3" "[-]" COEFFS 0 1. 0. 0 0 1 /end COMPU_METHOD
/begin COMPU_METHOD _CNV_A_R_LINEAR_____1_CM "" RAT_FUNC "%6.3" "-" COEFFS 0 1. 0. 0 0 1 /end COMPU_METHOD
/begin COMPU_METHOD _CNV_A_R_LINEAR_____27_CM "" RAT_FUNC "%6.3" "s" COEFFS 0 1. 0. 0 0 1 /end COMPU_METHOD
/begin COMPU_METHOD _CNV_A_R_LINEAR_____81_CM "" RAT_FUNC "%6.3" "rpm" COEFFS 0 3.125e-002 0. 0 0 1 /end COMPU_METHOD
/begin COMPU_METHOD _CNV_S_2_RANGE__0___85_CM "" TAB_VERB "%6.3" "-" COMPU_TAB_REF _CNV_S_2_RANGE__0___85 /end COMPU_METHOD
/begin COMPU_VTAB _CNV_S_2_RANGE__0___85 "" TAB_VERB 2 0 "0" 1 "1" /end COMPU_VTAB
/begin COMPU_METHOD _CNV_A_R_LINEAR_____121_CM "" RAT_FUNC "%6.3" "[V]" COEFFS 0 4.011764705882353 0. 0 0 1 /end COMPU_METHOD
/begin COMPU_METHOD _CNV_A_R_LINEAR_____122_CM "" RAT_FUNC "%6.3" "[uAs]" COEFFS 0 16. 0. 0 0 1 /end COMPU_METHOD
/begin COMPU_METHOD _CNV_A_R_LINEAR_____137_CM "" RAT_FUNC "%6.3" "-" COEFFS 0 65535.99999999996 0. 0 0 1 /end COMPU_METHOD
/begin COMPU_METHOD _CNV_A_R_LINEAR_____154_CM "" RAT_FUNC "%6.3" "rpm" COEFFS 0 1. 0. 0 0 1 /end COMPU_METHOD
/begin COMPU_METHOD _CNV_A_R_LINEAR_____226_CM "" RAT_FUNC "%6.3" "s" COEFFS 0 100. 0. 0 0 1 /end COMPU_METHOD
/begin COMPU_METHOD _CNV_A_R_LINEAR_____240_CM "" RAT_FUNC "%6.3" "s" COEFFS 0 10. 0. 0 0 1 /end COMPU_METHOD
/begin COMPU_METHOD _CNV_A_R_LINEAR_____245_CM "" RAT_FUNC "%6.3" "km/h" COEFFS 0 1. 0. 0 0 1 /end COMPU_METHOD
/begin COMPU_METHOD _CNV_A_R_LINEAR_____246_CM "" RAT_FUNC "%6.3" "-" COEFFS 0 128. 0. 0 0 1 /end COMPU_METHOD
/begin COMPU_METHOD _CNV_A_R_LINEAR_____254_CM "" RAT_FUNC "%6.3" "-" COEFFS 0 256. 0. 0 0 1 /end COMPU_METHOD
/begin COMPU_METHOD _CNV_A_R_LINEAR_____257_CM "" RAT_FUNC "%6.3" "°C" COEFFS 0 1.333333333333333 64. 0 0 1 /end COMPU_METHOD
/begin COMPU_METHOD _CNV_A_R_LINEAR_____258_CM "" RAT_FUNC "%6.3" "%" COEFFS 0 655.3599999999997 0. 0 0 1 /end COMPU_METHOD
/begin COMPU_METHOD _CNV_A_R_LINEAR_____265_CM "" RAT_FUNC "%6.3" "V" COEFFS 0 204.8 0. 0 0 1 /end COMPU_METHOD
/begin COMPU_METHOD _CNV_A_R_LINEAR_____364_CM "" RAT_FUNC "%6.3" "[-]" COEFFS 0 257. 0. 0 0 1 /end COMPU_METHOD
/begin COMPU_METHOD _CNV_A_R_LINEAR_____371_CM "" RAT_FUNC "%6.3" "mg/stk" COEFFS 0 0.183585313174946 0. 0 0 1 /end COMPU_METHOD
/begin COMPU_METHOD _CNV_A_R_LINEAR_____437_CM "" RAT_FUNC "%6.3" "ms" COEFFS 0 5.e-002 0. 0 0 1 /end COMPU_METHOD
/begin COMPU_METHOD _CNV_A_R_LINEAR_____465_CM "" RAT_FUNC "%6.3" "-" COEFFS 0 1024. 0. 0 0 1 /end COMPU_METHOD
/begin COMPU_METHOD _CNV_A_R_EGCP_LINEA_468_CM "Battery voltage" RAT_FUNC "%6.3" "°C" COEFFS 0 16. 0. 0 0 1 /end COMPU_METHOD
/begin COMPU_METHOD _CNV_A_R_EGCP_LINEA_469_CM "Battery voltage" RAT_FUNC "%6.3" "°C" COEFFS 0 16. 32768. 0 0 1 /end COMPU_METHOD
/begin COMPU_METHOD _CNV_A_R_LINEAR_____476_CM "" RAT_FUNC "%6.3" "-" COEFFS 0 32767.99999999992 0. 0 0 1 /end COMPU_METHOD
/begin COMPU_METHOD _CNV_A_R_LINEAR_____479_CM "" RAT_FUNC "%6.3" "kg/h" COEFFS 0 32. 0. 0 0 1 /end COMPU_METHOD
/begin COMPU_METHOD _CNV_A_R_LINEAR_____482_CM "" RAT_FUNC "%6.3" "g" COEFFS 0 35.99993408114611 0. 0 0 1 /end COMPU_METHOD
/begin COMPU_METHOD _CNV_A_R_EGCP_LINEA_483_CM "Battery voltage" RAT_FUNC "%6.3" "-" COEFFS 0 1024.002615046581 0. 0 0 1 /end COMPU_METHOD
/begin COMPU_METHOD _CNV_A_R_LINEAR_____486_CM "" RAT_FUNC "%6.3" "%" COEFFS 0 2.56 0. 0 0 1 /end COMPU_METHOD
/begin COMPU_METHOD _CNV_A_R_LINEAR_____487_CM "" RAT_FUNC "%6.3" "Ohm" COEFFS 0 1. 0. 0 0 1 /end COMPU_METHOD
/begin COMPU_METHOD _CNV_A_R_EGCP_LINEA_488_CM "" RAT_FUNC "%6.3" "J/K" COEFFS 0 16. 0. 0 0 1 /end COMPU_METHOD
/begin COMPU_METHOD _CNV_A_R_LINEAR_____489_CM "" RAT_FUNC "%6.3" "J" COEFFS 0 1. 0. 0 0 1 /end COMPU_METHOD
/begin COMPU_METHOD _CNV_A_R_LINEAR_____490_CM "" RAT_FUNC "%6.3" "mg/stk" COEFFS 0 47.18142548596112 0. 0 0 1 /end COMPU_METHOD
/begin COMPU_METHOD _CNV_A_R_LINEAR_____506_CM "" RAT_FUNC "%6.3" "-" COEFFS 0 16384. 0. 0 0 1 /end COMPU_METHOD
/begin COMPU_METHOD _CNV_A_R_EGCP_LINEA_509_CM "" RAT_FUNC "%6.3" "V" COEFFS 0 819.2192192192192 0. 0 0 1 /end COMPU_METHOD
/begin COMPU_METHOD _CNV_A_R_EGCP_LINEA_510_CM "" RAT_FUNC "%6.3" "-" COEFFS 0 2730.666642666301 0. 0 0 1 /end COMPU_METHOD
/begin COMPU_METHOD _CNV_S_3_EGCP_RANGE_512_CM "" TAB_VERB "%6.3" "-" COMPU_TAB_REF _CNV_S_3_EGCP_RANGE_512 /end COMPU_METHOD
/begin COMPU_VTAB _CNV_S_3_EGCP_RANGE_512 "" TAB_VERB 3 0 "NO_SYM" 1 "SYM_0" 2 "SYM_1" /end COMPU_VTAB
/begin COMPU_METHOD _CNV_A_R_LINEAR_____515_CM "" RAT_FUNC "%6.3" "%" COEFFS 0 655.3599999999997 -1.455191522836685e-011 0 0 1 /end COMPU_METHOD
/begin COMPU_METHOD _CNV_A_R_EGCP_LINEA_516_CM "" RAT_FUNC "%6.3" "g" COEFFS 0 47.18142548596112 0. 0 0 1 /end COMPU_METHOD
/begin COMPU_METHOD _CNV_S_3_EGCP_RANGE_517_CM "" TAB_VERB "%6.3" "-" COMPU_TAB_REF _CNV_S_3_EGCP_RANGE_517 /end COMPU_METHOD
/begin COMPU_VTAB _CNV_S_3_EGCP_RANGE_517 "" TAB_VERB 3 0 "NO_SYM" 1 "AF too RICH" 2 "AF too LEAN" /end COMPU_VTAB
/begin COMPU_METHOD _CNV_S_4_EGCP_RANGE_518_CM "" TAB_VERB "%6.3" "-" COMPU_TAB_REF _CNV_S_4_EGCP_RANGE_518 /end COMPU_METHOD
/begin COMPU_VTAB _CNV_S_4_EGCP_RANGE_518 "" TAB_VERB 4 0 "NO_SYM" 1 "TTIP_ERR" 2 "READY_ERR" 4 "TTIP_MES_ERR" /end COMPU_VTAB
/begin COMPU_METHOD _CNV_A_R_EGCP_LINEA_519_CM "" RAT_FUNC "%6.3" "K" COEFFS 0 1. 0. 0 0 1 /end COMPU_METHOD
/begin COMPU_METHOD _CNV_S_9_EGCP_RANGE_520_CM "" TAB_VERB "%6.3" "-" COMPU_TAB_REF _CNV_S_9_EGCP_RANGE_520 /end COMPU_METHOD
/begin COMPU_VTAB _CNV_S_9_EGCP_RANGE_520 "" TAB_VERB 9 0 "DIAG_OFF" 1 "DIAG_INIT" 2 "LS_READY" 3 "OBD1_DLY" 4 "OBD1_CHK" 5 "TEG_THD" 6 "POW_INT" 7 "DIAG_ACT" 8 "DIAG_END" /end COMPU_VTAB
/begin COMPU_METHOD _CNV_A_R_LINEAR_____521_CM "" RAT_FUNC "%6.3" "V" COEFFS 0 204.7999999487896 -2.556795379859977e-007 0 0 1 /end COMPU_METHOD
/begin COMPU_METHOD _CNV_A_R_EGCP_LINEA_522_CM "" RAT_FUNC "%6.3" "-" COEFFS 0 1024.000007000107 2.240034154965542e-004 0 0 1 /end COMPU_METHOD
/begin COMPU_METHOD _CNV_S_4_EGCP_RANGE_523_CM "" TAB_VERB "%6.3" "-" COMPU_TAB_REF _CNV_S_4_EGCP_RANGE_523 /end COMPU_METHOD
/begin COMPU_VTAB _CNV_S_4_EGCP_RANGE_523 "" TAB_VERB 4 0 "PASSIVE" 1 "RICH CHECK" 2 "LEAN CHECK" 3 "CHECK FINISHED" /end COMPU_VTAB
/begin COMPU_METHOD _CNV_A_R_EGCP_LINEA_524_CM "" RAT_FUNC "%6.3" "-" COEFFS 0 1016.260162601626 0. 0 0 1 /end COMPU_METHOD
/begin COMPU_METHOD _CNV_S_4_EGCP_RANGE_525_CM "" TAB_VERB "%6.3" "-" COMPU_TAB_REF _CNV_S_4_EGCP_RANGE_525 /end COMPU_METHOD
/begin COMPU_VTAB _CNV_S_4_EGCP_RANGE_525 "" TAB_VERB 4 0 "NO_SYM" 1 "Sensor too lean" 2 "Sensor too rich" 4 "Sensor not active" /end COMPU_VTAB
/begin COMPU_METHOD _CNV_S_3_EGCP_RANGE_526_CM "" TAB_VERB "%6.3" "-" COMPU_TAB_REF _CNV_S_3_EGCP_RANGE_526 /end COMPU_METHOD
/begin COMPU_VTAB _CNV_S_3_EGCP_RANGE_526 "" TAB_VERB 3 0 "NO_SYM" 1 "SIGNAL TOO_LOW" 2 "SIGNAL TOO_HIGH" /end COMPU_VTAB
/begin COMPU_METHOD _CNV_S_2_EGCP_RANGE_527_CM "" TAB_VERB "%6.3" "-" COMPU_TAB_REF _CNV_S_2_EGCP_RANGE_527 /end COMPU_METHOD
/begin COMPU_VTAB _CNV_S_2_EGCP_RANGE_527 "" TAB_VERB 2 0 "NO_SYM" 1 "SYM_0" /end COMPU_VTAB
/begin COMPU_METHOD _CNV_S_4_EGCP_RANGE_528_CM "" TAB_VERB "%6.3" "-" COMPU_TAB_REF _CNV_S_4_EGCP_RANGE_528 /end COMPU_METHOD
/begin COMPU_VTAB _CNV_S_4_EGCP_RANGE_528 "" TAB_VERB 4 0 "PASSIVE" 1 "WAIT" 2 "ACQUISITION" 3 "END" /end COMPU_VTAB
/begin COMPU_METHOD _CNV_A_R_EGCP_LINEA_529_CM "" RAT_FUNC "%6.3" "s" COEFFS 0 1000. 0. 0 0 1 /end COMPU_METHOD
/begin COMPU_METHOD _CNV_A_R_LINEAR_____530_CM "" RAT_FUNC "%6.3" "°C" COEFFS 0 64. 2112. 0 0 1 /end COMPU_METHOD
/begin COMPU_METHOD _CNV_A_R_EGCP_LINEA_533_CM "" RAT_FUNC "%6.3" "°C" COEFFS 0 0.25 8.25 0 0 1 /end COMPU_METHOD
/begin COMPU_METHOD _CNV_A_R_LINEAR_____540_CM "" RAT_FUNC "%6.3" "[ms]" COEFFS 0 1000. 0. 0 0 1 /end COMPU_METHOD
/begin COMPU_METHOD _CNV_A_R_LINEAR_____541_CM "" RAT_FUNC "%6.3" "[mJ]" COEFFS 0 125.3598432925406 0. 0 0 1 /end COMPU_METHOD
/begin RECORD_LAYOUT _REC_VAL_20_u1 FNC_VALUES 1 UBYTE COLUMN_DIR DIRECT /end RECORD_LAYOUT
/begin RECORD_LAYOUT _REC_AXS_20_u2 NO_AXIS_PTS_X 1 UWORD AXIS_PTS_X 2 UWORD INDEX_INCR DIRECT /end RECORD_LAYOUT
/begin RECORD_LAYOUT _REC_VAL_20_u2 FNC_VALUES 1 UWORD COLUMN_DIR DIRECT /end RECORD_LAYOUT
/begin RECORD_LAYOUT _REC_VAL_20_s2 FNC_VALUES 1 SWORD COLUMN_DIR DIRECT /end RECORD_LAYOUT
/begin RECORD_LAYOUT _REC_AXS_20_u1 NO_AXIS_PTS_X 1 UBYTE AXIS_PTS_X 2 UBYTE INDEX_INCR DIRECT /end RECORD_LAYOUT
/begin RECORD_LAYOUT _REC_CUR_20_u2_u2 FNC_VALUES 1 UWORD COLUMN_DIR DIRECT /end RECORD_LAYOUT
/begin RECORD_LAYOUT _REC_CUR_20_u1_u2 FNC_VALUES 1 UBYTE COLUMN_DIR DIRECT /end RECORD_LAYOUT
/begin RECORD_LAYOUT _REC_CUR_20_u1_u1 FNC_VALUES 1 UBYTE COLUMN_DIR DIRECT /end RECORD_LAYOUT
/begin RECORD_LAYOUT _REC_MAP_20_u1_u1_u1 FNC_VALUES 1 UBYTE COLUMN_DIR DIRECT /end RECORD_LAYOUT
/begin FUNCTION EGCP_A_I_WRAF_sens_electric_DIAG "_A_I_WRAF_sens_electric_DIAG" /begin DEF_CHARACTERISTIC c_abc_inc_diag_el_lsl_up c_abc_max_diag_el_lsl_up /end DEF_CHARACTERISTIC
 /begin OUT_MEASUREMENT egcp[0].egcp_struct_sigdglslai0.lv_inh_diag_el_lsl_up egcp[0].egcp_struct_sigdglslai0.lv_inh_diag_oc_lsl_up egcp[0].egcp_struct_sigdglslai0.lv_iplsl_diag_inh_lsl_up /end OUT_MEASUREMENT
/end FUNCTION
/begin FUNCTION EGCP_A_I_WRAF_sens_ctl_DIAG "_A_I_WRAF_sens_controller_DIAG" /begin OUT_MEASUREMENT egcp[0].egcp_struct_pladgspii0.lv_inh_diag_lsl_up_if /end OUT_MEASUREMENT /end FUNCTION
/begin FUNCTION EGCP_A_I_upst_ls_heat_OBDI_DIAG "_A_I_upst_ls_heat_OBDI_DIAG" /begin DEF_CHARACTERISTIC c_abc_inc_diag_lsh_up c_abc_max_diag_lsh_up /end DEF_CHARACTERISTIC /begin OUT_MEASUREMENT egcp[0].egcp_struct_outdglshi0.lv_inh_diag_lsh_up /end OUT_MEASUREMENT /end FUNCTION
/begin FUNCTION EGCP_downst_ls_heat_OBDI_DIAG_AI "_downst_ls_heat_OBDI_DIAG_AI" /begin DEF_CHARACTERISTIC c_abc_inc_diag_lsh_down c_abc_max_diag_lsh_down /end DEF_CHARACTERISTIC /begin OUT_MEASUREMENT egcp[0].egcp_struct_outdglshdi0.lv_inh_diag_lsh_down /end OUT_MEASUREMENT /end FUNCTION
/begin FUNCTION EGCP_A_I_downst_ls_probe_DIAG "_A_I_downst_ls_probe_DIAG"
 /begin DEF_CHARACTERISTIC c_abc_max_scg_ls_down c_abc_inc_scg_ls_down c_abc_inc_oc_ls_down c_abc_max_oc_ls_down c_abc_max_scp_ls_down c_abc_inc_scp_ls_down c_abc_inc_puc_ls_down c_abc_inc_fl_ls_down c_abc_max_puc_ls_down c_abc_max_fl_ls_down /end DEF_CHARACTERISTIC
 /begin OUT_MEASUREMENT egcp[0].egcp_struct_sigdglsdi1.lv_inh_diag_oc_ls_down egcp[0].egcp_struct_sigdglsdi1.lv_inh_diag_puc_ls_down egcp[0].egcp_struct_sigdglsdi1.lv_inh_diag_fl_ls_down egcp[0].egcp_struct_sigdglsdi1.lv_inh_diag_scg_ls_down egcp[0].egcp_struct_sigdglsdi1.lv_inh_diag_scp_ls_down /end OUT_MEASUREMENT
/end FUNCTION
/begin FUNCTION C_B_EGCP "C_B_EGCP"
 /begin SUB_FUNCTION EGCP_Dynamic_fuel_trim_diag EGCP_Dynamic_fuel_trim_diag_inci EGCP_O2_sensor_up_heater_diag EGCP_O2_sensor_down_heater_diag EGCP_O2_sensor_down_heat_diag_ai EGCP_O2_sensor_downstream_diag EGCP_O2_sensor_inter_signal_diag EGCP_O2_sensor_diag_management EGCP_O2_sensor_swap_sig_diag_ai EGCP_O2_sensor_swap_sig_diag EGCP_O2_sensor_probe_diag_plaus EGCP_O2_sensor_temperature EGCP_O2_sensor_down_diag_inci EGCP_O2_sensor_up_heater_diag_ai EGCP_Linear_O2_sensor_diag EGCP_Linear_O2_sensor_diag_inci EGCP_O2_sensor_temperature_inci EGCP_O2_sensor_diag_manag_inci EGCP_O2_sensor_probe_diag_inci EGCP_Down_O2_sensor_resist_inci EGCP_Linear_O2_sensor_hea_diag EGCP_Linear_O2_sens_hea_diag_AI /end SUB_FUNCTION
/end FUNCTION
/begin FUNCTION EGCP_Dynamic_fuel_trim_diag "Dynamic_fuel_trim_diag"
 /begin DEF_CHARACTERISTIC c_lamb_delta_i_max_diag c_lamb_delta_i_min_diag c_t_sum_max_diag_lam_adj c_t_sum_min_diag_lam_adj c_t_end_diag_lam_adj c_vls_dif_max_diag c_vls_dif_min_diag c_t_rst_sum_diag_lam_adj c_t_vls_down_dif_end_diag c_t_vls_down_dif_rst_sum_diag c_maf_int_vls_dif_dly_min c_maf_int_vls_dif_dly_max c_n_ldc_vls_dif_dly c_maf_ldc_vls_dif_dly c_lam_mv_ldc_vls_dif_dly c_n_crlc_ldc_vls_dif_dly c_maf_crlc_ldc_vls_dif_dly c_lam_mv_crlc_ldc_vls_dif_dly c_maf_int_min_vls_dif_dly_ldc /end DEF_CHARACTERISTIC
 /begin OUT_MEASUREMENT egcp[0].egcp_struct_pladgft0.lamb_delta_i_save_diag egcp[0].egcp_struct_pladgft0.lam_mmv_vls_dif_dly_ldc egcp[0].egcp_struct_pladgft0.maf_int_vls_dif_dly_min egcp[0].egcp_struct_pladgft0.maf_int_vls_dif_dly_max egcp[0].egcp_struct_pladgft0.maf_int_vls_dif_dly_ldc egcp[0].egcp_struct_pladgft0.t_sum_max_diag_lam_adj egcp[0].egcp_struct_pladgft0.t_sum_min_diag_lam_adj egcp[0].egcp_struct_pladgft0.t_rst_sum_diag_lam_adj egcp[0].egcp_struct_pladgft0.t_vls_down_dif_end_diag egcp[0].egcp_struct_pladgft0.t_vls_down_dif_sum_rst_diag egcp[0].egcp_struct_pladgft0.t_end_diag_lam_adj egcp[0].egcp_struct_pladgft0.state_err_vls_down_dif egcp[0].egcp_struct_pladgft0.state_err_delta_i_lam_adj egcp[0].egcp_struct_pladgft0.lv_vls_down_dif_end_diag egcp[0].egcp_struct_pladgft0.lv_vls_down_dif_cdn_diag egcp[0].egcp_struct_pladgft0.lv_vls_down_dif_sym_diag egcp[0].egcp_struct_pladgft0.lv_delta_i_lam_adj_cdn_diag egcp[0].egcp_struct_pladgft0.lv_delta_i_lam_adj_sym_diag egcp[0].egcp_struct_pladgft0.lv_delta_i_lam_adj_end_diag egcp[0].egcp_struct_pladgft0.lv_vls_dif_dly_ldc egcp[0].egcp_struct_pladgft0.lv_vls_dif_dly_ldc_lam_mv lv_err_lam_adj_1 lv_vls_dif_dly_ldc_n lv_vls_dif_dly_ldc_maf n_mmv_vls_dif_dly_ldc maf_mmv_vls_dif_dly_ldc /end OUT_MEASUREMENT
/end FUNCTION
/begin FUNCTION EGCP_Dynamic_fuel_trim_diag_inci "Dynamic_fuel_trim_diag_inci" /begin OUT_MEASUREMENT egcp[0].egcp_struct_pladgfti0.lv_inh_diag_dly_lam /end OUT_MEASUREMENT /end FUNCTION
/begin FUNCTION EGCP_O2_sensor_up_heater_diag "O2_sensor_up_heater_diag"
 /begin DEF_CHARACTERISTIC c_lshpwm_min_lsh_up c_ttip_min_obd_lsh_up c_ttip_max_obd_lsh_up c_tcc_thd_obd_lsh_up c_tcc_thd_err_obd_lsh_up lc_obd_rep_lsh_up ip_t_dly_ls_up_ready_raw_lsh_up ip_t_dly_ls_up_ready_obd_lsh_up lc_obd_lsh_up c_t_dly_pow_ctl_obd_lsh_up c_t_dly_ttip_mes_obd_lsh_up c_t_dly_ttip_res_obd_lsh_up /end DEF_CHARACTERISTIC
 /begin OUT_MEASUREMENT egcp[0].egcp_struct_fctdglslh0.ttip_mes_ls_up_obd_lsh_up egcp[0].egcp_struct_fctdglslh0.tcc_vld_obd_lsh_up egcp[0].egcp_struct_fctdglslh0.tcc_err_obd_lsh_up egcp[0].egcp_struct_fctdglslh0.state_sym_obd_lsl_lsh_up egcp[0].egcp_struct_fctdglslh0.lv_lamb_pls_req_diag_lsh_up egcp[0].egcp_struct_fctdglslh0.lv_diag_obd_cdn_lsh_up egcp[0].egcp_struct_fctdglslh0.lv_diag_obd_sym_lsh_up egcp[0].egcp_struct_fctdglslh0.lv_diag_obd_end_lsh_up /end OUT_MEASUREMENT
/end FUNCTION
/begin FUNCTION EGCP_O2_sensor_down_heater_diag "O2_sensor_down_heater_diag"
 /begin DEF_CHARACTERISTIC c_lshpwm_min_lsh_down c_lshpwm_max_lsh_down c_teg_cat_down_max_obd_lsh_down c_temp_sp_obd_lsh_down ldp_r_it_ls_down_new_lsh_down c_t_dly_obd_lsh_down ip_fac_maf_obd_lsh_down c_tcc_thd_err_obd_lsh_down c_tcc_thd_obd_lsh_down c_pow_int_min_obd_lsh_down ip_r_it_thd_obd_lsh_down /end DEF_CHARACTERISTIC
 /begin OUT_MEASUREMENT lv_err_obd_lsh_down_1 egcp[0].egcp_struct_fctdglshd1.r_it_thd_obd_lsh_down egcp[0].egcp_struct_fctdglshd1.r_it_obd_lsh_down egcp[0].egcp_struct_fctdglshd1.temp_dif_obd_lsh_down egcp[0].egcp_struct_fctdglshd1.pow_int_obd_lsh_down egcp[0].egcp_struct_fctdglshd1.tcc_vld_obd_lsh_down egcp[0].egcp_struct_fctdglshd1.tcc_err_obd_lsh_down egcp[0].egcp_struct_fctdglshd1.ctr_cycnr_r_it_obd_ls_down egcp[0].egcp_struct_fctdglshd1.state_obd_lsh_down /end OUT_MEASUREMENT
/end FUNCTION
/begin FUNCTION EGCP_O2_sensor_down_heat_diag_ai "O2_sensor_down_heater_diag" /begin OUT_MEASUREMENT egcp[0].egcp_struct_fctdglshdi1.lv_inh_diag_obd_lsh_down /end OUT_MEASUREMENT /end FUNCTION
/begin FUNCTION EGCP_O2_sensor_downstream_diag "O2_sensor_down_heater_diag"
 /begin DEF_CHARACTERISTIC c_tco_min_diag_mpl_ls_down c_vs_min_diag_mpl_ls_down c_vs_max_diag_mpl_ls_down c_temp_cat_min_diag_mpl_ls_down ldp_maf_kgh_ip_fac_ls_down ip_fac_cycnr_max_ls_down_act c_maf_int_puc_diag_pue_ls_down c_maf_int_diag_pue_ls_down c_ctr_swt_diag_ls_down c_ctr_sym_inc_diag_pue_ls_down c_ctr_sym_max_diag_pue_ls_down c_vls_dif_min_diag_pue_ls_down c_ctr_swt_ls_down c_maf_puc_max_diag_swt_ls_down c_maf_puc_min_diag_swt_ls_down c_fac_vls_max_diag_swt_ls_down c_vls_hys_diag_swt_ls_down c_vls_puc_min_diag_swt_ls_down c_fac_vls_min_diag_swt_ls_down c_ctr_end_diag_pue_ls_down /end DEF_CHARACTERISTIC
 /begin OUT_MEASUREMENT egcp[0].egcp_struct_sigdglsd2.vls_dif_diag_rgn_nt_ls_down egcp[0].egcp_struct_sigdglsd2.vls_down_tran_puc egcp[0].egcp_struct_sigdglsd2.vls_down_pue egcp[0].egcp_struct_sigdglsd2.vls_dif_diag_pue_ls_down egcp[0].egcp_struct_sigdglsd2.vls_dif_save_diag_ls_down egcp[0].egcp_struct_sigdglsd2.vls_down_rgn_nt_end egcp[0].egcp_struct_sigdglsd2.ctr_end_diag_pue_ls_down egcp[0].egcp_struct_sigdglsd2.ctr_quo_sum_swt_ls_down egcp[0].egcp_struct_sigdglsd2.ctr_quo_swt_ls_down egcp[0].egcp_struct_sigdglsd2.ctr_swt_act_ls_down egcp[0].egcp_struct_sigdglsd2.ctr_swt_ls_down egcp[0].egcp_struct_sigdglsd2.ctr_cycnr_swt_ls_down egcp[0].egcp_struct_sigdglsd2.ctr_save_swt_ls_down egcp[0].egcp_struct_sigdglsd2.ctr_sym_diag_pue_ls_down egcp[0].egcp_struct_sigdglsd2.lv_diag_pue_vld_ls_down egcp[0].egcp_struct_sigdglsd2.lv_diag_mpl_cdn_ls_down egcp[0].egcp_struct_sigdglsd2.lv_diag_mpl_end_ls_down egcp[0].egcp_struct_sigdglsd2.lv_swt_diag_vld_ls_down maf_kgh_min_puc lv_err_pue_ls_down_1 lv_err_swt_ls_down_1 /end OUT_MEASUREMENT
/end FUNCTION
/begin FUNCTION EGCP_O2_sensor_inter_signal_diag "O2_sensor_inter_signal_diag" /end FUNCTION
/begin FUNCTION EGCP_O2_sensor_diag_management "O2_sensor_diag_management" /begin DEF_CHARACTERISTIC lc_err_dyn_vld_ls_up /end DEF_CHARACTERISTIC
 /begin OUT_MEASUREMENT egcp[0].egcp_struct_sigdglsl1.lv_err_ls_up egcp[0].egcp_struct_sigdglsl1.lv_err_ls_down lv_err_obd_vld_lsh_up_1 lv_err_puc_vld_ls_up_1 lv_err_dyn_vld_ls_up_1 lv_err_shift_afl_lsl_up_1 lv_err_shift_afr_lsl_up_1 /end OUT_MEASUREMENT
/end FUNCTION
/begin FUNCTION EGCP_O2_sensor_swap_sig_diag_ai "O2_sensor_swap_sig_diag_ai"
 /begin OUT_MEASUREMENT t_end_diag_chg_ls_up t_end_diag_chg_ls_down lv_inh_diag_chg_ls_up lv_inh_diag_chg_ls_down /end OUT_MEASUREMENT
/end FUNCTION
/begin FUNCTION EGCP_O2_sensor_swap_sig_diag "O2_sensor_swap_sig_diag_ai"
 /begin DEF_CHARACTERISTIC c_t_end_diag_chg_ls_up c_t_end_diag_chg_ls_down c_maf_int_diag_chg_ls_up c_maf_int_diag_chg_ls_down c_fac_lam_lim_max_chg_ls_up c_fac_lam_lim_min_chg_ls_up c_fac_int_chg_ls_up c_vls_down_max_chg_ls_down c_vls_down_min_chg_ls_down c_fac_int_chg_ls_down /end DEF_CHARACTERISTIC
 /begin OUT_MEASUREMENT lv_err_chg_ls_up lv_err_chg_ls_down maf_int_diag_chg_ls_up maf_int_diag_chg_ls_down /end OUT_MEASUREMENT
/end FUNCTION
/begin FUNCTION EGCP_O2_sensor_probe_diag_plaus "O2_sensor_probe_diag_plaus"
 /begin DEF_CHARACTERISTIC c_maf_int_diag_ls_up_down c_t_max_diag_afr_ls_up_down c_t_max_diag_afl_ls_up_down c_t_diag_eol_ls_up_down c_maf_int_eol_diag_ls_up_down c_lamb_afl_min_diag_ls_up_down c_lamb_afl_max_diag_ls_up_down c_lamb_afr_min_diag_ls_up_down c_lamb_afr_max_diag_ls_up_down c_abc_max_chk_ls_down c_vls_afr_thd_diag_act_ls_down c_vls_afl_thd_diag_act_ls_down c_lamb_sp_afr_diag_ls_up_down c_lamb_sp_afl_diag_ls_up_down c_abc_inc_chk_ls_down c_lamb_sp_step_diag_ls_up_down lc_diag_auth_chk_ls_up_down c_abc_inc_chk_lsl_up c_lamb_afr_thd_diag_act_lsl_up c_lamb_afl_thd_diag_act_lsl_up c_ctr_sum_rst_afr_chk_lsl_up c_ctr_sum_rst_afl_chk_lsl_up c_abc_max_chk_lsl_up /end DEF_CHARACTERISTIC
 /begin OUT_MEASUREMENT egcp[0].egcp_struct_pladglsl1.lamb_sp_delta_ls_up_down egcp[0].egcp_struct_pladglsl1.maf_int_diag_ls_up_down egcp[0].egcp_struct_pladglsl1.lamb_sp_beg_diag_ls_up_down egcp[0].egcp_struct_pladglsl1.t_diag_act_afr_ls_up_down egcp[0].egcp_struct_pladglsl1.t_diag_act_afl_ls_up_down egcp[0].egcp_struct_pladglsl1.lamb_sp_diag_ls_up_down egcp[0].egcp_struct_pladglsl1.ctr_sum_rst_afr_chk_lsl_up egcp[0].egcp_struct_pladglsl1.ctr_sum_rst_afl_chk_lsl_up egcp[0].egcp_struct_pladglsl1.ctr_afr_chk_lsl_up egcp[0].egcp_struct_pladglsl1.ctr_afl_chk_lsl_up egcp[0].egcp_struct_pladglsl1.state_diag_act_ls_up_down egcp[0].egcp_struct_pladglsl1.lv_diag_afl_cdn_ls_up_down egcp[0].egcp_struct_pladglsl1.lv_diag_afr_cdn_ls_up_down egcp[0].egcp_struct_pladglsl1.lv_diag_act_end_ls_up_down egcp[0].egcp_struct_pladglsl1.lv_lamb_sp_afr_req_diag_act egcp[0].egcp_struct_pladglsl1.lv_lamb_sp_afl_req_diag_act egcp[0].egcp_struct_pladglsl1.lv_lamb_sp_req_diag_act egcp[0].egcp_struct_pladglsl1.lv_diag_cyc_end_ls_down egcp[0].egcp_struct_pladglsl1.lv_lam_di_req egcp[0].egcp_struct_pladglsl1.lv_diag_afr_end_ls_up_down egcp[0].egcp_struct_pladglsl1.lv_diag_afl_end_ls_up_down egcp[0].egcp_struct_pladglsl1.lv_diag_afr_chk_sym_lsl_up egcp[0].egcp_struct_pladglsl1.lv_diag_afl_chk_sym_lsl_up egcp[0].egcp_struct_pladglsl1.lv_diag_act_chk_cdn_lsl_up egcp[0].egcp_struct_pladglsl1.lv_diag_act_chk_end_lsl_up lv_err_chk_ls_down_1 /end OUT_MEASUREMENT
/end FUNCTION
/begin FUNCTION EGCP_O2_sensor_temperature "O2_sensor_temperature"
 /begin DEF_CHARACTERISTIC c_tcc_fac_gain_max_ttip_ls_up c_tcc_err_max_ttip_obd_ls_up lc_ttip_obd_rep_ls_up lc_ttip_obd_ls_up /end DEF_CHARACTERISTIC
 /begin OUT_MEASUREMENT egcp[0].egcp_struct_pladgtipa0.v_ofs_mes_r_it_obd_ls_up egcp[0].egcp_struct_pladgtipa0.v_ofs_adj_r_it_obd_ls_up egcp[0].egcp_struct_pladgtipa0.fac_gain_h_r_it_obd_ls_up egcp[0].egcp_struct_pladgtipa0.fac_gain_l_r_it_obd_ls_up egcp[0].egcp_struct_pladgtipa0.lv_ttip_obd_rep_ls_up lv_err_ttip_obd_ls_up_1 /end OUT_MEASUREMENT
/end FUNCTION
/begin FUNCTION EGCP_O2_sensor_down_diag_inci "O2_sensor_down_diag_inci" /begin DEF_CHARACTERISTIC c_abc_inc_rgn_nt_ls_down c_abc_max_rgn_nt_ls_down /end DEF_CHARACTERISTIC /begin OUT_MEASUREMENT egcp[0].egcp_struct_sigdglsdi2.lv_diag_mpl_inh_ls_down /end OUT_MEASUREMENT /end FUNCTION
/begin FUNCTION EGCP_O2_sensor_up_heater_diag_ai "O2_sensor_up_heater_diag_ai" /begin OUT_MEASUREMENT egcp[0].egcp_struct_fctdglslhi0.lv_inh_diag_obd_lsh_up /end OUT_MEASUREMENT /end FUNCTION
/begin FUNCTION EGCP_Linear_O2_sensor_diag "Linear_O2_sensor_diag"
 /begin DEF_CHARACTERISTIC c_t_on_thd_lsh_diag_st_lsl_up c_t_lam_lim_diag_st_lsl_up ldp_tco_ip_t_max_diag_st_lsl_up ip_t_max_diag_st_lsl_up c_vls_down_min_plaus_lsl_up c_vls_down_max_plaus_lsl_up c_temp_cat_min_plaus_lsl_up c_temp_cat_max_plaus_lsl_up c_maf_kgh_min_diag_plaus_lsl_up c_maf_kgh_max_diag_plaus_lsl_up c_eff_cat_diag_plaus_lsl_up c_vls_down_afl_plaus_lsl_up c_vls_down_afr_plaus_lsl_up c_lamb_afl_diag_plaus_lsl_up c_lamb_afr_diag_plaus_lsl_up c_lamb_min_diag_plaus_lsl_up c_lamb_max_diag_plaus_lsl_up c_tco_min_diag_plaus_lsl_up ldp_maf_kgh_ip_t_diag_lsl_up ip_t_sym_diag_plaus_lsl_up c_t_end_diag_plaus_lsl_up c_ctr_err_ini_diag_st_lsl_up c_ctr_inc_diag_plaus_lsl_up c_ctr_dec_diag_plaus_lsl_up c_ctr_thd_diag_plaus_lsl_up c_vls_up_max_diag_air_lsl_up c_t_sym_diag_air_lsl_up c_t_end_diag_air_lsl_up c_t_diag_sym_puc_lsl_up c_t_dly_diag_puc_lsl_up c_vls_up_min_diag_puc_lsl_up c_vls_up_max_diag_puc_lsl_up c_teg_dyn_min_diag_puc_ls_up c_t_diag_end_puc_lsl_up c_ctr_min_diag_dyn_lsl_up c_ctr_min_diag_eol_dyn_lsl_up c_ctr_wait_diag_dyn_lsl_up c_cycnr_ls_up_dyn_min c_cycnr_ls_up_dyn_min_ext_req c_n_min_ls_dyn c_n_max_ls_dyn c_ls_dyn_diag_maf_max c_ls_dyn_diag_maf_min c_lamb_min_diag_dyn_lsl_up c_lamb_max_diag_dyn_lsl_up c_fac_mv_thd_dyn_ls_up c_fac_ad_thd_dyn_ls_up c_fac_ad_delta_ls_up_dyn c_fac_ad_lpf_dyn_ls_up lc_diag_dyn_lsl_up_cat_syn lc_t1_ad_diag_dyn_lsl_up c_lamb_ampl_max_dyn_lsl_up c_lamb_ampl_min_dyn_lsl_up ip_lamb_ampl_max_dyn_lsl_up ip_lamb_ampl_min_dyn_lsl_up /end DEF_CHARACTERISTIC
 /begin OUT_MEASUREMENT egcp[0].egcp_struct_sigdglsl2.t_on_thd_lsh_diag_st_lsl_up egcp[0].egcp_struct_sigdglsl2.vls_up_save_diag_puc_lsl_up egcp[0].egcp_struct_sigdglsl2.t_sym_diag_air_lsl_up egcp[0].egcp_struct_sigdglsl2.t_end_diag_air_lsl_up egcp[0].egcp_struct_sigdglsl2.t_end_diag_plaus_lsl_up egcp[0].egcp_struct_sigdglsl2.t_diag_end_puc_lsl_up egcp[0].egcp_struct_sigdglsl2.t_dly_diag_puc_lsl_up egcp[0].egcp_struct_sigdglsl2.t_diag_sym_puc_lsl_up egcp[0].egcp_struct_sigdglsl2.t_sym_diag_plaus_lsl_up egcp[0].egcp_struct_sigdglsl2.lamb_min_diag_dyn_lsl_up egcp[0].egcp_struct_sigdglsl2.lamb_max_diag_dyn_lsl_up egcp[0].egcp_struct_sigdglsl2.lamb_ampl_int_diag_dyn_lsl_up egcp[0].egcp_struct_sigdglsl2.fac_value_diag_dyn_lsl_up egcp[0].egcp_struct_sigdglsl2.fac_sum_diag_dyn_lsl_up egcp[0].egcp_struct_sigdglsl2.fac_ad_min_diag_dyn_lsl_up egcp[0].egcp_struct_sigdglsl2.fac_mv_diag_dyn_lsl_up egcp[0].egcp_struct_sigdglsl2.fac_ad_max_diag_dyn_lsl_up egcp[0].egcp_struct_sigdglsl2.fac_diag_dyn_lsl_up egcp[0].egcp_struct_sigdglsl2.t_eng_st_diag_st_lsl_up egcp[0].egcp_struct_sigdglsl2.ctr_err_diag_st_lsl_up egcp[0].egcp_struct_sigdglsl2.t_lam_lim_diag_st_lsl_up egcp[0].egcp_struct_sigdglsl2.ctr_diag_plaus_lsl_up egcp[0].egcp_struct_sigdglsl2.lamb_ampl_diag_dyn_lsl_up egcp[0].egcp_struct_sigdglsl2.lamb_ampl_min_diag_dyn_lsl_up egcp[0].egcp_struct_sigdglsl2.lamb_ampl_max_diag_dyn_lsl_up egcp[0].egcp_struct_sigdglsl2.lamb_ampl_mv_diag_dyn_lsl_up egcp[0].egcp_struct_sigdglsl2.ctr_diag_dyn_lsl_up egcp[0].egcp_struct_sigdglsl2.ctr_wait_diag_dyn_lsl_up egcp[0].egcp_struct_sigdglsl2.cycnr_diag_dyn_lsl_up egcp[0].egcp_struct_sigdglsl2.state_sym_diag_plaus_lsl_up egcp[0].egcp_struct_sigdglsl2.state_sym_diag_puc_lsl_up egcp[0].egcp_struct_sigdglsl2.state_sym_diag_st_lsl_up egcp[0].egcp_struct_sigdglsl2.state_dyn_diag egcp[0].egcp_struct_sigdglsl2.lv_diag_plaus_sym_lsl_up egcp[0].egcp_struct_sigdglsl2.lv_diag_cdn_plaus_lsl_up egcp[0].egcp_struct_sigdglsl2.lv_diag_plaus_end_lsl_up egcp[0].egcp_struct_sigdglsl2.lv_diag_dyn_sym_lsl_up egcp[0].egcp_struct_sigdglsl2.lv_diag_dyn_end_lsl_up egcp[0].egcp_struct_sigdglsl2.lv_diag_dyn_cdn_lsl_up egcp[0].egcp_struct_sigdglsl2.lv_diag_puc_sym_lsl_up egcp[0].egcp_struct_sigdglsl2.lv_diag_cdn_puc_lsl_up egcp[0].egcp_struct_sigdglsl2.lv_diag_puc_end_lsl_up egcp[0].egcp_struct_sigdglsl2.lv_diag_st_sym_lsl_up egcp[0].egcp_struct_sigdglsl2.lv_diag_cdn_st_lsl_up egcp[0].egcp_struct_sigdglsl2.lv_diag_st_end_lsl_up egcp[0].egcp_struct_sigdglsl2.lv_lamb_pls_req_diag_dyn_lsl_up egcp[0].egcp_struct_sigdglsl2.lv_lam_adj_req_diag_dyn_lsl_up lv_err_air_lsl_up_1 ctr_min_diag_dyn_lsl_up /end OUT_MEASUREMENT
/end FUNCTION
/begin FUNCTION EGCP_Linear_O2_sensor_diag_inci "Linear_O2_sensor_diag_inci" /begin DEF_CHARACTERISTIC c_cl_mmv_ls_up_diag_max /end DEF_CHARACTERISTIC
 /begin OUT_MEASUREMENT egcp[0].egcp_struct_sigdglsli2.lv_inh_diag_st_lsl_up egcp[0].egcp_struct_sigdglsli2.lv_diag_plaus_inh_lsl_up egcp[0].egcp_struct_sigdglsli2.lv_diag_dyn_inh_lsl_up egcp[0].egcp_struct_sigdglsli2.lv_inh_diag_air_lsl_up egcp[0].egcp_struct_sigdglsli2.lv_inh_diag_puc_lsl_up egcp[0].egcp_struct_sigdglsli2.lv_diag_eol_dyn_ls_up lv_inh_diag_ls_up_dyn_cp /end OUT_MEASUREMENT
/end FUNCTION
/begin FUNCTION EGCP_O2_sensor_temperature_inci "O2_sensor_temperature" /begin OUT_MEASUREMENT egcp[0].egcp_struct_pladgtipai0.lv_inh_diag_ttip_obd_ls_up /end OUT_MEASUREMENT /end FUNCTION
/begin FUNCTION EGCP_O2_sensor_diag_manag_inci "O2_sensor_diag_manag_inci" /end FUNCTION
/begin FUNCTION EGCP_O2_sensor_probe_diag_inci "O2_sensor_probe_diag_inci"
 /begin OUT_MEASUREMENT egcp[0].egcp_struct_pladglsli1.lv_diag_act_inh_ls_up_down egcp[0].egcp_struct_pladglsli1.lv_diag_afr_inh_ls_up_down egcp[0].egcp_struct_pladglsli1.lv_diag_afl_inh_ls_up_down egcp[0].egcp_struct_pladglsli1.lv_diag_eol_req_ls_up_down /end OUT_MEASUREMENT
/end FUNCTION
/begin FUNCTION EGCP_Down_O2_sensor_resist_inci "" /begin OUT_MEASUREMENT egcp[0].egcp_struct_sigcvridi0.lv_inh_r_it_ls_down /end OUT_MEASUREMENT /end FUNCTION
/begin FUNCTION EGCP_Linear_O2_sensor_hea_diag "Linear_O2_sensor_hea_diag"
 /begin DEF_CHARACTERISTIC c_lamb_delta_lpf_thd c_cycnr_max_diag_lsh_lsl_up c_ctr_sym_diag_lsh_lsl_up c_lamb_sp_de_diag_lsh_lsl_up c_teg_dyn_min_diag_lsh_lsl_up c_maf_int_diag_lsh_lsl_up c_t_per_lamb_de_diag_lsh_lsl_up c_crlc_lpf_fall_diag_lsh_lsl_up c_crlc_lpf_rise_diag_lsh_lsl_up c_lshpwm_min_diag_lsh_lsl_up c_lshpwm_max_diag_lsh_lsl_up ldp_lshpwm_up_ip_t_dly_acq_vls ip_t_dly_trig_lsh_up /end DEF_CHARACTERISTIC
 /begin OUT_MEASUREMENT egcp[0].egcp_struct_sigdglsl3.lamb_delta_rise_lpf egcp[0].egcp_struct_sigdglsl3.lamb_delta_fall_lpf egcp[0].egcp_struct_sigdglsl3.lamb_syn_lshpwm_fall egcp[0].egcp_struct_sigdglsl3.lamb_syn_lshpwm_rise egcp[0].egcp_struct_sigdglsl3.lamb_delta_rise egcp[0].egcp_struct_sigdglsl3.lamb_delta_fall egcp[0].egcp_struct_sigdglsl3.ctr_sym_diag_lsh_lsl_up egcp[0].egcp_struct_sigdglsl3.cycnr_diag_lsh_lsl_up egcp[0].egcp_struct_sigdglsl3.t_dly_trig_lsh_up maf_int_diag_lsh_lsl_up lv_err_lsh_lsl_up_1 /end OUT_MEASUREMENT
/end FUNCTION
/begin FUNCTION EGCP_Linear_O2_sens_hea_diag_AI "Linear_O2_sens_hea_diag_AI" /begin OUT_MEASUREMENT egcp[0].egcp_struct_sigdglsli3.lv_inh_diag_lsh_lsl_up /end OUT_MEASUREMENT /end FUNCTION
/begin FUNCTION C_X_PECO ""
 /begin SUB_FUNCTION PECO_ENME PECO_ACQU PECO_ENCO PECO_CLCO PECO_FOCO PECO_TEPL PECO_STCO PECO_CORD /end SUB_FUNCTION
/end FUNCTION
/begin FUNCTION PECO_ENME ""
 /begin OUT_MEASUREMENT sf_mes_egy_inj_vld egy_inj_seq1_[0] egy_inj_seq1_[1] egy_inj_seq1_[2] egy_inj_seq1_[3] seg_nr_egy_mes /end OUT_MEASUREMENT
/end FUNCTION
/begin FUNCTION PECO_ACQU ""
 /begin OUT_MEASUREMENT t_iv_close_[0] t_iv_close_[1] t_iv_close_[2] t_iv_close_[3] v_delta_iv_foc_[0] v_delta_iv_foc_[1] v_delta_iv_foc_[2] v_delta_iv_foc_[3] v_delta_iv_foc_rel_[0] v_delta_iv_foc_rel_[1] v_delta_iv_foc_rel_[2] v_delta_iv_foc_rel_[3] egy_inj_det_dif_fil_[0] egy_inj_det_dif_fil_[1] egy_inj_det_dif_fil_[2] egy_inj_det_dif_fil_[3] egy_inj_det_dif_[0] egy_inj_det_dif_[1] egy_inj_det_dif_[2] egy_inj_det_dif_[3] egy_inj_det_fil_[0] egy_inj_det_fil_[1] egy_inj_det_fil_[2] egy_inj_det_fil_[3] egy_inj_det_[0] egy_inj_det_[1] egy_inj_det_[2] egy_inj_det_[3] egy_inj_lst_[0] egy_inj_lst_[1] egy_inj_lst_[2] egy_inj_lst_[3] nr_v_inj_dif_det_values_[0] nr_v_inj_dif_det_values_[1] nr_v_inj_dif_det_values_[2] nr_v_inj_dif_det_values_[3] nr_v_inj_dif_det_values_[4] nr_v_inj_dif_det_values_[5] nr_v_inj_dif_det_value_[0] nr_v_inj_dif_det_value_[1] nr_v_inj_dif_det_value_[2] nr_v_inj_dif_det_value_[3] q_inj_burst_act_[0] q_inj_burst_act_[1] q_inj_burst_act_[2] q_inj_burst_act_[3] q_inj_burst_act_[4] q_inj_burst_act_[5] q_inj_burst_act_[6] q_inj_burst_act_[7] q_inj_burst_act_[8] q_inj_burst_act_[9] q_inj_burst_act_[10] q_inj_burst_act_[11] q_inj_burst_act_[12] q_inj_burst_act_[13] q_inj_burst_act_[14] q_inj_burst_act_[15] q_inj_burst_act_[16] q_inj_burst_act_[17] q_inj_burst_act_[18] q_inj_burst_act_[19] q_inj_burst_act_[20] q_inj_burst_act_[21] q_inj_burst_act_[22] q_inj_burst_act_[23] q_inj_burst_act_[24] q_inj_burst_act_[25] q_inj_burst_act_[26] q_inj_burst_act_[27] q_inj_burst_act_[28] q_inj_burst_act_[29] q_inj_burst_act_[30] q_inj_burst_act_[31] q_inj_burst_act_[32] q_inj_burst_act_[33] q_inj_burst_act_[34] q_inj_burst_act_[35] q_inj_burst_act_[36] q_inj_burst_act_[37] q_inj_burst_act_[38] q_inj_burst_act_[39] q_inj_burst_act_[40] q_inj_burst_act_[41] q_inj_burst_act_[42] q_inj_burst_act_[43] q_inj_burst_act_[44] q_inj_burst_act_[45] q_inj_burst_act_[46] q_inj_burst_act_[47] q_inj_burst_exp_[0] q_inj_burst_exp_[1] q_inj_burst_exp_[2] q_inj_burst_exp_[3] q_inj_burst_exp_[4] q_inj_burst_exp_[5] q_inj_burst_exp_[6] q_inj_burst_exp_[7] q_inj_burst_exp_[8] q_inj_burst_exp_[9] q_inj_burst_exp_[10] q_inj_burst_exp_[11] q_inj_burst_exp_[12] q_inj_burst_exp_[13] q_inj_burst_exp_[14] q_inj_burst_exp_[15] q_inj_burst_exp_[16] q_inj_burst_exp_[17] q_inj_burst_exp_[18] q_inj_burst_exp_[19] q_inj_burst_exp_[20] q_inj_burst_exp_[21] q_inj_burst_exp_[22] q_inj_burst_exp_[23] q_inj_burst_exp_[24] q_inj_burst_exp_[25] q_inj_burst_exp_[26] q_inj_burst_exp_[27] q_inj_burst_exp_[28] q_inj_burst_exp_[29] q_inj_burst_exp_[30] q_inj_burst_exp_[31] q_inj_burst_exp_[32] q_inj_burst_exp_[33] q_inj_burst_exp_[34] q_inj_burst_exp_[35] q_inj_burst_exp_[36] q_inj_burst_exp_[37] q_inj_burst_exp_[38] q_inj_burst_exp_[39] q_inj_burst_exp_[40] q_inj_burst_exp_[41] q_inj_burst_exp_[42] q_inj_burst_exp_[43] q_inj_burst_exp_[44] q_inj_burst_exp_[45] q_inj_burst_exp_[46] q_inj_burst_exp_[47] q_inj_burst_intp_[0] q_inj_burst_intp_[1] q_inj_burst_intp_[2] q_inj_burst_intp_[3] q_inj_burst_intp_[4] q_inj_burst_intp_[5] q_inj_burst_intp_[6] q_inj_burst_intp_[7] q_inj_burst_intp_[8] q_inj_burst_intp_[9] q_inj_burst_intp_[10] q_inj_burst_intp_[11] q_inj_burst_intp_[12] q_inj_burst_intp_[13] q_inj_burst_intp_[14] q_inj_burst_intp_[15] q_inj_burst_intp_[16] q_inj_burst_intp_[17] q_inj_burst_intp_[18] q_inj_burst_intp_[19] q_inj_burst_intp_[20] q_inj_burst_intp_[21] q_inj_burst_intp_[22] q_inj_burst_intp_[23] q_inj_burst_intp_[24] q_inj_burst_intp_[25] q_inj_burst_intp_[26] q_inj_burst_intp_[27] q_inj_burst_intp_[28] q_inj_burst_intp_[29] q_inj_burst_intp_[30] q_inj_burst_intp_[31] q_inj_burst_intp_[32] q_inj_burst_intp_[33] q_inj_burst_intp_[34] q_inj_burst_intp_[35] q_inj_burst_intp_[36] q_inj_burst_intp_[37] q_inj_burst_intp_[38] q_inj_burst_intp_[39] q_inj_burst_intp_[40] q_inj_burst_intp_[41] q_inj_burst_intp_[42] q_inj_burst_intp_[43] q_inj_burst_intp_[44] q_inj_burst_intp_[45] q_inj_burst_intp_[46] q_inj_burst_intp_[47] q_inj_det_[0] q_inj_det_[1] q_inj_det_[2] q_inj_det_[3] seg_nr_pui_acq v_inj_burst_act_max_[0] /end OUT_MEASUREMENT
/end FUNCTION
/end MODULE
/end PROJECT
