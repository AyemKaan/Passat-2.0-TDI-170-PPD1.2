ASAP2_VERSION 1 41
/begin PROJECT SN0 "SIMOS PPD"
/begin HEADER "_default_HeaderComment" PROJECT_NO PRJ_NUM /end HEADER
/begin MODULE _default_ModuleName "_default_ModuleLongIdentifier"
/begin MOD_COMMON "_default_ModCommonComment" DEPOSIT ABSOLUTE BYTE_ORDER MSB_FIRST ALIGNMENT_BYTE 1 ALIGNMENT_WORD 2 ALIGNMENT_LONG 4 ALIGNMENT_FLOAT32_IEEE 4 ALIGNMENT_FLOAT64_IEEE 8 /end MOD_COMMON
/begin AXIS_PTS ldp_fmy_dtc "" 0x8416dc online_dummy _REC_AXS_20_u2 5. _CNV_A_R_LINEAR_____0_CM 6 0. 5. FORMAT "%2.0" /end AXIS_PTS
/begin AXIS_PTS ldp_fmy_envd "" 0x8416ea online_dummy _REC_AXS_20_u1 7. _CNV_A_R_LINEAR_____0_CM 8 0. 7. READ_ONLY FORMAT "%2.0" /end AXIS_PTS
/begin CHARACTERISTIC fmy_id_v_tpc_rng.dtc[0] "diagnostic trouble codes for diagnosis instance V_TPC_RNG" CURVE 0x85d376 _REC_CUR_20_u2_u2 65535. _CNV_A_R_LINEAR_____1_CM 0. 65535. DISPLAY_IDENTIFIER ID_ERR_DTC_V_TPC_RNG FORMAT "%5.0"
 /begin AXIS_DESCR COM_AXIS online_dummy _CNV_A_R_LINEAR_____0_CM 6 0. 5. FORMAT "%2.0" AXIS_PTS_REF ldp_fmy_dtc /end AXIS_DESCR
/end CHARACTERISTIC
/begin CHARACTERISTIC fmy_id_v_tpc_rng.envd "environmental data contents of customer specific freeze frame for diagnosis instance V_TPC_RNG" CURVE 0x85d382 _REC_CUR_20_u1_u1 255. _CNV_A_R_LINEAR_____1_CM 0. 255. DISPLAY_IDENTIFIER ID_ERR_ENVD_V_TPC_RNG FORMAT "%3.0"
 /begin AXIS_DESCR COM_AXIS online_dummy _CNV_A_R_LINEAR_____0_CM 8 0. 7. READ_ONLY FORMAT "%2.0" AXIS_PTS_REF ldp_fmy_envd /end AXIS_DESCR
/end CHARACTERISTIC
/begin CHARACTERISTIC fmy_id_v_tpc_rng.c_err_clas "error class for diagnosis instance V_TPC_RNG" VALUE 0x85d38a _REC_VAL_20_u1 255. _CNV_A_R_LINEAR_____1_CM 0. 255. DISPLAY_IDENTIFIER C_ERR_CLAS_V_TPC_RNG FORMAT "%3.0" /end CHARACTERISTIC
/begin CHARACTERISTIC fmy_id_tpc_mes_plaus.dtc[0] "diagnostic trouble codes for diagnosis instance TPC_MES_PLAUS" CURVE 0x85d38c _REC_CUR_20_u2_u2 65535. _CNV_A_R_LINEAR_____1_CM 0. 65535. DISPLAY_IDENTIFIER ID_ERR_DTC_TPC_MES_PLAUS FORMAT "%5.0"
 /begin AXIS_DESCR COM_AXIS online_dummy _CNV_A_R_LINEAR_____0_CM 6 0. 5. FORMAT "%2.0" AXIS_PTS_REF ldp_fmy_dtc /end AXIS_DESCR
/end CHARACTERISTIC
/begin CHARACTERISTIC fmy_id_tpc_mes_plaus.envd "environmental data contents of customer specific freeze frame for diagnosis instance TPC_MES_PLAUS" CURVE 0x85d398 _REC_CUR_20_u1_u1 255. _CNV_A_R_LINEAR_____1_CM 0. 255. DISPLAY_IDENTIFIER ID_ERR_ENVD_TPC_MES_PLAUS FORMAT "%3.0"
 /begin AXIS_DESCR COM_AXIS online_dummy _CNV_A_R_LINEAR_____0_CM 8 0. 7. READ_ONLY FORMAT "%2.0" AXIS_PTS_REF ldp_fmy_envd /end AXIS_DESCR
/end CHARACTERISTIC
/begin CHARACTERISTIC fmy_id_tpc_mes_plaus.c_err_clas "error class for diagnosis instance TPC_MES_PLAUS" VALUE 0x85d3a0 _REC_VAL_20_u1 255. _CNV_A_R_LINEAR_____1_CM 0. 255. DISPLAY_IDENTIFIER C_ERR_CLAS_TPC_MES_PLAUS FORMAT "%3.0" /end CHARACTERISTIC
/begin CHARACTERISTIC fmy_id_v_tac_rng.dtc[0] "diagnostic trouble codes for diagnosis instance V_TAC_RNG" CURVE 0x85d3a2 _REC_CUR_20_u2_u2 65535. _CNV_A_R_LINEAR_____1_CM 0. 65535. DISPLAY_IDENTIFIER ID_ERR_DTC_V_TAC_RNG FORMAT "%5.0"
 /begin AXIS_DESCR COM_AXIS online_dummy _CNV_A_R_LINEAR_____0_CM 6 0. 5. FORMAT "%2.0" AXIS_PTS_REF ldp_fmy_dtc /end AXIS_DESCR
/end CHARACTERISTIC
/begin CHARACTERISTIC fmy_id_v_tac_rng.envd "environmental data contents of customer specific freeze frame for diagnosis instance V_TAC_RNG" CURVE 0x85d3ae _REC_CUR_20_u1_u1 255. _CNV_A_R_LINEAR_____1_CM 0. 255. DISPLAY_IDENTIFIER ID_ERR_ENVD_V_TAC_RNG FORMAT "%3.0"
 /begin AXIS_DESCR COM_AXIS online_dummy _CNV_A_R_LINEAR_____0_CM 8 0. 7. READ_ONLY FORMAT "%2.0" AXIS_PTS_REF ldp_fmy_envd /end AXIS_DESCR
/end CHARACTERISTIC
/begin CHARACTERISTIC fmy_id_v_tac_rng.c_err_clas "error class for diagnosis instance V_TAC_RNG" VALUE 0x85d3b6 _REC_VAL_20_u1 255. _CNV_A_R_LINEAR_____1_CM 0. 255. DISPLAY_IDENTIFIER C_ERR_CLAS_V_TAC_RNG FORMAT "%3.0" /end CHARACTERISTIC
/begin CHARACTERISTIC fmy_id_tac_mes_grd.dtc[0] "diagnostic trouble codes for diagnosis instance TAC_MES_GRD" CURVE 0x85d3b8 _REC_CUR_20_u2_u2 65535. _CNV_A_R_LINEAR_____1_CM 0. 65535. DISPLAY_IDENTIFIER ID_ERR_DTC_TAC_MES_GRD FORMAT "%5.0"
 /begin AXIS_DESCR COM_AXIS online_dummy _CNV_A_R_LINEAR_____0_CM 6 0. 5. FORMAT "%2.0" AXIS_PTS_REF ldp_fmy_dtc /end AXIS_DESCR
/end CHARACTERISTIC
/begin CHARACTERISTIC fmy_id_tac_mes_grd.envd "environmental data contents of customer specific freeze frame for diagnosis instance TAC_MES_GRD" CURVE 0x85d3c4 _REC_CUR_20_u1_u1 255. _CNV_A_R_LINEAR_____1_CM 0. 255. DISPLAY_IDENTIFIER ID_ERR_ENVD_TAC_MES_GRD FORMAT "%3.0"
 /begin AXIS_DESCR COM_AXIS online_dummy _CNV_A_R_LINEAR_____0_CM 8 0. 7. READ_ONLY FORMAT "%2.0" AXIS_PTS_REF ldp_fmy_envd /end AXIS_DESCR
/end CHARACTERISTIC
/begin CHARACTERISTIC fmy_id_tac_mes_grd.c_err_clas "error class for diagnosis instance TAC_MES_GRD" VALUE 0x85d3cc _REC_VAL_20_u1 255. _CNV_A_R_LINEAR_____1_CM 0. 255. DISPLAY_IDENTIFIER C_ERR_CLAS_TAC_MES_GRD FORMAT "%3.0" /end CHARACTERISTIC
/begin CHARACTERISTIC fmy_id_mf_is_obd.dtc[0] "diagnostic trouble codes for diagnosis instance MF_IS_OBD" CURVE 0x85d3ce _REC_CUR_20_u2_u2 65535. _CNV_A_R_LINEAR_____1_CM 0. 65535. DISPLAY_IDENTIFIER ID_ERR_DTC_MF_IS_OBD FORMAT "%5.0"
 /begin AXIS_DESCR COM_AXIS online_dummy _CNV_A_R_LINEAR_____0_CM 6 0. 5. FORMAT "%2.0" AXIS_PTS_REF ldp_fmy_dtc /end AXIS_DESCR
/end CHARACTERISTIC
/begin CHARACTERISTIC fmy_id_mf_is_obd.envd "environmental data contents of customer specific freeze frame for diagnosis instance MF_IS_OBD" CURVE 0x85d3da _REC_CUR_20_u1_u1 255. _CNV_A_R_LINEAR_____1_CM 0. 255. DISPLAY_IDENTIFIER ID_ERR_ENVD_MF_IS_OBD FORMAT "%3.0"
 /begin AXIS_DESCR COM_AXIS online_dummy _CNV_A_R_LINEAR_____0_CM 8 0. 7. READ_ONLY FORMAT "%2.0" AXIS_PTS_REF ldp_fmy_envd /end AXIS_DESCR
/end CHARACTERISTIC
/begin CHARACTERISTIC fmy_id_mf_is_obd.c_err_clas "error class for diagnosis instance MF_IS_OBD" VALUE 0x85d3e2 _REC_VAL_20_u1 255. _CNV_A_R_LINEAR_____1_CM 0. 255. DISPLAY_IDENTIFIER C_ERR_CLAS_MF_IS_OBD FORMAT "%3.0" /end CHARACTERISTIC
/begin CHARACTERISTIC fmy_id_cyl_bal_0.dtc[0] "diagnostic trouble codes for diagnosis instance CYL_BAL_0" CURVE 0x85d3e4 _REC_CUR_20_u2_u2 65535. _CNV_A_R_LINEAR_____1_CM 0. 65535. DISPLAY_IDENTIFIER ID_ERR_DTC_CYL_BAL_0 FORMAT "%5.0"
 /begin AXIS_DESCR COM_AXIS online_dummy _CNV_A_R_LINEAR_____0_CM 6 0. 5. FORMAT "%2.0" AXIS_PTS_REF ldp_fmy_dtc /end AXIS_DESCR
/end CHARACTERISTIC
/begin CHARACTERISTIC fmy_id_cyl_bal_0.envd "environmental data contents of customer specific freeze frame for diagnosis instance CYL_BAL_0" CURVE 0x85d3f0 _REC_CUR_20_u1_u1 255. _CNV_A_R_LINEAR_____1_CM 0. 255. DISPLAY_IDENTIFIER ID_ERR_ENVD_CYL_BAL_0 FORMAT "%3.0"
 /begin AXIS_DESCR COM_AXIS online_dummy _CNV_A_R_LINEAR_____0_CM 8 0. 7. READ_ONLY FORMAT "%2.0" AXIS_PTS_REF ldp_fmy_envd /end AXIS_DESCR
/end CHARACTERISTIC
/begin CHARACTERISTIC fmy_id_cyl_bal_0.c_err_clas "error class for diagnosis instance CYL_BAL_0" VALUE 0x85d3f8 _REC_VAL_20_u1 255. _CNV_A_R_LINEAR_____1_CM 0. 255. DISPLAY_IDENTIFIER C_ERR_CLAS_CYL_BAL_0 FORMAT "%3.0" /end CHARACTERISTIC
/begin CHARACTERISTIC fmy_id_cyl_bal_1.dtc[0] "diagnostic trouble codes for diagnosis instance CYL_BAL_1" CURVE 0x85d3fa _REC_CUR_20_u2_u2 65535. _CNV_A_R_LINEAR_____1_CM 0. 65535. DISPLAY_IDENTIFIER ID_ERR_DTC_CYL_BAL_1 FORMAT "%5.0"
 /begin AXIS_DESCR COM_AXIS online_dummy _CNV_A_R_LINEAR_____0_CM 6 0. 5. FORMAT "%2.0" AXIS_PTS_REF ldp_fmy_dtc /end AXIS_DESCR
/end CHARACTERISTIC
/begin CHARACTERISTIC fmy_id_cyl_bal_1.envd "environmental data contents of customer specific freeze frame for diagnosis instance CYL_BAL_1" CURVE 0x85d406 _REC_CUR_20_u1_u1 255. _CNV_A_R_LINEAR_____1_CM 0. 255. DISPLAY_IDENTIFIER ID_ERR_ENVD_CYL_BAL_1 FORMAT "%3.0"
 /begin AXIS_DESCR COM_AXIS online_dummy _CNV_A_R_LINEAR_____0_CM 8 0. 7. READ_ONLY FORMAT "%2.0" AXIS_PTS_REF ldp_fmy_envd /end AXIS_DESCR
/end CHARACTERISTIC
/begin CHARACTERISTIC fmy_id_cyl_bal_1.c_err_clas "error class for diagnosis instance CYL_BAL_1" VALUE 0x85d40e _REC_VAL_20_u1 255. _CNV_A_R_LINEAR_____1_CM 0. 255. DISPLAY_IDENTIFIER C_ERR_CLAS_CYL_BAL_1 FORMAT "%3.0" /end CHARACTERISTIC
/begin CHARACTERISTIC fmy_id_cyl_bal_2.dtc[0] "diagnostic trouble codes for diagnosis instance CYL_BAL_2" CURVE 0x85d410 _REC_CUR_20_u2_u2 65535. _CNV_A_R_LINEAR_____1_CM 0. 65535. DISPLAY_IDENTIFIER ID_ERR_DTC_CYL_BAL_2 FORMAT "%5.0"
 /begin AXIS_DESCR COM_AXIS online_dummy _CNV_A_R_LINEAR_____0_CM 6 0. 5. FORMAT "%2.0" AXIS_PTS_REF ldp_fmy_dtc /end AXIS_DESCR
/end CHARACTERISTIC
/begin CHARACTERISTIC fmy_id_cyl_bal_2.envd "environmental data contents of customer specific freeze frame for diagnosis instance CYL_BAL_2" CURVE 0x85d41c _REC_CUR_20_u1_u1 255. _CNV_A_R_LINEAR_____1_CM 0. 255. DISPLAY_IDENTIFIER ID_ERR_ENVD_CYL_BAL_2 FORMAT "%3.0"
 /begin AXIS_DESCR COM_AXIS online_dummy _CNV_A_R_LINEAR_____0_CM 8 0. 7. READ_ONLY FORMAT "%2.0" AXIS_PTS_REF ldp_fmy_envd /end AXIS_DESCR
/end CHARACTERISTIC
/begin CHARACTERISTIC fmy_id_cyl_bal_2.c_err_clas "error class for diagnosis instance CYL_BAL_2" VALUE 0x85d424 _REC_VAL_20_u1 255. _CNV_A_R_LINEAR_____1_CM 0. 255. DISPLAY_IDENTIFIER C_ERR_CLAS_CYL_BAL_2 FORMAT "%3.0" /end CHARACTERISTIC
/begin CHARACTERISTIC fmy_id_cyl_bal_3.dtc[0] "diagnostic trouble codes for diagnosis instance CYL_BAL_3" CURVE 0x85d426 _REC_CUR_20_u2_u2 65535. _CNV_A_R_LINEAR_____1_CM 0. 65535. DISPLAY_IDENTIFIER ID_ERR_DTC_CYL_BAL_3 FORMAT "%5.0"
 /begin AXIS_DESCR COM_AXIS online_dummy _CNV_A_R_LINEAR_____0_CM 6 0. 5. FORMAT "%2.0" AXIS_PTS_REF ldp_fmy_dtc /end AXIS_DESCR
/end CHARACTERISTIC
/begin CHARACTERISTIC fmy_id_cyl_bal_3.envd "environmental data contents of customer specific freeze frame for diagnosis instance CYL_BAL_3" CURVE 0x85d432 _REC_CUR_20_u1_u1 255. _CNV_A_R_LINEAR_____1_CM 0. 255. DISPLAY_IDENTIFIER ID_ERR_ENVD_CYL_BAL_3 FORMAT "%3.0"
 /begin AXIS_DESCR COM_AXIS online_dummy _CNV_A_R_LINEAR_____0_CM 8 0. 7. READ_ONLY FORMAT "%2.0" AXIS_PTS_REF ldp_fmy_envd /end AXIS_DESCR
/end CHARACTERISTIC
/begin CHARACTERISTIC fmy_id_cyl_bal_3.c_err_clas "error class for diagnosis instance CYL_BAL_3" VALUE 0x85d43a _REC_VAL_20_u1 255. _CNV_A_R_LINEAR_____1_CM 0. 255. DISPLAY_IDENTIFIER C_ERR_CLAS_CYL_BAL_3 FORMAT "%3.0" /end CHARACTERISTIC
/begin CHARACTERISTIC fmy_id_egrv_0_ctl.dtc[0] "diagnostic trouble codes for diagnosis instance EGRV_0_CTL" CURVE 0x85d43c _REC_CUR_20_u2_u2 65535. _CNV_A_R_LINEAR_____1_CM 0. 65535. DISPLAY_IDENTIFIER ID_ERR_DTC_EGRV_0_CTL FORMAT "%5.0"
 /begin AXIS_DESCR COM_AXIS online_dummy _CNV_A_R_LINEAR_____0_CM 6 0. 5. FORMAT "%2.0" AXIS_PTS_REF ldp_fmy_dtc /end AXIS_DESCR
/end CHARACTERISTIC
/begin CHARACTERISTIC fmy_id_egrv_0_ctl.envd "environmental data contents of customer specific freeze frame for diagnosis instance EGRV_0_CTL" CURVE 0x85d448 _REC_CUR_20_u1_u1 255. _CNV_A_R_LINEAR_____1_CM 0. 255. DISPLAY_IDENTIFIER ID_ERR_ENVD_EGRV_0_CTL FORMAT "%3.0"
 /begin AXIS_DESCR COM_AXIS online_dummy _CNV_A_R_LINEAR_____0_CM 8 0. 7. READ_ONLY FORMAT "%2.0" AXIS_PTS_REF ldp_fmy_envd /end AXIS_DESCR
/end CHARACTERISTIC
/begin CHARACTERISTIC fmy_id_egrv_0_ctl.c_err_clas "error class for diagnosis instance EGRV_0_CTL" VALUE 0x85d450 _REC_VAL_20_u1 255. _CNV_A_R_LINEAR_____1_CM 0. 255. DISPLAY_IDENTIFIER C_ERR_CLAS_EGRV_0_CTL FORMAT "%3.0" /end CHARACTERISTIC
/begin CHARACTERISTIC fmy_id_v_egrv_0_bol_ad.dtc[0] "diagnostic trouble codes for diagnosis instance V_EGRV_0_BOL_AD" CURVE 0x85d452 _REC_CUR_20_u2_u2 65535. _CNV_A_R_LINEAR_____1_CM 0. 65535. DISPLAY_IDENTIFIER ID_ERR_DTC_V_EGRV_0_BOL_AD FORMAT "%5.0"
 /begin AXIS_DESCR COM_AXIS online_dummy _CNV_A_R_LINEAR_____0_CM 6 0. 5. FORMAT "%2.0" AXIS_PTS_REF ldp_fmy_dtc /end AXIS_DESCR
/end CHARACTERISTIC
/begin CHARACTERISTIC fmy_id_v_egrv_0_bol_ad.envd "environmental data contents of customer specific freeze frame for diagnosis instance V_EGRV_0_BOL_AD" CURVE 0x85d45e _REC_CUR_20_u1_u1 255. _CNV_A_R_LINEAR_____1_CM 0. 255. DISPLAY_IDENTIFIER ID_ERR_ENVD_V_EGRV_0_BOL_AD FORMAT "%3.0"
 /begin AXIS_DESCR COM_AXIS online_dummy _CNV_A_R_LINEAR_____0_CM 8 0. 7. READ_ONLY FORMAT "%2.0" AXIS_PTS_REF ldp_fmy_envd /end AXIS_DESCR
/end CHARACTERISTIC
/begin CHARACTERISTIC fmy_id_v_egrv_0_bol_ad.c_err_clas "error class for diagnosis instance V_EGRV_0_BOL_AD" VALUE 0x85d466 _REC_VAL_20_u1 255. _CNV_A_R_LINEAR_____1_CM 0. 255. DISPLAY_IDENTIFIER C_ERR_CLAS_V_EGRV_0_BOL_AD FORMAT "%3.0" /end CHARACTERISTIC
/begin CHARACTERISTIC fmy_id_thr_0_ctl.dtc[0] "diagnostic trouble codes for diagnosis instance THR_0_CTL" CURVE 0x85d468 _REC_CUR_20_u2_u2 65535. _CNV_A_R_LINEAR_____1_CM 0. 65535. DISPLAY_IDENTIFIER ID_ERR_DTC_THR_0_CTL FORMAT "%5.0"
 /begin AXIS_DESCR COM_AXIS online_dummy _CNV_A_R_LINEAR_____0_CM 6 0. 5. FORMAT "%2.0" AXIS_PTS_REF ldp_fmy_dtc /end AXIS_DESCR
/end CHARACTERISTIC
/begin CHARACTERISTIC fmy_id_thr_0_ctl.envd "environmental data contents of customer specific freeze frame for diagnosis instance THR_0_CTL" CURVE 0x85d474 _REC_CUR_20_u1_u1 255. _CNV_A_R_LINEAR_____1_CM 0. 255. DISPLAY_IDENTIFIER ID_ERR_ENVD_THR_0_CTL FORMAT "%3.0"
 /begin AXIS_DESCR COM_AXIS online_dummy _CNV_A_R_LINEAR_____0_CM 8 0. 7. READ_ONLY FORMAT "%2.0" AXIS_PTS_REF ldp_fmy_envd /end AXIS_DESCR
/end CHARACTERISTIC
/begin CHARACTERISTIC fmy_id_thr_0_ctl.c_err_clas "error class for diagnosis instance THR_0_CTL" VALUE 0x85d47c _REC_VAL_20_u1 255. _CNV_A_R_LINEAR_____1_CM 0. 255. DISPLAY_IDENTIFIER C_ERR_CLAS_THR_0_CTL FORMAT "%3.0" /end CHARACTERISTIC
/begin CHARACTERISTIC fmy_id_v_thr_0_bol_ad.dtc[0] "diagnostic trouble codes for diagnosis instance V_THR_0_BOL_AD" CURVE 0x85d47e _REC_CUR_20_u2_u2 65535. _CNV_A_R_LINEAR_____1_CM 0. 65535. DISPLAY_IDENTIFIER ID_ERR_DTC_V_THR_0_BOL_AD FORMAT "%5.0"
 /begin AXIS_DESCR COM_AXIS online_dummy _CNV_A_R_LINEAR_____0_CM 6 0. 5. FORMAT "%2.0" AXIS_PTS_REF ldp_fmy_dtc /end AXIS_DESCR
/end CHARACTERISTIC
/begin CHARACTERISTIC fmy_id_v_thr_0_bol_ad.envd "environmental data contents of customer specific freeze frame for diagnosis instance V_THR_0_BOL_AD" CURVE 0x85d48a _REC_CUR_20_u1_u1 255. _CNV_A_R_LINEAR_____1_CM 0. 255. DISPLAY_IDENTIFIER ID_ERR_ENVD_V_THR_0_BOL_AD FORMAT "%3.0"
 /begin AXIS_DESCR COM_AXIS online_dummy _CNV_A_R_LINEAR_____0_CM 8 0. 7. READ_ONLY FORMAT "%2.0" AXIS_PTS_REF ldp_fmy_envd /end AXIS_DESCR
/end CHARACTERISTIC
/begin CHARACTERISTIC fmy_id_v_thr_0_bol_ad.c_err_clas "error class for diagnosis instance V_THR_0_BOL_AD" VALUE 0x85d492 _REC_VAL_20_u1 255. _CNV_A_R_LINEAR_____1_CM 0. 255. DISPLAY_IDENTIFIER C_ERR_CLAS_V_THR_0_BOL_AD FORMAT "%3.0" /end CHARACTERISTIC
/begin CHARACTERISTIC fmy_id_bpa_0_ctl.dtc[0] "diagnostic trouble codes for diagnosis instance BPA_0_CTL" CURVE 0x85d494 _REC_CUR_20_u2_u2 65535. _CNV_A_R_LINEAR_____1_CM 0. 65535. DISPLAY_IDENTIFIER ID_ERR_DTC_BPA_0_CTL FORMAT "%5.0"
 /begin AXIS_DESCR COM_AXIS online_dummy _CNV_A_R_LINEAR_____0_CM 6 0. 5. FORMAT "%2.0" AXIS_PTS_REF ldp_fmy_dtc /end AXIS_DESCR
/end CHARACTERISTIC
/begin CHARACTERISTIC fmy_id_bpa_0_ctl.envd "environmental data contents of customer specific freeze frame for diagnosis instance BPA_0_CTL" CURVE 0x85d4a0 _REC_CUR_20_u1_u1 255. _CNV_A_R_LINEAR_____1_CM 0. 255. DISPLAY_IDENTIFIER ID_ERR_ENVD_BPA_0_CTL FORMAT "%3.0"
 /begin AXIS_DESCR COM_AXIS online_dummy _CNV_A_R_LINEAR_____0_CM 8 0. 7. READ_ONLY FORMAT "%2.0" AXIS_PTS_REF ldp_fmy_envd /end AXIS_DESCR
/end CHARACTERISTIC
/begin CHARACTERISTIC fmy_id_bpa_0_ctl.c_err_clas "error class for diagnosis instance BPA_0_CTL" VALUE 0x85d4a8 _REC_VAL_20_u1 255. _CNV_A_R_LINEAR_____1_CM 0. 255. DISPLAY_IDENTIFIER C_ERR_CLAS_BPA_0_CTL FORMAT "%3.0" /end CHARACTERISTIC
/begin CHARACTERISTIC fmy_id_v_bpa_0_bol_ad.dtc[0] "diagnostic trouble codes for diagnosis instance V_BPA_0_BOL_AD" CURVE 0x85d4aa _REC_CUR_20_u2_u2 65535. _CNV_A_R_LINEAR_____1_CM 0. 65535. DISPLAY_IDENTIFIER ID_ERR_DTC_V_BPA_0_BOL_AD FORMAT "%5.0"
 /begin AXIS_DESCR COM_AXIS online_dummy _CNV_A_R_LINEAR_____0_CM 6 0. 5. FORMAT "%2.0" AXIS_PTS_REF ldp_fmy_dtc /end AXIS_DESCR
/end CHARACTERISTIC
/begin CHARACTERISTIC fmy_id_v_bpa_0_bol_ad.envd "environmental data contents of customer specific freeze frame for diagnosis instance V_BPA_0_BOL_AD" CURVE 0x85d4b6 _REC_CUR_20_u1_u1 255. _CNV_A_R_LINEAR_____1_CM 0. 255. DISPLAY_IDENTIFIER ID_ERR_ENVD_V_BPA_0_BOL_AD FORMAT "%3.0"
 /begin AXIS_DESCR COM_AXIS online_dummy _CNV_A_R_LINEAR_____0_CM 8 0. 7. READ_ONLY FORMAT "%2.0" AXIS_PTS_REF ldp_fmy_envd /end AXIS_DESCR
/end CHARACTERISTIC
/begin CHARACTERISTIC fmy_id_v_bpa_0_bol_ad.c_err_clas "error class for diagnosis instance V_BPA_0_BOL_AD" VALUE 0x85d4be _REC_VAL_20_u1 255. _CNV_A_R_LINEAR_____1_CM 0. 255. DISPLAY_IDENTIFIER C_ERR_CLAS_V_BPA_0_BOL_AD FORMAT "%3.0" /end CHARACTERISTIC
/begin CHARACTERISTIC fmy_id_byp_0_ctl.dtc[0] "diagnostic trouble codes for diagnosis instance BYP_0_CTL" CURVE 0x85d4c0 _REC_CUR_20_u2_u2 65535. _CNV_A_R_LINEAR_____1_CM 0. 65535. DISPLAY_IDENTIFIER ID_ERR_DTC_BYP_0_CTL FORMAT "%5.0"
 /begin AXIS_DESCR COM_AXIS online_dummy _CNV_A_R_LINEAR_____0_CM 6 0. 5. FORMAT "%2.0" AXIS_PTS_REF ldp_fmy_dtc /end AXIS_DESCR
/end CHARACTERISTIC
/begin CHARACTERISTIC fmy_id_byp_0_ctl.envd "environmental data contents of customer specific freeze frame for diagnosis instance BYP_0_CTL" CURVE 0x85d4cc _REC_CUR_20_u1_u1 255. _CNV_A_R_LINEAR_____1_CM 0. 255. DISPLAY_IDENTIFIER ID_ERR_ENVD_BYP_0_CTL FORMAT "%3.0"
 /begin AXIS_DESCR COM_AXIS online_dummy _CNV_A_R_LINEAR_____0_CM 8 0. 7. READ_ONLY FORMAT "%2.0" AXIS_PTS_REF ldp_fmy_envd /end AXIS_DESCR
/end CHARACTERISTIC
/begin CHARACTERISTIC fmy_id_byp_0_ctl.c_err_clas "error class for diagnosis instance BYP_0_CTL" VALUE 0x85d4d4 _REC_VAL_20_u1 255. _CNV_A_R_LINEAR_____1_CM 0. 255. DISPLAY_IDENTIFIER C_ERR_CLAS_BYP_0_CTL FORMAT "%3.0" /end CHARACTERISTIC
/begin CHARACTERISTIC fmy_id_v_byp_0_bol_ad.dtc[0] "diagnostic trouble codes for diagnosis instance V_BYP_0_BOL_AD" CURVE 0x85d4d6 _REC_CUR_20_u2_u2 65535. _CNV_A_R_LINEAR_____1_CM 0. 65535. DISPLAY_IDENTIFIER ID_ERR_DTC_V_BYP_0_BOL_AD FORMAT "%5.0"
 /begin AXIS_DESCR COM_AXIS online_dummy _CNV_A_R_LINEAR_____0_CM 6 0. 5. FORMAT "%2.0" AXIS_PTS_REF ldp_fmy_dtc /end AXIS_DESCR
/end CHARACTERISTIC
/begin CHARACTERISTIC fmy_id_v_byp_0_bol_ad.envd "environmental data contents of customer specific freeze frame for diagnosis instance V_BYP_0_BOL_AD" CURVE 0x85d4e2 _REC_CUR_20_u1_u1 255. _CNV_A_R_LINEAR_____1_CM 0. 255. DISPLAY_IDENTIFIER ID_ERR_ENVD_V_BYP_0_BOL_AD FORMAT "%3.0"
 /begin AXIS_DESCR COM_AXIS online_dummy _CNV_A_R_LINEAR_____0_CM 8 0. 7. READ_ONLY FORMAT "%2.0" AXIS_PTS_REF ldp_fmy_envd /end AXIS_DESCR
/end CHARACTERISTIC
/begin CHARACTERISTIC fmy_id_v_byp_0_bol_ad.c_err_clas "error class for diagnosis instance V_BYP_0_BOL_AD" VALUE 0x85d4ea _REC_VAL_20_u1 255. _CNV_A_R_LINEAR_____1_CM 0. 255. DISPLAY_IDENTIFIER C_ERR_CLAS_V_BYP_0_BOL_AD FORMAT "%3.0" /end CHARACTERISTIC
/begin CHARACTERISTIC fmy_id_map_ctl_min.dtc[0] "diagnostic trouble codes for diagnosis instance MAP_CTL_MIN" CURVE 0x85d4ec _REC_CUR_20_u2_u2 65535. _CNV_A_R_LINEAR_____1_CM 0. 65535. DISPLAY_IDENTIFIER ID_ERR_DTC_MAP_CTL_MIN FORMAT "%5.0"
 /begin AXIS_DESCR COM_AXIS online_dummy _CNV_A_R_LINEAR_____0_CM 6 0. 5. FORMAT "%2.0" AXIS_PTS_REF ldp_fmy_dtc /end AXIS_DESCR
/end CHARACTERISTIC
/begin CHARACTERISTIC fmy_id_map_ctl_min.envd "environmental data contents of customer specific freeze frame for diagnosis instance MAP_CTL_MIN" CURVE 0x85d4f8 _REC_CUR_20_u1_u1 255. _CNV_A_R_LINEAR_____1_CM 0. 255. DISPLAY_IDENTIFIER ID_ERR_ENVD_MAP_CTL_MIN FORMAT "%3.0"
 /begin AXIS_DESCR COM_AXIS online_dummy _CNV_A_R_LINEAR_____0_CM 8 0. 7. READ_ONLY FORMAT "%2.0" AXIS_PTS_REF ldp_fmy_envd /end AXIS_DESCR
/end CHARACTERISTIC
/begin CHARACTERISTIC fmy_id_map_ctl_min.c_err_clas "error class for diagnosis instance MAP_CTL_MIN" VALUE 0x85d500 _REC_VAL_20_u1 255. _CNV_A_R_LINEAR_____1_CM 0. 255. DISPLAY_IDENTIFIER C_ERR_CLAS_MAP_CTL_MIN FORMAT "%3.0" /end CHARACTERISTIC
/begin CHARACTERISTIC fmy_id_map_ctl_max.dtc[0] "diagnostic trouble codes for diagnosis instance MAP_CTL_MAX" CURVE 0x85d502 _REC_CUR_20_u2_u2 65535. _CNV_A_R_LINEAR_____1_CM 0. 65535. DISPLAY_IDENTIFIER ID_ERR_DTC_MAP_CTL_MAX FORMAT "%5.0"
 /begin AXIS_DESCR COM_AXIS online_dummy _CNV_A_R_LINEAR_____0_CM 6 0. 5. FORMAT "%2.0" AXIS_PTS_REF ldp_fmy_dtc /end AXIS_DESCR
/end CHARACTERISTIC
/begin CHARACTERISTIC fmy_id_map_ctl_max.envd "environmental data contents of customer specific freeze frame for diagnosis instance MAP_CTL_MAX" CURVE 0x85d50e _REC_CUR_20_u1_u1 255. _CNV_A_R_LINEAR_____1_CM 0. 255. DISPLAY_IDENTIFIER ID_ERR_ENVD_MAP_CTL_MAX FORMAT "%3.0"
 /begin AXIS_DESCR COM_AXIS online_dummy _CNV_A_R_LINEAR_____0_CM 8 0. 7. READ_ONLY FORMAT "%2.0" AXIS_PTS_REF ldp_fmy_envd /end AXIS_DESCR
/end CHARACTERISTIC
/begin CHARACTERISTIC fmy_id_map_ctl_max.c_err_clas "error class for diagnosis instance MAP_CTL_MAX" VALUE 0x85d516 _REC_VAL_20_u1 255. _CNV_A_R_LINEAR_____1_CM 0. 255. DISPLAY_IDENTIFIER C_ERR_CLAS_MAP_CTL_MAX FORMAT "%3.0" /end CHARACTERISTIC
/begin CHARACTERISTIC fmy_id_egr_is_slow_obd.dtc[0] "diagnostic trouble codes for diagnosis instance EGR_IS_SLOW_OBD" CURVE 0x85d518 _REC_CUR_20_u2_u2 65535. _CNV_A_R_LINEAR_____1_CM 0. 65535. DISPLAY_IDENTIFIER ID_ERR_DTC_EGR_IS_SLOW_OBD FORMAT "%5.0"
 /begin AXIS_DESCR COM_AXIS online_dummy _CNV_A_R_LINEAR_____0_CM 6 0. 5. FORMAT "%2.0" AXIS_PTS_REF ldp_fmy_dtc /end AXIS_DESCR
/end CHARACTERISTIC
/begin CHARACTERISTIC fmy_id_egr_is_slow_obd.envd "environmental data contents of customer specific freeze frame for diagnosis instance EGR_IS_SLOW_OBD" CURVE 0x85d524 _REC_CUR_20_u1_u1 255. _CNV_A_R_LINEAR_____1_CM 0. 255. DISPLAY_IDENTIFIER ID_ERR_ENVD_EGR_IS_SLOW_OBD FORMAT "%3.0"
 /begin AXIS_DESCR COM_AXIS online_dummy _CNV_A_R_LINEAR_____0_CM 8 0. 7. READ_ONLY FORMAT "%2.0" AXIS_PTS_REF ldp_fmy_envd /end AXIS_DESCR
/end CHARACTERISTIC
/begin CHARACTERISTIC fmy_id_egr_is_slow_obd.c_err_clas "error class for diagnosis instance EGR_IS_SLOW_OBD" VALUE 0x85d52c _REC_VAL_20_u1 255. _CNV_A_R_LINEAR_____1_CM 0. 255. DISPLAY_IDENTIFIER C_ERR_CLAS_EGR_IS_SLOW_OBD FORMAT "%3.0" /end CHARACTERISTIC
/begin CHARACTERISTIC fmy_id_maf_egr_thr_obd.dtc[0] "diagnostic trouble codes for diagnosis instance MAF_EGR_THR_OBD" CURVE 0x85d52e _REC_CUR_20_u2_u2 65535. _CNV_A_R_LINEAR_____1_CM 0. 65535. DISPLAY_IDENTIFIER ID_ERR_DTC_MAF_EGR_THR_OBD FORMAT "%5.0"
 /begin AXIS_DESCR COM_AXIS online_dummy _CNV_A_R_LINEAR_____0_CM 6 0. 5. FORMAT "%2.0" AXIS_PTS_REF ldp_fmy_dtc /end AXIS_DESCR
/end CHARACTERISTIC
/begin CHARACTERISTIC fmy_id_maf_egr_thr_obd.envd "environmental data contents of customer specific freeze frame for diagnosis instance MAF_EGR_THR_OBD" CURVE 0x85d53a _REC_CUR_20_u1_u1 255. _CNV_A_R_LINEAR_____1_CM 0. 255. DISPLAY_IDENTIFIER ID_ERR_ENVD_MAF_EGR_THR_OBD FORMAT "%3.0"
 /begin AXIS_DESCR COM_AXIS online_dummy _CNV_A_R_LINEAR_____0_CM 8 0. 7. READ_ONLY FORMAT "%2.0" AXIS_PTS_REF ldp_fmy_envd /end AXIS_DESCR
/end CHARACTERISTIC
/begin CHARACTERISTIC fmy_id_maf_egr_thr_obd.c_err_clas "error class for diagnosis instance MAF_EGR_THR_OBD" VALUE 0x85d542 _REC_VAL_20_u1 255. _CNV_A_R_LINEAR_____1_CM 0. 255. DISPLAY_IDENTIFIER C_ERR_CLAS_MAF_EGR_THR_OBD FORMAT "%3.0" /end CHARACTERISTIC
/begin CHARACTERISTIC fmy_id_maf_dif_egr_thr_obd.dtc[0] "diagnostic trouble codes for diagnosis instance MAF_DIF_EGR_THR_OBD" CURVE 0x85d544 _REC_CUR_20_u2_u2 65535. _CNV_A_R_LINEAR_____1_CM 0. 65535. DISPLAY_IDENTIFIER ID_ERR_DTC_MAF_DIF_EGR_THR_OBD FORMAT "%5.0"
 /begin AXIS_DESCR COM_AXIS online_dummy _CNV_A_R_LINEAR_____0_CM 6 0. 5. FORMAT "%2.0" AXIS_PTS_REF ldp_fmy_dtc /end AXIS_DESCR
/end CHARACTERISTIC
/begin CHARACTERISTIC fmy_id_maf_dif_egr_thr_obd.envd "environmental data contents of customer specific freeze frame for diagnosis instance MAF_DIF_EGR_THR_OBD" CURVE 0x85d550 _REC_CUR_20_u1_u1 255. _CNV_A_R_LINEAR_____1_CM 0. 255. DISPLAY_IDENTIFIER ID_ERR_ENVD_MAF_DIF_EGR_THR_OBD FORMAT "%3.0"
 /begin AXIS_DESCR COM_AXIS online_dummy _CNV_A_R_LINEAR_____0_CM 8 0. 7. READ_ONLY FORMAT "%2.0" AXIS_PTS_REF ldp_fmy_envd /end AXIS_DESCR
/end CHARACTERISTIC
/begin CHARACTERISTIC fmy_id_maf_dif_egr_thr_obd.c_err_clas "error class for diagnosis instance MAF_DIF_EGR_THR_OBD" VALUE 0x85d558 _REC_VAL_20_u1 255. _CNV_A_R_LINEAR_____1_CM 0. 255. DISPLAY_IDENTIFIER C_ERR_CLAS_MAF_DIF_EGR_THR_OBD FORMAT "%3.0" /end CHARACTERISTIC
/begin CHARACTERISTIC fmy_id_map_dif_egr_thr_obd.dtc[0] "diagnostic trouble codes for diagnosis instance MAP_DIF_EGR_THR_OBD" CURVE 0x85d55a _REC_CUR_20_u2_u2 65535. _CNV_A_R_LINEAR_____1_CM 0. 65535. DISPLAY_IDENTIFIER ID_ERR_DTC_MAP_DIF_EGR_THR_OBD FORMAT "%5.0"
 /begin AXIS_DESCR COM_AXIS online_dummy _CNV_A_R_LINEAR_____0_CM 6 0. 5. FORMAT "%2.0" AXIS_PTS_REF ldp_fmy_dtc /end AXIS_DESCR
/end CHARACTERISTIC
/begin CHARACTERISTIC fmy_id_map_dif_egr_thr_obd.envd "environmental data contents of customer specific freeze frame for diagnosis instance MAP_DIF_EGR_THR_OBD" CURVE 0x85d566 _REC_CUR_20_u1_u1 255. _CNV_A_R_LINEAR_____1_CM 0. 255. DISPLAY_IDENTIFIER ID_ERR_ENVD_MAP_DIF_EGR_THR_OBD FORMAT "%3.0"
 /begin AXIS_DESCR COM_AXIS online_dummy _CNV_A_R_LINEAR_____0_CM 8 0. 7. READ_ONLY FORMAT "%2.0" AXIS_PTS_REF ldp_fmy_envd /end AXIS_DESCR
/end CHARACTERISTIC
/begin CHARACTERISTIC fmy_id_map_dif_egr_thr_obd.c_err_clas "error class for diagnosis instance MAP_DIF_EGR_THR_OBD" VALUE 0x85d56e _REC_VAL_20_u1 255. _CNV_A_R_LINEAR_____1_CM 0. 255. DISPLAY_IDENTIFIER C_ERR_CLAS_MAP_DIF_EGR_THR_OBD FORMAT "%3.0" /end CHARACTERISTIC
/begin CHARACTERISTIC fmy_id_vs.dtc[0] "diagnostic trouble codes for diagnosis instance VS" CURVE 0x85d570 _REC_CUR_20_u2_u2 65535. _CNV_A_R_LINEAR_____1_CM 0. 65535. DISPLAY_IDENTIFIER ID_ERR_DTC_VS FORMAT "%5.0"
 /begin AXIS_DESCR COM_AXIS online_dummy _CNV_A_R_LINEAR_____0_CM 6 0. 5. FORMAT "%2.0" AXIS_PTS_REF ldp_fmy_dtc /end AXIS_DESCR
/end CHARACTERISTIC
/begin CHARACTERISTIC fmy_id_vs.envd "environmental data contents of customer specific freeze frame for diagnosis instance VS" CURVE 0x85d57c _REC_CUR_20_u1_u1 255. _CNV_A_R_LINEAR_____1_CM 0. 255. DISPLAY_IDENTIFIER ID_ERR_ENVD_VS FORMAT "%3.0"
 /begin AXIS_DESCR COM_AXIS online_dummy _CNV_A_R_LINEAR_____0_CM 8 0. 7. READ_ONLY FORMAT "%2.0" AXIS_PTS_REF ldp_fmy_envd /end AXIS_DESCR
/end CHARACTERISTIC
/begin CHARACTERISTIC fmy_id_vs.c_err_clas "error class for diagnosis instance VS" VALUE 0x85d584 _REC_VAL_20_u1 255. _CNV_A_R_LINEAR_____1_CM 0. 255. DISPLAY_IDENTIFIER C_ERR_CLAS_VS FORMAT "%3.0" /end CHARACTERISTIC
/begin CHARACTERISTIC fmy_id_cs.dtc[0] "diagnostic trouble codes for diagnosis instance CS" CURVE 0x85d586 _REC_CUR_20_u2_u2 65535. _CNV_A_R_LINEAR_____1_CM 0. 65535. DISPLAY_IDENTIFIER ID_ERR_DTC_CS FORMAT "%5.0"
 /begin AXIS_DESCR COM_AXIS online_dummy _CNV_A_R_LINEAR_____0_CM 6 0. 5. FORMAT "%2.0" AXIS_PTS_REF ldp_fmy_dtc /end AXIS_DESCR
/end CHARACTERISTIC
/begin CHARACTERISTIC fmy_id_cs.envd "environmental data contents of customer specific freeze frame for diagnosis instance CS" CURVE 0x85d592 _REC_CUR_20_u1_u1 255. _CNV_A_R_LINEAR_____1_CM 0. 255. DISPLAY_IDENTIFIER ID_ERR_ENVD_CS FORMAT "%3.0"
 /begin AXIS_DESCR COM_AXIS online_dummy _CNV_A_R_LINEAR_____0_CM 8 0. 7. READ_ONLY FORMAT "%2.0" AXIS_PTS_REF ldp_fmy_envd /end AXIS_DESCR
/end CHARACTERISTIC
/begin CHARACTERISTIC fmy_id_cs.c_err_clas "error class for diagnosis instance CS" VALUE 0x85d59a _REC_VAL_20_u1 255. _CNV_A_R_LINEAR_____1_CM 0. 255. DISPLAY_IDENTIFIER C_ERR_CLAS_CS FORMAT "%3.0" /end CHARACTERISTIC
/begin CHARACTERISTIC fmy_id_bls.dtc[0] "diagnostic trouble codes for diagnosis instance BLS" CURVE 0x85d59c _REC_CUR_20_u2_u2 65535. _CNV_A_R_LINEAR_____1_CM 0. 65535. DISPLAY_IDENTIFIER ID_ERR_DTC_BLS FORMAT "%5.0"
 /begin AXIS_DESCR COM_AXIS online_dummy _CNV_A_R_LINEAR_____0_CM 6 0. 5. FORMAT "%2.0" AXIS_PTS_REF ldp_fmy_dtc /end AXIS_DESCR
/end CHARACTERISTIC
/begin CHARACTERISTIC fmy_id_bls.envd "environmental data contents of customer specific freeze frame for diagnosis instance BLS" CURVE 0x85d5a8 _REC_CUR_20_u1_u1 255. _CNV_A_R_LINEAR_____1_CM 0. 255. DISPLAY_IDENTIFIER ID_ERR_ENVD_BLS FORMAT "%3.0"
 /begin AXIS_DESCR COM_AXIS online_dummy _CNV_A_R_LINEAR_____0_CM 8 0. 7. READ_ONLY FORMAT "%2.0" AXIS_PTS_REF ldp_fmy_envd /end AXIS_DESCR
/end CHARACTERISTIC
/begin CHARACTERISTIC fmy_id_bls.c_err_clas "error class for diagnosis instance BLS" VALUE 0x85d5b0 _REC_VAL_20_u1 255. _CNV_A_R_LINEAR_____1_CM 0. 255. DISPLAY_IDENTIFIER C_ERR_CLAS_BLS FORMAT "%3.0" /end CHARACTERISTIC
/begin CHARACTERISTIC fmy_id_bls_bts_dece.dtc[0] "diagnostic trouble codes for diagnosis instance BLS_BTS_DECE" CURVE 0x85d5b2 _REC_CUR_20_u2_u2 65535. _CNV_A_R_LINEAR_____1_CM 0. 65535. DISPLAY_IDENTIFIER ID_ERR_DTC_BLS_BTS_DECE FORMAT "%5.0"
 /begin AXIS_DESCR COM_AXIS online_dummy _CNV_A_R_LINEAR_____0_CM 6 0. 5. FORMAT "%2.0" AXIS_PTS_REF ldp_fmy_dtc /end AXIS_DESCR
/end CHARACTERISTIC
/begin CHARACTERISTIC fmy_id_bls_bts_dece.envd "environmental data contents of customer specific freeze frame for diagnosis instance BLS_BTS_DECE" CURVE 0x85d5be _REC_CUR_20_u1_u1 255. _CNV_A_R_LINEAR_____1_CM 0. 255. DISPLAY_IDENTIFIER ID_ERR_ENVD_BLS_BTS_DECE FORMAT "%3.0"
 /begin AXIS_DESCR COM_AXIS online_dummy _CNV_A_R_LINEAR_____0_CM 8 0. 7. READ_ONLY FORMAT "%2.0" AXIS_PTS_REF ldp_fmy_envd /end AXIS_DESCR
/end CHARACTERISTIC
/begin CHARACTERISTIC fmy_id_bls_bts_dece.c_err_clas "error class for diagnosis instance BLS_BTS_DECE" VALUE 0x85d5c6 _REC_VAL_20_u1 255. _CNV_A_R_LINEAR_____1_CM 0. 255. DISPLAY_IDENTIFIER C_ERR_CLAS_BLS_BTS_DECE FORMAT "%3.0" /end CHARACTERISTIC
/begin CHARACTERISTIC fmy_id_bls_bts_plaus.dtc[0] "diagnostic trouble codes for diagnosis instance BLS_BTS_PLAUS" CURVE 0x85d5c8 _REC_CUR_20_u2_u2 65535. _CNV_A_R_LINEAR_____1_CM 0. 65535. DISPLAY_IDENTIFIER ID_ERR_DTC_BLS_BTS_PLAUS FORMAT "%5.0"
 /begin AXIS_DESCR COM_AXIS online_dummy _CNV_A_R_LINEAR_____0_CM 6 0. 5. FORMAT "%2.0" AXIS_PTS_REF ldp_fmy_dtc /end AXIS_DESCR
/end CHARACTERISTIC
/begin CHARACTERISTIC fmy_id_bls_bts_plaus.envd "environmental data contents of customer specific freeze frame for diagnosis instance BLS_BTS_PLAUS" CURVE 0x85d5d4 _REC_CUR_20_u1_u1 255. _CNV_A_R_LINEAR_____1_CM 0. 255. DISPLAY_IDENTIFIER ID_ERR_ENVD_BLS_BTS_PLAUS FORMAT "%3.0"
 /begin AXIS_DESCR COM_AXIS online_dummy _CNV_A_R_LINEAR_____0_CM 8 0. 7. READ_ONLY FORMAT "%2.0" AXIS_PTS_REF ldp_fmy_envd /end AXIS_DESCR
/end CHARACTERISTIC
/begin CHARACTERISTIC fmy_id_bls_bts_plaus.c_err_clas "error class for diagnosis instance BLS_BTS_PLAUS" VALUE 0x85d5dc _REC_VAL_20_u1 255. _CNV_A_R_LINEAR_____1_CM 0. 255. DISPLAY_IDENTIFIER C_ERR_CLAS_BLS_BTS_PLAUS FORMAT "%3.0" /end CHARACTERISTIC
/begin CHARACTERISTIC fmy_id_can_tcs.dtc[0] "diagnostic trouble codes for diagnosis instance CAN_TCS" CURVE 0x85d5de _REC_CUR_20_u2_u2 65535. _CNV_A_R_LINEAR_____1_CM 0. 65535. DISPLAY_IDENTIFIER ID_ERR_DTC_CAN_TCS FORMAT "%5.0"
 /begin AXIS_DESCR COM_AXIS online_dummy _CNV_A_R_LINEAR_____0_CM 6 0. 5. FORMAT "%2.0" AXIS_PTS_REF ldp_fmy_dtc /end AXIS_DESCR
/end CHARACTERISTIC
/begin CHARACTERISTIC fmy_id_can_tcs.envd "environmental data contents of customer specific freeze frame for diagnosis instance CAN_TCS" CURVE 0x85d5ea _REC_CUR_20_u1_u1 255. _CNV_A_R_LINEAR_____1_CM 0. 255. DISPLAY_IDENTIFIER ID_ERR_ENVD_CAN_TCS FORMAT "%3.0"
 /begin AXIS_DESCR COM_AXIS online_dummy _CNV_A_R_LINEAR_____0_CM 8 0. 7. READ_ONLY FORMAT "%2.0" AXIS_PTS_REF ldp_fmy_envd /end AXIS_DESCR
/end CHARACTERISTIC
/begin CHARACTERISTIC fmy_id_can_tcs.c_err_clas "error class for diagnosis instance CAN_TCS" VALUE 0x85d5f2 _REC_VAL_20_u1 255. _CNV_A_R_LINEAR_____1_CM 0. 255. DISPLAY_IDENTIFIER C_ERR_CLAS_CAN_TCS FORMAT "%3.0" /end CHARACTERISTIC
/begin CHARACTERISTIC fmy_id_can_tcu.dtc[0] "diagnostic trouble codes for diagnosis instance CAN_TCU" CURVE 0x85d5f4 _REC_CUR_20_u2_u2 65535. _CNV_A_R_LINEAR_____1_CM 0. 65535. DISPLAY_IDENTIFIER ID_ERR_DTC_CAN_TCU FORMAT "%5.0"
 /begin AXIS_DESCR COM_AXIS online_dummy _CNV_A_R_LINEAR_____0_CM 6 0. 5. FORMAT "%2.0" AXIS_PTS_REF ldp_fmy_dtc /end AXIS_DESCR
/end CHARACTERISTIC
/begin CHARACTERISTIC fmy_id_can_tcu.envd "environmental data contents of customer specific freeze frame for diagnosis instance CAN_TCU" CURVE 0x85d600 _REC_CUR_20_u1_u1 255. _CNV_A_R_LINEAR_____1_CM 0. 255. DISPLAY_IDENTIFIER ID_ERR_ENVD_CAN_TCU FORMAT "%3.0"
 /begin AXIS_DESCR COM_AXIS online_dummy _CNV_A_R_LINEAR_____0_CM 8 0. 7. READ_ONLY FORMAT "%2.0" AXIS_PTS_REF ldp_fmy_envd /end AXIS_DESCR
/end CHARACTERISTIC
/begin CHARACTERISTIC fmy_id_can_tcu.c_err_clas "error class for diagnosis instance CAN_TCU" VALUE 0x85d608 _REC_VAL_20_u1 255. _CNV_A_R_LINEAR_____1_CM 0. 255. DISPLAY_IDENTIFIER C_ERR_CLAS_CAN_TCU FORMAT "%3.0" /end CHARACTERISTIC
/begin CHARACTERISTIC fmy_id_can_acu.dtc[0] "diagnostic trouble codes for diagnosis instance CAN_ACU" CURVE 0x85d60a _REC_CUR_20_u2_u2 65535. _CNV_A_R_LINEAR_____1_CM 0. 65535. DISPLAY_IDENTIFIER ID_ERR_DTC_CAN_ACU FORMAT "%5.0"
 /begin AXIS_DESCR COM_AXIS online_dummy _CNV_A_R_LINEAR_____0_CM 6 0. 5. FORMAT "%2.0" AXIS_PTS_REF ldp_fmy_dtc /end AXIS_DESCR
/end CHARACTERISTIC
/begin CHARACTERISTIC fmy_id_can_acu.envd "environmental data contents of customer specific freeze frame for diagnosis instance CAN_ACU" CURVE 0x85d616 _REC_CUR_20_u1_u1 255. _CNV_A_R_LINEAR_____1_CM 0. 255. DISPLAY_IDENTIFIER ID_ERR_ENVD_CAN_ACU FORMAT "%3.0"
 /begin AXIS_DESCR COM_AXIS online_dummy _CNV_A_R_LINEAR_____0_CM 8 0. 7. READ_ONLY FORMAT "%2.0" AXIS_PTS_REF ldp_fmy_envd /end AXIS_DESCR
/end CHARACTERISTIC
/begin CHARACTERISTIC fmy_id_can_acu.c_err_clas "error class for diagnosis instance CAN_ACU" VALUE 0x85d61e _REC_VAL_20_u1 255. _CNV_A_R_LINEAR_____1_CM 0. 255. DISPLAY_IDENTIFIER C_ERR_CLAS_CAN_ACU FORMAT "%3.0" /end CHARACTERISTIC
/begin CHARACTERISTIC fmy_id_can_ccu.dtc[0] "diagnostic trouble codes for diagnosis instance CAN_CCU" CURVE 0x85d620 _REC_CUR_20_u2_u2 65535. _CNV_A_R_LINEAR_____1_CM 0. 65535. DISPLAY_IDENTIFIER ID_ERR_DTC_CAN_CCU FORMAT "%5.0"
 /begin AXIS_DESCR COM_AXIS online_dummy _CNV_A_R_LINEAR_____0_CM 6 0. 5. FORMAT "%2.0" AXIS_PTS_REF ldp_fmy_dtc /end AXIS_DESCR
/end CHARACTERISTIC
/begin CHARACTERISTIC fmy_id_can_ccu.envd "environmental data contents of customer specific freeze frame for diagnosis instance CAN_CCU" CURVE 0x85d62c _REC_CUR_20_u1_u1 255. _CNV_A_R_LINEAR_____1_CM 0. 255. DISPLAY_IDENTIFIER ID_ERR_ENVD_CAN_CCU FORMAT "%3.0"
 /begin AXIS_DESCR COM_AXIS online_dummy _CNV_A_R_LINEAR_____0_CM 8 0. 7. READ_ONLY FORMAT "%2.0" AXIS_PTS_REF ldp_fmy_envd /end AXIS_DESCR
/end CHARACTERISTIC
/begin CHARACTERISTIC fmy_id_can_ccu.c_err_clas "error class for diagnosis instance CAN_CCU" VALUE 0x85d634 _REC_VAL_20_u1 255. _CNV_A_R_LINEAR_____1_CM 0. 255. DISPLAY_IDENTIFIER C_ERR_CLAS_CAN_CCU FORMAT "%3.0" /end CHARACTERISTIC
/begin CHARACTERISTIC fmy_id_can_icl.dtc[0] "diagnostic trouble codes for diagnosis instance CAN_ICL" CURVE 0x85d636 _REC_CUR_20_u2_u2 65535. _CNV_A_R_LINEAR_____1_CM 0. 65535. DISPLAY_IDENTIFIER ID_ERR_DTC_CAN_ICL FORMAT "%5.0"
 /begin AXIS_DESCR COM_AXIS online_dummy _CNV_A_R_LINEAR_____0_CM 6 0. 5. FORMAT "%2.0" AXIS_PTS_REF ldp_fmy_dtc /end AXIS_DESCR
/end CHARACTERISTIC
/begin CHARACTERISTIC fmy_id_can_icl.envd "environmental data contents of customer specific freeze frame for diagnosis instance CAN_ICL" CURVE 0x85d642 _REC_CUR_20_u1_u1 255. _CNV_A_R_LINEAR_____1_CM 0. 255. DISPLAY_IDENTIFIER ID_ERR_ENVD_CAN_ICL FORMAT "%3.0"
 /begin AXIS_DESCR COM_AXIS online_dummy _CNV_A_R_LINEAR_____0_CM 8 0. 7. READ_ONLY FORMAT "%2.0" AXIS_PTS_REF ldp_fmy_envd /end AXIS_DESCR
/end CHARACTERISTIC
/begin CHARACTERISTIC fmy_id_can_icl.c_err_clas "error class for diagnosis instance CAN_ICL" VALUE 0x85d64a _REC_VAL_20_u1 255. _CNV_A_R_LINEAR_____1_CM 0. 255. DISPLAY_IDENTIFIER C_ERR_CLAS_CAN_ICL FORMAT "%3.0" /end CHARACTERISTIC
/begin CHARACTERISTIC fmy_id_can_vecu.dtc[0] "diagnostic trouble codes for diagnosis instance CAN_VECU" CURVE 0x85d64c _REC_CUR_20_u2_u2 65535. _CNV_A_R_LINEAR_____1_CM 0. 65535. DISPLAY_IDENTIFIER ID_ERR_DTC_CAN_VECU FORMAT "%5.0"
 /begin AXIS_DESCR COM_AXIS online_dummy _CNV_A_R_LINEAR_____0_CM 6 0. 5. FORMAT "%2.0" AXIS_PTS_REF ldp_fmy_dtc /end AXIS_DESCR
/end CHARACTERISTIC
/begin CHARACTERISTIC fmy_id_can_vecu.envd "environmental data contents of customer specific freeze frame for diagnosis instance CAN_VECU" CURVE 0x85d658 _REC_CUR_20_u1_u1 255. _CNV_A_R_LINEAR_____1_CM 0. 255. DISPLAY_IDENTIFIER ID_ERR_ENVD_CAN_VECU FORMAT "%3.0"
 /begin AXIS_DESCR COM_AXIS online_dummy _CNV_A_R_LINEAR_____0_CM 8 0. 7. READ_ONLY FORMAT "%2.0" AXIS_PTS_REF ldp_fmy_envd /end AXIS_DESCR
/end CHARACTERISTIC
/begin CHARACTERISTIC fmy_id_can_vecu.c_err_clas "error class for diagnosis instance CAN_VECU" VALUE 0x85d660 _REC_VAL_20_u1 255. _CNV_A_R_LINEAR_____1_CM 0. 255. DISPLAY_IDENTIFIER C_ERR_CLAS_CAN_VECU FORMAT "%3.0" /end CHARACTERISTIC
/begin CHARACTERISTIC fmy_id_can_smls.dtc[0] "diagnostic trouble codes for diagnosis instance CAN_SMLS" CURVE 0x85d662 _REC_CUR_20_u2_u2 65535. _CNV_A_R_LINEAR_____1_CM 0. 65535. DISPLAY_IDENTIFIER ID_ERR_DTC_CAN_SMLS FORMAT "%5.0"
 /begin AXIS_DESCR COM_AXIS online_dummy _CNV_A_R_LINEAR_____0_CM 6 0. 5. FORMAT "%2.0" AXIS_PTS_REF ldp_fmy_dtc /end AXIS_DESCR
/end CHARACTERISTIC
/begin CHARACTERISTIC fmy_id_can_smls.envd "environmental data contents of customer specific freeze frame for diagnosis instance CAN_SMLS" CURVE 0x85d66e _REC_CUR_20_u1_u1 255. _CNV_A_R_LINEAR_____1_CM 0. 255. DISPLAY_IDENTIFIER ID_ERR_ENVD_CAN_SMLS FORMAT "%3.0"
 /begin AXIS_DESCR COM_AXIS online_dummy _CNV_A_R_LINEAR_____0_CM 8 0. 7. READ_ONLY FORMAT "%2.0" AXIS_PTS_REF ldp_fmy_envd /end AXIS_DESCR
/end CHARACTERISTIC
/begin CHARACTERISTIC fmy_id_can_smls.c_err_clas "error class for diagnosis instance CAN_SMLS" VALUE 0x85d676 _REC_VAL_20_u1 255. _CNV_A_R_LINEAR_____1_CM 0. 255. DISPLAY_IDENTIFIER C_ERR_CLAS_CAN_SMLS FORMAT "%3.0" /end CHARACTERISTIC
/begin CHARACTERISTIC fmy_id_can_boff.dtc[0] "diagnostic trouble codes for diagnosis instance CAN_BOFF" CURVE 0x85d678 _REC_CUR_20_u2_u2 65535. _CNV_A_R_LINEAR_____1_CM 0. 65535. DISPLAY_IDENTIFIER ID_ERR_DTC_CAN_BOFF FORMAT "%5.0"
 /begin AXIS_DESCR COM_AXIS online_dummy _CNV_A_R_LINEAR_____0_CM 6 0. 5. FORMAT "%2.0" AXIS_PTS_REF ldp_fmy_dtc /end AXIS_DESCR
/end CHARACTERISTIC
/begin CHARACTERISTIC fmy_id_can_boff.envd "environmental data contents of customer specific freeze frame for diagnosis instance CAN_BOFF" CURVE 0x85d684 _REC_CUR_20_u1_u1 255. _CNV_A_R_LINEAR_____1_CM 0. 255. DISPLAY_IDENTIFIER ID_ERR_ENVD_CAN_BOFF FORMAT "%3.0"
 /begin AXIS_DESCR COM_AXIS online_dummy _CNV_A_R_LINEAR_____0_CM 8 0. 7. READ_ONLY FORMAT "%2.0" AXIS_PTS_REF ldp_fmy_envd /end AXIS_DESCR
/end CHARACTERISTIC
/begin CHARACTERISTIC fmy_id_can_boff.c_err_clas "error class for diagnosis instance CAN_BOFF" VALUE 0x85d68c _REC_VAL_20_u1 255. _CNV_A_R_LINEAR_____1_CM 0. 255. DISPLAY_IDENTIFIER C_ERR_CLAS_CAN_BOFF FORMAT "%3.0" /end CHARACTERISTIC
/begin CHARACTERISTIC fmy_id_can_if_cft.dtc[0] "diagnostic trouble codes for diagnosis instance CAN_IF_CFT" CURVE 0x85d68e _REC_CUR_20_u2_u2 65535. _CNV_A_R_LINEAR_____1_CM 0. 65535. DISPLAY_IDENTIFIER ID_ERR_DTC_CAN_IF_CFT FORMAT "%5.0"
 /begin AXIS_DESCR COM_AXIS online_dummy _CNV_A_R_LINEAR_____0_CM 6 0. 5. FORMAT "%2.0" AXIS_PTS_REF ldp_fmy_dtc /end AXIS_DESCR
/end CHARACTERISTIC
/begin CHARACTERISTIC fmy_id_can_if_cft.envd "environmental data contents of customer specific freeze frame for diagnosis instance CAN_IF_CFT" CURVE 0x85d69a _REC_CUR_20_u1_u1 255. _CNV_A_R_LINEAR_____1_CM 0. 255. DISPLAY_IDENTIFIER ID_ERR_ENVD_CAN_IF_CFT FORMAT "%3.0"
 /begin AXIS_DESCR COM_AXIS online_dummy _CNV_A_R_LINEAR_____0_CM 8 0. 7. READ_ONLY FORMAT "%2.0" AXIS_PTS_REF ldp_fmy_envd /end AXIS_DESCR
/end CHARACTERISTIC
/begin CHARACTERISTIC fmy_id_can_if_cft.c_err_clas "error class for diagnosis instance CAN_IF_CFT" VALUE 0x85d6a2 _REC_VAL_20_u1 255. _CNV_A_R_LINEAR_____1_CM 0. 255. DISPLAY_IDENTIFIER C_ERR_CLAS_CAN_IF_CFT FORMAT "%3.0" /end CHARACTERISTIC
/begin CHARACTERISTIC fmy_id_can_eilu.dtc[0] "diagnostic trouble codes for diagnosis instance CAN_EILU" CURVE 0x85d6a4 _REC_CUR_20_u2_u2 65535. _CNV_A_R_LINEAR_____1_CM 0. 65535. DISPLAY_IDENTIFIER ID_ERR_DTC_CAN_EILU FORMAT "%5.0"
 /begin AXIS_DESCR COM_AXIS online_dummy _CNV_A_R_LINEAR_____0_CM 6 0. 5. FORMAT "%2.0" AXIS_PTS_REF ldp_fmy_dtc /end AXIS_DESCR
/end CHARACTERISTIC
/begin CHARACTERISTIC fmy_id_can_eilu.envd "environmental data contents of customer specific freeze frame for diagnosis instance CAN_EILU" CURVE 0x85d6b0 _REC_CUR_20_u1_u1 255. _CNV_A_R_LINEAR_____1_CM 0. 255. DISPLAY_IDENTIFIER ID_ERR_ENVD_CAN_EILU FORMAT "%3.0"
 /begin AXIS_DESCR COM_AXIS online_dummy _CNV_A_R_LINEAR_____0_CM 8 0. 7. READ_ONLY FORMAT "%2.0" AXIS_PTS_REF ldp_fmy_envd /end AXIS_DESCR
/end CHARACTERISTIC
/begin CHARACTERISTIC fmy_id_can_eilu.c_err_clas "error class for diagnosis instance CAN_EILU" VALUE 0x85d6b8 _REC_VAL_20_u1 255. _CNV_A_R_LINEAR_____1_CM 0. 255. DISPLAY_IDENTIFIER C_ERR_CLAS_CAN_EILU FORMAT "%3.0" /end CHARACTERISTIC
/begin CHARACTERISTIC fmy_id_can_dcc.dtc[0] "diagnostic trouble codes for diagnosis instance CAN_DCC" CURVE 0x85d6ba _REC_CUR_20_u2_u2 65535. _CNV_A_R_LINEAR_____1_CM 0. 65535. DISPLAY_IDENTIFIER ID_ERR_DTC_CAN_DCC FORMAT "%5.0"
 /begin AXIS_DESCR COM_AXIS online_dummy _CNV_A_R_LINEAR_____0_CM 6 0. 5. FORMAT "%2.0" AXIS_PTS_REF ldp_fmy_dtc /end AXIS_DESCR
/end CHARACTERISTIC
/begin CHARACTERISTIC fmy_id_can_dcc.envd "environmental data contents of customer specific freeze frame for diagnosis instance CAN_DCC" CURVE 0x85d6c6 _REC_CUR_20_u1_u1 255. _CNV_A_R_LINEAR_____1_CM 0. 255. DISPLAY_IDENTIFIER ID_ERR_ENVD_CAN_DCC FORMAT "%3.0"
 /begin AXIS_DESCR COM_AXIS online_dummy _CNV_A_R_LINEAR_____0_CM 8 0. 7. READ_ONLY FORMAT "%2.0" AXIS_PTS_REF ldp_fmy_envd /end AXIS_DESCR
/end CHARACTERISTIC
/begin CHARACTERISTIC fmy_id_can_dcc.c_err_clas "error class for diagnosis instance CAN_DCC" VALUE 0x85d6ce _REC_VAL_20_u1 255. _CNV_A_R_LINEAR_____1_CM 0. 255. DISPLAY_IDENTIFIER C_ERR_CLAS_CAN_DCC FORMAT "%3.0" /end CHARACTERISTIC
/begin CHARACTERISTIC fmy_id_can_whl.dtc[0] "diagnostic trouble codes for diagnosis instance CAN_WHL" CURVE 0x85d6d0 _REC_CUR_20_u2_u2 65535. _CNV_A_R_LINEAR_____1_CM 0. 65535. DISPLAY_IDENTIFIER ID_ERR_DTC_CAN_WHL FORMAT "%5.0"
 /begin AXIS_DESCR COM_AXIS online_dummy _CNV_A_R_LINEAR_____0_CM 6 0. 5. FORMAT "%2.0" AXIS_PTS_REF ldp_fmy_dtc /end AXIS_DESCR
/end CHARACTERISTIC
/begin CHARACTERISTIC fmy_id_can_whl.envd "environmental data contents of customer specific freeze frame for diagnosis instance CAN_WHL" CURVE 0x85d6dc _REC_CUR_20_u1_u1 255. _CNV_A_R_LINEAR_____1_CM 0. 255. DISPLAY_IDENTIFIER ID_ERR_ENVD_CAN_WHL FORMAT "%3.0"
 /begin AXIS_DESCR COM_AXIS online_dummy _CNV_A_R_LINEAR_____0_CM 8 0. 7. READ_ONLY FORMAT "%2.0" AXIS_PTS_REF ldp_fmy_envd /end AXIS_DESCR
/end CHARACTERISTIC
/begin CHARACTERISTIC fmy_id_can_whl.c_err_clas "error class for diagnosis instance CAN_WHL" VALUE 0x85d6e4 _REC_VAL_20_u1 255. _CNV_A_R_LINEAR_____1_CM 0. 255. DISPLAY_IDENTIFIER C_ERR_CLAS_CAN_WHL FORMAT "%3.0" /end CHARACTERISTIC
/begin CHARACTERISTIC fmy_id_can_sys_info.dtc[0] "diagnostic trouble codes for diagnosis instance CAN_SYS_INFO" CURVE 0x85d6e6 _REC_CUR_20_u2_u2 65535. _CNV_A_R_LINEAR_____1_CM 0. 65535. DISPLAY_IDENTIFIER ID_ERR_DTC_CAN_SYS_INFO FORMAT "%5.0"
 /begin AXIS_DESCR COM_AXIS online_dummy _CNV_A_R_LINEAR_____0_CM 6 0. 5. FORMAT "%2.0" AXIS_PTS_REF ldp_fmy_dtc /end AXIS_DESCR
/end CHARACTERISTIC
/begin CHARACTERISTIC fmy_id_can_sys_info.envd "environmental data contents of customer specific freeze frame for diagnosis instance CAN_SYS_INFO" CURVE 0x85d6f2 _REC_CUR_20_u1_u1 255. _CNV_A_R_LINEAR_____1_CM 0. 255. DISPLAY_IDENTIFIER ID_ERR_ENVD_CAN_SYS_INFO FORMAT "%3.0"
 /begin AXIS_DESCR COM_AXIS online_dummy _CNV_A_R_LINEAR_____0_CM 8 0. 7. READ_ONLY FORMAT "%2.0" AXIS_PTS_REF ldp_fmy_envd /end AXIS_DESCR
/end CHARACTERISTIC
/begin CHARACTERISTIC fmy_id_can_sys_info.c_err_clas "error class for diagnosis instance CAN_SYS_INFO" VALUE 0x85d6fa _REC_VAL_20_u1 255. _CNV_A_R_LINEAR_____1_CM 0. 255. DISPLAY_IDENTIFIER C_ERR_CLAS_CAN_SYS_INFO FORMAT "%3.0" /end CHARACTERISTIC
/begin CHARACTERISTIC fmy_id_can_nom_sys.dtc[0] "diagnostic trouble codes for diagnosis instance CAN_NOM_SYS" CURVE 0x85d6fc _REC_CUR_20_u2_u2 65535. _CNV_A_R_LINEAR_____1_CM 0. 65535. DISPLAY_IDENTIFIER ID_ERR_DTC_CAN_NOM_SYS FORMAT "%5.0"
 /begin AXIS_DESCR COM_AXIS online_dummy _CNV_A_R_LINEAR_____0_CM 6 0. 5. FORMAT "%2.0" AXIS_PTS_REF ldp_fmy_dtc /end AXIS_DESCR
/end CHARACTERISTIC
/begin CHARACTERISTIC fmy_id_can_nom_sys.envd "environmental data contents of customer specific freeze frame for diagnosis instance CAN_NOM_SYS" CURVE 0x85d708 _REC_CUR_20_u1_u1 255. _CNV_A_R_LINEAR_____1_CM 0. 255. DISPLAY_IDENTIFIER ID_ERR_ENVD_CAN_NOM_SYS FORMAT "%3.0"
 /begin AXIS_DESCR COM_AXIS online_dummy _CNV_A_R_LINEAR_____0_CM 8 0. 7. READ_ONLY FORMAT "%2.0" AXIS_PTS_REF ldp_fmy_envd /end AXIS_DESCR
/end CHARACTERISTIC
/begin CHARACTERISTIC fmy_id_can_nom_sys.c_err_clas "error class for diagnosis instance CAN_NOM_SYS" VALUE 0x85d710 _REC_VAL_20_u1 255. _CNV_A_R_LINEAR_____1_CM 0. 255. DISPLAY_IDENTIFIER C_ERR_CLAS_CAN_NOM_SYS FORMAT "%3.0" /end CHARACTERISTIC
/begin CHARACTERISTIC fmy_id_can_tot.dtc[0] "diagnostic trouble codes for diagnosis instance CAN_TOT" CURVE 0x85d712 _REC_CUR_20_u2_u2 65535. _CNV_A_R_LINEAR_____1_CM 0. 65535. DISPLAY_IDENTIFIER ID_ERR_DTC_CAN_TOT FORMAT "%5.0"
 /begin AXIS_DESCR COM_AXIS online_dummy _CNV_A_R_LINEAR_____0_CM 6 0. 5. FORMAT "%2.0" AXIS_PTS_REF ldp_fmy_dtc /end AXIS_DESCR
/end CHARACTERISTIC
/begin CHARACTERISTIC fmy_id_can_tot.envd "environmental data contents of customer specific freeze frame for diagnosis instance CAN_TOT" CURVE 0x85d71e _REC_CUR_20_u1_u1 255. _CNV_A_R_LINEAR_____1_CM 0. 255. DISPLAY_IDENTIFIER ID_ERR_ENVD_CAN_TOT FORMAT "%3.0"
 /begin AXIS_DESCR COM_AXIS online_dummy _CNV_A_R_LINEAR_____0_CM 8 0. 7. READ_ONLY FORMAT "%2.0" AXIS_PTS_REF ldp_fmy_envd /end AXIS_DESCR
/end CHARACTERISTIC
/begin CHARACTERISTIC fmy_id_can_tot.c_err_clas "error class for diagnosis instance CAN_TOT" VALUE 0x85d726 _REC_VAL_20_u1 255. _CNV_A_R_LINEAR_____1_CM 0. 255. DISPLAY_IDENTIFIER C_ERR_CLAS_CAN_TOT FORMAT "%3.0" /end CHARACTERISTIC
/begin CHARACTERISTIC fmy_id_varcod.dtc[0] "diagnostic trouble codes for diagnosis instance VARCOD" CURVE 0x85d728 _REC_CUR_20_u2_u2 65535. _CNV_A_R_LINEAR_____1_CM 0. 65535. DISPLAY_IDENTIFIER ID_ERR_DTC_VARCOD FORMAT "%5.0"
 /begin AXIS_DESCR COM_AXIS online_dummy _CNV_A_R_LINEAR_____0_CM 6 0. 5. FORMAT "%2.0" AXIS_PTS_REF ldp_fmy_dtc /end AXIS_DESCR
/end CHARACTERISTIC
/begin CHARACTERISTIC fmy_id_varcod.envd "environmental data contents of customer specific freeze frame for diagnosis instance VARCOD" CURVE 0x85d734 _REC_CUR_20_u1_u1 255. _CNV_A_R_LINEAR_____1_CM 0. 255. DISPLAY_IDENTIFIER ID_ERR_ENVD_VARCOD FORMAT "%3.0"
 /begin AXIS_DESCR COM_AXIS online_dummy _CNV_A_R_LINEAR_____0_CM 8 0. 7. READ_ONLY FORMAT "%2.0" AXIS_PTS_REF ldp_fmy_envd /end AXIS_DESCR
/end CHARACTERISTIC
/begin CHARACTERISTIC fmy_id_varcod.c_err_clas "error class for diagnosis instance VARCOD" VALUE 0x85d73c _REC_VAL_20_u1 255. _CNV_A_R_LINEAR_____1_CM 0. 255. DISPLAY_IDENTIFIER C_ERR_CLAS_VARCOD FORMAT "%3.0" /end CHARACTERISTIC
/begin CHARACTERISTIC fmy_id_acp_mes_rng.dtc[0] "diagnostic trouble codes for diagnosis instance ACP_MES_RNG" CURVE 0x85d73e _REC_CUR_20_u2_u2 65535. _CNV_A_R_LINEAR_____1_CM 0. 65535. DISPLAY_IDENTIFIER ID_ERR_DTC_ACP_MES_RNG FORMAT "%5.0"
 /begin AXIS_DESCR COM_AXIS online_dummy _CNV_A_R_LINEAR_____0_CM 6 0. 5. FORMAT "%2.0" AXIS_PTS_REF ldp_fmy_dtc /end AXIS_DESCR
/end CHARACTERISTIC
/begin CHARACTERISTIC fmy_id_acp_mes_rng.envd "environmental data contents of customer specific freeze frame for diagnosis instance ACP_MES_RNG" CURVE 0x85d74a _REC_CUR_20_u1_u1 255. _CNV_A_R_LINEAR_____1_CM 0. 255. DISPLAY_IDENTIFIER ID_ERR_ENVD_ACP_MES_RNG FORMAT "%3.0"
 /begin AXIS_DESCR COM_AXIS online_dummy _CNV_A_R_LINEAR_____0_CM 8 0. 7. READ_ONLY FORMAT "%2.0" AXIS_PTS_REF ldp_fmy_envd /end AXIS_DESCR
/end CHARACTERISTIC
/begin CHARACTERISTIC fmy_id_acp_mes_rng.c_err_clas "error class for diagnosis instance ACP_MES_RNG" VALUE 0x85d752 _REC_VAL_20_u1 255. _CNV_A_R_LINEAR_____1_CM 0. 255. DISPLAY_IDENTIFIER C_ERR_CLAS_ACP_MES_RNG FORMAT "%3.0" /end CHARACTERISTIC
/begin CHARACTERISTIC fmy_id_acp_mes_grd.dtc[0] "diagnostic trouble codes for diagnosis instance ACP_MES_GRD" CURVE 0x85d754 _REC_CUR_20_u2_u2 65535. _CNV_A_R_LINEAR_____1_CM 0. 65535. DISPLAY_IDENTIFIER ID_ERR_DTC_ACP_MES_GRD FORMAT "%5.0"
 /begin AXIS_DESCR COM_AXIS online_dummy _CNV_A_R_LINEAR_____0_CM 6 0. 5. FORMAT "%2.0" AXIS_PTS_REF ldp_fmy_dtc /end AXIS_DESCR
/end CHARACTERISTIC
/begin CHARACTERISTIC fmy_id_acp_mes_grd.envd "environmental data contents of customer specific freeze frame for diagnosis instance ACP_MES_GRD" CURVE 0x85d760 _REC_CUR_20_u1_u1 255. _CNV_A_R_LINEAR_____1_CM 0. 255. DISPLAY_IDENTIFIER ID_ERR_ENVD_ACP_MES_GRD FORMAT "%3.0"
 /begin AXIS_DESCR COM_AXIS online_dummy _CNV_A_R_LINEAR_____0_CM 8 0. 7. READ_ONLY FORMAT "%2.0" AXIS_PTS_REF ldp_fmy_envd /end AXIS_DESCR
/end CHARACTERISTIC
/begin CHARACTERISTIC fmy_id_acp_mes_grd.c_err_clas "error class for diagnosis instance ACP_MES_GRD" VALUE 0x85d768 _REC_VAL_20_u1 255. _CNV_A_R_LINEAR_____1_CM 0. 255. DISPLAY_IDENTIFIER C_ERR_CLAS_ACP_MES_GRD FORMAT "%3.0" /end CHARACTERISTIC
/begin CHARACTERISTIC fmy_id_v_tba_rng.dtc[0] "diagnostic trouble codes for diagnosis instance V_TBA_RNG" CURVE 0x85d76a _REC_CUR_20_u2_u2 65535. _CNV_A_R_LINEAR_____1_CM 0. 65535. DISPLAY_IDENTIFIER ID_ERR_DTC_V_TBA_RNG FORMAT "%5.0"
 /begin AXIS_DESCR COM_AXIS online_dummy _CNV_A_R_LINEAR_____0_CM 6 0. 5. FORMAT "%2.0" AXIS_PTS_REF ldp_fmy_dtc /end AXIS_DESCR
/end CHARACTERISTIC
/begin CHARACTERISTIC fmy_id_v_tba_rng.envd "environmental data contents of customer specific freeze frame for diagnosis instance V_TBA_RNG" CURVE 0x85d776 _REC_CUR_20_u1_u1 255. _CNV_A_R_LINEAR_____1_CM 0. 255. DISPLAY_IDENTIFIER ID_ERR_ENVD_V_TBA_RNG FORMAT "%3.0"
 /begin AXIS_DESCR COM_AXIS online_dummy _CNV_A_R_LINEAR_____0_CM 8 0. 7. READ_ONLY FORMAT "%2.0" AXIS_PTS_REF ldp_fmy_envd /end AXIS_DESCR
/end CHARACTERISTIC
/begin CHARACTERISTIC fmy_id_v_tba_rng.c_err_clas "error class for diagnosis instance V_TBA_RNG" VALUE 0x85d77e _REC_VAL_20_u1 255. _CNV_A_R_LINEAR_____1_CM 0. 255. DISPLAY_IDENTIFIER C_ERR_CLAS_V_TBA_RNG FORMAT "%3.0" /end CHARACTERISTIC
/begin CHARACTERISTIC fmy_id_tba_mes_grd.dtc[0] "diagnostic trouble codes for diagnosis instance TBA_MES_GRD" CURVE 0x85d780 _REC_CUR_20_u2_u2 65535. _CNV_A_R_LINEAR_____1_CM 0. 65535. DISPLAY_IDENTIFIER ID_ERR_DTC_TBA_MES_GRD FORMAT "%5.0"
 /begin AXIS_DESCR COM_AXIS online_dummy _CNV_A_R_LINEAR_____0_CM 6 0. 5. FORMAT "%2.0" AXIS_PTS_REF ldp_fmy_dtc /end AXIS_DESCR
/end CHARACTERISTIC
/begin CHARACTERISTIC fmy_id_tba_mes_grd.envd "environmental data contents of customer specific freeze frame for diagnosis instance TBA_MES_GRD" CURVE 0x85d78c _REC_CUR_20_u1_u1 255. _CNV_A_R_LINEAR_____1_CM 0. 255. DISPLAY_IDENTIFIER ID_ERR_ENVD_TBA_MES_GRD FORMAT "%3.0"
 /begin AXIS_DESCR COM_AXIS online_dummy _CNV_A_R_LINEAR_____0_CM 8 0. 7. READ_ONLY FORMAT "%2.0" AXIS_PTS_REF ldp_fmy_envd /end AXIS_DESCR
/end CHARACTERISTIC
/begin CHARACTERISTIC fmy_id_tba_mes_grd.c_err_clas "error class for diagnosis instance TBA_MES_GRD" VALUE 0x85d794 _REC_VAL_20_u1 255. _CNV_A_R_LINEAR_____1_CM 0. 255. DISPLAY_IDENTIFIER C_ERR_CLAS_TBA_MES_GRD FORMAT "%3.0" /end CHARACTERISTIC
/begin CHARACTERISTIC fmy_id_ducy_alter_pwm_rng.dtc[0] "diagnostic trouble codes for diagnosis instance DUCY_ALTER_PWM_RNG" CURVE 0x85d796 _REC_CUR_20_u2_u2 65535. _CNV_A_R_LINEAR_____1_CM 0. 65535. DISPLAY_IDENTIFIER ID_ERR_DTC_DUCY_ALTER_PWM_RNG FORMAT "%5.0"
 /begin AXIS_DESCR COM_AXIS online_dummy _CNV_A_R_LINEAR_____0_CM 6 0. 5. FORMAT "%2.0" AXIS_PTS_REF ldp_fmy_dtc /end AXIS_DESCR
/end CHARACTERISTIC
/begin CHARACTERISTIC fmy_id_ducy_alter_pwm_rng.envd "environmental data contents of customer specific freeze frame for diagnosis instance DUCY_ALTER_PWM_RNG" CURVE 0x85d7a2 _REC_CUR_20_u1_u1 255. _CNV_A_R_LINEAR_____1_CM 0. 255. DISPLAY_IDENTIFIER ID_ERR_ENVD_DUCY_ALTER_PWM_RNG FORMAT "%3.0"
 /begin AXIS_DESCR COM_AXIS online_dummy _CNV_A_R_LINEAR_____0_CM 8 0. 7. READ_ONLY FORMAT "%2.0" AXIS_PTS_REF ldp_fmy_envd /end AXIS_DESCR
/end CHARACTERISTIC
/begin CHARACTERISTIC fmy_id_ducy_alter_pwm_rng.c_err_clas "error class for diagnosis instance DUCY_ALTER_PWM_RNG" VALUE 0x85d7aa _REC_VAL_20_u1 255. _CNV_A_R_LINEAR_____1_CM 0. 255. DISPLAY_IDENTIFIER C_ERR_CLAS_DUCY_ALTER_PWM_RNG FORMAT "%3.0" /end CHARACTERISTIC
/begin CHARACTERISTIC fmy_id_ducy_alter_pwm_grd.dtc[0] "diagnostic trouble codes for diagnosis instance DUCY_ALTER_PWM_GRD" CURVE 0x85d7ac _REC_CUR_20_u2_u2 65535. _CNV_A_R_LINEAR_____1_CM 0. 65535. DISPLAY_IDENTIFIER ID_ERR_DTC_DUCY_ALTER_PWM_GRD FORMAT "%5.0"
 /begin AXIS_DESCR COM_AXIS online_dummy _CNV_A_R_LINEAR_____0_CM 6 0. 5. FORMAT "%2.0" AXIS_PTS_REF ldp_fmy_dtc /end AXIS_DESCR
/end CHARACTERISTIC
/begin CHARACTERISTIC fmy_id_ducy_alter_pwm_grd.envd "environmental data contents of customer specific freeze frame for diagnosis instance DUCY_ALTER_PWM_GRD" CURVE 0x85d7b8 _REC_CUR_20_u1_u1 255. _CNV_A_R_LINEAR_____1_CM 0. 255. DISPLAY_IDENTIFIER ID_ERR_ENVD_DUCY_ALTER_PWM_GRD FORMAT "%3.0"
 /begin AXIS_DESCR COM_AXIS online_dummy _CNV_A_R_LINEAR_____0_CM 8 0. 7. READ_ONLY FORMAT "%2.0" AXIS_PTS_REF ldp_fmy_envd /end AXIS_DESCR
/end CHARACTERISTIC
/begin CHARACTERISTIC fmy_id_ducy_alter_pwm_grd.c_err_clas "error class for diagnosis instance DUCY_ALTER_PWM_GRD" VALUE 0x85d7c0 _REC_VAL_20_u1 255. _CNV_A_R_LINEAR_____1_CM 0. 255. DISPLAY_IDENTIFIER C_ERR_CLAS_DUCY_ALTER_PWM_GRD FORMAT "%3.0" /end CHARACTERISTIC
/begin CHARACTERISTIC fmy_id_v_egrv_0_rng.dtc[0] "diagnostic trouble codes for diagnosis instance V_EGRV_0_RNG" CURVE 0x85d7c2 _REC_CUR_20_u2_u2 65535. _CNV_A_R_LINEAR_____1_CM 0. 65535. DISPLAY_IDENTIFIER ID_ERR_DTC_V_EGRV_0_RNG FORMAT "%5.0"
 /begin AXIS_DESCR COM_AXIS online_dummy _CNV_A_R_LINEAR_____0_CM 6 0. 5. FORMAT "%2.0" AXIS_PTS_REF ldp_fmy_dtc /end AXIS_DESCR
/end CHARACTERISTIC
/begin CHARACTERISTIC fmy_id_v_egrv_0_rng.envd "environmental data contents of customer specific freeze frame for diagnosis instance V_EGRV_0_RNG" CURVE 0x85d7ce _REC_CUR_20_u1_u1 255. _CNV_A_R_LINEAR_____1_CM 0. 255. DISPLAY_IDENTIFIER ID_ERR_ENVD_V_EGRV_0_RNG FORMAT "%3.0"
 /begin AXIS_DESCR COM_AXIS online_dummy _CNV_A_R_LINEAR_____0_CM 8 0. 7. READ_ONLY FORMAT "%2.0" AXIS_PTS_REF ldp_fmy_envd /end AXIS_DESCR
/end CHARACTERISTIC
/begin CHARACTERISTIC fmy_id_v_egrv_0_rng.c_err_clas "error class for diagnosis instance V_EGRV_0_RNG" VALUE 0x85d7d6 _REC_VAL_20_u1 255. _CNV_A_R_LINEAR_____1_CM 0. 255. DISPLAY_IDENTIFIER C_ERR_CLAS_V_EGRV_0_RNG FORMAT "%3.0" /end CHARACTERISTIC
/begin CHARACTERISTIC fmy_id_v_egrv_1_rng.dtc[0] "diagnostic trouble codes for diagnosis instance V_EGRV_1_RNG" CURVE 0x85d7d8 _REC_CUR_20_u2_u2 65535. _CNV_A_R_LINEAR_____1_CM 0. 65535. DISPLAY_IDENTIFIER ID_ERR_DTC_V_EGRV_1_RNG FORMAT "%5.0"
 /begin AXIS_DESCR COM_AXIS online_dummy _CNV_A_R_LINEAR_____0_CM 6 0. 5. FORMAT "%2.0" AXIS_PTS_REF ldp_fmy_dtc /end AXIS_DESCR
/end CHARACTERISTIC
/begin CHARACTERISTIC fmy_id_v_egrv_1_rng.envd "environmental data contents of customer specific freeze frame for diagnosis instance V_EGRV_1_RNG" CURVE 0x85d7e4 _REC_CUR_20_u1_u1 255. _CNV_A_R_LINEAR_____1_CM 0. 255. DISPLAY_IDENTIFIER ID_ERR_ENVD_V_EGRV_1_RNG FORMAT "%3.0"
 /begin AXIS_DESCR COM_AXIS online_dummy _CNV_A_R_LINEAR_____0_CM 8 0. 7. READ_ONLY FORMAT "%2.0" AXIS_PTS_REF ldp_fmy_envd /end AXIS_DESCR
/end CHARACTERISTIC
/begin CHARACTERISTIC fmy_id_v_egrv_1_rng.c_err_clas "error class for diagnosis instance V_EGRV_1_RNG" VALUE 0x85d7ec _REC_VAL_20_u1 255. _CNV_A_R_LINEAR_____1_CM 0. 255. DISPLAY_IDENTIFIER C_ERR_CLAS_V_EGRV_1_RNG FORMAT "%3.0" /end CHARACTERISTIC
/begin CHARACTERISTIC fmy_id_v_egrv_0_grd.dtc[0] "diagnostic trouble codes for diagnosis instance V_EGRV_0_GRD" CURVE 0x85d7ee _REC_CUR_20_u2_u2 65535. _CNV_A_R_LINEAR_____1_CM 0. 65535. DISPLAY_IDENTIFIER ID_ERR_DTC_V_EGRV_0_GRD FORMAT "%5.0"
 /begin AXIS_DESCR COM_AXIS online_dummy _CNV_A_R_LINEAR_____0_CM 6 0. 5. FORMAT "%2.0" AXIS_PTS_REF ldp_fmy_dtc /end AXIS_DESCR
/end CHARACTERISTIC
/begin CHARACTERISTIC fmy_id_v_egrv_0_grd.envd "environmental data contents of customer specific freeze frame for diagnosis instance V_EGRV_0_GRD" CURVE 0x85d7fa _REC_CUR_20_u1_u1 255. _CNV_A_R_LINEAR_____1_CM 0. 255. DISPLAY_IDENTIFIER ID_ERR_ENVD_V_EGRV_0_GRD FORMAT "%3.0"
 /begin AXIS_DESCR COM_AXIS online_dummy _CNV_A_R_LINEAR_____0_CM 8 0. 7. READ_ONLY FORMAT "%2.0" AXIS_PTS_REF ldp_fmy_envd /end AXIS_DESCR
/end CHARACTERISTIC
/begin CHARACTERISTIC fmy_id_v_egrv_0_grd.c_err_clas "error class for diagnosis instance V_EGRV_0_GRD" VALUE 0x85d802 _REC_VAL_20_u1 255. _CNV_A_R_LINEAR_____1_CM 0. 255. DISPLAY_IDENTIFIER C_ERR_CLAS_V_EGRV_0_GRD FORMAT "%3.0" /end CHARACTERISTIC
/begin CHARACTERISTIC fmy_id_v_egrv_1_grd.dtc[0] "diagnostic trouble codes for diagnosis instance V_EGRV_1_GRD" CURVE 0x85d804 _REC_CUR_20_u2_u2 65535. _CNV_A_R_LINEAR_____1_CM 0. 65535. DISPLAY_IDENTIFIER ID_ERR_DTC_V_EGRV_1_GRD FORMAT "%5.0"
 /begin AXIS_DESCR COM_AXIS online_dummy _CNV_A_R_LINEAR_____0_CM 6 0. 5. FORMAT "%2.0" AXIS_PTS_REF ldp_fmy_dtc /end AXIS_DESCR
/end CHARACTERISTIC
/begin CHARACTERISTIC fmy_id_v_egrv_1_grd.envd "environmental data contents of customer specific freeze frame for diagnosis instance V_EGRV_1_GRD" CURVE 0x85d810 _REC_CUR_20_u1_u1 255. _CNV_A_R_LINEAR_____1_CM 0. 255. DISPLAY_IDENTIFIER ID_ERR_ENVD_V_EGRV_1_GRD FORMAT "%3.0"
 /begin AXIS_DESCR COM_AXIS online_dummy _CNV_A_R_LINEAR_____0_CM 8 0. 7. READ_ONLY FORMAT "%2.0" AXIS_PTS_REF ldp_fmy_envd /end AXIS_DESCR
/end CHARACTERISTIC
/begin CHARACTERISTIC fmy_id_v_egrv_1_grd.c_err_clas "error class for diagnosis instance V_EGRV_1_GRD" VALUE 0x85d818 _REC_VAL_20_u1 255. _CNV_A_R_LINEAR_____1_CM 0. 255. DISPLAY_IDENTIFIER C_ERR_CLAS_V_EGRV_1_GRD FORMAT "%3.0" /end CHARACTERISTIC
/begin CHARACTERISTIC fmy_id_ges_maf_0_max.dtc[0] "diagnostic trouble codes for diagnosis instance GES_MAF_0_MAX" CURVE 0x85d81a _REC_CUR_20_u2_u2 65535. _CNV_A_R_LINEAR_____1_CM 0. 65535. DISPLAY_IDENTIFIER ID_ERR_DTC_GES_MAF_0_MAX FORMAT "%5.0"
 /begin AXIS_DESCR COM_AXIS online_dummy _CNV_A_R_LINEAR_____0_CM 6 0. 5. FORMAT "%2.0" AXIS_PTS_REF ldp_fmy_dtc /end AXIS_DESCR
/end CHARACTERISTIC
/begin CHARACTERISTIC fmy_id_ges_maf_0_max.envd "environmental data contents of customer specific freeze frame for diagnosis instance GES_MAF_0_MAX" CURVE 0x85d826 _REC_CUR_20_u1_u1 255. _CNV_A_R_LINEAR_____1_CM 0. 255. DISPLAY_IDENTIFIER ID_ERR_ENVD_GES_MAF_0_MAX FORMAT "%3.0"
 /begin AXIS_DESCR COM_AXIS online_dummy _CNV_A_R_LINEAR_____0_CM 8 0. 7. READ_ONLY FORMAT "%2.0" AXIS_PTS_REF ldp_fmy_envd /end AXIS_DESCR
/end CHARACTERISTIC
/begin CHARACTERISTIC fmy_id_ges_maf_0_max.c_err_clas "error class for diagnosis instance GES_MAF_0_MAX" VALUE 0x85d82e _REC_VAL_20_u1 255. _CNV_A_R_LINEAR_____1_CM 0. 255. DISPLAY_IDENTIFIER C_ERR_CLAS_GES_MAF_0_MAX FORMAT "%3.0" /end CHARACTERISTIC
/begin CHARACTERISTIC fmy_id_tco_1_2_plaus.dtc[0] "diagnostic trouble codes for diagnosis instance TCO_1_2_PLAUS" CURVE 0x85d830 _REC_CUR_20_u2_u2 65535. _CNV_A_R_LINEAR_____1_CM 0. 65535. DISPLAY_IDENTIFIER ID_ERR_DTC_TCO_1_2_PLAUS FORMAT "%5.0"
 /begin AXIS_DESCR COM_AXIS online_dummy _CNV_A_R_LINEAR_____0_CM 6 0. 5. FORMAT "%2.0" AXIS_PTS_REF ldp_fmy_dtc /end AXIS_DESCR
/end CHARACTERISTIC
/begin CHARACTERISTIC fmy_id_tco_1_2_plaus.envd "environmental data contents of customer specific freeze frame for diagnosis instance TCO_1_2_PLAUS" CURVE 0x85d83c _REC_CUR_20_u1_u1 255. _CNV_A_R_LINEAR_____1_CM 0. 255. DISPLAY_IDENTIFIER ID_ERR_ENVD_TCO_1_2_PLAUS FORMAT "%3.0"
 /begin AXIS_DESCR COM_AXIS online_dummy _CNV_A_R_LINEAR_____0_CM 8 0. 7. READ_ONLY FORMAT "%2.0" AXIS_PTS_REF ldp_fmy_envd /end AXIS_DESCR
/end CHARACTERISTIC
/begin CHARACTERISTIC fmy_id_tco_1_2_plaus.c_err_clas "error class for diagnosis instance TCO_1_2_PLAUS" VALUE 0x85d844 _REC_VAL_20_u1 255. _CNV_A_R_LINEAR_____1_CM 0. 255. DISPLAY_IDENTIFIER C_ERR_CLAS_TCO_1_2_PLAUS FORMAT "%3.0" /end CHARACTERISTIC
/begin CHARACTERISTIC fmy_id_efp_rly_dps.dtc[0] "diagnostic trouble codes for diagnosis instance EFP_RLY_DPS" CURVE 0x85d846 _REC_CUR_20_u2_u2 65535. _CNV_A_R_LINEAR_____1_CM 0. 65535. DISPLAY_IDENTIFIER ID_ERR_DTC_EFP_RLY_DPS FORMAT "%5.0"
 /begin AXIS_DESCR COM_AXIS online_dummy _CNV_A_R_LINEAR_____0_CM 6 0. 5. FORMAT "%2.0" AXIS_PTS_REF ldp_fmy_dtc /end AXIS_DESCR
/end CHARACTERISTIC
/begin CHARACTERISTIC fmy_id_efp_rly_dps.envd "environmental data contents of customer specific freeze frame for diagnosis instance EFP_RLY_DPS" CURVE 0x85d852 _REC_CUR_20_u1_u1 255. _CNV_A_R_LINEAR_____1_CM 0. 255. DISPLAY_IDENTIFIER ID_ERR_ENVD_EFP_RLY_DPS FORMAT "%3.0"
 /begin AXIS_DESCR COM_AXIS online_dummy _CNV_A_R_LINEAR_____0_CM 8 0. 7. READ_ONLY FORMAT "%2.0" AXIS_PTS_REF ldp_fmy_envd /end AXIS_DESCR
/end CHARACTERISTIC
/begin CHARACTERISTIC fmy_id_efp_rly_dps.c_err_clas "error class for diagnosis instance EFP_RLY_DPS" VALUE 0x85d85a _REC_VAL_20_u1 255. _CNV_A_R_LINEAR_____1_CM 0. 255. DISPLAY_IDENTIFIER C_ERR_CLAS_EFP_RLY_DPS FORMAT "%3.0" /end CHARACTERISTIC
/begin CHARACTERISTIC fmy_id_efp_rly_plaus_1.dtc[0] "diagnostic trouble codes for diagnosis instance EFP_RLY_PLAUS_1" CURVE 0x85d85c _REC_CUR_20_u2_u2 65535. _CNV_A_R_LINEAR_____1_CM 0. 65535. DISPLAY_IDENTIFIER ID_ERR_DTC_EFP_RLY_PLAUS_1 FORMAT "%5.0"
 /begin AXIS_DESCR COM_AXIS online_dummy _CNV_A_R_LINEAR_____0_CM 6 0. 5. FORMAT "%2.0" AXIS_PTS_REF ldp_fmy_dtc /end AXIS_DESCR
/end CHARACTERISTIC
/begin CHARACTERISTIC fmy_id_efp_rly_plaus_1.envd "environmental data contents of customer specific freeze frame for diagnosis instance EFP_RLY_PLAUS_1" CURVE 0x85d868 _REC_CUR_20_u1_u1 255. _CNV_A_R_LINEAR_____1_CM 0. 255. DISPLAY_IDENTIFIER ID_ERR_ENVD_EFP_RLY_PLAUS_1 FORMAT "%3.0"
 /begin AXIS_DESCR COM_AXIS online_dummy _CNV_A_R_LINEAR_____0_CM 8 0. 7. READ_ONLY FORMAT "%2.0" AXIS_PTS_REF ldp_fmy_envd /end AXIS_DESCR
/end CHARACTERISTIC
/begin CHARACTERISTIC fmy_id_efp_rly_plaus_1.c_err_clas "error class for diagnosis instance EFP_RLY_PLAUS_1" VALUE 0x85d870 _REC_VAL_20_u1 255. _CNV_A_R_LINEAR_____1_CM 0. 255. DISPLAY_IDENTIFIER C_ERR_CLAS_EFP_RLY_PLAUS_1 FORMAT "%3.0" /end CHARACTERISTIC
/begin CHARACTERISTIC fmy_id_efp_rly_plaus_2.dtc[0] "diagnostic trouble codes for diagnosis instance EFP_RLY_PLAUS_2" CURVE 0x85d872 _REC_CUR_20_u2_u2 65535. _CNV_A_R_LINEAR_____1_CM 0. 65535. DISPLAY_IDENTIFIER ID_ERR_DTC_EFP_RLY_PLAUS_2 FORMAT "%5.0"
 /begin AXIS_DESCR COM_AXIS online_dummy _CNV_A_R_LINEAR_____0_CM 6 0. 5. FORMAT "%2.0" AXIS_PTS_REF ldp_fmy_dtc /end AXIS_DESCR
/end CHARACTERISTIC
/begin CHARACTERISTIC fmy_id_efp_rly_plaus_2.envd "environmental data contents of customer specific freeze frame for diagnosis instance EFP_RLY_PLAUS_2" CURVE 0x85d87e _REC_CUR_20_u1_u1 255. _CNV_A_R_LINEAR_____1_CM 0. 255. DISPLAY_IDENTIFIER ID_ERR_ENVD_EFP_RLY_PLAUS_2 FORMAT "%3.0"
 /begin AXIS_DESCR COM_AXIS online_dummy _CNV_A_R_LINEAR_____0_CM 8 0. 7. READ_ONLY FORMAT "%2.0" AXIS_PTS_REF ldp_fmy_envd /end AXIS_DESCR
/end CHARACTERISTIC
/begin CHARACTERISTIC fmy_id_efp_rly_plaus_2.c_err_clas "error class for diagnosis instance EFP_RLY_PLAUS_2" VALUE 0x85d886 _REC_VAL_20_u1 255. _CNV_A_R_LINEAR_____1_CM 0. 255. DISPLAY_IDENTIFIER C_ERR_CLAS_EFP_RLY_PLAUS_2 FORMAT "%3.0" /end CHARACTERISTIC
/begin CHARACTERISTIC fmy_id_spi_mps.dtc[0] "diagnostic trouble codes for diagnosis instance SPI_MPS" CURVE 0x85d888 _REC_CUR_20_u2_u2 65535. _CNV_A_R_LINEAR_____1_CM 0. 65535. DISPLAY_IDENTIFIER ID_ERR_DTC_SPI_MPS FORMAT "%5.0"
 /begin AXIS_DESCR COM_AXIS online_dummy _CNV_A_R_LINEAR_____0_CM 6 0. 5. FORMAT "%2.0" AXIS_PTS_REF ldp_fmy_dtc /end AXIS_DESCR
/end CHARACTERISTIC
/begin CHARACTERISTIC fmy_id_spi_mps.envd "environmental data contents of customer specific freeze frame for diagnosis instance SPI_MPS" CURVE 0x85d894 _REC_CUR_20_u1_u1 255. _CNV_A_R_LINEAR_____1_CM 0. 255. DISPLAY_IDENTIFIER ID_ERR_ENVD_SPI_MPS FORMAT "%3.0"
 /begin AXIS_DESCR COM_AXIS online_dummy _CNV_A_R_LINEAR_____0_CM 8 0. 7. READ_ONLY FORMAT "%2.0" AXIS_PTS_REF ldp_fmy_envd /end AXIS_DESCR
/end CHARACTERISTIC
/begin CHARACTERISTIC fmy_id_spi_mps.c_err_clas "error class for diagnosis instance SPI_MPS" VALUE 0x85d89c _REC_VAL_20_u1 255. _CNV_A_R_LINEAR_____1_CM 0. 255. DISPLAY_IDENTIFIER C_ERR_CLAS_SPI_MPS FORMAT "%3.0" /end CHARACTERISTIC
/begin CHARACTERISTIC fmy_id_spi_oct.dtc[0] "diagnostic trouble codes for diagnosis instance SPI_OCT" CURVE 0x85d89e _REC_CUR_20_u2_u2 65535. _CNV_A_R_LINEAR_____1_CM 0. 65535. DISPLAY_IDENTIFIER ID_ERR_DTC_SPI_OCT FORMAT "%5.0"
 /begin AXIS_DESCR COM_AXIS online_dummy _CNV_A_R_LINEAR_____0_CM 6 0. 5. FORMAT "%2.0" AXIS_PTS_REF ldp_fmy_dtc /end AXIS_DESCR
/end CHARACTERISTIC
/begin CHARACTERISTIC fmy_id_spi_oct.envd "environmental data contents of customer specific freeze frame for diagnosis instance SPI_OCT" CURVE 0x85d8aa _REC_CUR_20_u1_u1 255. _CNV_A_R_LINEAR_____1_CM 0. 255. DISPLAY_IDENTIFIER ID_ERR_ENVD_SPI_OCT FORMAT "%3.0"
 /begin AXIS_DESCR COM_AXIS online_dummy _CNV_A_R_LINEAR_____0_CM 8 0. 7. READ_ONLY FORMAT "%2.0" AXIS_PTS_REF ldp_fmy_envd /end AXIS_DESCR
/end CHARACTERISTIC
/begin CHARACTERISTIC fmy_id_spi_oct.c_err_clas "error class for diagnosis instance SPI_OCT" VALUE 0x85d8b2 _REC_VAL_20_u1 255. _CNV_A_R_LINEAR_____1_CM 0. 255. DISPLAY_IDENTIFIER C_ERR_CLAS_SPI_OCT FORMAT "%3.0" /end CHARACTERISTIC
/begin CHARACTERISTIC fmy_id_spi_qps.dtc[0] "diagnostic trouble codes for diagnosis instance SPI_QPS" CURVE 0x85d8b4 _REC_CUR_20_u2_u2 65535. _CNV_A_R_LINEAR_____1_CM 0. 65535. DISPLAY_IDENTIFIER ID_ERR_DTC_SPI_QPS FORMAT "%5.0"
 /begin AXIS_DESCR COM_AXIS online_dummy _CNV_A_R_LINEAR_____0_CM 6 0. 5. FORMAT "%2.0" AXIS_PTS_REF ldp_fmy_dtc /end AXIS_DESCR
/end CHARACTERISTIC
/begin CHARACTERISTIC fmy_id_spi_qps.envd "environmental data contents of customer specific freeze frame for diagnosis instance SPI_QPS" CURVE 0x85d8c0 _REC_CUR_20_u1_u1 255. _CNV_A_R_LINEAR_____1_CM 0. 255. DISPLAY_IDENTIFIER ID_ERR_ENVD_SPI_QPS FORMAT "%3.0"
 /begin AXIS_DESCR COM_AXIS online_dummy _CNV_A_R_LINEAR_____0_CM 8 0. 7. READ_ONLY FORMAT "%2.0" AXIS_PTS_REF ldp_fmy_envd /end AXIS_DESCR
/end CHARACTERISTIC
/begin CHARACTERISTIC fmy_id_spi_qps.c_err_clas "error class for diagnosis instance SPI_QPS" VALUE 0x85d8c8 _REC_VAL_20_u1 255. _CNV_A_R_LINEAR_____1_CM 0. 255. DISPLAY_IDENTIFIER C_ERR_CLAS_SPI_QPS FORMAT "%3.0" /end CHARACTERISTIC
/begin CHARACTERISTIC fmy_id_egr_byp_dps.dtc[0] "diagnostic trouble codes for diagnosis instance EGR_BYP_DPS" CURVE 0x85d8ca _REC_CUR_20_u2_u2 65535. _CNV_A_R_LINEAR_____1_CM 0. 65535. DISPLAY_IDENTIFIER ID_ERR_DTC_EGR_BYP_DPS FORMAT "%5.0"
 /begin AXIS_DESCR COM_AXIS online_dummy _CNV_A_R_LINEAR_____0_CM 6 0. 5. FORMAT "%2.0" AXIS_PTS_REF ldp_fmy_dtc /end AXIS_DESCR
/end CHARACTERISTIC
/begin CHARACTERISTIC fmy_id_egr_byp_dps.envd "environmental data contents of customer specific freeze frame for diagnosis instance EGR_BYP_DPS" CURVE 0x85d8d6 _REC_CUR_20_u1_u1 255. _CNV_A_R_LINEAR_____1_CM 0. 255. DISPLAY_IDENTIFIER ID_ERR_ENVD_EGR_BYP_DPS FORMAT "%3.0"
 /begin AXIS_DESCR COM_AXIS online_dummy _CNV_A_R_LINEAR_____0_CM 8 0. 7. READ_ONLY FORMAT "%2.0" AXIS_PTS_REF ldp_fmy_envd /end AXIS_DESCR
/end CHARACTERISTIC
/begin CHARACTERISTIC fmy_id_egr_byp_dps.c_err_clas "error class for diagnosis instance EGR_BYP_DPS" VALUE 0x85d8de _REC_VAL_20_u1 255. _CNV_A_R_LINEAR_____1_CM 0. 255. DISPLAY_IDENTIFIER C_ERR_CLAS_EGR_BYP_DPS FORMAT "%3.0" /end CHARACTERISTIC
/begin CHARACTERISTIC fmy_id_egrv_0.dtc[0] "diagnostic trouble codes for diagnosis instance EGRV_0" CURVE 0x85d8e0 _REC_CUR_20_u2_u2 65535. _CNV_A_R_LINEAR_____1_CM 0. 65535. DISPLAY_IDENTIFIER ID_ERR_DTC_EGRV_0 FORMAT "%5.0"
 /begin AXIS_DESCR COM_AXIS online_dummy _CNV_A_R_LINEAR_____0_CM 6 0. 5. FORMAT "%2.0" AXIS_PTS_REF ldp_fmy_dtc /end AXIS_DESCR
/end CHARACTERISTIC
/begin CHARACTERISTIC fmy_id_egrv_0.envd "environmental data contents of customer specific freeze frame for diagnosis instance EGRV_0" CURVE 0x85d8ec _REC_CUR_20_u1_u1 255. _CNV_A_R_LINEAR_____1_CM 0. 255. DISPLAY_IDENTIFIER ID_ERR_ENVD_EGRV_0 FORMAT "%3.0"
 /begin AXIS_DESCR COM_AXIS online_dummy _CNV_A_R_LINEAR_____0_CM 8 0. 7. READ_ONLY FORMAT "%2.0" AXIS_PTS_REF ldp_fmy_envd /end AXIS_DESCR
/end CHARACTERISTIC
/begin CHARACTERISTIC fmy_id_egrv_0.c_err_clas "error class for diagnosis instance EGRV_0" VALUE 0x85d8f4 _REC_VAL_20_u1 255. _CNV_A_R_LINEAR_____1_CM 0. 255. DISPLAY_IDENTIFIER C_ERR_CLAS_EGRV_0 FORMAT "%3.0" /end CHARACTERISTIC
/begin CHARACTERISTIC fmy_id_pps_ini_0.dtc[0] "diagnostic trouble codes for diagnosis instance PPS_INI_0" CURVE 0x85d8f6 _REC_CUR_20_u2_u2 65535. _CNV_A_R_LINEAR_____1_CM 0. 65535. DISPLAY_IDENTIFIER ID_ERR_DTC_PPS_INI_0 FORMAT "%5.0"
 /begin AXIS_DESCR COM_AXIS online_dummy _CNV_A_R_LINEAR_____0_CM 6 0. 5. FORMAT "%2.0" AXIS_PTS_REF ldp_fmy_dtc /end AXIS_DESCR
/end CHARACTERISTIC
/begin CHARACTERISTIC fmy_id_pps_ini_0.envd "environmental data contents of customer specific freeze frame for diagnosis instance PPS_INI_0" CURVE 0x85d902 _REC_CUR_20_u1_u1 255. _CNV_A_R_LINEAR_____1_CM 0. 255. DISPLAY_IDENTIFIER ID_ERR_ENVD_PPS_INI_0 FORMAT "%3.0"
 /begin AXIS_DESCR COM_AXIS online_dummy _CNV_A_R_LINEAR_____0_CM 8 0. 7. READ_ONLY FORMAT "%2.0" AXIS_PTS_REF ldp_fmy_envd /end AXIS_DESCR
/end CHARACTERISTIC
/begin CHARACTERISTIC fmy_id_pps_ini_0.c_err_clas "error class for diagnosis instance PPS_INI_0" VALUE 0x85d90a _REC_VAL_20_u1 255. _CNV_A_R_LINEAR_____1_CM 0. 255. DISPLAY_IDENTIFIER C_ERR_CLAS_PPS_INI_0 FORMAT "%3.0" /end CHARACTERISTIC
/begin CHARACTERISTIC fmy_id_pps_ini_tout_0.dtc[0] "diagnostic trouble codes for diagnosis instance PPS_INI_TOUT_0" CURVE 0x85d90c _REC_CUR_20_u2_u2 65535. _CNV_A_R_LINEAR_____1_CM 0. 65535. DISPLAY_IDENTIFIER ID_ERR_DTC_PPS_INI_TOUT_0 FORMAT "%5.0"
 /begin AXIS_DESCR COM_AXIS online_dummy _CNV_A_R_LINEAR_____0_CM 6 0. 5. FORMAT "%2.0" AXIS_PTS_REF ldp_fmy_dtc /end AXIS_DESCR
/end CHARACTERISTIC
/begin CHARACTERISTIC fmy_id_pps_ini_tout_0.envd "environmental data contents of customer specific freeze frame for diagnosis instance PPS_INI_TOUT_0" CURVE 0x85d918 _REC_CUR_20_u1_u1 255. _CNV_A_R_LINEAR_____1_CM 0. 255. DISPLAY_IDENTIFIER ID_ERR_ENVD_PPS_INI_TOUT_0 FORMAT "%3.0"
 /begin AXIS_DESCR COM_AXIS online_dummy _CNV_A_R_LINEAR_____0_CM 8 0. 7. READ_ONLY FORMAT "%2.0" AXIS_PTS_REF ldp_fmy_envd /end AXIS_DESCR
/end CHARACTERISTIC
/begin CHARACTERISTIC fmy_id_pps_ini_tout_0.c_err_clas "error class for diagnosis instance PPS_INI_TOUT_0" VALUE 0x85d920 _REC_VAL_20_u1 255. _CNV_A_R_LINEAR_____1_CM 0. 255. DISPLAY_IDENTIFIER C_ERR_CLAS_PPS_INI_TOUT_0 FORMAT "%3.0" /end CHARACTERISTIC
/begin CHARACTERISTIC fmy_id_pps_plaus_0.dtc[0] "diagnostic trouble codes for diagnosis instance PPS_PLAUS_0" CURVE 0x85d922 _REC_CUR_20_u2_u2 65535. _CNV_A_R_LINEAR_____1_CM 0. 65535. DISPLAY_IDENTIFIER ID_ERR_DTC_PPS_PLAUS_0 FORMAT "%5.0"
 /begin AXIS_DESCR COM_AXIS online_dummy _CNV_A_R_LINEAR_____0_CM 6 0. 5. FORMAT "%2.0" AXIS_PTS_REF ldp_fmy_dtc /end AXIS_DESCR
/end CHARACTERISTIC
/begin CHARACTERISTIC fmy_id_pps_plaus_0.envd "environmental data contents of customer specific freeze frame for diagnosis instance PPS_PLAUS_0" CURVE 0x85d92e _REC_CUR_20_u1_u1 255. _CNV_A_R_LINEAR_____1_CM 0. 255. DISPLAY_IDENTIFIER ID_ERR_ENVD_PPS_PLAUS_0 FORMAT "%3.0"
 /begin AXIS_DESCR COM_AXIS online_dummy _CNV_A_R_LINEAR_____0_CM 8 0. 7. READ_ONLY FORMAT "%2.0" AXIS_PTS_REF ldp_fmy_envd /end AXIS_DESCR
/end CHARACTERISTIC
/begin CHARACTERISTIC fmy_id_pps_plaus_0.c_err_clas "error class for diagnosis instance PPS_PLAUS_0" VALUE 0x85d936 _REC_VAL_20_u1 255. _CNV_A_R_LINEAR_____1_CM 0. 255. DISPLAY_IDENTIFIER C_ERR_CLAS_PPS_PLAUS_0 FORMAT "%3.0" /end CHARACTERISTIC
/begin CHARACTERISTIC fmy_id_pps_cal_0.dtc[0] "diagnostic trouble codes for diagnosis instance PPS_CAL_0" CURVE 0x85d938 _REC_CUR_20_u2_u2 65535. _CNV_A_R_LINEAR_____1_CM 0. 65535. DISPLAY_IDENTIFIER ID_ERR_DTC_PPS_CAL_0 FORMAT "%5.0"
 /begin AXIS_DESCR COM_AXIS online_dummy _CNV_A_R_LINEAR_____0_CM 6 0. 5. FORMAT "%2.0" AXIS_PTS_REF ldp_fmy_dtc /end AXIS_DESCR
/end CHARACTERISTIC
/begin CHARACTERISTIC fmy_id_pps_cal_0.envd "environmental data contents of customer specific freeze frame for diagnosis instance PPS_CAL_0" CURVE 0x85d944 _REC_CUR_20_u1_u1 255. _CNV_A_R_LINEAR_____1_CM 0. 255. DISPLAY_IDENTIFIER ID_ERR_ENVD_PPS_CAL_0 FORMAT "%3.0"
 /begin AXIS_DESCR COM_AXIS online_dummy _CNV_A_R_LINEAR_____0_CM 8 0. 7. READ_ONLY FORMAT "%2.0" AXIS_PTS_REF ldp_fmy_envd /end AXIS_DESCR
/end CHARACTERISTIC
/begin CHARACTERISTIC fmy_id_pps_cal_0.c_err_clas "error class for diagnosis instance PPS_CAL_0" VALUE 0x85d94c _REC_VAL_20_u1 255. _CNV_A_R_LINEAR_____1_CM 0. 255. DISPLAY_IDENTIFIER C_ERR_CLAS_PPS_CAL_0 FORMAT "%3.0" /end CHARACTERISTIC
/begin CHARACTERISTIC fmy_id_pps_v_inj_0.dtc[0] "diagnostic trouble codes for diagnosis instance PPS_V_INJ_0" CURVE 0x85d94e _REC_CUR_20_u2_u2 65535. _CNV_A_R_LINEAR_____1_CM 0. 65535. DISPLAY_IDENTIFIER ID_ERR_DTC_PPS_V_INJ_0 FORMAT "%5.0"
 /begin AXIS_DESCR COM_AXIS online_dummy _CNV_A_R_LINEAR_____0_CM 6 0. 5. FORMAT "%2.0" AXIS_PTS_REF ldp_fmy_dtc /end AXIS_DESCR
/end CHARACTERISTIC
/begin CHARACTERISTIC fmy_id_pps_v_inj_0.envd "environmental data contents of customer specific freeze frame for diagnosis instance PPS_V_INJ_0" CURVE 0x85d95a _REC_CUR_20_u1_u1 255. _CNV_A_R_LINEAR_____1_CM 0. 255. DISPLAY_IDENTIFIER ID_ERR_ENVD_PPS_V_INJ_0 FORMAT "%3.0"
 /begin AXIS_DESCR COM_AXIS online_dummy _CNV_A_R_LINEAR_____0_CM 8 0. 7. READ_ONLY FORMAT "%2.0" AXIS_PTS_REF ldp_fmy_envd /end AXIS_DESCR
/end CHARACTERISTIC
/begin CHARACTERISTIC fmy_id_pps_v_inj_0.c_err_clas "error class for diagnosis instance PPS_V_INJ_0" VALUE 0x85d962 _REC_VAL_20_u1 255. _CNV_A_R_LINEAR_____1_CM 0. 255. DISPLAY_IDENTIFIER C_ERR_CLAS_PPS_V_INJ_0 FORMAT "%3.0" /end CHARACTERISTIC
/begin CHARACTERISTIC fmy_id_pps_wdt_0.dtc[0] "diagnostic trouble codes for diagnosis instance PPS_WDT_0" CURVE 0x85d964 _REC_CUR_20_u2_u2 65535. _CNV_A_R_LINEAR_____1_CM 0. 65535. DISPLAY_IDENTIFIER ID_ERR_DTC_PPS_WDT_0 FORMAT "%5.0"
 /begin AXIS_DESCR COM_AXIS online_dummy _CNV_A_R_LINEAR_____0_CM 6 0. 5. FORMAT "%2.0" AXIS_PTS_REF ldp_fmy_dtc /end AXIS_DESCR
/end CHARACTERISTIC
/begin CHARACTERISTIC fmy_id_pps_wdt_0.envd "environmental data contents of customer specific freeze frame for diagnosis instance PPS_WDT_0" CURVE 0x85d970 _REC_CUR_20_u1_u1 255. _CNV_A_R_LINEAR_____1_CM 0. 255. DISPLAY_IDENTIFIER ID_ERR_ENVD_PPS_WDT_0 FORMAT "%3.0"
 /begin AXIS_DESCR COM_AXIS online_dummy _CNV_A_R_LINEAR_____0_CM 8 0. 7. READ_ONLY FORMAT "%2.0" AXIS_PTS_REF ldp_fmy_envd /end AXIS_DESCR
/end CHARACTERISTIC
/begin CHARACTERISTIC fmy_id_pps_wdt_0.c_err_clas "error class for diagnosis instance PPS_WDT_0" VALUE 0x85d978 _REC_VAL_20_u1 255. _CNV_A_R_LINEAR_____1_CM 0. 255. DISPLAY_IDENTIFIER C_ERR_CLAS_PPS_WDT_0 FORMAT "%3.0" /end CHARACTERISTIC
/begin CHARACTERISTIC fmy_id_pps_fsm_0.dtc[0] "diagnostic trouble codes for diagnosis instance PPS_FSM_0" CURVE 0x85d97a _REC_CUR_20_u2_u2 65535. _CNV_A_R_LINEAR_____1_CM 0. 65535. DISPLAY_IDENTIFIER ID_ERR_DTC_PPS_FSM_0 FORMAT "%5.0"
 /begin AXIS_DESCR COM_AXIS online_dummy _CNV_A_R_LINEAR_____0_CM 6 0. 5. FORMAT "%2.0" AXIS_PTS_REF ldp_fmy_dtc /end AXIS_DESCR
/end CHARACTERISTIC
/begin CHARACTERISTIC fmy_id_pps_fsm_0.envd "environmental data contents of customer specific freeze frame for diagnosis instance PPS_FSM_0" CURVE 0x85d986 _REC_CUR_20_u1_u1 255. _CNV_A_R_LINEAR_____1_CM 0. 255. DISPLAY_IDENTIFIER ID_ERR_ENVD_PPS_FSM_0 FORMAT "%3.0"
 /begin AXIS_DESCR COM_AXIS online_dummy _CNV_A_R_LINEAR_____0_CM 8 0. 7. READ_ONLY FORMAT "%2.0" AXIS_PTS_REF ldp_fmy_envd /end AXIS_DESCR
/end CHARACTERISTIC
/begin CHARACTERISTIC fmy_id_pps_fsm_0.c_err_clas "error class for diagnosis instance PPS_FSM_0" VALUE 0x85d98e _REC_VAL_20_u1 255. _CNV_A_R_LINEAR_____1_CM 0. 255. DISPLAY_IDENTIFIER C_ERR_CLAS_PPS_FSM_0 FORMAT "%3.0" /end CHARACTERISTIC
/begin CHARACTERISTIC fmy_id_pps_oc_0.dtc[0] "diagnostic trouble codes for diagnosis instance PPS_OC_0" CURVE 0x85d990 _REC_CUR_20_u2_u2 65535. _CNV_A_R_LINEAR_____1_CM 0. 65535. DISPLAY_IDENTIFIER ID_ERR_DTC_PPS_OC_0 FORMAT "%5.0"
 /begin AXIS_DESCR COM_AXIS online_dummy _CNV_A_R_LINEAR_____0_CM 6 0. 5. FORMAT "%2.0" AXIS_PTS_REF ldp_fmy_dtc /end AXIS_DESCR
/end CHARACTERISTIC
/begin CHARACTERISTIC fmy_id_pps_oc_0.envd "environmental data contents of customer specific freeze frame for diagnosis instance PPS_OC_0" CURVE 0x85d99c _REC_CUR_20_u1_u1 255. _CNV_A_R_LINEAR_____1_CM 0. 255. DISPLAY_IDENTIFIER ID_ERR_ENVD_PPS_OC_0 FORMAT "%3.0"
 /begin AXIS_DESCR COM_AXIS online_dummy _CNV_A_R_LINEAR_____0_CM 8 0. 7. READ_ONLY FORMAT "%2.0" AXIS_PTS_REF ldp_fmy_envd /end AXIS_DESCR
/end CHARACTERISTIC
/begin CHARACTERISTIC fmy_id_pps_oc_0.c_err_clas "error class for diagnosis instance PPS_OC_0" VALUE 0x85d9a4 _REC_VAL_20_u1 255. _CNV_A_R_LINEAR_____1_CM 0. 255. DISPLAY_IDENTIFIER C_ERR_CLAS_PPS_OC_0 FORMAT "%3.0" /end CHARACTERISTIC
/begin CHARACTERISTIC fmy_id_pps_oc_1.dtc[0] "diagnostic trouble codes for diagnosis instance PPS_OC_1" CURVE 0x85d9a6 _REC_CUR_20_u2_u2 65535. _CNV_A_R_LINEAR_____1_CM 0. 65535. DISPLAY_IDENTIFIER ID_ERR_DTC_PPS_OC_1 FORMAT "%5.0"
 /begin AXIS_DESCR COM_AXIS online_dummy _CNV_A_R_LINEAR_____0_CM 6 0. 5. FORMAT "%2.0" AXIS_PTS_REF ldp_fmy_dtc /end AXIS_DESCR
/end CHARACTERISTIC
/begin CHARACTERISTIC fmy_id_pps_oc_1.envd "environmental data contents of customer specific freeze frame for diagnosis instance PPS_OC_1" CURVE 0x85d9b2 _REC_CUR_20_u1_u1 255. _CNV_A_R_LINEAR_____1_CM 0. 255. DISPLAY_IDENTIFIER ID_ERR_ENVD_PPS_OC_1 FORMAT "%3.0"
 /begin AXIS_DESCR COM_AXIS online_dummy _CNV_A_R_LINEAR_____0_CM 8 0. 7. READ_ONLY FORMAT "%2.0" AXIS_PTS_REF ldp_fmy_envd /end AXIS_DESCR
/end CHARACTERISTIC
/begin CHARACTERISTIC fmy_id_pps_oc_1.c_err_clas "error class for diagnosis instance PPS_OC_1" VALUE 0x85d9ba _REC_VAL_20_u1 255. _CNV_A_R_LINEAR_____1_CM 0. 255. DISPLAY_IDENTIFIER C_ERR_CLAS_PPS_OC_1 FORMAT "%3.0" /end CHARACTERISTIC
/begin CHARACTERISTIC fmy_id_pps_oc_2.dtc[0] "diagnostic trouble codes for diagnosis instance PPS_OC_2" CURVE 0x85d9bc _REC_CUR_20_u2_u2 65535. _CNV_A_R_LINEAR_____1_CM 0. 65535. DISPLAY_IDENTIFIER ID_ERR_DTC_PPS_OC_2 FORMAT "%5.0"
 /begin AXIS_DESCR COM_AXIS online_dummy _CNV_A_R_LINEAR_____0_CM 6 0. 5. FORMAT "%2.0" AXIS_PTS_REF ldp_fmy_dtc /end AXIS_DESCR
/end CHARACTERISTIC
/begin CHARACTERISTIC fmy_id_pps_oc_2.envd "environmental data contents of customer specific freeze frame for diagnosis instance PPS_OC_2" CURVE 0x85d9c8 _REC_CUR_20_u1_u1 255. _CNV_A_R_LINEAR_____1_CM 0. 255. DISPLAY_IDENTIFIER ID_ERR_ENVD_PPS_OC_2 FORMAT "%3.0"
 /begin AXIS_DESCR COM_AXIS online_dummy _CNV_A_R_LINEAR_____0_CM 8 0. 7. READ_ONLY FORMAT "%2.0" AXIS_PTS_REF ldp_fmy_envd /end AXIS_DESCR
/end CHARACTERISTIC
/begin CHARACTERISTIC fmy_id_pps_oc_2.c_err_clas "error class for diagnosis instance PPS_OC_2" VALUE 0x85d9d0 _REC_VAL_20_u1 255. _CNV_A_R_LINEAR_____1_CM 0. 255. DISPLAY_IDENTIFIER C_ERR_CLAS_PPS_OC_2 FORMAT "%3.0" /end CHARACTERISTIC
/begin CHARACTERISTIC fmy_id_pps_oc_3.dtc[0] "diagnostic trouble codes for diagnosis instance PPS_OC_3" CURVE 0x85d9d2 _REC_CUR_20_u2_u2 65535. _CNV_A_R_LINEAR_____1_CM 0. 65535. DISPLAY_IDENTIFIER ID_ERR_DTC_PPS_OC_3 FORMAT "%5.0"
 /begin AXIS_DESCR COM_AXIS online_dummy _CNV_A_R_LINEAR_____0_CM 6 0. 5. FORMAT "%2.0" AXIS_PTS_REF ldp_fmy_dtc /end AXIS_DESCR
/end CHARACTERISTIC
/begin CHARACTERISTIC fmy_id_pps_oc_3.envd "environmental data contents of customer specific freeze frame for diagnosis instance PPS_OC_3" CURVE 0x85d9de _REC_CUR_20_u1_u1 255. _CNV_A_R_LINEAR_____1_CM 0. 255. DISPLAY_IDENTIFIER ID_ERR_ENVD_PPS_OC_3 FORMAT "%3.0"
 /begin AXIS_DESCR COM_AXIS online_dummy _CNV_A_R_LINEAR_____0_CM 8 0. 7. READ_ONLY FORMAT "%2.0" AXIS_PTS_REF ldp_fmy_envd /end AXIS_DESCR
/end CHARACTERISTIC
/begin CHARACTERISTIC fmy_id_pps_oc_3.c_err_clas "error class for diagnosis instance PPS_OC_3" VALUE 0x85d9e6 _REC_VAL_20_u1 255. _CNV_A_R_LINEAR_____1_CM 0. 255. DISPLAY_IDENTIFIER C_ERR_CLAS_PPS_OC_3 FORMAT "%3.0" /end CHARACTERISTIC
/begin CHARACTERISTIC fmy_id_pps_sc_h_l_0.dtc[0] "diagnostic trouble codes for diagnosis instance PPS_SC_H_L_0" CURVE 0x85d9e8 _REC_CUR_20_u2_u2 65535. _CNV_A_R_LINEAR_____1_CM 0. 65535. DISPLAY_IDENTIFIER ID_ERR_DTC_PPS_SC_H_L_0 FORMAT "%5.0"
 /begin AXIS_DESCR COM_AXIS online_dummy _CNV_A_R_LINEAR_____0_CM 6 0. 5. FORMAT "%2.0" AXIS_PTS_REF ldp_fmy_dtc /end AXIS_DESCR
/end CHARACTERISTIC
/begin CHARACTERISTIC fmy_id_pps_sc_h_l_0.envd "environmental data contents of customer specific freeze frame for diagnosis instance PPS_SC_H_L_0" CURVE 0x85d9f4 _REC_CUR_20_u1_u1 255. _CNV_A_R_LINEAR_____1_CM 0. 255. DISPLAY_IDENTIFIER ID_ERR_ENVD_PPS_SC_H_L_0 FORMAT "%3.0"
 /begin AXIS_DESCR COM_AXIS online_dummy _CNV_A_R_LINEAR_____0_CM 8 0. 7. READ_ONLY FORMAT "%2.0" AXIS_PTS_REF ldp_fmy_envd /end AXIS_DESCR
/end CHARACTERISTIC
/begin CHARACTERISTIC fmy_id_pps_sc_h_l_0.c_err_clas "error class for diagnosis instance PPS_SC_H_L_0" VALUE 0x85d9fc _REC_VAL_20_u1 255. _CNV_A_R_LINEAR_____1_CM 0. 255. DISPLAY_IDENTIFIER C_ERR_CLAS_PPS_SC_H_L_0 FORMAT "%3.0" /end CHARACTERISTIC
/begin CHARACTERISTIC fmy_id_pps_sc_h_l_1.dtc[0] "diagnostic trouble codes for diagnosis instance PPS_SC_H_L_1" CURVE 0x85d9fe _REC_CUR_20_u2_u2 65535. _CNV_A_R_LINEAR_____1_CM 0. 65535. DISPLAY_IDENTIFIER ID_ERR_DTC_PPS_SC_H_L_1 FORMAT "%5.0"
 /begin AXIS_DESCR COM_AXIS online_dummy _CNV_A_R_LINEAR_____0_CM 6 0. 5. FORMAT "%2.0" AXIS_PTS_REF ldp_fmy_dtc /end AXIS_DESCR
/end CHARACTERISTIC
/begin CHARACTERISTIC fmy_id_pps_sc_h_l_1.envd "environmental data contents of customer specific freeze frame for diagnosis instance PPS_SC_H_L_1" CURVE 0x85da0a _REC_CUR_20_u1_u1 255. _CNV_A_R_LINEAR_____1_CM 0. 255. DISPLAY_IDENTIFIER ID_ERR_ENVD_PPS_SC_H_L_1 FORMAT "%3.0"
 /begin AXIS_DESCR COM_AXIS online_dummy _CNV_A_R_LINEAR_____0_CM 8 0. 7. READ_ONLY FORMAT "%2.0" AXIS_PTS_REF ldp_fmy_envd /end AXIS_DESCR
/end CHARACTERISTIC
/begin CHARACTERISTIC fmy_id_pps_sc_h_l_1.c_err_clas "error class for diagnosis instance PPS_SC_H_L_1" VALUE 0x85da12 _REC_VAL_20_u1 255. _CNV_A_R_LINEAR_____1_CM 0. 255. DISPLAY_IDENTIFIER C_ERR_CLAS_PPS_SC_H_L_1 FORMAT "%3.0" /end CHARACTERISTIC
/begin CHARACTERISTIC fmy_id_pps_sc_h_l_2.dtc[0] "diagnostic trouble codes for diagnosis instance PPS_SC_H_L_2" CURVE 0x85da14 _REC_CUR_20_u2_u2 65535. _CNV_A_R_LINEAR_____1_CM 0. 65535. DISPLAY_IDENTIFIER ID_ERR_DTC_PPS_SC_H_L_2 FORMAT "%5.0"
 /begin AXIS_DESCR COM_AXIS online_dummy _CNV_A_R_LINEAR_____0_CM 6 0. 5. FORMAT "%2.0" AXIS_PTS_REF ldp_fmy_dtc /end AXIS_DESCR
/end CHARACTERISTIC
/begin CHARACTERISTIC fmy_id_pps_sc_h_l_2.envd "environmental data contents of customer specific freeze frame for diagnosis instance PPS_SC_H_L_2" CURVE 0x85da20 _REC_CUR_20_u1_u1 255. _CNV_A_R_LINEAR_____1_CM 0. 255. DISPLAY_IDENTIFIER ID_ERR_ENVD_PPS_SC_H_L_2 FORMAT "%3.0"
 /begin AXIS_DESCR COM_AXIS online_dummy _CNV_A_R_LINEAR_____0_CM 8 0. 7. READ_ONLY FORMAT "%2.0" AXIS_PTS_REF ldp_fmy_envd /end AXIS_DESCR
/end CHARACTERISTIC
/begin CHARACTERISTIC fmy_id_pps_sc_h_l_2.c_err_clas "error class for diagnosis instance PPS_SC_H_L_2" VALUE 0x85da28 _REC_VAL_20_u1 255. _CNV_A_R_LINEAR_____1_CM 0. 255. DISPLAY_IDENTIFIER C_ERR_CLAS_PPS_SC_H_L_2 FORMAT "%3.0" /end CHARACTERISTIC
/begin CHARACTERISTIC fmy_id_pps_sc_h_l_3.dtc[0] "diagnostic trouble codes for diagnosis instance PPS_SC_H_L_3" CURVE 0x85da2a _REC_CUR_20_u2_u2 65535. _CNV_A_R_LINEAR_____1_CM 0. 65535. DISPLAY_IDENTIFIER ID_ERR_DTC_PPS_SC_H_L_3 FORMAT "%5.0"
 /begin AXIS_DESCR COM_AXIS online_dummy _CNV_A_R_LINEAR_____0_CM 6 0. 5. FORMAT "%2.0" AXIS_PTS_REF ldp_fmy_dtc /end AXIS_DESCR
/end CHARACTERISTIC
/begin CHARACTERISTIC fmy_id_pps_sc_h_l_3.envd "environmental data contents of customer specific freeze frame for diagnosis instance PPS_SC_H_L_3" CURVE 0x85da36 _REC_CUR_20_u1_u1 255. _CNV_A_R_LINEAR_____1_CM 0. 255. DISPLAY_IDENTIFIER ID_ERR_ENVD_PPS_SC_H_L_3 FORMAT "%3.0"
 /begin AXIS_DESCR COM_AXIS online_dummy _CNV_A_R_LINEAR_____0_CM 8 0. 7. READ_ONLY FORMAT "%2.0" AXIS_PTS_REF ldp_fmy_envd /end AXIS_DESCR
/end CHARACTERISTIC
/begin CHARACTERISTIC fmy_id_pps_sc_h_l_3.c_err_clas "error class for diagnosis instance PPS_SC_H_L_3" VALUE 0x85da3e _REC_VAL_20_u1 255. _CNV_A_R_LINEAR_____1_CM 0. 255. DISPLAY_IDENTIFIER C_ERR_CLAS_PPS_SC_H_L_3 FORMAT "%3.0" /end CHARACTERISTIC
/begin CHARACTERISTIC fmy_id_pps_sc_h_0.dtc[0] "diagnostic trouble codes for diagnosis instance PPS_SC_H_0" CURVE 0x85da40 _REC_CUR_20_u2_u2 65535. _CNV_A_R_LINEAR_____1_CM 0. 65535. DISPLAY_IDENTIFIER ID_ERR_DTC_PPS_SC_H_0 FORMAT "%5.0"
 /begin AXIS_DESCR COM_AXIS online_dummy _CNV_A_R_LINEAR_____0_CM 6 0. 5. FORMAT "%2.0" AXIS_PTS_REF ldp_fmy_dtc /end AXIS_DESCR
/end CHARACTERISTIC
/begin CHARACTERISTIC fmy_id_pps_sc_h_0.envd "environmental data contents of customer specific freeze frame for diagnosis instance PPS_SC_H_0" CURVE 0x85da4c _REC_CUR_20_u1_u1 255. _CNV_A_R_LINEAR_____1_CM 0. 255. DISPLAY_IDENTIFIER ID_ERR_ENVD_PPS_SC_H_0 FORMAT "%3.0"
 /begin AXIS_DESCR COM_AXIS online_dummy _CNV_A_R_LINEAR_____0_CM 8 0. 7. READ_ONLY FORMAT "%2.0" AXIS_PTS_REF ldp_fmy_envd /end AXIS_DESCR
/end CHARACTERISTIC
/begin CHARACTERISTIC fmy_id_pps_sc_h_0.c_err_clas "error class for diagnosis instance PPS_SC_H_0" VALUE 0x85da54 _REC_VAL_20_u1 255. _CNV_A_R_LINEAR_____1_CM 0. 255. DISPLAY_IDENTIFIER C_ERR_CLAS_PPS_SC_H_0 FORMAT "%3.0" /end CHARACTERISTIC
/begin CHARACTERISTIC fmy_id_pps_sc_l_0.dtc[0] "diagnostic trouble codes for diagnosis instance PPS_SC_L_0" CURVE 0x85da56 _REC_CUR_20_u2_u2 65535. _CNV_A_R_LINEAR_____1_CM 0. 65535. DISPLAY_IDENTIFIER ID_ERR_DTC_PPS_SC_L_0 FORMAT "%5.0"
 /begin AXIS_DESCR COM_AXIS online_dummy _CNV_A_R_LINEAR_____0_CM 6 0. 5. FORMAT "%2.0" AXIS_PTS_REF ldp_fmy_dtc /end AXIS_DESCR
/end CHARACTERISTIC
/begin CHARACTERISTIC fmy_id_pps_sc_l_0.envd "environmental data contents of customer specific freeze frame for diagnosis instance PPS_SC_L_0" CURVE 0x85da62 _REC_CUR_20_u1_u1 255. _CNV_A_R_LINEAR_____1_CM 0. 255. DISPLAY_IDENTIFIER ID_ERR_ENVD_PPS_SC_L_0 FORMAT "%3.0"
 /begin AXIS_DESCR COM_AXIS online_dummy _CNV_A_R_LINEAR_____0_CM 8 0. 7. READ_ONLY FORMAT "%2.0" AXIS_PTS_REF ldp_fmy_envd /end AXIS_DESCR
/end CHARACTERISTIC
/begin CHARACTERISTIC fmy_id_pps_sc_l_0.c_err_clas "error class for diagnosis instance PPS_SC_L_0" VALUE 0x85da6a _REC_VAL_20_u1 255. _CNV_A_R_LINEAR_____1_CM 0. 255. DISPLAY_IDENTIFIER C_ERR_CLAS_PPS_SC_L_0 FORMAT "%3.0" /end CHARACTERISTIC
/begin CHARACTERISTIC fmy_id_v_teg_tur_up_rng.dtc[0] "diagnostic trouble codes for diagnosis instance V_TEG_TUR_UP_RNG" CURVE 0x85da6c _REC_CUR_20_u2_u2 65535. _CNV_A_R_LINEAR_____1_CM 0. 65535. DISPLAY_IDENTIFIER ID_ERR_DTC_V_TEG_TUR_UP_RNG FORMAT "%5.0"
 /begin AXIS_DESCR COM_AXIS online_dummy _CNV_A_R_LINEAR_____0_CM 6 0. 5. FORMAT "%2.0" AXIS_PTS_REF ldp_fmy_dtc /end AXIS_DESCR
/end CHARACTERISTIC
/begin CHARACTERISTIC fmy_id_v_teg_tur_up_rng.envd "environmental data contents of customer specific freeze frame for diagnosis instance V_TEG_TUR_UP_RNG" CURVE 0x85da78 _REC_CUR_20_u1_u1 255. _CNV_A_R_LINEAR_____1_CM 0. 255. DISPLAY_IDENTIFIER ID_ERR_ENVD_V_TEG_TUR_UP_RNG FORMAT "%3.0"
 /begin AXIS_DESCR COM_AXIS online_dummy _CNV_A_R_LINEAR_____0_CM 8 0. 7. READ_ONLY FORMAT "%2.0" AXIS_PTS_REF ldp_fmy_envd /end AXIS_DESCR
/end CHARACTERISTIC
/begin CHARACTERISTIC fmy_id_v_teg_tur_up_rng.c_err_clas "error class for diagnosis instance V_TEG_TUR_UP_RNG" VALUE 0x85da80 _REC_VAL_20_u1 255. _CNV_A_R_LINEAR_____1_CM 0. 255. DISPLAY_IDENTIFIER C_ERR_CLAS_V_TEG_TUR_UP_RNG FORMAT "%3.0" /end CHARACTERISTIC
/begin CHARACTERISTIC fmy_id_teg_tur_up_mes_grd.dtc[0] "diagnostic trouble codes for diagnosis instance TEG_TUR_UP_MES_GRD" CURVE 0x85da82 _REC_CUR_20_u2_u2 65535. _CNV_A_R_LINEAR_____1_CM 0. 65535. DISPLAY_IDENTIFIER ID_ERR_DTC_TEG_TUR_UP_MES_GRD FORMAT "%5.0"
 /begin AXIS_DESCR COM_AXIS online_dummy _CNV_A_R_LINEAR_____0_CM 6 0. 5. FORMAT "%2.0" AXIS_PTS_REF ldp_fmy_dtc /end AXIS_DESCR
/end CHARACTERISTIC
/begin CHARACTERISTIC fmy_id_teg_tur_up_mes_grd.envd "environmental data contents of customer specific freeze frame for diagnosis instance TEG_TUR_UP_MES_GRD" CURVE 0x85da8e _REC_CUR_20_u1_u1 255. _CNV_A_R_LINEAR_____1_CM 0. 255. DISPLAY_IDENTIFIER ID_ERR_ENVD_TEG_TUR_UP_MES_GRD FORMAT "%3.0"
 /begin AXIS_DESCR COM_AXIS online_dummy _CNV_A_R_LINEAR_____0_CM 8 0. 7. READ_ONLY FORMAT "%2.0" AXIS_PTS_REF ldp_fmy_envd /end AXIS_DESCR
/end CHARACTERISTIC
/begin CHARACTERISTIC fmy_id_teg_tur_up_mes_grd.c_err_clas "error class for diagnosis instance TEG_TUR_UP_MES_GRD" VALUE 0x85da96 _REC_VAL_20_u1 255. _CNV_A_R_LINEAR_____1_CM 0. 255. DISPLAY_IDENTIFIER C_ERR_CLAS_TEG_TUR_UP_MES_GRD FORMAT "%3.0" /end CHARACTERISTIC
/begin CHARACTERISTIC fmy_id_bpa.dtc[0] "diagnostic trouble codes for diagnosis instance BPA" CURVE 0x85da98 _REC_CUR_20_u2_u2 65535. _CNV_A_R_LINEAR_____1_CM 0. 65535. DISPLAY_IDENTIFIER ID_ERR_DTC_BPA FORMAT "%5.0"
 /begin AXIS_DESCR COM_AXIS online_dummy _CNV_A_R_LINEAR_____0_CM 6 0. 5. FORMAT "%2.0" AXIS_PTS_REF ldp_fmy_dtc /end AXIS_DESCR
/end CHARACTERISTIC
/begin CHARACTERISTIC fmy_id_bpa.envd "environmental data contents of customer specific freeze frame for diagnosis instance BPA" CURVE 0x85daa4 _REC_CUR_20_u1_u1 255. _CNV_A_R_LINEAR_____1_CM 0. 255. DISPLAY_IDENTIFIER ID_ERR_ENVD_BPA FORMAT "%3.0"
 /begin AXIS_DESCR COM_AXIS online_dummy _CNV_A_R_LINEAR_____0_CM 8 0. 7. READ_ONLY FORMAT "%2.0" AXIS_PTS_REF ldp_fmy_envd /end AXIS_DESCR
/end CHARACTERISTIC
/begin CHARACTERISTIC fmy_id_bpa.c_err_clas "error class for diagnosis instance BPA" VALUE 0x85daac _REC_VAL_20_u1 255. _CNV_A_R_LINEAR_____1_CM 0. 255. DISPLAY_IDENTIFIER C_ERR_CLAS_BPA FORMAT "%3.0" /end CHARACTERISTIC
/begin CHARACTERISTIC fmy_id_egrv.dtc[0] "diagnostic trouble codes for diagnosis instance EGRV" CURVE 0x85daae _REC_CUR_20_u2_u2 65535. _CNV_A_R_LINEAR_____1_CM 0. 65535. DISPLAY_IDENTIFIER ID_ERR_DTC_EGRV FORMAT "%5.0"
 /begin AXIS_DESCR COM_AXIS online_dummy _CNV_A_R_LINEAR_____0_CM 6 0. 5. FORMAT "%2.0" AXIS_PTS_REF ldp_fmy_dtc /end AXIS_DESCR
/end CHARACTERISTIC
/begin CHARACTERISTIC fmy_id_egrv.envd "environmental data contents of customer specific freeze frame for diagnosis instance EGRV" CURVE 0x85daba _REC_CUR_20_u1_u1 255. _CNV_A_R_LINEAR_____1_CM 0. 255. DISPLAY_IDENTIFIER ID_ERR_ENVD_EGRV FORMAT "%3.0"
 /begin AXIS_DESCR COM_AXIS online_dummy _CNV_A_R_LINEAR_____0_CM 8 0. 7. READ_ONLY FORMAT "%2.0" AXIS_PTS_REF ldp_fmy_envd /end AXIS_DESCR
/end CHARACTERISTIC
/begin CHARACTERISTIC fmy_id_egrv.c_err_clas "error class for diagnosis instance EGRV" VALUE 0x85dac2 _REC_VAL_20_u1 255. _CNV_A_R_LINEAR_____1_CM 0. 255. DISPLAY_IDENTIFIER C_ERR_CLAS_EGRV FORMAT "%3.0" /end CHARACTERISTIC
/begin CHARACTERISTIC fmy_id_fsd_1.dtc[0] "diagnostic trouble codes for diagnosis instance FSD_1" CURVE 0x85dac4 _REC_CUR_20_u2_u2 65535. _CNV_A_R_LINEAR_____1_CM 0. 65535. DISPLAY_IDENTIFIER ID_ERR_DTC_FSD_1 FORMAT "%5.0"
 /begin AXIS_DESCR COM_AXIS online_dummy _CNV_A_R_LINEAR_____0_CM 6 0. 5. FORMAT "%2.0" AXIS_PTS_REF ldp_fmy_dtc /end AXIS_DESCR
/end CHARACTERISTIC
/begin CHARACTERISTIC fmy_id_fsd_1.envd "environmental data contents of customer specific freeze frame for diagnosis instance FSD_1" CURVE 0x85dad0 _REC_CUR_20_u1_u1 255. _CNV_A_R_LINEAR_____1_CM 0. 255. DISPLAY_IDENTIFIER ID_ERR_ENVD_FSD_1 FORMAT "%3.0"
 /begin AXIS_DESCR COM_AXIS online_dummy _CNV_A_R_LINEAR_____0_CM 8 0. 7. READ_ONLY FORMAT "%2.0" AXIS_PTS_REF ldp_fmy_envd /end AXIS_DESCR
/end CHARACTERISTIC
/begin CHARACTERISTIC fmy_id_fsd_1.c_err_clas "error class for diagnosis instance FSD_1" VALUE 0x85dad8 _REC_VAL_20_u1 255. _CNV_A_R_LINEAR_____1_CM 0. 255. DISPLAY_IDENTIFIER C_ERR_CLAS_FSD_1 FORMAT "%3.0" /end CHARACTERISTIC
/begin CHARACTERISTIC fmy_id_gl_rly_dps.dtc[0] "diagnostic trouble codes for diagnosis instance GL_RLY_DPS" CURVE 0x85dada _REC_CUR_20_u2_u2 65535. _CNV_A_R_LINEAR_____1_CM 0. 65535. DISPLAY_IDENTIFIER ID_ERR_DTC_GL_RLY_DPS FORMAT "%5.0"
 /begin AXIS_DESCR COM_AXIS online_dummy _CNV_A_R_LINEAR_____0_CM 6 0. 5. FORMAT "%2.0" AXIS_PTS_REF ldp_fmy_dtc /end AXIS_DESCR
/end CHARACTERISTIC
/begin CHARACTERISTIC fmy_id_gl_rly_dps.envd "environmental data contents of customer specific freeze frame for diagnosis instance GL_RLY_DPS" CURVE 0x85dae6 _REC_CUR_20_u1_u1 255. _CNV_A_R_LINEAR_____1_CM 0. 255. DISPLAY_IDENTIFIER ID_ERR_ENVD_GL_RLY_DPS FORMAT "%3.0"
 /begin AXIS_DESCR COM_AXIS online_dummy _CNV_A_R_LINEAR_____0_CM 8 0. 7. READ_ONLY FORMAT "%2.0" AXIS_PTS_REF ldp_fmy_envd /end AXIS_DESCR
/end CHARACTERISTIC
/begin CHARACTERISTIC fmy_id_gl_rly_dps.c_err_clas "error class for diagnosis instance GL_RLY_DPS" VALUE 0x85daee _REC_VAL_20_u1 255. _CNV_A_R_LINEAR_____1_CM 0. 255. DISPLAY_IDENTIFIER C_ERR_CLAS_GL_RLY_DPS FORMAT "%3.0" /end CHARACTERISTIC
/begin CHARACTERISTIC fmy_id_mis_a.dtc[0] "diagnostic trouble codes for diagnosis instance MIS_A" CURVE 0x85daf0 _REC_CUR_20_u2_u2 65535. _CNV_A_R_LINEAR_____1_CM 0. 65535. DISPLAY_IDENTIFIER ID_ERR_DTC_MIS_A FORMAT "%5.0"
 /begin AXIS_DESCR COM_AXIS online_dummy _CNV_A_R_LINEAR_____0_CM 6 0. 5. FORMAT "%2.0" AXIS_PTS_REF ldp_fmy_dtc /end AXIS_DESCR
/end CHARACTERISTIC
/begin CHARACTERISTIC fmy_id_mis_a.envd "environmental data contents of customer specific freeze frame for diagnosis instance MIS_A" CURVE 0x85dafc _REC_CUR_20_u1_u1 255. _CNV_A_R_LINEAR_____1_CM 0. 255. DISPLAY_IDENTIFIER ID_ERR_ENVD_MIS_A FORMAT "%3.0"
 /begin AXIS_DESCR COM_AXIS online_dummy _CNV_A_R_LINEAR_____0_CM 8 0. 7. READ_ONLY FORMAT "%2.0" AXIS_PTS_REF ldp_fmy_envd /end AXIS_DESCR
/end CHARACTERISTIC
/begin CHARACTERISTIC fmy_id_mis_a.c_err_clas "error class for diagnosis instance MIS_A" VALUE 0x85db04 _REC_VAL_20_u1 255. _CNV_A_R_LINEAR_____1_CM 0. 255. DISPLAY_IDENTIFIER C_ERR_CLAS_MIS_A FORMAT "%3.0" /end CHARACTERISTIC
/begin CHARACTERISTIC fmy_id_mis_b1.dtc[0] "diagnostic trouble codes for diagnosis instance MIS_B1" CURVE 0x85db06 _REC_CUR_20_u2_u2 65535. _CNV_A_R_LINEAR_____1_CM 0. 65535. DISPLAY_IDENTIFIER ID_ERR_DTC_MIS_B1 FORMAT "%5.0"
 /begin AXIS_DESCR COM_AXIS online_dummy _CNV_A_R_LINEAR_____0_CM 6 0. 5. FORMAT "%2.0" AXIS_PTS_REF ldp_fmy_dtc /end AXIS_DESCR
/end CHARACTERISTIC
/begin CHARACTERISTIC fmy_id_mis_b1.envd "environmental data contents of customer specific freeze frame for diagnosis instance MIS_B1" CURVE 0x85db12 _REC_CUR_20_u1_u1 255. _CNV_A_R_LINEAR_____1_CM 0. 255. DISPLAY_IDENTIFIER ID_ERR_ENVD_MIS_B1 FORMAT "%3.0"
 /begin AXIS_DESCR COM_AXIS online_dummy _CNV_A_R_LINEAR_____0_CM 8 0. 7. READ_ONLY FORMAT "%2.0" AXIS_PTS_REF ldp_fmy_envd /end AXIS_DESCR
/end CHARACTERISTIC
/begin CHARACTERISTIC fmy_id_mis_b1.c_err_clas "error class for diagnosis instance MIS_B1" VALUE 0x85db1a _REC_VAL_20_u1 255. _CNV_A_R_LINEAR_____1_CM 0. 255. DISPLAY_IDENTIFIER C_ERR_CLAS_MIS_B1 FORMAT "%3.0" /end CHARACTERISTIC
/begin CHARACTERISTIC fmy_id_mis_b4.dtc[0] "diagnostic trouble codes for diagnosis instance MIS_B4" CURVE 0x85db1c _REC_CUR_20_u2_u2 65535. _CNV_A_R_LINEAR_____1_CM 0. 65535. DISPLAY_IDENTIFIER ID_ERR_DTC_MIS_B4 FORMAT "%5.0"
 /begin AXIS_DESCR COM_AXIS online_dummy _CNV_A_R_LINEAR_____0_CM 6 0. 5. FORMAT "%2.0" AXIS_PTS_REF ldp_fmy_dtc /end AXIS_DESCR
/end CHARACTERISTIC
/begin CHARACTERISTIC fmy_id_mis_b4.envd "environmental data contents of customer specific freeze frame for diagnosis instance MIS_B4" CURVE 0x85db28 _REC_CUR_20_u1_u1 255. _CNV_A_R_LINEAR_____1_CM 0. 255. DISPLAY_IDENTIFIER ID_ERR_ENVD_MIS_B4 FORMAT "%3.0"
 /begin AXIS_DESCR COM_AXIS online_dummy _CNV_A_R_LINEAR_____0_CM 8 0. 7. READ_ONLY FORMAT "%2.0" AXIS_PTS_REF ldp_fmy_envd /end AXIS_DESCR
/end CHARACTERISTIC
/begin CHARACTERISTIC fmy_id_mis_b4.c_err_clas "error class for diagnosis instance MIS_B4" VALUE 0x85db30 _REC_VAL_20_u1 255. _CNV_A_R_LINEAR_____1_CM 0. 255. DISPLAY_IDENTIFIER C_ERR_CLAS_MIS_B4 FORMAT "%3.0" /end CHARACTERISTIC
/begin CHARACTERISTIC fmy_id_pcv_1.dtc[0] "diagnostic trouble codes for diagnosis instance PCV_1" CURVE 0x85db32 _REC_CUR_20_u2_u2 65535. _CNV_A_R_LINEAR_____1_CM 0. 65535. DISPLAY_IDENTIFIER ID_ERR_DTC_PCV_1 FORMAT "%5.0"
 /begin AXIS_DESCR COM_AXIS online_dummy _CNV_A_R_LINEAR_____0_CM 6 0. 5. FORMAT "%2.0" AXIS_PTS_REF ldp_fmy_dtc /end AXIS_DESCR
/end CHARACTERISTIC
/begin CHARACTERISTIC fmy_id_pcv_1.envd "environmental data contents of customer specific freeze frame for diagnosis instance PCV_1" CURVE 0x85db3e _REC_CUR_20_u1_u1 255. _CNV_A_R_LINEAR_____1_CM 0. 255. DISPLAY_IDENTIFIER ID_ERR_ENVD_PCV_1 FORMAT "%3.0"
 /begin AXIS_DESCR COM_AXIS online_dummy _CNV_A_R_LINEAR_____0_CM 8 0. 7. READ_ONLY FORMAT "%2.0" AXIS_PTS_REF ldp_fmy_envd /end AXIS_DESCR
/end CHARACTERISTIC
/begin CHARACTERISTIC fmy_id_pcv_1.c_err_clas "error class for diagnosis instance PCV_1" VALUE 0x85db46 _REC_VAL_20_u1 255. _CNV_A_R_LINEAR_____1_CM 0. 255. DISPLAY_IDENTIFIER C_ERR_CLAS_PCV_1 FORMAT "%3.0" /end CHARACTERISTIC
/begin CHARACTERISTIC fmy_id_pcv_2.dtc[0] "diagnostic trouble codes for diagnosis instance PCV_2" CURVE 0x85db48 _REC_CUR_20_u2_u2 65535. _CNV_A_R_LINEAR_____1_CM 0. 65535. DISPLAY_IDENTIFIER ID_ERR_DTC_PCV_2 FORMAT "%5.0"
 /begin AXIS_DESCR COM_AXIS online_dummy _CNV_A_R_LINEAR_____0_CM 6 0. 5. FORMAT "%2.0" AXIS_PTS_REF ldp_fmy_dtc /end AXIS_DESCR
/end CHARACTERISTIC
/begin CHARACTERISTIC fmy_id_pcv_2.envd "environmental data contents of customer specific freeze frame for diagnosis instance PCV_2" CURVE 0x85db54 _REC_CUR_20_u1_u1 255. _CNV_A_R_LINEAR_____1_CM 0. 255. DISPLAY_IDENTIFIER ID_ERR_ENVD_PCV_2 FORMAT "%3.0"
 /begin AXIS_DESCR COM_AXIS online_dummy _CNV_A_R_LINEAR_____0_CM 8 0. 7. READ_ONLY FORMAT "%2.0" AXIS_PTS_REF ldp_fmy_envd /end AXIS_DESCR
/end CHARACTERISTIC
/begin CHARACTERISTIC fmy_id_pcv_2.c_err_clas "error class for diagnosis instance PCV_2" VALUE 0x85db5c _REC_VAL_20_u1 255. _CNV_A_R_LINEAR_____1_CM 0. 255. DISPLAY_IDENTIFIER C_ERR_CLAS_PCV_2 FORMAT "%3.0" /end CHARACTERISTIC
/begin CHARACTERISTIC fmy_id_pcv_3.dtc[0] "diagnostic trouble codes for diagnosis instance PCV_3" CURVE 0x85db5e _REC_CUR_20_u2_u2 65535. _CNV_A_R_LINEAR_____1_CM 0. 65535. DISPLAY_IDENTIFIER ID_ERR_DTC_PCV_3 FORMAT "%5.0"
 /begin AXIS_DESCR COM_AXIS online_dummy _CNV_A_R_LINEAR_____0_CM 6 0. 5. FORMAT "%2.0" AXIS_PTS_REF ldp_fmy_dtc /end AXIS_DESCR
/end CHARACTERISTIC
/begin CHARACTERISTIC fmy_id_pcv_3.envd "environmental data contents of customer specific freeze frame for diagnosis instance PCV_3" CURVE 0x85db6a _REC_CUR_20_u1_u1 255. _CNV_A_R_LINEAR_____1_CM 0. 255. DISPLAY_IDENTIFIER ID_ERR_ENVD_PCV_3 FORMAT "%3.0"
 /begin AXIS_DESCR COM_AXIS online_dummy _CNV_A_R_LINEAR_____0_CM 8 0. 7. READ_ONLY FORMAT "%2.0" AXIS_PTS_REF ldp_fmy_envd /end AXIS_DESCR
/end CHARACTERISTIC
/begin CHARACTERISTIC fmy_id_pcv_3.c_err_clas "error class for diagnosis instance PCV_3" VALUE 0x85db72 _REC_VAL_20_u1 255. _CNV_A_R_LINEAR_____1_CM 0. 255. DISPLAY_IDENTIFIER C_ERR_CLAS_PCV_3 FORMAT "%3.0" /end CHARACTERISTIC
/begin CHARACTERISTIC fmy_id_rly_main.dtc[0] "diagnostic trouble codes for diagnosis instance RLY_MAIN" CURVE 0x85db74 _REC_CUR_20_u2_u2 65535. _CNV_A_R_LINEAR_____1_CM 0. 65535. DISPLAY_IDENTIFIER ID_ERR_DTC_RLY_MAIN FORMAT "%5.0"
 /begin AXIS_DESCR COM_AXIS online_dummy _CNV_A_R_LINEAR_____0_CM 6 0. 5. FORMAT "%2.0" AXIS_PTS_REF ldp_fmy_dtc /end AXIS_DESCR
/end CHARACTERISTIC
/begin CHARACTERISTIC fmy_id_rly_main.envd "environmental data contents of customer specific freeze frame for diagnosis instance RLY_MAIN" CURVE 0x85db80 _REC_CUR_20_u1_u1 255. _CNV_A_R_LINEAR_____1_CM 0. 255. DISPLAY_IDENTIFIER ID_ERR_ENVD_RLY_MAIN FORMAT "%3.0"
 /begin AXIS_DESCR COM_AXIS online_dummy _CNV_A_R_LINEAR_____0_CM 8 0. 7. READ_ONLY FORMAT "%2.0" AXIS_PTS_REF ldp_fmy_envd /end AXIS_DESCR
/end CHARACTERISTIC
/begin CHARACTERISTIC fmy_id_rly_main.c_err_clas "error class for diagnosis instance RLY_MAIN" VALUE 0x85db88 _REC_VAL_20_u1 255. _CNV_A_R_LINEAR_____1_CM 0. 255. DISPLAY_IDENTIFIER C_ERR_CLAS_RLY_MAIN FORMAT "%3.0" /end CHARACTERISTIC
/begin CHARACTERISTIC fmy_id_rly_power.dtc[0] "diagnostic trouble codes for diagnosis instance RLY_POWER" CURVE 0x85db8a _REC_CUR_20_u2_u2 65535. _CNV_A_R_LINEAR_____1_CM 0. 65535. DISPLAY_IDENTIFIER ID_ERR_DTC_RLY_POWER FORMAT "%5.0"
 /begin AXIS_DESCR COM_AXIS online_dummy _CNV_A_R_LINEAR_____0_CM 6 0. 5. FORMAT "%2.0" AXIS_PTS_REF ldp_fmy_dtc /end AXIS_DESCR
/end CHARACTERISTIC
/begin CHARACTERISTIC fmy_id_rly_power.envd "environmental data contents of customer specific freeze frame for diagnosis instance RLY_POWER" CURVE 0x85db96 _REC_CUR_20_u1_u1 255. _CNV_A_R_LINEAR_____1_CM 0. 255. DISPLAY_IDENTIFIER ID_ERR_ENVD_RLY_POWER FORMAT "%3.0"
 /begin AXIS_DESCR COM_AXIS online_dummy _CNV_A_R_LINEAR_____0_CM 8 0. 7. READ_ONLY FORMAT "%2.0" AXIS_PTS_REF ldp_fmy_envd /end AXIS_DESCR
/end CHARACTERISTIC
/begin CHARACTERISTIC fmy_id_rly_power.c_err_clas "error class for diagnosis instance RLY_POWER" VALUE 0x85db9e _REC_VAL_20_u1 255. _CNV_A_R_LINEAR_____1_CM 0. 255. DISPLAY_IDENTIFIER C_ERR_CLAS_RLY_POWER FORMAT "%3.0" /end CHARACTERISTIC
/begin CHARACTERISTIC fmy_id_thr.dtc[0] "diagnostic trouble codes for diagnosis instance THR" CURVE 0x85dba0 _REC_CUR_20_u2_u2 65535. _CNV_A_R_LINEAR_____1_CM 0. 65535. DISPLAY_IDENTIFIER ID_ERR_DTC_THR FORMAT "%5.0"
 /begin AXIS_DESCR COM_AXIS online_dummy _CNV_A_R_LINEAR_____0_CM 6 0. 5. FORMAT "%2.0" AXIS_PTS_REF ldp_fmy_dtc /end AXIS_DESCR
/end CHARACTERISTIC
/begin CHARACTERISTIC fmy_id_thr.envd "environmental data contents of customer specific freeze frame for diagnosis instance THR" CURVE 0x85dbac _REC_CUR_20_u1_u1 255. _CNV_A_R_LINEAR_____1_CM 0. 255. DISPLAY_IDENTIFIER ID_ERR_ENVD_THR FORMAT "%3.0"
 /begin AXIS_DESCR COM_AXIS online_dummy _CNV_A_R_LINEAR_____0_CM 8 0. 7. READ_ONLY FORMAT "%2.0" AXIS_PTS_REF ldp_fmy_envd /end AXIS_DESCR
/end CHARACTERISTIC
/begin CHARACTERISTIC fmy_id_thr.c_err_clas "error class for diagnosis instance THR" VALUE 0x85dbb4 _REC_VAL_20_u1 255. _CNV_A_R_LINEAR_____1_CM 0. 255. DISPLAY_IDENTIFIER C_ERR_CLAS_THR FORMAT "%3.0" /end CHARACTERISTIC
/begin CHARACTERISTIC fmy_id_var_cod.dtc[0] "diagnostic trouble codes for diagnosis instance VAR_COD" CURVE 0x85dbb6 _REC_CUR_20_u2_u2 65535. _CNV_A_R_LINEAR_____1_CM 0. 65535. DISPLAY_IDENTIFIER ID_ERR_DTC_VAR_COD FORMAT "%5.0"
 /begin AXIS_DESCR COM_AXIS online_dummy _CNV_A_R_LINEAR_____0_CM 6 0. 5. FORMAT "%2.0" AXIS_PTS_REF ldp_fmy_dtc /end AXIS_DESCR
/end CHARACTERISTIC
/begin CHARACTERISTIC fmy_id_var_cod.envd "environmental data contents of customer specific freeze frame for diagnosis instance VAR_COD" CURVE 0x85dbc2 _REC_CUR_20_u1_u1 255. _CNV_A_R_LINEAR_____1_CM 0. 255. DISPLAY_IDENTIFIER ID_ERR_ENVD_VAR_COD FORMAT "%3.0"
 /begin AXIS_DESCR COM_AXIS online_dummy _CNV_A_R_LINEAR_____0_CM 8 0. 7. READ_ONLY FORMAT "%2.0" AXIS_PTS_REF ldp_fmy_envd /end AXIS_DESCR
/end CHARACTERISTIC
/begin CHARACTERISTIC fmy_id_var_cod.c_err_clas "error class for diagnosis instance VAR_COD" VALUE 0x85dbca _REC_VAL_20_u1 255. _CNV_A_R_LINEAR_____1_CM 0. 255. DISPLAY_IDENTIFIER C_ERR_CLAS_VAR_COD FORMAT "%3.0" /end CHARACTERISTIC
/begin CHARACTERISTIC fmy_id_vb.dtc[0] "diagnostic trouble codes for diagnosis instance VB" CURVE 0x85dbcc _REC_CUR_20_u2_u2 65535. _CNV_A_R_LINEAR_____1_CM 0. 65535. DISPLAY_IDENTIFIER ID_ERR_DTC_VB FORMAT "%5.0"
 /begin AXIS_DESCR COM_AXIS online_dummy _CNV_A_R_LINEAR_____0_CM 6 0. 5. FORMAT "%2.0" AXIS_PTS_REF ldp_fmy_dtc /end AXIS_DESCR
/end CHARACTERISTIC
/begin CHARACTERISTIC fmy_id_vb.envd "environmental data contents of customer specific freeze frame for diagnosis instance VB" CURVE 0x85dbd8 _REC_CUR_20_u1_u1 255. _CNV_A_R_LINEAR_____1_CM 0. 255. DISPLAY_IDENTIFIER ID_ERR_ENVD_VB FORMAT "%3.0"
 /begin AXIS_DESCR COM_AXIS online_dummy _CNV_A_R_LINEAR_____0_CM 8 0. 7. READ_ONLY FORMAT "%2.0" AXIS_PTS_REF ldp_fmy_envd /end AXIS_DESCR
/end CHARACTERISTIC
/begin CHARACTERISTIC fmy_id_vb.c_err_clas "error class for diagnosis instance VB" VALUE 0x85dbe0 _REC_VAL_20_u1 255. _CNV_A_R_LINEAR_____1_CM 0. 255. DISPLAY_IDENTIFIER C_ERR_CLAS_VB FORMAT "%3.0" /end CHARACTERISTIC
/begin CHARACTERISTIC fmy_id_vcv_1.dtc[0] "diagnostic trouble codes for diagnosis instance VCV_1" CURVE 0x85dbe2 _REC_CUR_20_u2_u2 65535. _CNV_A_R_LINEAR_____1_CM 0. 65535. DISPLAY_IDENTIFIER ID_ERR_DTC_VCV_1 FORMAT "%5.0"
 /begin AXIS_DESCR COM_AXIS online_dummy _CNV_A_R_LINEAR_____0_CM 6 0. 5. FORMAT "%2.0" AXIS_PTS_REF ldp_fmy_dtc /end AXIS_DESCR
/end CHARACTERISTIC
/begin CHARACTERISTIC fmy_id_vcv_1.envd "environmental data contents of customer specific freeze frame for diagnosis instance VCV_1" CURVE 0x85dbee _REC_CUR_20_u1_u1 255. _CNV_A_R_LINEAR_____1_CM 0. 255. DISPLAY_IDENTIFIER ID_ERR_ENVD_VCV_1 FORMAT "%3.0"
 /begin AXIS_DESCR COM_AXIS online_dummy _CNV_A_R_LINEAR_____0_CM 8 0. 7. READ_ONLY FORMAT "%2.0" AXIS_PTS_REF ldp_fmy_envd /end AXIS_DESCR
/end CHARACTERISTIC
/begin CHARACTERISTIC fmy_id_vcv_1.c_err_clas "error class for diagnosis instance VCV_1" VALUE 0x85dbf6 _REC_VAL_20_u1 255. _CNV_A_R_LINEAR_____1_CM 0. 255. DISPLAY_IDENTIFIER C_ERR_CLAS_VCV_1 FORMAT "%3.0" /end CHARACTERISTIC
/begin CHARACTERISTIC fmy_id_vcv_2.dtc[0] "diagnostic trouble codes for diagnosis instance VCV_2" CURVE 0x85dbf8 _REC_CUR_20_u2_u2 65535. _CNV_A_R_LINEAR_____1_CM 0. 65535. DISPLAY_IDENTIFIER ID_ERR_DTC_VCV_2 FORMAT "%5.0"
 /begin AXIS_DESCR COM_AXIS online_dummy _CNV_A_R_LINEAR_____0_CM 6 0. 5. FORMAT "%2.0" AXIS_PTS_REF ldp_fmy_dtc /end AXIS_DESCR
/end CHARACTERISTIC
/begin CHARACTERISTIC fmy_id_vcv_2.envd "environmental data contents of customer specific freeze frame for diagnosis instance VCV_2" CURVE 0x85dc04 _REC_CUR_20_u1_u1 255. _CNV_A_R_LINEAR_____1_CM 0. 255. DISPLAY_IDENTIFIER ID_ERR_ENVD_VCV_2 FORMAT "%3.0"
 /begin AXIS_DESCR COM_AXIS online_dummy _CNV_A_R_LINEAR_____0_CM 8 0. 7. READ_ONLY FORMAT "%2.0" AXIS_PTS_REF ldp_fmy_envd /end AXIS_DESCR
/end CHARACTERISTIC
/begin CHARACTERISTIC fmy_id_vcv_2.c_err_clas "error class for diagnosis instance VCV_2" VALUE 0x85dc0c _REC_VAL_20_u1 255. _CNV_A_R_LINEAR_____1_CM 0. 255. DISPLAY_IDENTIFIER C_ERR_CLAS_VCV_2 FORMAT "%3.0" /end CHARACTERISTIC
/begin CHARACTERISTIC fmy_id_vcv_3.dtc[0] "diagnostic trouble codes for diagnosis instance VCV_3" CURVE 0x85dc0e _REC_CUR_20_u2_u2 65535. _CNV_A_R_LINEAR_____1_CM 0. 65535. DISPLAY_IDENTIFIER ID_ERR_DTC_VCV_3 FORMAT "%5.0"
 /begin AXIS_DESCR COM_AXIS online_dummy _CNV_A_R_LINEAR_____0_CM 6 0. 5. FORMAT "%2.0" AXIS_PTS_REF ldp_fmy_dtc /end AXIS_DESCR
/end CHARACTERISTIC
/begin CHARACTERISTIC fmy_id_vcv_3.envd "environmental data contents of customer specific freeze frame for diagnosis instance VCV_3" CURVE 0x85dc1a _REC_CUR_20_u1_u1 255. _CNV_A_R_LINEAR_____1_CM 0. 255. DISPLAY_IDENTIFIER ID_ERR_ENVD_VCV_3 FORMAT "%3.0"
 /begin AXIS_DESCR COM_AXIS online_dummy _CNV_A_R_LINEAR_____0_CM 8 0. 7. READ_ONLY FORMAT "%2.0" AXIS_PTS_REF ldp_fmy_envd /end AXIS_DESCR
/end CHARACTERISTIC
/begin CHARACTERISTIC fmy_id_vcv_3.c_err_clas "error class for diagnosis instance VCV_3" VALUE 0x85dc22 _REC_VAL_20_u1 255. _CNV_A_R_LINEAR_____1_CM 0. 255. DISPLAY_IDENTIFIER C_ERR_CLAS_VCV_3 FORMAT "%3.0" /end CHARACTERISTIC
/begin CHARACTERISTIC fmy_id_conv_mon_1.dtc[0] "diagnostic trouble codes for diagnosis instance CONV_MON_1" CURVE 0x85dc24 _REC_CUR_20_u2_u2 65535. _CNV_A_R_LINEAR_____1_CM 0. 65535. DISPLAY_IDENTIFIER ID_ERR_DTC_CONV_MON_1 FORMAT "%5.0"
 /begin AXIS_DESCR COM_AXIS online_dummy _CNV_A_R_LINEAR_____0_CM 6 0. 5. FORMAT "%2.0" AXIS_PTS_REF ldp_fmy_dtc /end AXIS_DESCR
/end CHARACTERISTIC
/begin CHARACTERISTIC fmy_id_conv_mon_1.envd "environmental data contents of customer specific freeze frame for diagnosis instance CONV_MON_1" CURVE 0x85dc30 _REC_CUR_20_u1_u1 255. _CNV_A_R_LINEAR_____1_CM 0. 255. DISPLAY_IDENTIFIER ID_ERR_ENVD_CONV_MON_1 FORMAT "%3.0"
 /begin AXIS_DESCR COM_AXIS online_dummy _CNV_A_R_LINEAR_____0_CM 8 0. 7. READ_ONLY FORMAT "%2.0" AXIS_PTS_REF ldp_fmy_envd /end AXIS_DESCR
/end CHARACTERISTIC
/begin CHARACTERISTIC fmy_id_conv_mon_1.c_err_clas "error class for diagnosis instance CONV_MON_1" VALUE 0x85dc38 _REC_VAL_20_u1 255. _CNV_A_R_LINEAR_____1_CM 0. 255. DISPLAY_IDENTIFIER C_ERR_CLAS_CONV_MON_1 FORMAT "%3.0" /end CHARACTERISTIC
/begin CHARACTERISTIC fmy_id_n_32_mon_1.dtc[0] "diagnostic trouble codes for diagnosis instance N_32_MON_1" CURVE 0x85dc3a _REC_CUR_20_u2_u2 65535. _CNV_A_R_LINEAR_____1_CM 0. 65535. DISPLAY_IDENTIFIER ID_ERR_DTC_N_32_MON_1 FORMAT "%5.0"
 /begin AXIS_DESCR COM_AXIS online_dummy _CNV_A_R_LINEAR_____0_CM 6 0. 5. FORMAT "%2.0" AXIS_PTS_REF ldp_fmy_dtc /end AXIS_DESCR
/end CHARACTERISTIC
/begin CHARACTERISTIC fmy_id_n_32_mon_1.envd "environmental data contents of customer specific freeze frame for diagnosis instance N_32_MON_1" CURVE 0x85dc46 _REC_CUR_20_u1_u1 255. _CNV_A_R_LINEAR_____1_CM 0. 255. DISPLAY_IDENTIFIER ID_ERR_ENVD_N_32_MON_1 FORMAT "%3.0"
 /begin AXIS_DESCR COM_AXIS online_dummy _CNV_A_R_LINEAR_____0_CM 8 0. 7. READ_ONLY FORMAT "%2.0" AXIS_PTS_REF ldp_fmy_envd /end AXIS_DESCR
/end CHARACTERISTIC
/begin CHARACTERISTIC fmy_id_n_32_mon_1.c_err_clas "error class for diagnosis instance N_32_MON_1" VALUE 0x85dc4e _REC_VAL_20_u1 255. _CNV_A_R_LINEAR_____1_CM 0. 255. DISPLAY_IDENTIFIER C_ERR_CLAS_N_32_MON_1 FORMAT "%3.0" /end CHARACTERISTIC
/begin CHARACTERISTIC fmy_id_pvs_mon_1.dtc[0] "diagnostic trouble codes for diagnosis instance PVS_MON_1" CURVE 0x85dc50 _REC_CUR_20_u2_u2 65535. _CNV_A_R_LINEAR_____1_CM 0. 65535. DISPLAY_IDENTIFIER ID_ERR_DTC_PVS_MON_1 FORMAT "%5.0"
 /begin AXIS_DESCR COM_AXIS online_dummy _CNV_A_R_LINEAR_____0_CM 6 0. 5. FORMAT "%2.0" AXIS_PTS_REF ldp_fmy_dtc /end AXIS_DESCR
/end CHARACTERISTIC
/begin CHARACTERISTIC fmy_id_pvs_mon_1.envd "environmental data contents of customer specific freeze frame for diagnosis instance PVS_MON_1" CURVE 0x85dc5c _REC_CUR_20_u1_u1 255. _CNV_A_R_LINEAR_____1_CM 0. 255. DISPLAY_IDENTIFIER ID_ERR_ENVD_PVS_MON_1 FORMAT "%3.0"
 /begin AXIS_DESCR COM_AXIS online_dummy _CNV_A_R_LINEAR_____0_CM 8 0. 7. READ_ONLY FORMAT "%2.0" AXIS_PTS_REF ldp_fmy_envd /end AXIS_DESCR
/end CHARACTERISTIC
/begin CHARACTERISTIC fmy_id_pvs_mon_1.c_err_clas "error class for diagnosis instance PVS_MON_1" VALUE 0x85dc64 _REC_VAL_20_u1 255. _CNV_A_R_LINEAR_____1_CM 0. 255. DISPLAY_IDENTIFIER C_ERR_CLAS_PVS_MON_1 FORMAT "%3.0" /end CHARACTERISTIC
/begin CHARACTERISTIC fmy_id_fcut_mon_1.dtc[0] "diagnostic trouble codes for diagnosis instance FCUT_MON_1" CURVE 0x85dc66 _REC_CUR_20_u2_u2 65535. _CNV_A_R_LINEAR_____1_CM 0. 65535. DISPLAY_IDENTIFIER ID_ERR_DTC_FCUT_MON_1 FORMAT "%5.0"
 /begin AXIS_DESCR COM_AXIS online_dummy _CNV_A_R_LINEAR_____0_CM 6 0. 5. FORMAT "%2.0" AXIS_PTS_REF ldp_fmy_dtc /end AXIS_DESCR
/end CHARACTERISTIC
/begin CHARACTERISTIC fmy_id_fcut_mon_1.envd "environmental data contents of customer specific freeze frame for diagnosis instance FCUT_MON_1" CURVE 0x85dc72 _REC_CUR_20_u1_u1 255. _CNV_A_R_LINEAR_____1_CM 0. 255. DISPLAY_IDENTIFIER ID_ERR_ENVD_FCUT_MON_1 FORMAT "%3.0"
 /begin AXIS_DESCR COM_AXIS online_dummy _CNV_A_R_LINEAR_____0_CM 8 0. 7. READ_ONLY FORMAT "%2.0" AXIS_PTS_REF ldp_fmy_envd /end AXIS_DESCR
/end CHARACTERISTIC
/begin CHARACTERISTIC fmy_id_fcut_mon_1.c_err_clas "error class for diagnosis instance FCUT_MON_1" VALUE 0x85dc7a _REC_VAL_20_u1 255. _CNV_A_R_LINEAR_____1_CM 0. 255. DISPLAY_IDENTIFIER C_ERR_CLAS_FCUT_MON_1 FORMAT "%3.0" /end CHARACTERISTIC
/begin CHARACTERISTIC fmy_id_tqi_n_max_mon_1.dtc[0] "diagnostic trouble codes for diagnosis instance TQI_N_MAX_MON_1" CURVE 0x85dc7c _REC_CUR_20_u2_u2 65535. _CNV_A_R_LINEAR_____1_CM 0. 65535. DISPLAY_IDENTIFIER ID_ERR_DTC_TQI_N_MAX_MON_1 FORMAT "%5.0"
 /begin AXIS_DESCR COM_AXIS online_dummy _CNV_A_R_LINEAR_____0_CM 6 0. 5. FORMAT "%2.0" AXIS_PTS_REF ldp_fmy_dtc /end AXIS_DESCR
/end CHARACTERISTIC
/begin CHARACTERISTIC fmy_id_tqi_n_max_mon_1.envd "environmental data contents of customer specific freeze frame for diagnosis instance TQI_N_MAX_MON_1" CURVE 0x85dc88 _REC_CUR_20_u1_u1 255. _CNV_A_R_LINEAR_____1_CM 0. 255. DISPLAY_IDENTIFIER ID_ERR_ENVD_TQI_N_MAX_MON_1 FORMAT "%3.0"
 /begin AXIS_DESCR COM_AXIS online_dummy _CNV_A_R_LINEAR_____0_CM 8 0. 7. READ_ONLY FORMAT "%2.0" AXIS_PTS_REF ldp_fmy_envd /end AXIS_DESCR
/end CHARACTERISTIC
/begin CHARACTERISTIC fmy_id_tqi_n_max_mon_1.c_err_clas "error class for diagnosis instance TQI_N_MAX_MON_1" VALUE 0x85dc90 _REC_VAL_20_u1 255. _CNV_A_R_LINEAR_____1_CM 0. 255. DISPLAY_IDENTIFIER C_ERR_CLAS_TQI_N_MAX_MON_1 FORMAT "%3.0" /end CHARACTERISTIC
/begin CHARACTERISTIC fmy_id_serv_mon_1.dtc[0] "diagnostic trouble codes for diagnosis instance SERV_MON_1" CURVE 0x85dc92 _REC_CUR_20_u2_u2 65535. _CNV_A_R_LINEAR_____1_CM 0. 65535. DISPLAY_IDENTIFIER ID_ERR_DTC_SERV_MON_1 FORMAT "%5.0"
 /begin AXIS_DESCR COM_AXIS online_dummy _CNV_A_R_LINEAR_____0_CM 6 0. 5. FORMAT "%2.0" AXIS_PTS_REF ldp_fmy_dtc /end AXIS_DESCR
/end CHARACTERISTIC
/begin CHARACTERISTIC fmy_id_serv_mon_1.envd "environmental data contents of customer specific freeze frame for diagnosis instance SERV_MON_1" CURVE 0x85dc9e _REC_CUR_20_u1_u1 255. _CNV_A_R_LINEAR_____1_CM 0. 255. DISPLAY_IDENTIFIER ID_ERR_ENVD_SERV_MON_1 FORMAT "%3.0"
 /begin AXIS_DESCR COM_AXIS online_dummy _CNV_A_R_LINEAR_____0_CM 8 0. 7. READ_ONLY FORMAT "%2.0" AXIS_PTS_REF ldp_fmy_envd /end AXIS_DESCR
/end CHARACTERISTIC
/begin CHARACTERISTIC fmy_id_serv_mon_1.c_err_clas "error class for diagnosis instance SERV_MON_1" VALUE 0x85dca6 _REC_VAL_20_u1 255. _CNV_A_R_LINEAR_____1_CM 0. 255. DISPLAY_IDENTIFIER C_ERR_CLAS_SERV_MON_1 FORMAT "%3.0" /end CHARACTERISTIC
/begin CHARACTERISTIC fmy_id_post_inh_mon.dtc[0] "diagnostic trouble codes for diagnosis instance POST_INH_MON" CURVE 0x85dca8 _REC_CUR_20_u2_u2 65535. _CNV_A_R_LINEAR_____1_CM 0. 65535. DISPLAY_IDENTIFIER ID_ERR_DTC_POST_INH_MON FORMAT "%5.0"
 /begin AXIS_DESCR COM_AXIS online_dummy _CNV_A_R_LINEAR_____0_CM 6 0. 5. FORMAT "%2.0" AXIS_PTS_REF ldp_fmy_dtc /end AXIS_DESCR
/end CHARACTERISTIC
/begin CHARACTERISTIC fmy_id_post_inh_mon.envd "environmental data contents of customer specific freeze frame for diagnosis instance POST_INH_MON" CURVE 0x85dcb4 _REC_CUR_20_u1_u1 255. _CNV_A_R_LINEAR_____1_CM 0. 255. DISPLAY_IDENTIFIER ID_ERR_ENVD_POST_INH_MON FORMAT "%3.0"
 /begin AXIS_DESCR COM_AXIS online_dummy _CNV_A_R_LINEAR_____0_CM 8 0. 7. READ_ONLY FORMAT "%2.0" AXIS_PTS_REF ldp_fmy_envd /end AXIS_DESCR
/end CHARACTERISTIC
/begin CHARACTERISTIC fmy_id_post_inh_mon.c_err_clas "error class for diagnosis instance POST_INH_MON" VALUE 0x85dcbc _REC_VAL_20_u1 255. _CNV_A_R_LINEAR_____1_CM 0. 255. DISPLAY_IDENTIFIER C_ERR_CLAS_POST_INH_MON FORMAT "%3.0" /end CHARACTERISTIC
/begin CHARACTERISTIC fmy_id_cru_inh_mon.dtc[0] "diagnostic trouble codes for diagnosis instance CRU_INH_MON" CURVE 0x85dcbe _REC_CUR_20_u2_u2 65535. _CNV_A_R_LINEAR_____1_CM 0. 65535. DISPLAY_IDENTIFIER ID_ERR_DTC_CRU_INH_MON FORMAT "%5.0"
 /begin AXIS_DESCR COM_AXIS online_dummy _CNV_A_R_LINEAR_____0_CM 6 0. 5. FORMAT "%2.0" AXIS_PTS_REF ldp_fmy_dtc /end AXIS_DESCR
/end CHARACTERISTIC
/begin CHARACTERISTIC fmy_id_cru_inh_mon.envd "environmental data contents of customer specific freeze frame for diagnosis instance CRU_INH_MON" CURVE 0x85dcca _REC_CUR_20_u1_u1 255. _CNV_A_R_LINEAR_____1_CM 0. 255. DISPLAY_IDENTIFIER ID_ERR_ENVD_CRU_INH_MON FORMAT "%3.0"
 /begin AXIS_DESCR COM_AXIS online_dummy _CNV_A_R_LINEAR_____0_CM 8 0. 7. READ_ONLY FORMAT "%2.0" AXIS_PTS_REF ldp_fmy_envd /end AXIS_DESCR
/end CHARACTERISTIC
/begin CHARACTERISTIC fmy_id_cru_inh_mon.c_err_clas "error class for diagnosis instance CRU_INH_MON" VALUE 0x85dcd2 _REC_VAL_20_u1 255. _CNV_A_R_LINEAR_____1_CM 0. 255. DISPLAY_IDENTIFIER C_ERR_CLAS_CRU_INH_MON FORMAT "%3.0" /end CHARACTERISTIC
/begin CHARACTERISTIC fmy_id_can_inh_mon.dtc[0] "diagnostic trouble codes for diagnosis instance CAN_INH_MON" CURVE 0x85dcd4 _REC_CUR_20_u2_u2 65535. _CNV_A_R_LINEAR_____1_CM 0. 65535. DISPLAY_IDENTIFIER ID_ERR_DTC_CAN_INH_MON FORMAT "%5.0"
 /begin AXIS_DESCR COM_AXIS online_dummy _CNV_A_R_LINEAR_____0_CM 6 0. 5. FORMAT "%2.0" AXIS_PTS_REF ldp_fmy_dtc /end AXIS_DESCR
/end CHARACTERISTIC
/begin CHARACTERISTIC fmy_id_can_inh_mon.envd "environmental data contents of customer specific freeze frame for diagnosis instance CAN_INH_MON" CURVE 0x85dce0 _REC_CUR_20_u1_u1 255. _CNV_A_R_LINEAR_____1_CM 0. 255. DISPLAY_IDENTIFIER ID_ERR_ENVD_CAN_INH_MON FORMAT "%3.0"
 /begin AXIS_DESCR COM_AXIS online_dummy _CNV_A_R_LINEAR_____0_CM 8 0. 7. READ_ONLY FORMAT "%2.0" AXIS_PTS_REF ldp_fmy_envd /end AXIS_DESCR
/end CHARACTERISTIC
/begin CHARACTERISTIC fmy_id_can_inh_mon.c_err_clas "error class for diagnosis instance CAN_INH_MON" VALUE 0x85dce8 _REC_VAL_20_u1 255. _CNV_A_R_LINEAR_____1_CM 0. 255. DISPLAY_IDENTIFIER C_ERR_CLAS_CAN_INH_MON FORMAT "%3.0" /end CHARACTERISTIC
/begin CHARACTERISTIC fmy_id_mon_3.dtc[0] "diagnostic trouble codes for diagnosis instance MON_3" CURVE 0x85dcea _REC_CUR_20_u2_u2 65535. _CNV_A_R_LINEAR_____1_CM 0. 65535. DISPLAY_IDENTIFIER ID_ERR_DTC_MON_3 FORMAT "%5.0"
 /begin AXIS_DESCR COM_AXIS online_dummy _CNV_A_R_LINEAR_____0_CM 6 0. 5. FORMAT "%2.0" AXIS_PTS_REF ldp_fmy_dtc /end AXIS_DESCR
/end CHARACTERISTIC
/begin CHARACTERISTIC fmy_id_mon_3.envd "environmental data contents of customer specific freeze frame for diagnosis instance MON_3" CURVE 0x85dcf6 _REC_CUR_20_u1_u1 255. _CNV_A_R_LINEAR_____1_CM 0. 255. DISPLAY_IDENTIFIER ID_ERR_ENVD_MON_3 FORMAT "%3.0"
 /begin AXIS_DESCR COM_AXIS online_dummy _CNV_A_R_LINEAR_____0_CM 8 0. 7. READ_ONLY FORMAT "%2.0" AXIS_PTS_REF ldp_fmy_envd /end AXIS_DESCR
/end CHARACTERISTIC
/begin CHARACTERISTIC fmy_id_mon_3.c_err_clas "error class for diagnosis instance MON_3" VALUE 0x85dcfe _REC_VAL_20_u1 255. _CNV_A_R_LINEAR_____1_CM 0. 255. DISPLAY_IDENTIFIER C_ERR_CLAS_MON_3 FORMAT "%3.0" /end CHARACTERISTIC
/begin CHARACTERISTIC fmy_id_per_cam_in_1.dtc[0] "diagnostic trouble codes for diagnosis instance PER_CAM_IN_1" CURVE 0x85dd00 _REC_CUR_20_u2_u2 65535. _CNV_A_R_LINEAR_____1_CM 0. 65535. DISPLAY_IDENTIFIER ID_ERR_DTC_PER_CAM_IN_1 FORMAT "%5.0"
 /begin AXIS_DESCR COM_AXIS online_dummy _CNV_A_R_LINEAR_____0_CM 6 0. 5. FORMAT "%2.0" AXIS_PTS_REF ldp_fmy_dtc /end AXIS_DESCR
/end CHARACTERISTIC
/begin CHARACTERISTIC fmy_id_per_cam_in_1.envd "environmental data contents of customer specific freeze frame for diagnosis instance PER_CAM_IN_1" CURVE 0x85dd0c _REC_CUR_20_u1_u1 255. _CNV_A_R_LINEAR_____1_CM 0. 255. DISPLAY_IDENTIFIER ID_ERR_ENVD_PER_CAM_IN_1 FORMAT "%3.0"
 /begin AXIS_DESCR COM_AXIS online_dummy _CNV_A_R_LINEAR_____0_CM 8 0. 7. READ_ONLY FORMAT "%2.0" AXIS_PTS_REF ldp_fmy_envd /end AXIS_DESCR
/end CHARACTERISTIC
/begin CHARACTERISTIC fmy_id_per_cam_in_1.c_err_clas "error class for diagnosis instance PER_CAM_IN_1" VALUE 0x85dd14 _REC_VAL_20_u1 255. _CNV_A_R_LINEAR_____1_CM 0. 255. DISPLAY_IDENTIFIER C_ERR_CLAS_PER_CAM_IN_1 FORMAT "%3.0" /end CHARACTERISTIC
/begin CHARACTERISTIC fmy_id_syn_cam_in_1.dtc[0] "diagnostic trouble codes for diagnosis instance SYN_CAM_IN_1" CURVE 0x85dd16 _REC_CUR_20_u2_u2 65535. _CNV_A_R_LINEAR_____1_CM 0. 65535. DISPLAY_IDENTIFIER ID_ERR_DTC_SYN_CAM_IN_1 FORMAT "%5.0"
 /begin AXIS_DESCR COM_AXIS online_dummy _CNV_A_R_LINEAR_____0_CM 6 0. 5. FORMAT "%2.0" AXIS_PTS_REF ldp_fmy_dtc /end AXIS_DESCR
/end CHARACTERISTIC
/begin CHARACTERISTIC fmy_id_syn_cam_in_1.envd "environmental data contents of customer specific freeze frame for diagnosis instance SYN_CAM_IN_1" CURVE 0x85dd22 _REC_CUR_20_u1_u1 255. _CNV_A_R_LINEAR_____1_CM 0. 255. DISPLAY_IDENTIFIER ID_ERR_ENVD_SYN_CAM_IN_1 FORMAT "%3.0"
 /begin AXIS_DESCR COM_AXIS online_dummy _CNV_A_R_LINEAR_____0_CM 8 0. 7. READ_ONLY FORMAT "%2.0" AXIS_PTS_REF ldp_fmy_envd /end AXIS_DESCR
/end CHARACTERISTIC
/begin CHARACTERISTIC fmy_id_syn_cam_in_1.c_err_clas "error class for diagnosis instance SYN_CAM_IN_1" VALUE 0x85dd2a _REC_VAL_20_u1 255. _CNV_A_R_LINEAR_____1_CM 0. 255. DISPLAY_IDENTIFIER C_ERR_CLAS_SYN_CAM_IN_1 FORMAT "%3.0" /end CHARACTERISTIC
/begin CHARACTERISTIC fmy_id_ref_crk_cam_in_1.dtc[0] "diagnostic trouble codes for diagnosis instance REF_CRK_CAM_IN_1" CURVE 0x85dd2c _REC_CUR_20_u2_u2 65535. _CNV_A_R_LINEAR_____1_CM 0. 65535. DISPLAY_IDENTIFIER ID_ERR_DTC_REF_CRK_CAM_IN_1 FORMAT "%5.0"
 /begin AXIS_DESCR COM_AXIS online_dummy _CNV_A_R_LINEAR_____0_CM 6 0. 5. FORMAT "%2.0" AXIS_PTS_REF ldp_fmy_dtc /end AXIS_DESCR
/end CHARACTERISTIC
/begin CHARACTERISTIC fmy_id_ref_crk_cam_in_1.envd "environmental data contents of customer specific freeze frame for diagnosis instance REF_CRK_CAM_IN_1" CURVE 0x85dd38 _REC_CUR_20_u1_u1 255. _CNV_A_R_LINEAR_____1_CM 0. 255. DISPLAY_IDENTIFIER ID_ERR_ENVD_REF_CRK_CAM_IN_1 FORMAT "%3.0"
 /begin AXIS_DESCR COM_AXIS online_dummy _CNV_A_R_LINEAR_____0_CM 8 0. 7. READ_ONLY FORMAT "%2.0" AXIS_PTS_REF ldp_fmy_envd /end AXIS_DESCR
/end CHARACTERISTIC
/begin CHARACTERISTIC fmy_id_ref_crk_cam_in_1.c_err_clas "error class for diagnosis instance REF_CRK_CAM_IN_1" VALUE 0x85dd40 _REC_VAL_20_u1 255. _CNV_A_R_LINEAR_____1_CM 0. 255. DISPLAY_IDENTIFIER C_ERR_CLAS_REF_CRK_CAM_IN_1 FORMAT "%3.0" /end CHARACTERISTIC
/begin CHARACTERISTIC fmy_id_crk_tooth.dtc[0] "diagnostic trouble codes for diagnosis instance CRK_TOOTH" CURVE 0x85dd42 _REC_CUR_20_u2_u2 65535. _CNV_A_R_LINEAR_____1_CM 0. 65535. DISPLAY_IDENTIFIER ID_ERR_DTC_CRK_TOOTH FORMAT "%5.0"
 /begin AXIS_DESCR COM_AXIS online_dummy _CNV_A_R_LINEAR_____0_CM 6 0. 5. FORMAT "%2.0" AXIS_PTS_REF ldp_fmy_dtc /end AXIS_DESCR
/end CHARACTERISTIC
/begin CHARACTERISTIC fmy_id_crk_tooth.envd "environmental data contents of customer specific freeze frame for diagnosis instance CRK_TOOTH" CURVE 0x85dd4e _REC_CUR_20_u1_u1 255. _CNV_A_R_LINEAR_____1_CM 0. 255. DISPLAY_IDENTIFIER ID_ERR_ENVD_CRK_TOOTH FORMAT "%3.0"
 /begin AXIS_DESCR COM_AXIS online_dummy _CNV_A_R_LINEAR_____0_CM 8 0. 7. READ_ONLY FORMAT "%2.0" AXIS_PTS_REF ldp_fmy_envd /end AXIS_DESCR
/end CHARACTERISTIC
/begin CHARACTERISTIC fmy_id_crk_tooth.c_err_clas "error class for diagnosis instance CRK_TOOTH" VALUE 0x85dd56 _REC_VAL_20_u1 255. _CNV_A_R_LINEAR_____1_CM 0. 255. DISPLAY_IDENTIFIER C_ERR_CLAS_CRK_TOOTH FORMAT "%3.0" /end CHARACTERISTIC
/begin CHARACTERISTIC fmy_id_crk_tooth_per.dtc[0] "diagnostic trouble codes for diagnosis instance CRK_TOOTH_PER" CURVE 0x85dd58 _REC_CUR_20_u2_u2 65535. _CNV_A_R_LINEAR_____1_CM 0. 65535. DISPLAY_IDENTIFIER ID_ERR_DTC_CRK_TOOTH_PER FORMAT "%5.0"
 /begin AXIS_DESCR COM_AXIS online_dummy _CNV_A_R_LINEAR_____0_CM 6 0. 5. FORMAT "%2.0" AXIS_PTS_REF ldp_fmy_dtc /end AXIS_DESCR
/end CHARACTERISTIC
/begin CHARACTERISTIC fmy_id_crk_tooth_per.envd "environmental data contents of customer specific freeze frame for diagnosis instance CRK_TOOTH_PER" CURVE 0x85dd64 _REC_CUR_20_u1_u1 255. _CNV_A_R_LINEAR_____1_CM 0. 255. DISPLAY_IDENTIFIER ID_ERR_ENVD_CRK_TOOTH_PER FORMAT "%3.0"
 /begin AXIS_DESCR COM_AXIS online_dummy _CNV_A_R_LINEAR_____0_CM 8 0. 7. READ_ONLY FORMAT "%2.0" AXIS_PTS_REF ldp_fmy_envd /end AXIS_DESCR
/end CHARACTERISTIC
/begin CHARACTERISTIC fmy_id_crk_tooth_per.c_err_clas "error class for diagnosis instance CRK_TOOTH_PER" VALUE 0x85dd6c _REC_VAL_20_u1 255. _CNV_A_R_LINEAR_____1_CM 0. 255. DISPLAY_IDENTIFIER C_ERR_CLAS_CRK_TOOTH_PER FORMAT "%3.0" /end CHARACTERISTIC
/begin CHARACTERISTIC fmy_id_crk_syn.dtc[0] "diagnostic trouble codes for diagnosis instance CRK_SYN" CURVE 0x85dd6e _REC_CUR_20_u2_u2 65535. _CNV_A_R_LINEAR_____1_CM 0. 65535. DISPLAY_IDENTIFIER ID_ERR_DTC_CRK_SYN FORMAT "%5.0"
 /begin AXIS_DESCR COM_AXIS online_dummy _CNV_A_R_LINEAR_____0_CM 6 0. 5. FORMAT "%2.0" AXIS_PTS_REF ldp_fmy_dtc /end AXIS_DESCR
/end CHARACTERISTIC
/begin CHARACTERISTIC fmy_id_crk_syn.envd "environmental data contents of customer specific freeze frame for diagnosis instance CRK_SYN" CURVE 0x85dd7a _REC_CUR_20_u1_u1 255. _CNV_A_R_LINEAR_____1_CM 0. 255. DISPLAY_IDENTIFIER ID_ERR_ENVD_CRK_SYN FORMAT "%3.0"
 /begin AXIS_DESCR COM_AXIS online_dummy _CNV_A_R_LINEAR_____0_CM 8 0. 7. READ_ONLY FORMAT "%2.0" AXIS_PTS_REF ldp_fmy_envd /end AXIS_DESCR
/end CHARACTERISTIC
/begin CHARACTERISTIC fmy_id_crk_syn.c_err_clas "error class for diagnosis instance CRK_SYN" VALUE 0x85dd82 _REC_VAL_20_u1 255. _CNV_A_R_LINEAR_____1_CM 0. 255. DISPLAY_IDENTIFIER C_ERR_CLAS_CRK_SYN FORMAT "%3.0" /end CHARACTERISTIC
/begin CHARACTERISTIC fmy_id_crk_plaus.dtc[0] "diagnostic trouble codes for diagnosis instance CRK_PLAUS" CURVE 0x85dd84 _REC_CUR_20_u2_u2 65535. _CNV_A_R_LINEAR_____1_CM 0. 65535. DISPLAY_IDENTIFIER ID_ERR_DTC_CRK_PLAUS FORMAT "%5.0"
 /begin AXIS_DESCR COM_AXIS online_dummy _CNV_A_R_LINEAR_____0_CM 6 0. 5. FORMAT "%2.0" AXIS_PTS_REF ldp_fmy_dtc /end AXIS_DESCR
/end CHARACTERISTIC
/begin CHARACTERISTIC fmy_id_crk_plaus.envd "environmental data contents of customer specific freeze frame for diagnosis instance CRK_PLAUS" CURVE 0x85dd90 _REC_CUR_20_u1_u1 255. _CNV_A_R_LINEAR_____1_CM 0. 255. DISPLAY_IDENTIFIER ID_ERR_ENVD_CRK_PLAUS FORMAT "%3.0"
 /begin AXIS_DESCR COM_AXIS online_dummy _CNV_A_R_LINEAR_____0_CM 8 0. 7. READ_ONLY FORMAT "%2.0" AXIS_PTS_REF ldp_fmy_envd /end AXIS_DESCR
/end CHARACTERISTIC
/begin CHARACTERISTIC fmy_id_crk_plaus.c_err_clas "error class for diagnosis instance CRK_PLAUS" VALUE 0x85dd98 _REC_VAL_20_u1 255. _CNV_A_R_LINEAR_____1_CM 0. 255. DISPLAY_IDENTIFIER C_ERR_CLAS_CRK_PLAUS FORMAT "%3.0" /end CHARACTERISTIC
/begin CHARACTERISTIC fmy_id_plaus_cam_in_1.dtc[0] "diagnostic trouble codes for diagnosis instance PLAUS_CAM_IN_1" CURVE 0x85dd9a _REC_CUR_20_u2_u2 65535. _CNV_A_R_LINEAR_____1_CM 0. 65535. DISPLAY_IDENTIFIER ID_ERR_DTC_PLAUS_CAM_IN_1 FORMAT "%5.0"
 /begin AXIS_DESCR COM_AXIS online_dummy _CNV_A_R_LINEAR_____0_CM 6 0. 5. FORMAT "%2.0" AXIS_PTS_REF ldp_fmy_dtc /end AXIS_DESCR
/end CHARACTERISTIC
/begin CHARACTERISTIC fmy_id_plaus_cam_in_1.envd "environmental data contents of customer specific freeze frame for diagnosis instance PLAUS_CAM_IN_1" CURVE 0x85dda6 _REC_CUR_20_u1_u1 255. _CNV_A_R_LINEAR_____1_CM 0. 255. DISPLAY_IDENTIFIER ID_ERR_ENVD_PLAUS_CAM_IN_1 FORMAT "%3.0"
 /begin AXIS_DESCR COM_AXIS online_dummy _CNV_A_R_LINEAR_____0_CM 8 0. 7. READ_ONLY FORMAT "%2.0" AXIS_PTS_REF ldp_fmy_envd /end AXIS_DESCR
/end CHARACTERISTIC
/begin CHARACTERISTIC fmy_id_plaus_cam_in_1.c_err_clas "error class for diagnosis instance PLAUS_CAM_IN_1" VALUE 0x85ddae _REC_VAL_20_u1 255. _CNV_A_R_LINEAR_____1_CM 0. 255. DISPLAY_IDENTIFIER C_ERR_CLAS_PLAUS_CAM_IN_1 FORMAT "%3.0" /end CHARACTERISTIC
/begin CHARACTERISTIC fmy_id_syn_crk_cam_in_1.dtc[0] "diagnostic trouble codes for diagnosis instance SYN_CRK_CAM_IN_1" CURVE 0x85ddb0 _REC_CUR_20_u2_u2 65535. _CNV_A_R_LINEAR_____1_CM 0. 65535. DISPLAY_IDENTIFIER ID_ERR_DTC_SYN_CRK_CAM_IN_1 FORMAT "%5.0"
 /begin AXIS_DESCR COM_AXIS online_dummy _CNV_A_R_LINEAR_____0_CM 6 0. 5. FORMAT "%2.0" AXIS_PTS_REF ldp_fmy_dtc /end AXIS_DESCR
/end CHARACTERISTIC
/begin CHARACTERISTIC fmy_id_syn_crk_cam_in_1.envd "environmental data contents of customer specific freeze frame for diagnosis instance SYN_CRK_CAM_IN_1" CURVE 0x85ddbc _REC_CUR_20_u1_u1 255. _CNV_A_R_LINEAR_____1_CM 0. 255. DISPLAY_IDENTIFIER ID_ERR_ENVD_SYN_CRK_CAM_IN_1 FORMAT "%3.0"
 /begin AXIS_DESCR COM_AXIS online_dummy _CNV_A_R_LINEAR_____0_CM 8 0. 7. READ_ONLY FORMAT "%2.0" AXIS_PTS_REF ldp_fmy_envd /end AXIS_DESCR
/end CHARACTERISTIC
/begin CHARACTERISTIC fmy_id_syn_crk_cam_in_1.c_err_clas "error class for diagnosis instance SYN_CRK_CAM_IN_1" VALUE 0x85ddc4 _REC_VAL_20_u1 255. _CNV_A_R_LINEAR_____1_CM 0. 255. DISPLAY_IDENTIFIER C_ERR_CLAS_SYN_CRK_CAM_IN_1 FORMAT "%3.0" /end CHARACTERISTIC
/begin CHARACTERISTIC fmy_id_lsh_up_1.dtc[0] "diagnostic trouble codes for diagnosis instance LSH_UP_1" CURVE 0x85ddc6 _REC_CUR_20_u2_u2 65535. _CNV_A_R_LINEAR_____1_CM 0. 65535. DISPLAY_IDENTIFIER ID_ERR_DTC_LSH_UP_1 FORMAT "%5.0"
 /begin AXIS_DESCR COM_AXIS online_dummy _CNV_A_R_LINEAR_____0_CM 6 0. 5. FORMAT "%2.0" AXIS_PTS_REF ldp_fmy_dtc /end AXIS_DESCR
/end CHARACTERISTIC
/begin CHARACTERISTIC fmy_id_lsh_up_1.envd "environmental data contents of customer specific freeze frame for diagnosis instance LSH_UP_1" CURVE 0x85ddd2 _REC_CUR_20_u1_u1 255. _CNV_A_R_LINEAR_____1_CM 0. 255. DISPLAY_IDENTIFIER ID_ERR_ENVD_LSH_UP_1 FORMAT "%3.0"
 /begin AXIS_DESCR COM_AXIS online_dummy _CNV_A_R_LINEAR_____0_CM 8 0. 7. READ_ONLY FORMAT "%2.0" AXIS_PTS_REF ldp_fmy_envd /end AXIS_DESCR
/end CHARACTERISTIC
/begin CHARACTERISTIC fmy_id_lsh_up_1.c_err_clas "error class for diagnosis instance LSH_UP_1" VALUE 0x85ddda _REC_VAL_20_u1 255. _CNV_A_R_LINEAR_____1_CM 0. 255. DISPLAY_IDENTIFIER C_ERR_CLAS_LSH_UP_1 FORMAT "%3.0" /end CHARACTERISTIC
/begin CHARACTERISTIC fmy_id_lsh_down_1.dtc[0] "diagnostic trouble codes for diagnosis instance LSH_DOWN_1" CURVE 0x85dddc _REC_CUR_20_u2_u2 65535. _CNV_A_R_LINEAR_____1_CM 0. 65535. DISPLAY_IDENTIFIER ID_ERR_DTC_LSH_DOWN_1 FORMAT "%5.0"
 /begin AXIS_DESCR COM_AXIS online_dummy _CNV_A_R_LINEAR_____0_CM 6 0. 5. FORMAT "%2.0" AXIS_PTS_REF ldp_fmy_dtc /end AXIS_DESCR
/end CHARACTERISTIC
/begin CHARACTERISTIC fmy_id_lsh_down_1.envd "environmental data contents of customer specific freeze frame for diagnosis instance LSH_DOWN_1" CURVE 0x85dde8 _REC_CUR_20_u1_u1 255. _CNV_A_R_LINEAR_____1_CM 0. 255. DISPLAY_IDENTIFIER ID_ERR_ENVD_LSH_DOWN_1 FORMAT "%3.0"
 /begin AXIS_DESCR COM_AXIS online_dummy _CNV_A_R_LINEAR_____0_CM 8 0. 7. READ_ONLY FORMAT "%2.0" AXIS_PTS_REF ldp_fmy_envd /end AXIS_DESCR
/end CHARACTERISTIC
/begin CHARACTERISTIC fmy_id_lsh_down_1.c_err_clas "error class for diagnosis instance LSH_DOWN_1" VALUE 0x85ddf0 _REC_VAL_20_u1 255. _CNV_A_R_LINEAR_____1_CM 0. 255. DISPLAY_IDENTIFIER C_ERR_CLAS_LSH_DOWN_1 FORMAT "%3.0" /end CHARACTERISTIC
/begin CHARACTERISTIC fmy_id_scg_ls_down_1.dtc[0] "diagnostic trouble codes for diagnosis instance SCG_LS_DOWN_1" CURVE 0x85ddf2 _REC_CUR_20_u2_u2 65535. _CNV_A_R_LINEAR_____1_CM 0. 65535. DISPLAY_IDENTIFIER ID_ERR_DTC_SCG_LS_DOWN_1 FORMAT "%5.0"
 /begin AXIS_DESCR COM_AXIS online_dummy _CNV_A_R_LINEAR_____0_CM 6 0. 5. FORMAT "%2.0" AXIS_PTS_REF ldp_fmy_dtc /end AXIS_DESCR
/end CHARACTERISTIC
/begin CHARACTERISTIC fmy_id_scg_ls_down_1.envd "environmental data contents of customer specific freeze frame for diagnosis instance SCG_LS_DOWN_1" CURVE 0x85ddfe _REC_CUR_20_u1_u1 255. _CNV_A_R_LINEAR_____1_CM 0. 255. DISPLAY_IDENTIFIER ID_ERR_ENVD_SCG_LS_DOWN_1 FORMAT "%3.0"
 /begin AXIS_DESCR COM_AXIS online_dummy _CNV_A_R_LINEAR_____0_CM 8 0. 7. READ_ONLY FORMAT "%2.0" AXIS_PTS_REF ldp_fmy_envd /end AXIS_DESCR
/end CHARACTERISTIC
/begin CHARACTERISTIC fmy_id_scg_ls_down_1.c_err_clas "error class for diagnosis instance SCG_LS_DOWN_1" VALUE 0x85de06 _REC_VAL_20_u1 255. _CNV_A_R_LINEAR_____1_CM 0. 255. DISPLAY_IDENTIFIER C_ERR_CLAS_SCG_LS_DOWN_1 FORMAT "%3.0" /end CHARACTERISTIC
/begin CHARACTERISTIC fmy_id_scp_ls_down_1.dtc[0] "diagnostic trouble codes for diagnosis instance SCP_LS_DOWN_1" CURVE 0x85de08 _REC_CUR_20_u2_u2 65535. _CNV_A_R_LINEAR_____1_CM 0. 65535. DISPLAY_IDENTIFIER ID_ERR_DTC_SCP_LS_DOWN_1 FORMAT "%5.0"
 /begin AXIS_DESCR COM_AXIS online_dummy _CNV_A_R_LINEAR_____0_CM 6 0. 5. FORMAT "%2.0" AXIS_PTS_REF ldp_fmy_dtc /end AXIS_DESCR
/end CHARACTERISTIC
/begin CHARACTERISTIC fmy_id_scp_ls_down_1.envd "environmental data contents of customer specific freeze frame for diagnosis instance SCP_LS_DOWN_1" CURVE 0x85de14 _REC_CUR_20_u1_u1 255. _CNV_A_R_LINEAR_____1_CM 0. 255. DISPLAY_IDENTIFIER ID_ERR_ENVD_SCP_LS_DOWN_1 FORMAT "%3.0"
 /begin AXIS_DESCR COM_AXIS online_dummy _CNV_A_R_LINEAR_____0_CM 8 0. 7. READ_ONLY FORMAT "%2.0" AXIS_PTS_REF ldp_fmy_envd /end AXIS_DESCR
/end CHARACTERISTIC
/begin CHARACTERISTIC fmy_id_scp_ls_down_1.c_err_clas "error class for diagnosis instance SCP_LS_DOWN_1" VALUE 0x85de1c _REC_VAL_20_u1 255. _CNV_A_R_LINEAR_____1_CM 0. 255. DISPLAY_IDENTIFIER C_ERR_CLAS_SCP_LS_DOWN_1 FORMAT "%3.0" /end CHARACTERISTIC
/begin CHARACTERISTIC fmy_id_oc_ls_down_1.dtc[0] "diagnostic trouble codes for diagnosis instance OC_LS_DOWN_1" CURVE 0x85de1e _REC_CUR_20_u2_u2 65535. _CNV_A_R_LINEAR_____1_CM 0. 65535. DISPLAY_IDENTIFIER ID_ERR_DTC_OC_LS_DOWN_1 FORMAT "%5.0"
 /begin AXIS_DESCR COM_AXIS online_dummy _CNV_A_R_LINEAR_____0_CM 6 0. 5. FORMAT "%2.0" AXIS_PTS_REF ldp_fmy_dtc /end AXIS_DESCR
/end CHARACTERISTIC
/begin CHARACTERISTIC fmy_id_oc_ls_down_1.envd "environmental data contents of customer specific freeze frame for diagnosis instance OC_LS_DOWN_1" CURVE 0x85de2a _REC_CUR_20_u1_u1 255. _CNV_A_R_LINEAR_____1_CM 0. 255. DISPLAY_IDENTIFIER ID_ERR_ENVD_OC_LS_DOWN_1 FORMAT "%3.0"
 /begin AXIS_DESCR COM_AXIS online_dummy _CNV_A_R_LINEAR_____0_CM 8 0. 7. READ_ONLY FORMAT "%2.0" AXIS_PTS_REF ldp_fmy_envd /end AXIS_DESCR
/end CHARACTERISTIC
/begin CHARACTERISTIC fmy_id_oc_ls_down_1.c_err_clas "error class for diagnosis instance OC_LS_DOWN_1" VALUE 0x85de32 _REC_VAL_20_u1 255. _CNV_A_R_LINEAR_____1_CM 0. 255. DISPLAY_IDENTIFIER C_ERR_CLAS_OC_LS_DOWN_1 FORMAT "%3.0" /end CHARACTERISTIC
/begin CHARACTERISTIC fmy_id_obd_lsh_down_1.dtc[0] "diagnostic trouble codes for diagnosis instance OBD_LSH_DOWN_1" CURVE 0x85de34 _REC_CUR_20_u2_u2 65535. _CNV_A_R_LINEAR_____1_CM 0. 65535. DISPLAY_IDENTIFIER ID_ERR_DTC_OBD_LSH_DOWN_1 FORMAT "%5.0"
 /begin AXIS_DESCR COM_AXIS online_dummy _CNV_A_R_LINEAR_____0_CM 6 0. 5. FORMAT "%2.0" AXIS_PTS_REF ldp_fmy_dtc /end AXIS_DESCR
/end CHARACTERISTIC
/begin CHARACTERISTIC fmy_id_obd_lsh_down_1.envd "environmental data contents of customer specific freeze frame for diagnosis instance OBD_LSH_DOWN_1" CURVE 0x85de40 _REC_CUR_20_u1_u1 255. _CNV_A_R_LINEAR_____1_CM 0. 255. DISPLAY_IDENTIFIER ID_ERR_ENVD_OBD_LSH_DOWN_1 FORMAT "%3.0"
 /begin AXIS_DESCR COM_AXIS online_dummy _CNV_A_R_LINEAR_____0_CM 8 0. 7. READ_ONLY FORMAT "%2.0" AXIS_PTS_REF ldp_fmy_envd /end AXIS_DESCR
/end CHARACTERISTIC
/begin CHARACTERISTIC fmy_id_obd_lsh_down_1.c_err_clas "error class for diagnosis instance OBD_LSH_DOWN_1" VALUE 0x85de48 _REC_VAL_20_u1 255. _CNV_A_R_LINEAR_____1_CM 0. 255. DISPLAY_IDENTIFIER C_ERR_CLAS_OBD_LSH_DOWN_1 FORMAT "%3.0" /end CHARACTERISTIC
/begin CHARACTERISTIC fmy_id_lam_adj_1.dtc[0] "diagnostic trouble codes for diagnosis instance LAM_ADJ_1" CURVE 0x85de4a _REC_CUR_20_u2_u2 65535. _CNV_A_R_LINEAR_____1_CM 0. 65535. DISPLAY_IDENTIFIER ID_ERR_DTC_LAM_ADJ_1 FORMAT "%5.0"
 /begin AXIS_DESCR COM_AXIS online_dummy _CNV_A_R_LINEAR_____0_CM 6 0. 5. FORMAT "%2.0" AXIS_PTS_REF ldp_fmy_dtc /end AXIS_DESCR
/end CHARACTERISTIC
/begin CHARACTERISTIC fmy_id_lam_adj_1.envd "environmental data contents of customer specific freeze frame for diagnosis instance LAM_ADJ_1" CURVE 0x85de56 _REC_CUR_20_u1_u1 255. _CNV_A_R_LINEAR_____1_CM 0. 255. DISPLAY_IDENTIFIER ID_ERR_ENVD_LAM_ADJ_1 FORMAT "%3.0"
 /begin AXIS_DESCR COM_AXIS online_dummy _CNV_A_R_LINEAR_____0_CM 8 0. 7. READ_ONLY FORMAT "%2.0" AXIS_PTS_REF ldp_fmy_envd /end AXIS_DESCR
/end CHARACTERISTIC
/begin CHARACTERISTIC fmy_id_lam_adj_1.c_err_clas "error class for diagnosis instance LAM_ADJ_1" VALUE 0x85de5e _REC_VAL_20_u1 255. _CNV_A_R_LINEAR_____1_CM 0. 255. DISPLAY_IDENTIFIER C_ERR_CLAS_LAM_ADJ_1 FORMAT "%3.0" /end CHARACTERISTIC
/begin CHARACTERISTIC fmy_id_chk_ls_down_1.dtc[0] "diagnostic trouble codes for diagnosis instance CHK_LS_DOWN_1" CURVE 0x85de60 _REC_CUR_20_u2_u2 65535. _CNV_A_R_LINEAR_____1_CM 0. 65535. DISPLAY_IDENTIFIER ID_ERR_DTC_CHK_LS_DOWN_1 FORMAT "%5.0"
 /begin AXIS_DESCR COM_AXIS online_dummy _CNV_A_R_LINEAR_____0_CM 6 0. 5. FORMAT "%2.0" AXIS_PTS_REF ldp_fmy_dtc /end AXIS_DESCR
/end CHARACTERISTIC
/begin CHARACTERISTIC fmy_id_chk_ls_down_1.envd "environmental data contents of customer specific freeze frame for diagnosis instance CHK_LS_DOWN_1" CURVE 0x85de6c _REC_CUR_20_u1_u1 255. _CNV_A_R_LINEAR_____1_CM 0. 255. DISPLAY_IDENTIFIER ID_ERR_ENVD_CHK_LS_DOWN_1 FORMAT "%3.0"
 /begin AXIS_DESCR COM_AXIS online_dummy _CNV_A_R_LINEAR_____0_CM 8 0. 7. READ_ONLY FORMAT "%2.0" AXIS_PTS_REF ldp_fmy_envd /end AXIS_DESCR
/end CHARACTERISTIC
/begin CHARACTERISTIC fmy_id_chk_ls_down_1.c_err_clas "error class for diagnosis instance CHK_LS_DOWN_1" VALUE 0x85de74 _REC_VAL_20_u1 255. _CNV_A_R_LINEAR_____1_CM 0. 255. DISPLAY_IDENTIFIER C_ERR_CLAS_CHK_LS_DOWN_1 FORMAT "%3.0" /end CHARACTERISTIC
/begin CHARACTERISTIC fmy_id_puc_ls_down_1.dtc[0] "diagnostic trouble codes for diagnosis instance PUC_LS_DOWN_1" CURVE 0x85de76 _REC_CUR_20_u2_u2 65535. _CNV_A_R_LINEAR_____1_CM 0. 65535. DISPLAY_IDENTIFIER ID_ERR_DTC_PUC_LS_DOWN_1 FORMAT "%5.0"
 /begin AXIS_DESCR COM_AXIS online_dummy _CNV_A_R_LINEAR_____0_CM 6 0. 5. FORMAT "%2.0" AXIS_PTS_REF ldp_fmy_dtc /end AXIS_DESCR
/end CHARACTERISTIC
/begin CHARACTERISTIC fmy_id_puc_ls_down_1.envd "environmental data contents of customer specific freeze frame for diagnosis instance PUC_LS_DOWN_1" CURVE 0x85de82 _REC_CUR_20_u1_u1 255. _CNV_A_R_LINEAR_____1_CM 0. 255. DISPLAY_IDENTIFIER ID_ERR_ENVD_PUC_LS_DOWN_1 FORMAT "%3.0"
 /begin AXIS_DESCR COM_AXIS online_dummy _CNV_A_R_LINEAR_____0_CM 8 0. 7. READ_ONLY FORMAT "%2.0" AXIS_PTS_REF ldp_fmy_envd /end AXIS_DESCR
/end CHARACTERISTIC
/begin CHARACTERISTIC fmy_id_puc_ls_down_1.c_err_clas "error class for diagnosis instance PUC_LS_DOWN_1" VALUE 0x85de8a _REC_VAL_20_u1 255. _CNV_A_R_LINEAR_____1_CM 0. 255. DISPLAY_IDENTIFIER C_ERR_CLAS_PUC_LS_DOWN_1 FORMAT "%3.0" /end CHARACTERISTIC
/begin CHARACTERISTIC fmy_id_fl_ls_down_1.dtc[0] "diagnostic trouble codes for diagnosis instance FL_LS_DOWN_1" CURVE 0x85de8c _REC_CUR_20_u2_u2 65535. _CNV_A_R_LINEAR_____1_CM 0. 65535. DISPLAY_IDENTIFIER ID_ERR_DTC_FL_LS_DOWN_1 FORMAT "%5.0"
 /begin AXIS_DESCR COM_AXIS online_dummy _CNV_A_R_LINEAR_____0_CM 6 0. 5. FORMAT "%2.0" AXIS_PTS_REF ldp_fmy_dtc /end AXIS_DESCR
/end CHARACTERISTIC
/begin CHARACTERISTIC fmy_id_fl_ls_down_1.envd "environmental data contents of customer specific freeze frame for diagnosis instance FL_LS_DOWN_1" CURVE 0x85de98 _REC_CUR_20_u1_u1 255. _CNV_A_R_LINEAR_____1_CM 0. 255. DISPLAY_IDENTIFIER ID_ERR_ENVD_FL_LS_DOWN_1 FORMAT "%3.0"
 /begin AXIS_DESCR COM_AXIS online_dummy _CNV_A_R_LINEAR_____0_CM 8 0. 7. READ_ONLY FORMAT "%2.0" AXIS_PTS_REF ldp_fmy_envd /end AXIS_DESCR
/end CHARACTERISTIC
/begin CHARACTERISTIC fmy_id_fl_ls_down_1.c_err_clas "error class for diagnosis instance FL_LS_DOWN_1" VALUE 0x85dea0 _REC_VAL_20_u1 255. _CNV_A_R_LINEAR_____1_CM 0. 255. DISPLAY_IDENTIFIER C_ERR_CLAS_FL_LS_DOWN_1 FORMAT "%3.0" /end CHARACTERISTIC
/begin CHARACTERISTIC fmy_id_el_lsl_up_1.dtc[0] "diagnostic trouble codes for diagnosis instance EL_LSL_UP_1" CURVE 0x85dea2 _REC_CUR_20_u2_u2 65535. _CNV_A_R_LINEAR_____1_CM 0. 65535. DISPLAY_IDENTIFIER ID_ERR_DTC_EL_LSL_UP_1 FORMAT "%5.0"
 /begin AXIS_DESCR COM_AXIS online_dummy _CNV_A_R_LINEAR_____0_CM 6 0. 5. FORMAT "%2.0" AXIS_PTS_REF ldp_fmy_dtc /end AXIS_DESCR
/end CHARACTERISTIC
/begin CHARACTERISTIC fmy_id_el_lsl_up_1.envd "environmental data contents of customer specific freeze frame for diagnosis instance EL_LSL_UP_1" CURVE 0x85deae _REC_CUR_20_u1_u1 255. _CNV_A_R_LINEAR_____1_CM 0. 255. DISPLAY_IDENTIFIER ID_ERR_ENVD_EL_LSL_UP_1 FORMAT "%3.0"
 /begin AXIS_DESCR COM_AXIS online_dummy _CNV_A_R_LINEAR_____0_CM 8 0. 7. READ_ONLY FORMAT "%2.0" AXIS_PTS_REF ldp_fmy_envd /end AXIS_DESCR
/end CHARACTERISTIC
/begin CHARACTERISTIC fmy_id_el_lsl_up_1.c_err_clas "error class for diagnosis instance EL_LSL_UP_1" VALUE 0x85deb6 _REC_VAL_20_u1 255. _CNV_A_R_LINEAR_____1_CM 0. 255. DISPLAY_IDENTIFIER C_ERR_CLAS_EL_LSL_UP_1 FORMAT "%3.0" /end CHARACTERISTIC
/begin CHARACTERISTIC fmy_id_oc_lsl_up_1.dtc[0] "diagnostic trouble codes for diagnosis instance OC_LSL_UP_1" CURVE 0x85deb8 _REC_CUR_20_u2_u2 65535. _CNV_A_R_LINEAR_____1_CM 0. 65535. DISPLAY_IDENTIFIER ID_ERR_DTC_OC_LSL_UP_1 FORMAT "%5.0"
 /begin AXIS_DESCR COM_AXIS online_dummy _CNV_A_R_LINEAR_____0_CM 6 0. 5. FORMAT "%2.0" AXIS_PTS_REF ldp_fmy_dtc /end AXIS_DESCR
/end CHARACTERISTIC
/begin CHARACTERISTIC fmy_id_oc_lsl_up_1.envd "environmental data contents of customer specific freeze frame for diagnosis instance OC_LSL_UP_1" CURVE 0x85dec4 _REC_CUR_20_u1_u1 255. _CNV_A_R_LINEAR_____1_CM 0. 255. DISPLAY_IDENTIFIER ID_ERR_ENVD_OC_LSL_UP_1 FORMAT "%3.0"
 /begin AXIS_DESCR COM_AXIS online_dummy _CNV_A_R_LINEAR_____0_CM 8 0. 7. READ_ONLY FORMAT "%2.0" AXIS_PTS_REF ldp_fmy_envd /end AXIS_DESCR
/end CHARACTERISTIC
/begin CHARACTERISTIC fmy_id_oc_lsl_up_1.c_err_clas "error class for diagnosis instance OC_LSL_UP_1" VALUE 0x85decc _REC_VAL_20_u1 255. _CNV_A_R_LINEAR_____1_CM 0. 255. DISPLAY_IDENTIFIER C_ERR_CLAS_OC_LSL_UP_1 FORMAT "%3.0" /end CHARACTERISTIC
/begin CHARACTERISTIC fmy_id_lsl_up_if_1.dtc[0] "diagnostic trouble codes for diagnosis instance LSL_UP_IF_1" CURVE 0x85dece _REC_CUR_20_u2_u2 65535. _CNV_A_R_LINEAR_____1_CM 0. 65535. DISPLAY_IDENTIFIER ID_ERR_DTC_LSL_UP_IF_1 FORMAT "%5.0"
 /begin AXIS_DESCR COM_AXIS online_dummy _CNV_A_R_LINEAR_____0_CM 6 0. 5. FORMAT "%2.0" AXIS_PTS_REF ldp_fmy_dtc /end AXIS_DESCR
/end CHARACTERISTIC
/begin CHARACTERISTIC fmy_id_lsl_up_if_1.envd "environmental data contents of customer specific freeze frame for diagnosis instance LSL_UP_IF_1" CURVE 0x85deda _REC_CUR_20_u1_u1 255. _CNV_A_R_LINEAR_____1_CM 0. 255. DISPLAY_IDENTIFIER ID_ERR_ENVD_LSL_UP_IF_1 FORMAT "%3.0"
 /begin AXIS_DESCR COM_AXIS online_dummy _CNV_A_R_LINEAR_____0_CM 8 0. 7. READ_ONLY FORMAT "%2.0" AXIS_PTS_REF ldp_fmy_envd /end AXIS_DESCR
/end CHARACTERISTIC
/begin CHARACTERISTIC fmy_id_lsl_up_if_1.c_err_clas "error class for diagnosis instance LSL_UP_IF_1" VALUE 0x85dee2 _REC_VAL_20_u1 255. _CNV_A_R_LINEAR_____1_CM 0. 255. DISPLAY_IDENTIFIER C_ERR_CLAS_LSL_UP_IF_1 FORMAT "%3.0" /end CHARACTERISTIC
/begin CHARACTERISTIC fmy_id_air_lsl_up_1.dtc[0] "diagnostic trouble codes for diagnosis instance AIR_LSL_UP_1" CURVE 0x85dee4 _REC_CUR_20_u2_u2 65535. _CNV_A_R_LINEAR_____1_CM 0. 65535. DISPLAY_IDENTIFIER ID_ERR_DTC_AIR_LSL_UP_1 FORMAT "%5.0"
 /begin AXIS_DESCR COM_AXIS online_dummy _CNV_A_R_LINEAR_____0_CM 6 0. 5. FORMAT "%2.0" AXIS_PTS_REF ldp_fmy_dtc /end AXIS_DESCR
/end CHARACTERISTIC
/begin CHARACTERISTIC fmy_id_air_lsl_up_1.envd "environmental data contents of customer specific freeze frame for diagnosis instance AIR_LSL_UP_1" CURVE 0x85def0 _REC_CUR_20_u1_u1 255. _CNV_A_R_LINEAR_____1_CM 0. 255. DISPLAY_IDENTIFIER ID_ERR_ENVD_AIR_LSL_UP_1 FORMAT "%3.0"
 /begin AXIS_DESCR COM_AXIS online_dummy _CNV_A_R_LINEAR_____0_CM 8 0. 7. READ_ONLY FORMAT "%2.0" AXIS_PTS_REF ldp_fmy_envd /end AXIS_DESCR
/end CHARACTERISTIC
/begin CHARACTERISTIC fmy_id_air_lsl_up_1.c_err_clas "error class for diagnosis instance AIR_LSL_UP_1" VALUE 0x85def8 _REC_VAL_20_u1 255. _CNV_A_R_LINEAR_____1_CM 0. 255. DISPLAY_IDENTIFIER C_ERR_CLAS_AIR_LSL_UP_1 FORMAT "%3.0" /end CHARACTERISTIC
/begin CHARACTERISTIC fmy_id_ttip_obd_ls_up_1.dtc[0] "diagnostic trouble codes for diagnosis instance TTIP_OBD_LS_UP_1" CURVE 0x85defa _REC_CUR_20_u2_u2 65535. _CNV_A_R_LINEAR_____1_CM 0. 65535. DISPLAY_IDENTIFIER ID_ERR_DTC_TTIP_OBD_LS_UP_1 FORMAT "%5.0"
 /begin AXIS_DESCR COM_AXIS online_dummy _CNV_A_R_LINEAR_____0_CM 6 0. 5. FORMAT "%2.0" AXIS_PTS_REF ldp_fmy_dtc /end AXIS_DESCR
/end CHARACTERISTIC
/begin CHARACTERISTIC fmy_id_ttip_obd_ls_up_1.envd "environmental data contents of customer specific freeze frame for diagnosis instance TTIP_OBD_LS_UP_1" CURVE 0x85df06 _REC_CUR_20_u1_u1 255. _CNV_A_R_LINEAR_____1_CM 0. 255. DISPLAY_IDENTIFIER ID_ERR_ENVD_TTIP_OBD_LS_UP_1 FORMAT "%3.0"
 /begin AXIS_DESCR COM_AXIS online_dummy _CNV_A_R_LINEAR_____0_CM 8 0. 7. READ_ONLY FORMAT "%2.0" AXIS_PTS_REF ldp_fmy_envd /end AXIS_DESCR
/end CHARACTERISTIC
/begin CHARACTERISTIC fmy_id_ttip_obd_ls_up_1.c_err_clas "error class for diagnosis instance TTIP_OBD_LS_UP_1" VALUE 0x85df0e _REC_VAL_20_u1 255. _CNV_A_R_LINEAR_____1_CM 0. 255. DISPLAY_IDENTIFIER C_ERR_CLAS_TTIP_OBD_LS_UP_1 FORMAT "%3.0" /end CHARACTERISTIC
/begin CHARACTERISTIC fmy_id_dyn_vld_ls_up_1.dtc[0] "diagnostic trouble codes for diagnosis instance DYN_VLD_LS_UP_1" CURVE 0x85df10 _REC_CUR_20_u2_u2 65535. _CNV_A_R_LINEAR_____1_CM 0. 65535. DISPLAY_IDENTIFIER ID_ERR_DTC_DYN_VLD_LS_UP_1 FORMAT "%5.0"
 /begin AXIS_DESCR COM_AXIS online_dummy _CNV_A_R_LINEAR_____0_CM 6 0. 5. FORMAT "%2.0" AXIS_PTS_REF ldp_fmy_dtc /end AXIS_DESCR
/end CHARACTERISTIC
/begin CHARACTERISTIC fmy_id_dyn_vld_ls_up_1.envd "environmental data contents of customer specific freeze frame for diagnosis instance DYN_VLD_LS_UP_1" CURVE 0x85df1c _REC_CUR_20_u1_u1 255. _CNV_A_R_LINEAR_____1_CM 0. 255. DISPLAY_IDENTIFIER ID_ERR_ENVD_DYN_VLD_LS_UP_1 FORMAT "%3.0"
 /begin AXIS_DESCR COM_AXIS online_dummy _CNV_A_R_LINEAR_____0_CM 8 0. 7. READ_ONLY FORMAT "%2.0" AXIS_PTS_REF ldp_fmy_envd /end AXIS_DESCR
/end CHARACTERISTIC
/begin CHARACTERISTIC fmy_id_dyn_vld_ls_up_1.c_err_clas "error class for diagnosis instance DYN_VLD_LS_UP_1" VALUE 0x85df24 _REC_VAL_20_u1 255. _CNV_A_R_LINEAR_____1_CM 0. 255. DISPLAY_IDENTIFIER C_ERR_CLAS_DYN_VLD_LS_UP_1 FORMAT "%3.0" /end CHARACTERISTIC
/begin CHARACTERISTIC fmy_id_puc_vld_ls_up_1.dtc[0] "diagnostic trouble codes for diagnosis instance PUC_VLD_LS_UP_1" CURVE 0x85df26 _REC_CUR_20_u2_u2 65535. _CNV_A_R_LINEAR_____1_CM 0. 65535. DISPLAY_IDENTIFIER ID_ERR_DTC_PUC_VLD_LS_UP_1 FORMAT "%5.0"
 /begin AXIS_DESCR COM_AXIS online_dummy _CNV_A_R_LINEAR_____0_CM 6 0. 5. FORMAT "%2.0" AXIS_PTS_REF ldp_fmy_dtc /end AXIS_DESCR
/end CHARACTERISTIC
/begin CHARACTERISTIC fmy_id_puc_vld_ls_up_1.envd "environmental data contents of customer specific freeze frame for diagnosis instance PUC_VLD_LS_UP_1" CURVE 0x85df32 _REC_CUR_20_u1_u1 255. _CNV_A_R_LINEAR_____1_CM 0. 255. DISPLAY_IDENTIFIER ID_ERR_ENVD_PUC_VLD_LS_UP_1 FORMAT "%3.0"
 /begin AXIS_DESCR COM_AXIS online_dummy _CNV_A_R_LINEAR_____0_CM 8 0. 7. READ_ONLY FORMAT "%2.0" AXIS_PTS_REF ldp_fmy_envd /end AXIS_DESCR
/end CHARACTERISTIC
/begin CHARACTERISTIC fmy_id_puc_vld_ls_up_1.c_err_clas "error class for diagnosis instance PUC_VLD_LS_UP_1" VALUE 0x85df3a _REC_VAL_20_u1 255. _CNV_A_R_LINEAR_____1_CM 0. 255. DISPLAY_IDENTIFIER C_ERR_CLAS_PUC_VLD_LS_UP_1 FORMAT "%3.0" /end CHARACTERISTIC
/begin CHARACTERISTIC fmy_id_obd_vld_lsh_up_1.dtc[0] "diagnostic trouble codes for diagnosis instance OBD_VLD_LSH_UP_1" CURVE 0x85df3c _REC_CUR_20_u2_u2 65535. _CNV_A_R_LINEAR_____1_CM 0. 65535. DISPLAY_IDENTIFIER ID_ERR_DTC_OBD_VLD_LSH_UP_1 FORMAT "%5.0"
 /begin AXIS_DESCR COM_AXIS online_dummy _CNV_A_R_LINEAR_____0_CM 6 0. 5. FORMAT "%2.0" AXIS_PTS_REF ldp_fmy_dtc /end AXIS_DESCR
/end CHARACTERISTIC
/begin CHARACTERISTIC fmy_id_obd_vld_lsh_up_1.envd "environmental data contents of customer specific freeze frame for diagnosis instance OBD_VLD_LSH_UP_1" CURVE 0x85df48 _REC_CUR_20_u1_u1 255. _CNV_A_R_LINEAR_____1_CM 0. 255. DISPLAY_IDENTIFIER ID_ERR_ENVD_OBD_VLD_LSH_UP_1 FORMAT "%3.0"
 /begin AXIS_DESCR COM_AXIS online_dummy _CNV_A_R_LINEAR_____0_CM 8 0. 7. READ_ONLY FORMAT "%2.0" AXIS_PTS_REF ldp_fmy_envd /end AXIS_DESCR
/end CHARACTERISTIC
/begin CHARACTERISTIC fmy_id_obd_vld_lsh_up_1.c_err_clas "error class for diagnosis instance OBD_VLD_LSH_UP_1" VALUE 0x85df50 _REC_VAL_20_u1 255. _CNV_A_R_LINEAR_____1_CM 0. 255. DISPLAY_IDENTIFIER C_ERR_CLAS_OBD_VLD_LSH_UP_1 FORMAT "%3.0" /end CHARACTERISTIC
/begin CHARACTERISTIC fmy_id_shift_afl_lsl_up_1.dtc[0] "diagnostic trouble codes for diagnosis instance SHIFT_AFL_LSL_UP_1" CURVE 0x85df52 _REC_CUR_20_u2_u2 65535. _CNV_A_R_LINEAR_____1_CM 0. 65535. DISPLAY_IDENTIFIER ID_ERR_DTC_SHIFT_AFL_LSL_UP_1 FORMAT "%5.0"
 /begin AXIS_DESCR COM_AXIS online_dummy _CNV_A_R_LINEAR_____0_CM 6 0. 5. FORMAT "%2.0" AXIS_PTS_REF ldp_fmy_dtc /end AXIS_DESCR
/end CHARACTERISTIC
/begin CHARACTERISTIC fmy_id_shift_afl_lsl_up_1.envd "environmental data contents of customer specific freeze frame for diagnosis instance SHIFT_AFL_LSL_UP_1" CURVE 0x85df5e _REC_CUR_20_u1_u1 255. _CNV_A_R_LINEAR_____1_CM 0. 255. DISPLAY_IDENTIFIER ID_ERR_ENVD_SHIFT_AFL_LSL_UP_1 FORMAT "%3.0"
 /begin AXIS_DESCR COM_AXIS online_dummy _CNV_A_R_LINEAR_____0_CM 8 0. 7. READ_ONLY FORMAT "%2.0" AXIS_PTS_REF ldp_fmy_envd /end AXIS_DESCR
/end CHARACTERISTIC
/begin CHARACTERISTIC fmy_id_shift_afl_lsl_up_1.c_err_clas "error class for diagnosis instance SHIFT_AFL_LSL_UP_1" VALUE 0x85df66 _REC_VAL_20_u1 255. _CNV_A_R_LINEAR_____1_CM 0. 255. DISPLAY_IDENTIFIER C_ERR_CLAS_SHIFT_AFL_LSL_UP_1 FORMAT "%3.0" /end CHARACTERISTIC
/begin CHARACTERISTIC fmy_id_shift_afr_lsl_up_1.dtc[0] "diagnostic trouble codes for diagnosis instance SHIFT_AFR_LSL_UP_1" CURVE 0x85df68 _REC_CUR_20_u2_u2 65535. _CNV_A_R_LINEAR_____1_CM 0. 65535. DISPLAY_IDENTIFIER ID_ERR_DTC_SHIFT_AFR_LSL_UP_1 FORMAT "%5.0"
 /begin AXIS_DESCR COM_AXIS online_dummy _CNV_A_R_LINEAR_____0_CM 6 0. 5. FORMAT "%2.0" AXIS_PTS_REF ldp_fmy_dtc /end AXIS_DESCR
/end CHARACTERISTIC
/begin CHARACTERISTIC fmy_id_shift_afr_lsl_up_1.envd "environmental data contents of customer specific freeze frame for diagnosis instance SHIFT_AFR_LSL_UP_1" CURVE 0x85df74 _REC_CUR_20_u1_u1 255. _CNV_A_R_LINEAR_____1_CM 0. 255. DISPLAY_IDENTIFIER ID_ERR_ENVD_SHIFT_AFR_LSL_UP_1 FORMAT "%3.0"
 /begin AXIS_DESCR COM_AXIS online_dummy _CNV_A_R_LINEAR_____0_CM 8 0. 7. READ_ONLY FORMAT "%2.0" AXIS_PTS_REF ldp_fmy_envd /end AXIS_DESCR
/end CHARACTERISTIC
/begin CHARACTERISTIC fmy_id_shift_afr_lsl_up_1.c_err_clas "error class for diagnosis instance SHIFT_AFR_LSL_UP_1" VALUE 0x85df7c _REC_VAL_20_u1 255. _CNV_A_R_LINEAR_____1_CM 0. 255. DISPLAY_IDENTIFIER C_ERR_CLAS_SHIFT_AFR_LSL_UP_1 FORMAT "%3.0" /end CHARACTERISTIC
/begin CHARACTERISTIC fmy_id_lsh_lsl_up_1.dtc[0] "diagnostic trouble codes for diagnosis instance LSH_LSL_UP_1" CURVE 0x85df7e _REC_CUR_20_u2_u2 65535. _CNV_A_R_LINEAR_____1_CM 0. 65535. DISPLAY_IDENTIFIER ID_ERR_DTC_LSH_LSL_UP_1 FORMAT "%5.0"
 /begin AXIS_DESCR COM_AXIS online_dummy _CNV_A_R_LINEAR_____0_CM 6 0. 5. FORMAT "%2.0" AXIS_PTS_REF ldp_fmy_dtc /end AXIS_DESCR
/end CHARACTERISTIC
/begin CHARACTERISTIC fmy_id_lsh_lsl_up_1.envd "environmental data contents of customer specific freeze frame for diagnosis instance LSH_LSL_UP_1" CURVE 0x85df8a _REC_CUR_20_u1_u1 255. _CNV_A_R_LINEAR_____1_CM 0. 255. DISPLAY_IDENTIFIER ID_ERR_ENVD_LSH_LSL_UP_1 FORMAT "%3.0"
 /begin AXIS_DESCR COM_AXIS online_dummy _CNV_A_R_LINEAR_____0_CM 8 0. 7. READ_ONLY FORMAT "%2.0" AXIS_PTS_REF ldp_fmy_envd /end AXIS_DESCR
/end CHARACTERISTIC
/begin CHARACTERISTIC fmy_id_lsh_lsl_up_1.c_err_clas "error class for diagnosis instance LSH_LSL_UP_1" VALUE 0x85df92 _REC_VAL_20_u1 255. _CNV_A_R_LINEAR_____1_CM 0. 255. DISPLAY_IDENTIFIER C_ERR_CLAS_LSH_LSL_UP_1 FORMAT "%3.0" /end CHARACTERISTIC
/begin CHARACTERISTIC fmy_id_swt_ls_down_1.dtc[0] "diagnostic trouble codes for diagnosis instance SWT_LS_DOWN_1" CURVE 0x85df94 _REC_CUR_20_u2_u2 65535. _CNV_A_R_LINEAR_____1_CM 0. 65535. DISPLAY_IDENTIFIER ID_ERR_DTC_SWT_LS_DOWN_1 FORMAT "%5.0"
 /begin AXIS_DESCR COM_AXIS online_dummy _CNV_A_R_LINEAR_____0_CM 6 0. 5. FORMAT "%2.0" AXIS_PTS_REF ldp_fmy_dtc /end AXIS_DESCR
/end CHARACTERISTIC
/begin CHARACTERISTIC fmy_id_swt_ls_down_1.envd "environmental data contents of customer specific freeze frame for diagnosis instance SWT_LS_DOWN_1" CURVE 0x85dfa0 _REC_CUR_20_u1_u1 255. _CNV_A_R_LINEAR_____1_CM 0. 255. DISPLAY_IDENTIFIER ID_ERR_ENVD_SWT_LS_DOWN_1 FORMAT "%3.0"
 /begin AXIS_DESCR COM_AXIS online_dummy _CNV_A_R_LINEAR_____0_CM 8 0. 7. READ_ONLY FORMAT "%2.0" AXIS_PTS_REF ldp_fmy_envd /end AXIS_DESCR
/end CHARACTERISTIC
/begin CHARACTERISTIC fmy_id_swt_ls_down_1.c_err_clas "error class for diagnosis instance SWT_LS_DOWN_1" VALUE 0x85dfa8 _REC_VAL_20_u1 255. _CNV_A_R_LINEAR_____1_CM 0. 255. DISPLAY_IDENTIFIER C_ERR_CLAS_SWT_LS_DOWN_1 FORMAT "%3.0" /end CHARACTERISTIC
/begin CHARACTERISTIC fmy_id_pue_ls_down_1.dtc[0] "diagnostic trouble codes for diagnosis instance PUE_LS_DOWN_1" CURVE 0x85dfaa _REC_CUR_20_u2_u2 65535. _CNV_A_R_LINEAR_____1_CM 0. 65535. DISPLAY_IDENTIFIER ID_ERR_DTC_PUE_LS_DOWN_1 FORMAT "%5.0"
 /begin AXIS_DESCR COM_AXIS online_dummy _CNV_A_R_LINEAR_____0_CM 6 0. 5. FORMAT "%2.0" AXIS_PTS_REF ldp_fmy_dtc /end AXIS_DESCR
/end CHARACTERISTIC
/begin CHARACTERISTIC fmy_id_pue_ls_down_1.envd "environmental data contents of customer specific freeze frame for diagnosis instance PUE_LS_DOWN_1" CURVE 0x85dfb6 _REC_CUR_20_u1_u1 255. _CNV_A_R_LINEAR_____1_CM 0. 255. DISPLAY_IDENTIFIER ID_ERR_ENVD_PUE_LS_DOWN_1 FORMAT "%3.0"
 /begin AXIS_DESCR COM_AXIS online_dummy _CNV_A_R_LINEAR_____0_CM 8 0. 7. READ_ONLY FORMAT "%2.0" AXIS_PTS_REF ldp_fmy_envd /end AXIS_DESCR
/end CHARACTERISTIC
/begin CHARACTERISTIC fmy_id_pue_ls_down_1.c_err_clas "error class for diagnosis instance PUE_LS_DOWN_1" VALUE 0x85dfbe _REC_VAL_20_u1 255. _CNV_A_R_LINEAR_____1_CM 0. 255. DISPLAY_IDENTIFIER C_ERR_CLAS_PUE_LS_DOWN_1 FORMAT "%3.0" /end CHARACTERISTIC
/begin CHARACTERISTIC fmy_id_chg_ls_up.dtc[0] "diagnostic trouble codes for diagnosis instance CHG_LS_UP" CURVE 0x85dfc0 _REC_CUR_20_u2_u2 65535. _CNV_A_R_LINEAR_____1_CM 0. 65535. DISPLAY_IDENTIFIER ID_ERR_DTC_CHG_LS_UP FORMAT "%5.0"
 /begin AXIS_DESCR COM_AXIS online_dummy _CNV_A_R_LINEAR_____0_CM 6 0. 5. FORMAT "%2.0" AXIS_PTS_REF ldp_fmy_dtc /end AXIS_DESCR
/end CHARACTERISTIC
/begin CHARACTERISTIC fmy_id_chg_ls_up.envd "environmental data contents of customer specific freeze frame for diagnosis instance CHG_LS_UP" CURVE 0x85dfcc _REC_CUR_20_u1_u1 255. _CNV_A_R_LINEAR_____1_CM 0. 255. DISPLAY_IDENTIFIER ID_ERR_ENVD_CHG_LS_UP FORMAT "%3.0"
 /begin AXIS_DESCR COM_AXIS online_dummy _CNV_A_R_LINEAR_____0_CM 8 0. 7. READ_ONLY FORMAT "%2.0" AXIS_PTS_REF ldp_fmy_envd /end AXIS_DESCR
/end CHARACTERISTIC
/begin CHARACTERISTIC fmy_id_chg_ls_up.c_err_clas "error class for diagnosis instance CHG_LS_UP" VALUE 0x85dfd4 _REC_VAL_20_u1 255. _CNV_A_R_LINEAR_____1_CM 0. 255. DISPLAY_IDENTIFIER C_ERR_CLAS_CHG_LS_UP FORMAT "%3.0" /end CHARACTERISTIC
/begin CHARACTERISTIC fmy_id_chg_ls_down.dtc[0] "diagnostic trouble codes for diagnosis instance CHG_LS_DOWN" CURVE 0x85dfd6 _REC_CUR_20_u2_u2 65535. _CNV_A_R_LINEAR_____1_CM 0. 65535. DISPLAY_IDENTIFIER ID_ERR_DTC_CHG_LS_DOWN FORMAT "%5.0"
 /begin AXIS_DESCR COM_AXIS online_dummy _CNV_A_R_LINEAR_____0_CM 6 0. 5. FORMAT "%2.0" AXIS_PTS_REF ldp_fmy_dtc /end AXIS_DESCR
/end CHARACTERISTIC
/begin CHARACTERISTIC fmy_id_chg_ls_down.envd "environmental data contents of customer specific freeze frame for diagnosis instance CHG_LS_DOWN" CURVE 0x85dfe2 _REC_CUR_20_u1_u1 255. _CNV_A_R_LINEAR_____1_CM 0. 255. DISPLAY_IDENTIFIER ID_ERR_ENVD_CHG_LS_DOWN FORMAT "%3.0"
 /begin AXIS_DESCR COM_AXIS online_dummy _CNV_A_R_LINEAR_____0_CM 8 0. 7. READ_ONLY FORMAT "%2.0" AXIS_PTS_REF ldp_fmy_envd /end AXIS_DESCR
/end CHARACTERISTIC
/begin CHARACTERISTIC fmy_id_chg_ls_down.c_err_clas "error class for diagnosis instance CHG_LS_DOWN" VALUE 0x85dfea _REC_VAL_20_u1 255. _CNV_A_R_LINEAR_____1_CM 0. 255. DISPLAY_IDENTIFIER C_ERR_CLAS_CHG_LS_DOWN FORMAT "%3.0" /end CHARACTERISTIC
/begin AXIS_PTS ldpm_temp_ini_ls_up_1_egcp "" 0x840a30 online_dummy _REC_AXS_20_u2 4095.9375 _CNV_A_R_EGCP_LINEA_469_CM 6 -2048. 2047.9375 FORMAT "%10.4" /end AXIS_PTS
/begin AXIS_PTS ldpm_temp_ini_ls_down_1_egcp "" 0x840a22 online_dummy _REC_AXS_20_u2 4095.9375 _CNV_A_R_EGCP_LINEA_469_CM 6 -2048. 2047.9375 FORMAT "%10.4" /end AXIS_PTS
/begin AXIS_PTS ldpm_n_32_3_egcp "" 0x8409e6 n_32 _REC_AXS_20_u1 8160. _CNV_A_R_LINEAR_____81_CM 6 0. 8160. FORMAT "%4.0" /end AXIS_PTS
/begin AXIS_PTS ldpm_teg_cat_up_mdl_1_egcp "" 0x840a14 online_dummy _REC_AXS_20_u2 2047. _CNV_A_R_EGCP_LINEA_468_CM 6 0. 2047. FORMAT "%9.4" /end AXIS_PTS
/begin AXIS_PTS ldpm_teg_cat_down_mdl_1_egcp "" 0x840a06 online_dummy _REC_AXS_20_u2 2047. _CNV_A_R_EGCP_LINEA_468_CM 6 0. 2047. FORMAT "%9.4" /end AXIS_PTS
/begin AXIS_PTS ldpm_vs_1_egcp "" 0x840a45 online_dummy _REC_AXS_20_u1 255. _CNV_A_R_LINEAR_____245_CM 6 0. 255. FORMAT "%3.0" /end AXIS_PTS
/begin AXIS_PTS ldpm_n_32_1_egcp "" 0x8409d6 n_32 _REC_AXS_20_u1 8160. _CNV_A_R_LINEAR_____81_CM 6 0. 8160. FORMAT "%4.0" /end AXIS_PTS
/begin AXIS_PTS ldpm_n_32_2_egcp "" 0x8409dd n_32 _REC_AXS_20_u1 8160. _CNV_A_R_LINEAR_____81_CM 8 0. 8160. FORMAT "%4.0" /end AXIS_PTS
/begin AXIS_PTS ldpm_maf_1_egcp "" 0x84099a maf _REC_AXS_20_u2 1389. _CNV_A_R_LINEAR_____490_CM 8 0. 1389. FORMAT "%7.2" /end AXIS_PTS
/begin AXIS_PTS ldpm_n_32_ls_up_dyn "" 0x8409ed n_32 _REC_AXS_20_u1 8160. _CNV_A_R_LINEAR_____81_CM 8 0. 8160. FORMAT "%4.0" /end AXIS_PTS
/begin AXIS_PTS ldpm_maf_hb_ls_up_dyn "" 0x8409ac maf_hb _REC_AXS_20_u1 1389. _CNV_A_R_LINEAR_____371_CM 8 0. 1389. FORMAT "%4.0" /end AXIS_PTS
/begin COMPU_METHOD _CNV_A_R_LINEAR_____0_CM "" RAT_FUNC "%6.3" "[-]" COEFFS 0 1. 0. 0 0 1 /end COMPU_METHOD
/begin COMPU_METHOD _CNV_A_R_LINEAR_____1_CM "" RAT_FUNC "%6.3" "-" COEFFS 0 1. 0. 0 0 1 /end COMPU_METHOD
/begin COMPU_METHOD _CNV_A_R_LINEAR_____81_CM "" RAT_FUNC "%6.3" "rpm" COEFFS 0 3.125e-002 0. 0 0 1 /end COMPU_METHOD
/begin COMPU_METHOD _CNV_A_R_LINEAR_____245_CM "" RAT_FUNC "%6.3" "km/h" COEFFS 0 1. 0. 0 0 1 /end COMPU_METHOD
/begin COMPU_METHOD _CNV_A_R_LINEAR_____371_CM "" RAT_FUNC "%6.3" "mg/stk" COEFFS 0 0.183585313174946 0. 0 0 1 /end COMPU_METHOD
/begin COMPU_METHOD _CNV_A_R_EGCP_LINEA_468_CM "Battery voltage" RAT_FUNC "%6.3" "°C" COEFFS 0 16. 0. 0 0 1 /end COMPU_METHOD
/begin COMPU_METHOD _CNV_A_R_EGCP_LINEA_469_CM "Battery voltage" RAT_FUNC "%6.3" "°C" COEFFS 0 16. 32768. 0 0 1 /end COMPU_METHOD
/begin COMPU_METHOD _CNV_A_R_LINEAR_____490_CM "" RAT_FUNC "%6.3" "mg/stk" COEFFS 0 47.18142548596112 0. 0 0 1 /end COMPU_METHOD
/begin RECORD_LAYOUT _REC_VAL_20_u1 FNC_VALUES 1 UBYTE COLUMN_DIR DIRECT /end RECORD_LAYOUT
/begin RECORD_LAYOUT _REC_AXS_20_u2 NO_AXIS_PTS_X 1 UWORD AXIS_PTS_X 2 UWORD INDEX_INCR DIRECT /end RECORD_LAYOUT
/begin RECORD_LAYOUT _REC_AXS_20_u1 NO_AXIS_PTS_X 1 UBYTE AXIS_PTS_X 2 UBYTE INDEX_INCR DIRECT /end RECORD_LAYOUT
/begin RECORD_LAYOUT _REC_CUR_20_u2_u2 FNC_VALUES 1 UWORD COLUMN_DIR DIRECT /end RECORD_LAYOUT
/begin RECORD_LAYOUT _REC_CUR_20_u1_u1 FNC_VALUES 1 UBYTE COLUMN_DIR DIRECT /end RECORD_LAYOUT
/begin FUNCTION ERRM_CAL_ATPCDIAG "Error Management Calibrations for diagnosis ATPCDIAG"
 /begin DEF_CHARACTERISTIC fmy_id_v_tpc_rng.dtc[0] fmy_id_v_tpc_rng.envd fmy_id_v_tpc_rng.c_err_clas fmy_id_tpc_mes_plaus.dtc[0] fmy_id_tpc_mes_plaus.envd fmy_id_tpc_mes_plaus.c_err_clas /end DEF_CHARACTERISTIC
/end FUNCTION
/begin FUNCTION ERRM_CAL_ATACDIAG "Error Management Calibrations for diagnosis ATACDIAG"
 /begin DEF_CHARACTERISTIC fmy_id_v_tac_rng.dtc[0] fmy_id_v_tac_rng.envd fmy_id_v_tac_rng.c_err_clas fmy_id_tac_mes_grd.dtc[0] fmy_id_tac_mes_grd.envd fmy_id_tac_mes_grd.c_err_clas /end DEF_CHARACTERISTIC
/end FUNCTION
/begin FUNCTION ERRM_CAL_AOBDFSD "Error Management Calibrations for diagnosis AOBDFSD"
 /begin DEF_CHARACTERISTIC fmy_id_mf_is_obd.dtc[0] fmy_id_mf_is_obd.envd fmy_id_mf_is_obd.c_err_clas /end DEF_CHARACTERISTIC
/end FUNCTION
/begin FUNCTION ERRM_CAL_ACYBDIAG "Error Management Calibrations for diagnosis ACYBDIAG"
 /begin DEF_CHARACTERISTIC fmy_id_cyl_bal_0.dtc[0] fmy_id_cyl_bal_0.envd fmy_id_cyl_bal_0.c_err_clas fmy_id_cyl_bal_1.dtc[0] fmy_id_cyl_bal_1.envd fmy_id_cyl_bal_1.c_err_clas fmy_id_cyl_bal_2.dtc[0] fmy_id_cyl_bal_2.envd fmy_id_cyl_bal_2.c_err_clas fmy_id_cyl_bal_3.dtc[0] fmy_id_cyl_bal_3.envd fmy_id_cyl_bal_3.c_err_clas /end DEF_CHARACTERISTIC
/end FUNCTION
/begin FUNCTION ERRM_CAL_AEGRVCAD "Error Management Calibrations for diagnosis AEGRVCAD"
 /begin DEF_CHARACTERISTIC fmy_id_egrv_0_ctl.dtc[0] fmy_id_egrv_0_ctl.envd fmy_id_egrv_0_ctl.c_err_clas fmy_id_v_egrv_0_bol_ad.dtc[0] fmy_id_v_egrv_0_bol_ad.envd fmy_id_v_egrv_0_bol_ad.c_err_clas /end DEF_CHARACTERISTIC
/end FUNCTION
/begin FUNCTION ERRM_CAL_ATHRCAD "Error Management Calibrations for diagnosis ATHRCAD"
 /begin DEF_CHARACTERISTIC fmy_id_thr_0_ctl.dtc[0] fmy_id_thr_0_ctl.envd fmy_id_thr_0_ctl.c_err_clas fmy_id_v_thr_0_bol_ad.dtc[0] fmy_id_v_thr_0_bol_ad.envd fmy_id_v_thr_0_bol_ad.c_err_clas /end DEF_CHARACTERISTIC
/end FUNCTION
/begin FUNCTION ERRM_CAL_ABPACAD "Error Management Calibrations for diagnosis ABPACAD"
 /begin DEF_CHARACTERISTIC fmy_id_bpa_0_ctl.dtc[0] fmy_id_bpa_0_ctl.envd fmy_id_bpa_0_ctl.c_err_clas fmy_id_v_bpa_0_bol_ad.dtc[0] fmy_id_v_bpa_0_bol_ad.envd fmy_id_v_bpa_0_bol_ad.c_err_clas /end DEF_CHARACTERISTIC
/end FUNCTION
/begin FUNCTION ERRM_CAL_ABYPCAD "Error Management Calibrations for diagnosis ABYPCAD"
 /begin DEF_CHARACTERISTIC fmy_id_byp_0_ctl.dtc[0] fmy_id_byp_0_ctl.envd fmy_id_byp_0_ctl.c_err_clas fmy_id_v_byp_0_bol_ad.dtc[0] fmy_id_v_byp_0_bol_ad.envd fmy_id_v_byp_0_bol_ad.c_err_clas /end DEF_CHARACTERISTIC
/end FUNCTION
/begin FUNCTION ERRM_CAL_AMAPCTLD "Error Management Calibrations for diagnosis AMAPCTLD"
 /begin DEF_CHARACTERISTIC fmy_id_map_ctl_min.dtc[0] fmy_id_map_ctl_min.envd fmy_id_map_ctl_min.c_err_clas fmy_id_map_ctl_max.dtc[0] fmy_id_map_ctl_max.envd fmy_id_map_ctl_max.c_err_clas /end DEF_CHARACTERISTIC
/end FUNCTION
/begin FUNCTION ERRM_CAL_ERRM_DIAG "Error Management Calibrations for diagnosis ERRM_DIAG"
 /begin DEF_CHARACTERISTIC fmy_id_egr_is_slow_obd.dtc[0] fmy_id_egr_is_slow_obd.envd fmy_id_egr_is_slow_obd.c_err_clas fmy_id_egrv.dtc[0] fmy_id_egrv.envd fmy_id_egrv.c_err_clas fmy_id_fsd_1.dtc[0] fmy_id_fsd_1.envd fmy_id_fsd_1.c_err_clas fmy_id_mis_a.dtc[0] fmy_id_mis_a.envd fmy_id_mis_a.c_err_clas fmy_id_mis_b1.dtc[0] fmy_id_mis_b1.envd fmy_id_mis_b1.c_err_clas fmy_id_mis_b4.dtc[0] fmy_id_mis_b4.envd fmy_id_mis_b4.c_err_clas fmy_id_pcv_2.dtc[0] fmy_id_pcv_2.envd fmy_id_pcv_2.c_err_clas fmy_id_thr.dtc[0] fmy_id_thr.envd fmy_id_thr.c_err_clas fmy_id_var_cod.dtc[0] fmy_id_var_cod.envd fmy_id_var_cod.c_err_clas fmy_id_vcv_2.dtc[0] fmy_id_vcv_2.envd fmy_id_vcv_2.c_err_clas /end DEF_CHARACTERISTIC
/end FUNCTION
/begin FUNCTION ERRM_CAL_AOBDEGR "Error Management Calibrations for diagnosis AOBDEGR"
 /begin DEF_CHARACTERISTIC fmy_id_maf_egr_thr_obd.dtc[0] fmy_id_maf_egr_thr_obd.envd fmy_id_maf_egr_thr_obd.c_err_clas fmy_id_maf_dif_egr_thr_obd.dtc[0] fmy_id_maf_dif_egr_thr_obd.envd fmy_id_maf_dif_egr_thr_obd.c_err_clas fmy_id_map_dif_egr_thr_obd.dtc[0] fmy_id_map_dif_egr_thr_obd.envd fmy_id_map_dif_egr_thr_obd.c_err_clas /end DEF_CHARACTERISTIC
/end FUNCTION
/begin FUNCTION ERRM_CAL_AVSDIAG "Error Management Calibrations for diagnosis AVSDIAG" /begin DEF_CHARACTERISTIC fmy_id_vs.dtc[0] fmy_id_vs.envd fmy_id_vs.c_err_clas /end DEF_CHARACTERISTIC /end FUNCTION
/begin FUNCTION ERRM_CAL_ACSDIAG "Error Management Calibrations for diagnosis ACSDIAG" /begin DEF_CHARACTERISTIC fmy_id_cs.dtc[0] fmy_id_cs.envd fmy_id_cs.c_err_clas /end DEF_CHARACTERISTIC /end FUNCTION
/begin FUNCTION ERRM_CAL_ABRAKE_D "Error Management Calibrations for diagnosis ABRAKE_D"
 /begin DEF_CHARACTERISTIC fmy_id_bls.dtc[0] fmy_id_bls.envd fmy_id_bls.c_err_clas fmy_id_bls_bts_dece.dtc[0] fmy_id_bls_bts_dece.envd fmy_id_bls_bts_dece.c_err_clas fmy_id_bls_bts_plaus.dtc[0] fmy_id_bls_bts_plaus.envd fmy_id_bls_bts_plaus.c_err_clas /end DEF_CHARACTERISTIC
/end FUNCTION
/begin FUNCTION ERRM_CAL_ACANDGO "Error Management Calibrations for diagnosis ACANDGO"
 /begin DEF_CHARACTERISTIC fmy_id_can_tcs.dtc[0] fmy_id_can_tcs.envd fmy_id_can_tcs.c_err_clas fmy_id_can_tcu.dtc[0] fmy_id_can_tcu.envd fmy_id_can_tcu.c_err_clas fmy_id_can_acu.dtc[0] fmy_id_can_acu.envd fmy_id_can_acu.c_err_clas fmy_id_can_ccu.dtc[0] fmy_id_can_ccu.envd fmy_id_can_ccu.c_err_clas fmy_id_can_icl.dtc[0] fmy_id_can_icl.envd fmy_id_can_icl.c_err_clas fmy_id_can_vecu.dtc[0] fmy_id_can_vecu.envd fmy_id_can_vecu.c_err_clas fmy_id_can_smls.dtc[0] fmy_id_can_smls.envd fmy_id_can_smls.c_err_clas fmy_id_can_boff.dtc[0] fmy_id_can_boff.envd fmy_id_can_boff.c_err_clas fmy_id_can_if_cft.dtc[0] fmy_id_can_if_cft.envd fmy_id_can_if_cft.c_err_clas fmy_id_can_eilu.dtc[0] fmy_id_can_eilu.envd fmy_id_can_eilu.c_err_clas fmy_id_can_dcc.dtc[0] fmy_id_can_dcc.envd fmy_id_can_dcc.c_err_clas fmy_id_can_whl.dtc[0] fmy_id_can_whl.envd fmy_id_can_whl.c_err_clas fmy_id_can_sys_info.dtc[0] fmy_id_can_sys_info.envd fmy_id_can_sys_info.c_err_clas fmy_id_can_nom_sys.dtc[0] fmy_id_can_nom_sys.envd fmy_id_can_nom_sys.c_err_clas fmy_id_can_tot.dtc[0] fmy_id_can_tot.envd fmy_id_can_tot.c_err_clas /end DEF_CHARACTERISTIC
/end FUNCTION
/begin FUNCTION ERRM_CAL_AVARDIAG "Error Management Calibrations for diagnosis AVARDIAG"
 /begin DEF_CHARACTERISTIC fmy_id_varcod.dtc[0] fmy_id_varcod.envd fmy_id_varcod.c_err_clas /end DEF_CHARACTERISTIC
/end FUNCTION
/begin FUNCTION ERRM_CAL_AAC_DIAG "Error Management Calibrations for diagnosis AAC_DIAG"
 /begin DEF_CHARACTERISTIC fmy_id_acp_mes_rng.dtc[0] fmy_id_acp_mes_rng.envd fmy_id_acp_mes_rng.c_err_clas fmy_id_acp_mes_grd.dtc[0] fmy_id_acp_mes_grd.envd fmy_id_acp_mes_grd.c_err_clas /end DEF_CHARACTERISTIC
/end FUNCTION
/begin FUNCTION ERRM_CAL_ATBADIAG "Error Management Calibrations for diagnosis ATBADIAG"
 /begin DEF_CHARACTERISTIC fmy_id_v_tba_rng.dtc[0] fmy_id_v_tba_rng.envd fmy_id_v_tba_rng.c_err_clas fmy_id_tba_mes_grd.dtc[0] fmy_id_tba_mes_grd.envd fmy_id_tba_mes_grd.c_err_clas /end DEF_CHARACTERISTIC
/end FUNCTION
/begin FUNCTION ERRM_CAL_AALTDIAG "Error Management Calibrations for diagnosis AALTDIAG"
 /begin DEF_CHARACTERISTIC fmy_id_ducy_alter_pwm_rng.dtc[0] fmy_id_ducy_alter_pwm_rng.envd fmy_id_ducy_alter_pwm_rng.c_err_clas fmy_id_ducy_alter_pwm_grd.dtc[0] fmy_id_ducy_alter_pwm_grd.envd fmy_id_ducy_alter_pwm_grd.c_err_clas /end DEF_CHARACTERISTIC
/end FUNCTION
/begin FUNCTION ERRM_CAL_AVEGRVDG "Error Management Calibrations for diagnosis AVEGRVDG"
 /begin DEF_CHARACTERISTIC fmy_id_v_egrv_0_rng.dtc[0] fmy_id_v_egrv_0_rng.envd fmy_id_v_egrv_0_rng.c_err_clas fmy_id_v_egrv_1_rng.dtc[0] fmy_id_v_egrv_1_rng.envd fmy_id_v_egrv_1_rng.c_err_clas fmy_id_v_egrv_0_grd.dtc[0] fmy_id_v_egrv_0_grd.envd fmy_id_v_egrv_0_grd.c_err_clas fmy_id_v_egrv_1_grd.dtc[0] fmy_id_v_egrv_1_grd.envd fmy_id_v_egrv_1_grd.c_err_clas /end DEF_CHARACTERISTIC
/end FUNCTION
/begin FUNCTION ERRM_CAL_ACAPDIAG "Error Management Calibrations for diagnosis ACAPDIAG"
 /begin DEF_CHARACTERISTIC fmy_id_ges_maf_0_max.dtc[0] fmy_id_ges_maf_0_max.envd fmy_id_ges_maf_0_max.c_err_clas /end DEF_CHARACTERISTIC
/end FUNCTION
/begin FUNCTION ERRM_CAL_ATCOPLAD "Error Management Calibrations for diagnosis ATCOPLAD"
 /begin DEF_CHARACTERISTIC fmy_id_tco_1_2_plaus.dtc[0] fmy_id_tco_1_2_plaus.envd fmy_id_tco_1_2_plaus.c_err_clas /end DEF_CHARACTERISTIC
/end FUNCTION
/begin FUNCTION ERRM_CAL_AEFPDIAG "Error Management Calibrations for diagnosis AEFPDIAG"
 /begin DEF_CHARACTERISTIC fmy_id_efp_rly_dps.dtc[0] fmy_id_efp_rly_dps.envd fmy_id_efp_rly_dps.c_err_clas fmy_id_efp_rly_plaus_1.dtc[0] fmy_id_efp_rly_plaus_1.envd fmy_id_efp_rly_plaus_1.c_err_clas fmy_id_efp_rly_plaus_2.dtc[0] fmy_id_efp_rly_plaus_2.envd fmy_id_efp_rly_plaus_2.c_err_clas /end DEF_CHARACTERISTIC
/end FUNCTION
/begin FUNCTION ERRM_CAL_ASPIDIAG "Error Management Calibrations for diagnosis ASPIDIAG"
 /begin DEF_CHARACTERISTIC fmy_id_spi_mps.dtc[0] fmy_id_spi_mps.envd fmy_id_spi_mps.c_err_clas fmy_id_spi_oct.dtc[0] fmy_id_spi_oct.envd fmy_id_spi_oct.c_err_clas fmy_id_spi_qps.dtc[0] fmy_id_spi_qps.envd fmy_id_spi_qps.c_err_clas /end DEF_CHARACTERISTIC
/end FUNCTION
/begin FUNCTION ERRM_CAL_AEGRBYPD "Error Management Calibrations for diagnosis AEGRBYPD"
 /begin DEF_CHARACTERISTIC fmy_id_egr_byp_dps.dtc[0] fmy_id_egr_byp_dps.envd fmy_id_egr_byp_dps.c_err_clas /end DEF_CHARACTERISTIC
/end FUNCTION
/begin FUNCTION ERRM_CAL_AEGRVDHB "Error Management Calibrations for diagnosis AEGRVDHB"
 /begin DEF_CHARACTERISTIC fmy_id_egrv_0.dtc[0] fmy_id_egrv_0.envd fmy_id_egrv_0.c_err_clas /end DEF_CHARACTERISTIC
/end FUNCTION
/begin FUNCTION ERRM_CAL_AINJDIAG "Error Management Calibrations for diagnosis AINJDIAG"
 /begin DEF_CHARACTERISTIC fmy_id_pps_ini_0.dtc[0] fmy_id_pps_ini_0.envd fmy_id_pps_ini_0.c_err_clas fmy_id_pps_ini_tout_0.dtc[0] fmy_id_pps_ini_tout_0.envd fmy_id_pps_ini_tout_0.c_err_clas fmy_id_pps_plaus_0.dtc[0] fmy_id_pps_plaus_0.envd fmy_id_pps_plaus_0.c_err_clas fmy_id_pps_cal_0.dtc[0] fmy_id_pps_cal_0.envd fmy_id_pps_cal_0.c_err_clas fmy_id_pps_v_inj_0.dtc[0] fmy_id_pps_v_inj_0.envd fmy_id_pps_v_inj_0.c_err_clas fmy_id_pps_wdt_0.dtc[0] fmy_id_pps_wdt_0.envd fmy_id_pps_wdt_0.c_err_clas fmy_id_pps_fsm_0.dtc[0] fmy_id_pps_fsm_0.envd fmy_id_pps_fsm_0.c_err_clas fmy_id_pps_oc_0.dtc[0] fmy_id_pps_oc_0.envd fmy_id_pps_oc_0.c_err_clas fmy_id_pps_oc_1.dtc[0] fmy_id_pps_oc_1.envd fmy_id_pps_oc_1.c_err_clas fmy_id_pps_oc_2.dtc[0] fmy_id_pps_oc_2.envd fmy_id_pps_oc_2.c_err_clas fmy_id_pps_oc_3.dtc[0] fmy_id_pps_oc_3.envd fmy_id_pps_oc_3.c_err_clas fmy_id_pps_sc_h_l_0.dtc[0] fmy_id_pps_sc_h_l_0.envd fmy_id_pps_sc_h_l_0.c_err_clas fmy_id_pps_sc_h_l_1.dtc[0] fmy_id_pps_sc_h_l_1.envd fmy_id_pps_sc_h_l_1.c_err_clas fmy_id_pps_sc_h_l_2.dtc[0] fmy_id_pps_sc_h_l_2.envd fmy_id_pps_sc_h_l_2.c_err_clas fmy_id_pps_sc_h_l_3.dtc[0] fmy_id_pps_sc_h_l_3.envd fmy_id_pps_sc_h_l_3.c_err_clas fmy_id_pps_sc_h_0.dtc[0] fmy_id_pps_sc_h_0.envd fmy_id_pps_sc_h_0.c_err_clas fmy_id_pps_sc_l_0.dtc[0] fmy_id_pps_sc_l_0.envd fmy_id_pps_sc_l_0.c_err_clas /end DEF_CHARACTERISTIC
/end FUNCTION
/begin FUNCTION ERRM_CAL_ATEGTURD "Error Management Calibrations for diagnosis ATEGTURD"
 /begin DEF_CHARACTERISTIC fmy_id_v_teg_tur_up_rng.dtc[0] fmy_id_v_teg_tur_up_rng.envd fmy_id_v_teg_tur_up_rng.c_err_clas fmy_id_teg_tur_up_mes_grd.dtc[0] fmy_id_teg_tur_up_mes_grd.envd fmy_id_teg_tur_up_mes_grd.c_err_clas /end DEF_CHARACTERISTIC
/end FUNCTION
/begin FUNCTION ERRM_CAL_ADGOSPI "Error Management Calibrations for diagnosis ADGOSPI"
 /begin DEF_CHARACTERISTIC fmy_id_bpa.dtc[0] fmy_id_bpa.envd fmy_id_bpa.c_err_clas fmy_id_gl_rly_dps.dtc[0] fmy_id_gl_rly_dps.envd fmy_id_gl_rly_dps.c_err_clas fmy_id_pcv_1.dtc[0] fmy_id_pcv_1.envd fmy_id_pcv_1.c_err_clas fmy_id_pcv_3.dtc[0] fmy_id_pcv_3.envd fmy_id_pcv_3.c_err_clas fmy_id_vcv_1.dtc[0] fmy_id_vcv_1.envd fmy_id_vcv_1.c_err_clas fmy_id_vcv_3.dtc[0] fmy_id_vcv_3.envd fmy_id_vcv_3.c_err_clas /end DEF_CHARACTERISTIC
/end FUNCTION
/begin FUNCTION ERRM_CAL_ARLYDIAG "Error Management Calibrations for diagnosis ARLYDIAG"
 /begin DEF_CHARACTERISTIC fmy_id_rly_main.dtc[0] fmy_id_rly_main.envd fmy_id_rly_main.c_err_clas fmy_id_rly_power.dtc[0] fmy_id_rly_power.envd fmy_id_rly_power.c_err_clas /end DEF_CHARACTERISTIC
/end FUNCTION
/begin FUNCTION ERRM_CAL_AVBDIAG "Error Management Calibrations for diagnosis AVBDIAG" /begin DEF_CHARACTERISTIC fmy_id_vb.dtc[0] fmy_id_vb.envd fmy_id_vb.c_err_clas /end DEF_CHARACTERISTIC /end FUNCTION
/begin FUNCTION ERRM_CAL_AERRMON "Error Management Calibrations for diagnosis AERRMON"
 /begin DEF_CHARACTERISTIC fmy_id_conv_mon_1.dtc[0] fmy_id_conv_mon_1.envd fmy_id_conv_mon_1.c_err_clas fmy_id_n_32_mon_1.dtc[0] fmy_id_n_32_mon_1.envd fmy_id_n_32_mon_1.c_err_clas fmy_id_pvs_mon_1.dtc[0] fmy_id_pvs_mon_1.envd fmy_id_pvs_mon_1.c_err_clas fmy_id_fcut_mon_1.dtc[0] fmy_id_fcut_mon_1.envd fmy_id_fcut_mon_1.c_err_clas fmy_id_tqi_n_max_mon_1.dtc[0] fmy_id_tqi_n_max_mon_1.envd fmy_id_tqi_n_max_mon_1.c_err_clas fmy_id_serv_mon_1.dtc[0] fmy_id_serv_mon_1.envd fmy_id_serv_mon_1.c_err_clas fmy_id_post_inh_mon.dtc[0] fmy_id_post_inh_mon.envd fmy_id_post_inh_mon.c_err_clas fmy_id_cru_inh_mon.dtc[0] fmy_id_cru_inh_mon.envd fmy_id_cru_inh_mon.c_err_clas fmy_id_can_inh_mon.dtc[0] fmy_id_can_inh_mon.envd fmy_id_can_inh_mon.c_err_clas /end DEF_CHARACTERISTIC
/end FUNCTION
/begin FUNCTION ERRM_CAL_TMO3ERRM "Error Management Calibrations for diagnosis TMO3ERRM"
 /begin DEF_CHARACTERISTIC fmy_id_mon_3.dtc[0] fmy_id_mon_3.envd fmy_id_mon_3.c_err_clas /end DEF_CHARACTERISTIC
/end FUNCTION
/begin FUNCTION ERRM_CAL_ENSD_DIAG "Error Management Calibrations for diagnosis ENSD_DIAG"
 /begin DEF_CHARACTERISTIC fmy_id_per_cam_in_1.dtc[0] fmy_id_per_cam_in_1.envd fmy_id_per_cam_in_1.c_err_clas fmy_id_syn_cam_in_1.dtc[0] fmy_id_syn_cam_in_1.envd fmy_id_syn_cam_in_1.c_err_clas fmy_id_ref_crk_cam_in_1.dtc[0] fmy_id_ref_crk_cam_in_1.envd fmy_id_ref_crk_cam_in_1.c_err_clas fmy_id_crk_tooth.dtc[0] fmy_id_crk_tooth.envd fmy_id_crk_tooth.c_err_clas fmy_id_crk_tooth_per.dtc[0] fmy_id_crk_tooth_per.envd fmy_id_crk_tooth_per.c_err_clas fmy_id_crk_syn.dtc[0] fmy_id_crk_syn.envd fmy_id_crk_syn.c_err_clas fmy_id_crk_plaus.dtc[0] fmy_id_crk_plaus.envd fmy_id_crk_plaus.c_err_clas fmy_id_plaus_cam_in_1.dtc[0] fmy_id_plaus_cam_in_1.envd fmy_id_plaus_cam_in_1.c_err_clas fmy_id_syn_crk_cam_in_1.dtc[0] fmy_id_syn_crk_cam_in_1.envd fmy_id_syn_crk_cam_in_1.c_err_clas /end DEF_CHARACTERISTIC
/end FUNCTION
/begin FUNCTION ERRM_CAL_EGCP_DIAG "Error Management Calibrations for diagnosis EGCP_DIAG"
 /begin DEF_CHARACTERISTIC fmy_id_lsh_up_1.dtc[0] fmy_id_lsh_up_1.envd fmy_id_lsh_up_1.c_err_clas fmy_id_lsh_down_1.dtc[0] fmy_id_lsh_down_1.envd fmy_id_lsh_down_1.c_err_clas fmy_id_scg_ls_down_1.dtc[0] fmy_id_scg_ls_down_1.envd fmy_id_scg_ls_down_1.c_err_clas fmy_id_scp_ls_down_1.dtc[0] fmy_id_scp_ls_down_1.envd fmy_id_scp_ls_down_1.c_err_clas fmy_id_oc_ls_down_1.dtc[0] fmy_id_oc_ls_down_1.envd fmy_id_oc_ls_down_1.c_err_clas fmy_id_obd_lsh_down_1.dtc[0] fmy_id_obd_lsh_down_1.envd fmy_id_obd_lsh_down_1.c_err_clas fmy_id_lam_adj_1.dtc[0] fmy_id_lam_adj_1.envd fmy_id_lam_adj_1.c_err_clas fmy_id_chk_ls_down_1.dtc[0] fmy_id_chk_ls_down_1.envd fmy_id_chk_ls_down_1.c_err_clas fmy_id_puc_ls_down_1.dtc[0] fmy_id_puc_ls_down_1.envd fmy_id_puc_ls_down_1.c_err_clas fmy_id_fl_ls_down_1.dtc[0] fmy_id_fl_ls_down_1.envd fmy_id_fl_ls_down_1.c_err_clas fmy_id_el_lsl_up_1.dtc[0] fmy_id_el_lsl_up_1.envd fmy_id_el_lsl_up_1.c_err_clas fmy_id_oc_lsl_up_1.dtc[0] fmy_id_oc_lsl_up_1.envd fmy_id_oc_lsl_up_1.c_err_clas fmy_id_lsl_up_if_1.dtc[0] fmy_id_lsl_up_if_1.envd fmy_id_lsl_up_if_1.c_err_clas fmy_id_air_lsl_up_1.dtc[0] fmy_id_air_lsl_up_1.envd fmy_id_air_lsl_up_1.c_err_clas fmy_id_ttip_obd_ls_up_1.dtc[0] fmy_id_ttip_obd_ls_up_1.envd fmy_id_ttip_obd_ls_up_1.c_err_clas fmy_id_dyn_vld_ls_up_1.dtc[0] fmy_id_dyn_vld_ls_up_1.envd fmy_id_dyn_vld_ls_up_1.c_err_clas fmy_id_puc_vld_ls_up_1.dtc[0] fmy_id_puc_vld_ls_up_1.envd fmy_id_puc_vld_ls_up_1.c_err_clas fmy_id_obd_vld_lsh_up_1.dtc[0] fmy_id_obd_vld_lsh_up_1.envd fmy_id_obd_vld_lsh_up_1.c_err_clas fmy_id_shift_afl_lsl_up_1.dtc[0] fmy_id_shift_afl_lsl_up_1.envd fmy_id_shift_afl_lsl_up_1.c_err_clas fmy_id_shift_afr_lsl_up_1.dtc[0] fmy_id_shift_afr_lsl_up_1.envd fmy_id_shift_afr_lsl_up_1.c_err_clas fmy_id_lsh_lsl_up_1.dtc[0] fmy_id_lsh_lsl_up_1.envd fmy_id_lsh_lsl_up_1.c_err_clas fmy_id_swt_ls_down_1.dtc[0] fmy_id_swt_ls_down_1.envd fmy_id_swt_ls_down_1.c_err_clas fmy_id_pue_ls_down_1.dtc[0] fmy_id_pue_ls_down_1.envd fmy_id_pue_ls_down_1.c_err_clas fmy_id_chg_ls_up.dtc[0] fmy_id_chg_ls_up.envd fmy_id_chg_ls_up.c_err_clas fmy_id_chg_ls_down.dtc[0] fmy_id_chg_ls_down.envd fmy_id_chg_ls_down.c_err_clas /end DEF_CHARACTERISTIC
/end FUNCTION
/begin FUNCTION C_7_EGCP "C_7_EGCP"
 /begin DEF_CHARACTERISTIC ldpm_temp_ini_ls_up_1_egcp ldpm_temp_ini_ls_down_1_egcp ldpm_n_32_3_egcp ldpm_teg_cat_up_mdl_1_egcp ldpm_teg_cat_down_mdl_1_egcp ldpm_vs_1_egcp ldpm_n_32_1_egcp ldpm_n_32_2_egcp ldpm_maf_1_egcp ldpm_n_32_ls_up_dyn ldpm_maf_hb_ls_up_dyn /end DEF_CHARACTERISTIC
 /begin SUB_FUNCTION EGCP_Upstream_ls_heat_mng EGCP_Downstream_ls_heat_mng EGCP_Downstream_ls_sig_V EGCP_Downstream_ls_read_det EGCP_ACQ_compensation_WRAF_ls EGCP_Operability_detection_lsl EGCP_WRAF_sensor_control EGCP_WRAF_GAIN_AD_fuel_cut_off EGCP_Air_fuel_cycle_evaluation EGCP_WRAF_GAIN_AD_fuel_cutoff_AI EGCP_A_I_upstream_ls_heater_mng EGCP_A_I_downstream_ls_heat_mng /end SUB_FUNCTION
/end FUNCTION
/end MODULE
/end PROJECT
