ASAP2_VERSION 1 41
/begin PROJECT SN0 "SIMOS PPD"
/begin HEADER "_default_HeaderComment" PROJECT_NO PRJ_NUM /end HEADER
/begin MODULE _default_ModuleName "_default_ModuleLongIdentifier"
/begin MOD_COMMON "_default_ModCommonComment" DEPOSIT ABSOLUTE BYTE_ORDER MSB_FIRST ALIGNMENT_BYTE 1 ALIGNMENT_WORD 2 ALIGNMENT_LONG 4 ALIGNMENT_FLOAT32_IEEE 4 ALIGNMENT_FLOAT64_IEEE 8 /end MOD_COMMON
/include if_ccp.a2l
/begin CHARACTERISTIC c_abc_max_var_cod "" VALUE 0x85c860 _REC_VAL_20_u1 255. _CNV_A_R_LINEAR_____0_CM 0. 255. DISPLAY_IDENTIFIER C_ABC_MAX_VAR_COD FORMAT "%3.0" /end CHARACTERISTIC
/begin CHARACTERISTIC c_abc_inc_egr_ctl_min "" VALUE 0x84fa99 _REC_VAL_20_u1 255. _CNV_A_R_LINEAR_____0_CM 0. 255. DISPLAY_IDENTIFIER C_ABC_INC_EGR_CTL_MIN FORMAT "%3.0" /end CHARACTERISTIC
/begin CHARACTERISTIC c_abc_max_egr_ctl_min "" VALUE 0x84fb25 _REC_VAL_20_u1 255. _CNV_A_R_LINEAR_____0_CM 0. 255. DISPLAY_IDENTIFIER C_ABC_MAX_EGR_CTL_MIN FORMAT "%3.0" /end CHARACTERISTIC
/begin CHARACTERISTIC c_abc_inc_egr_ctl_max "" VALUE 0x84fa98 _REC_VAL_20_u1 255. _CNV_A_R_LINEAR_____0_CM 0. 255. DISPLAY_IDENTIFIER C_ABC_INC_EGR_CTL_MAX FORMAT "%3.0" /end CHARACTERISTIC
/begin CHARACTERISTIC c_abc_max_egr_ctl_max "" VALUE 0x84fb24 _REC_VAL_20_u1 255. _CNV_A_R_LINEAR_____0_CM 0. 255. DISPLAY_IDENTIFIER C_ABC_MAX_EGR_CTL_MAX FORMAT "%3.0" /end CHARACTERISTIC
/begin CHARACTERISTIC c_egr_dif_min_diag "" VALUE 0x85c992 _REC_VAL_20_s2 99.99694814999999 _CNV_A_R_LINEAR_____12_CM -100. -3.05185e-003 DISPLAY_IDENTIFIER C_EGR_DIF_MIN_DIAG /end CHARACTERISTIC
/begin CHARACTERISTIC c_egr_dif_max_diag "" VALUE 0x85c990 _REC_VAL_20_s2 99.996948242 _CNV_A_R_LINEAR_____46_CM 0. 99.996948242 DISPLAY_IDENTIFIER C_EGR_DIF_MAX_DIAG /end CHARACTERISTIC
/begin MEASUREMENT ctr_egr_ctl_min "" UBYTE _CNV_A_R_LINEAR_____0_CM 1 0. 0. 255. DISPLAY_IDENTIFIER CTR_EGR_CTL_MIN ECU_ADDRESS 0x7fbdf8 FORMAT "%3.0" /end MEASUREMENT
/begin MEASUREMENT ctr_egr_ctl_max "" UBYTE _CNV_A_R_LINEAR_____0_CM 1 0. 0. 255. DISPLAY_IDENTIFIER CTR_EGR_CTL_MAX ECU_ADDRESS 0x7fbdf9 FORMAT "%3.0" /end MEASUREMENT
/begin CHARACTERISTIC ip_ctr_max_egr_ctl_min__n "DIAG_EGR_CTL: maximum value of CTR_EGR_CTL_MIN" CURVE 0x851d7e _REC_CUR_20_u1_u2 255. _CNV_A_R_LINEAR_____0_CM 0. 255. DISPLAY_IDENTIFIER IP_CTR_MAX_EGR_CTL_MIN__N FORMAT "%3.0"
 /begin AXIS_DESCR COM_AXIS n _CNV_A_R_LINEAR_____5_CM 8 0. 6375. FORMAT "%4.0" AXIS_PTS_REF ldpm_n_ip_ctr_max_egr_ctl_diag /end AXIS_DESCR
/end CHARACTERISTIC
/begin CHARACTERISTIC ip_ctr_max_egr_ctl_max__n "DIAG_EGR_CTL: maximum value of CTR_EGR_CTL_MAX" CURVE 0x851d76 _REC_CUR_20_u1_u2 255. _CNV_A_R_LINEAR_____0_CM 0. 255. DISPLAY_IDENTIFIER IP_CTR_MAX_EGR_CTL_MAX__N FORMAT "%3.0"
 /begin AXIS_DESCR COM_AXIS n _CNV_A_R_LINEAR_____5_CM 8 0. 6375. FORMAT "%4.0" AXIS_PTS_REF ldpm_n_ip_ctr_max_egr_ctl_diag /end AXIS_DESCR
/end CHARACTERISTIC
/begin AXIS_PTS ldpm_n_ip_ctr_max_egr_ctl_diag "" 0x842f88 n _REC_AXS_20_u2 6375. _CNV_A_R_LINEAR_____5_CM 8 0. 6375. FORMAT "%4.0" /end AXIS_PTS
/begin CHARACTERISTIC c_abc_inc_v_tpc_rng "" VALUE 0x84faf2 _REC_VAL_20_u1 255. _CNV_A_R_LINEAR_____0_CM 0. 255. DISPLAY_IDENTIFIER C_ABC_INC_V_TPC_RNG FORMAT "%3.0" /end CHARACTERISTIC
/begin CHARACTERISTIC c_abc_max_v_tpc_rng "" VALUE 0x84fb7e _REC_VAL_20_u1 255. _CNV_A_R_LINEAR_____0_CM 0. 255. DISPLAY_IDENTIFIER C_ABC_MAX_V_TPC_RNG FORMAT "%3.0" /end CHARACTERISTIC
/begin CHARACTERISTIC c_abc_inc_tpc_mes_plaus "" VALUE 0x84fadb _REC_VAL_20_u1 255. _CNV_A_R_LINEAR_____0_CM 0. 255. DISPLAY_IDENTIFIER C_ABC_INC_TPC_MES_PLAUS FORMAT "%3.0" /end CHARACTERISTIC
/begin CHARACTERISTIC c_abc_max_tpc_mes_plaus "" VALUE 0x84fb67 _REC_VAL_20_u1 255. _CNV_A_R_LINEAR_____0_CM 0. 255. DISPLAY_IDENTIFIER C_ABC_MAX_TPC_MES_PLAUS FORMAT "%3.0" /end CHARACTERISTIC
/begin MEASUREMENT lv_err_tpc_mes "" UBYTE _CNV_S_2_RANGE______23_CM 1 0. 0. 1. DISPLAY_IDENTIFIER LV_ERR_TPC_MES ECU_ADDRESS 0x7fb829 /end MEASUREMENT
/begin MEASUREMENT t_v_tpc_rng_diag "" UWORD _CNV_A_R_LINEAR_____19_CM 1 0. 0. 6553.5 DISPLAY_IDENTIFIER T_V_TPC_RNG_DIAG ECU_ADDRESS 0x7fa642 BYTE_ORDER MSB_LAST FORMAT "%4.1" /end MEASUREMENT
/begin CHARACTERISTIC c_v_tpc_max_diag "" VALUE 0x85ce02 _REC_VAL_20_u2 4.9951171875 _CNV_A_R_LINEAR_____28_CM 0. 4.9951171875 DISPLAY_IDENTIFIER C_V_TPC_MAX_DIAG FORMAT "%3.2" /end CHARACTERISTIC
/begin CHARACTERISTIC c_v_tpc_min_diag "" VALUE 0x85ce04 _REC_VAL_20_u2 4.9951171875 _CNV_A_R_LINEAR_____28_CM 0. 4.9951171875 DISPLAY_IDENTIFIER C_V_TPC_MIN_DIAG FORMAT "%3.2" /end CHARACTERISTIC
/begin CHARACTERISTIC c_n_v_tpc_rng_diag "" VALUE 0x85cb50 _REC_VAL_20_u2 6375. _CNV_A_R_LINEAR_____5_CM 0. 6375. DISPLAY_IDENTIFIER C_N_V_TPC_RNG_DIAG FORMAT "%4.0" /end CHARACTERISTIC
/begin CHARACTERISTIC c_mf_tot_v_tpc_rng_diag "" VALUE 0x85caec _REC_VAL_20_u2 65.535 _CNV_A_R_LINEAR_____50_CM 0. 65.535 DISPLAY_IDENTIFIER C_MF_TOT_V_TPC_RNG_DIAG FORMAT "%4.2" /end CHARACTERISTIC
/begin CHARACTERISTIC c_t_max_v_tpc_rng_diag "" VALUE 0x85cc62 _REC_VAL_20_u2 6553.5 _CNV_A_R_LINEAR_____19_CM 0. 6553.5 DISPLAY_IDENTIFIER C_T_MAX_V_TPC_RNG_DIAG FORMAT "%5.1" /end CHARACTERISTIC
/begin CHARACTERISTIC c_tco_tpc_mes_plaus_diag "" VALUE 0x85ccc6 _REC_VAL_20_u1 255. _CNV_A_R_LINEAR_____18_CM -50. 205. DISPLAY_IDENTIFIER C_TCO_TPC_MES_PLAUS_DIAG /end CHARACTERISTIC
/begin CHARACTERISTIC c_tpc_mes_plaus_diag "" VALUE 0x85cd28 _REC_VAL_20_u2 1024. _CNV_A_R_LINEAR_____51_CM 0. 1024. DISPLAY_IDENTIFIER C_TPC_MES_PLAUS_DIAG FORMAT "%6.2" /end CHARACTERISTIC
/begin CHARACTERISTIC c_abc_inc_v_tac_rng "anti bounce counter increment for diagnosis instance V_TAC_RNG" VALUE 0x84faea _REC_VAL_20_u1 255. _CNV_A_R_LINEAR_____0_CM 0. 255. DISPLAY_IDENTIFIER C_ABC_INC_V_TAC_RNG FORMAT "%3.0" /end CHARACTERISTIC
/begin CHARACTERISTIC c_abc_max_v_tac_rng "maximum value of anti bounce counter for diagnosis instance V_TAC_RNG" VALUE 0x84fb76 _REC_VAL_20_u1 255. _CNV_A_R_LINEAR_____0_CM 0. 255. DISPLAY_IDENTIFIER C_ABC_MAX_V_TAC_RNG FORMAT "%3.0" /end CHARACTERISTIC
/begin CHARACTERISTIC c_abc_inc_tac_mes_grd "anti bounce counter increment for diagnosis instance TAC_MES_GRD" VALUE 0x84face _REC_VAL_20_u1 255. _CNV_A_R_LINEAR_____0_CM 0. 255. DISPLAY_IDENTIFIER C_ABC_INC_TAC_MES_GRD FORMAT "%3.0" /end CHARACTERISTIC
/begin CHARACTERISTIC c_abc_max_tac_mes_grd "maximum value of anti bounce counter for diagnosis instance TAC_MES_GRD" VALUE 0x84fb5a _REC_VAL_20_u1 255. _CNV_A_R_LINEAR_____0_CM 0. 255. DISPLAY_IDENTIFIER C_ABC_MAX_TAC_MES_GRD FORMAT "%3.0" /end CHARACTERISTIC
/begin MEASUREMENT ctr_v_tac_rng_up "timer for TAC range check dependent on torque request and engine speed" UWORD _CNV_A_R_LINEAR_____0_CM 1 0. 0. 65535. DISPLAY_IDENTIFIER CTR_V_TAC_RNG_UP ECU_ADDRESS 0x7fa644 BYTE_ORDER MSB_LAST FORMAT "%5.0" /end MEASUREMENT
/begin MEASUREMENT lv_v_tac_rng_up "diagnostic condition for diagnostic instance V_TAC_RNG" UBYTE _CNV_S_2_RANGE______11_CM 1 0. 0. 1. DISPLAY_IDENTIFIER LV_V_TAC_RNG_UP ECU_ADDRESS 0x7fbe00 /end MEASUREMENT
/begin MEASUREMENT lv_err_tac_mes "global error flag" UBYTE _CNV_S_2_RANGE______23_CM 1 0. 0. 1. DISPLAY_IDENTIFIER LV_ERR_TAC_MES ECU_ADDRESS 0x7fb82a /end MEASUREMENT
/begin CHARACTERISTIC c_v_tac_max_diag "TAC maximum voltage threshold for diagnostic instance V_TAC_RNG (related to minimal temperature)" VALUE 0x8500b8 _REC_VAL_20_u2 4.9951171875 _CNV_A_R_LINEAR_____28_CM 0. 4.9951171875 DISPLAY_IDENTIFIER C_V_TAC_MAX_DIAG FORMAT "%4.3" /end CHARACTERISTIC
/begin CHARACTERISTIC c_v_tac_min_diag "TAC minimum voltage threshold for diagnostic instance V_TAC_RNG (related to maximal temperature)" VALUE 0x8500ba _REC_VAL_20_u2 4.9951171875 _CNV_A_R_LINEAR_____28_CM 0. 4.9951171875 DISPLAY_IDENTIFIER C_V_TAC_MIN_DIAG FORMAT "%4.3" /end CHARACTERISTIC
/begin CHARACTERISTIC c_n_v_tac_rng_diag "engine speed threshold for diagnostic instance V_TAC_RNG" VALUE 0x84fe34 _REC_VAL_20_u2 8160. _CNV_A_R_LINEAR_____5_CM 0. 8160. DISPLAY_IDENTIFIER C_N_V_TAC_RNG_DIAG FORMAT "%4.0" /end CHARACTERISTIC
/begin CHARACTERISTIC c_tqi_sp_v_tac_rng_diag "torque setpoint threshold for diagnostic instance V_TAC_RNG" VALUE 0x850076 _REC_VAL_20_s2 2047.96875 _CNV_A_R_LINEAR_____52_CM -1024. 1023.96875 DISPLAY_IDENTIFIER C_TQI_SP_V_TAC_RNG_DIAG FORMAT "%6.2" /end CHARACTERISTIC
/begin CHARACTERISTIC c_ctr_max_v_tac_rng_up "counter maximum for check of upper voltage limit in error instance V_TAC_RNG" VALUE 0x84fc00 _REC_VAL_20_u2 65535. _CNV_A_R_LINEAR_____0_CM 0. 65535. DISPLAY_IDENTIFIER C_CTR_MAX_V_TAC_RNG_UP FORMAT "%5.0" /end CHARACTERISTIC
/begin CHARACTERISTIC c_ctr_inc_v_tac_rng_up "counter increment for check of upper voltage limit in instance V_TAC_RNG" VALUE 0x84fbfe _REC_VAL_20_u1 255. _CNV_A_R_LINEAR_____0_CM 0. 255. DISPLAY_IDENTIFIER C_CTR_INC_V_TAC_RNG_UP FORMAT "%3.0" /end CHARACTERISTIC
/begin CHARACTERISTIC c_tac_mes_grd_diag "gradient threshold for diagnostic instance TAC_MES_GRD" VALUE 0x850004 _REC_VAL_20_u2 1023.984375 _CNV_A_R_LINEAR_____53_CM 0. 1023.984375 DISPLAY_IDENTIFIER C_TAC_MES_GRD_DIAG FORMAT "%6.2" /end CHARACTERISTIC
/begin CHARACTERISTIC c_abc_inc_mf_is_obd "" VALUE 0x84faab _REC_VAL_20_u1 255. _CNV_A_R_LINEAR_____0_CM 0. 255. DISPLAY_IDENTIFIER C_ABC_INC_MF_IS_OBD FORMAT "%3.0" /end CHARACTERISTIC
/begin CHARACTERISTIC c_abc_max_mf_is_obd "" VALUE 0x84fb37 _REC_VAL_20_u1 255. _CNV_A_R_LINEAR_____0_CM 0. 255. DISPLAY_IDENTIFIER C_ABC_MAX_MF_IS_OBD FORMAT "%3.0" /end CHARACTERISTIC
/begin CHARACTERISTIC lc_mf_is_obd_rst "" VALUE 0x85ce8d _REC_VAL_20_u1 1. _CNV_S_2_RANGE______11_CM 0. 1. DISPLAY_IDENTIFIER LC_MF_IS_OBD_RST /end CHARACTERISTIC
/begin CHARACTERISTIC c_t_dly_mf_is_obd "" VALUE 0x85cc2e _REC_VAL_20_u2 41.9424 _CNV_A_R_LINEAR_____54_CM 0. 41.9424 DISPLAY_IDENTIFIER C_T_DLY_MF_IS_OBD FORMAT "%5.3" /end CHARACTERISTIC
/begin CHARACTERISTIC c_ctr_mf_is_obd "" VALUE 0x85c972 _REC_VAL_20_u1 255. _CNV_A_R_LINEAR_____0_CM 0. 255. DISPLAY_IDENTIFIER C_CTR_MF_IS_OBD FORMAT "%3.0" /end CHARACTERISTIC
/begin CHARACTERISTIC c_mf_is_max_obd "" VALUE 0x85cad6 _REC_VAL_20_u2 262.14 _CNV_A_R_LINEAR_____38_CM 0. 262.14 DISPLAY_IDENTIFIER C_MF_IS_MAX_OBD FORMAT "%5.3" /end CHARACTERISTIC
/begin CHARACTERISTIC c_mf_is_min_obd "" VALUE 0x85cad8 _REC_VAL_20_u2 262.14 _CNV_A_R_LINEAR_____38_CM 0. 262.14 DISPLAY_IDENTIFIER C_MF_IS_MIN_OBD FORMAT "%5.3" /end CHARACTERISTIC
/begin MEASUREMENT t_dly_mf_is_obd "" UWORD _CNV_A_R_LINEAR_____54_CM 1 0. 0. 41.9424 DISPLAY_IDENTIFIER T_DLY_MF_IS_OBD ECU_ADDRESS 0x7fcd2a BYTE_ORDER MSB_LAST FORMAT "%5.3" /end MEASUREMENT
/begin MEASUREMENT ctr_mf_is_max_obd "" UBYTE _CNV_A_R_LINEAR_____0_CM 1 0. 0. 255. DISPLAY_IDENTIFIER CTR_MF_IS_MAX_OBD ECU_ADDRESS 0x7fce2b FORMAT "%3.0" /end MEASUREMENT
/begin MEASUREMENT ctr_mf_is_min_obd "" UBYTE _CNV_A_R_LINEAR_____0_CM 1 0. 0. 255. DISPLAY_IDENTIFIER CTR_MF_IS_MIN_OBD ECU_ADDRESS 0x7fce2a FORMAT "%3.0" /end MEASUREMENT
/begin MEASUREMENT mf_is_max_obd "" UWORD _CNV_A_R_LINEAR_____38_CM 1 0. 0. 262.14 DISPLAY_IDENTIFIER MF_IS_MAX_OBD ECU_ADDRESS 0x7fcd28 BYTE_ORDER MSB_LAST FORMAT "%5.3" /end MEASUREMENT
/begin MEASUREMENT mf_is_min_obd "" UWORD _CNV_A_R_LINEAR_____38_CM 1 0. 0. 262.14 DISPLAY_IDENTIFIER MF_IS_MIN_OBD ECU_ADDRESS 0x7fcd26 BYTE_ORDER MSB_LAST FORMAT "%5.3" /end MEASUREMENT
/begin CHARACTERISTIC c_n_thd_byp_ect "" VALUE 0x85cb4a _REC_VAL_20_u1 8160. _CNV_A_R_LINEAR_____55_CM 0. 8160. DISPLAY_IDENTIFIER C_N_THD_BYP_ECT FORMAT "%4.0" /end CHARACTERISTIC
/begin CHARACTERISTIC c_pwm_byp_ect_min "" VALUE 0x85cb7a _REC_VAL_20_u1 99.99600000000001 _CNV_A_R_LINEAR_____37_CM 0. 99.996 DISPLAY_IDENTIFIER C_PWM_BYP_ECT_MIN FORMAT "%4.2" /end CHARACTERISTIC
/begin CHARACTERISTIC c_tco_hys_byp_ect_warm "" VALUE 0x85ccaf _REC_VAL_20_u1 255. _CNV_A_R_LINEAR_____20_CM 0. 255. DISPLAY_IDENTIFIER C_TCO_HYS_BYP_ECT_WARM FORMAT "%3.0" /end CHARACTERISTIC
/begin CHARACTERISTIC c_tco_hys_byp_ect_hot "" VALUE 0x85ccae _REC_VAL_20_u1 255. _CNV_A_R_LINEAR_____20_CM 0. 255. DISPLAY_IDENTIFIER C_TCO_HYS_BYP_ECT_HOT FORMAT "%3.0" /end CHARACTERISTIC
/begin CHARACTERISTIC c_tco_add_ect "" VALUE 0x85cca2 _REC_VAL_20_u1 255. _CNV_A_R_LINEAR_____20_CM 0. 255. DISPLAY_IDENTIFIER C_TCO_ADD_ECT FORMAT "%3.0" /end CHARACTERISTIC
/begin CHARACTERISTIC ip_tco_ect__pwm_ect "Coolant temperature " CURVE 0x85b136 _REC_CUR_20_u1_u1 255. _CNV_A_R_LINEAR_____18_CM -50. 205. DISPLAY_IDENTIFIER IP_TCO_ECT__PWM_ECT FORMAT "%3.0"
 /begin AXIS_DESCR COM_AXIS pwm_ect_ctl _CNV_A_R_LINEAR_____37_CM 10 0. 99.996 FORMAT "%4.2" AXIS_PTS_REF ldp_pwm_ect_ip_tco_ect /end AXIS_DESCR
/end CHARACTERISTIC
/begin MEASUREMENT pwm_byp_ect "" UBYTE _CNV_A_R_LINEAR_____37_CM 1 0. 0. 99.996 DISPLAY_IDENTIFIER PWM_BYP_ECT ECU_ADDRESS 0x7fbb04 FORMAT "%4.2" /end MEASUREMENT
/begin MEASUREMENT lv_exv "" UBYTE _CNV_S_2_RANGE______11_CM 1 0. 0. 1. DISPLAY_IDENTIFIER LV_EXV ECU_ADDRESS 0x7fbb03 /end MEASUREMENT
/begin AXIS_PTS ldp_pwm_ect_ip_tco_ect "" 0x8420ec pwm_ect_ctl _REC_AXS_20_u1 99.99600000000001 _CNV_A_R_LINEAR_____37_CM 10 0. 99.996 FORMAT "%4.2" /end AXIS_PTS
/begin CHARACTERISTIC c_t_per_exv_cold "" VALUE 0x85cc6a _REC_VAL_20_u1 255. _CNV_A_R_LINEAR_____16_CM 0. 255. DISPLAY_IDENTIFIER C_T_PER_EXV_COLD FORMAT "%3.0" /end CHARACTERISTIC
/begin CHARACTERISTIC c_t_act_exv_cold "" VALUE 0x85cbea _REC_VAL_20_u1 255. _CNV_A_R_LINEAR_____16_CM 0. 255. DISPLAY_IDENTIFIER C_T_ACT_EXV_COLD FORMAT "%3.0" /end CHARACTERISTIC
/begin CHARACTERISTIC c_t_act_exv_warm "" VALUE 0x85cbeb _REC_VAL_20_u1 255. _CNV_A_R_LINEAR_____16_CM 0. 255. DISPLAY_IDENTIFIER C_T_ACT_EXV_WARM FORMAT "%3.0" /end CHARACTERISTIC
/begin MEASUREMENT pwm_ect_ctl "Control signal of the thermostat without VB correction" UBYTE _CNV_A_R_LINEAR_____37_CM 1 0. 0. 99.996 DISPLAY_IDENTIFIER PWM_ECT_CTL ECU_ADDRESS 0x7fbb1e FORMAT "%4.2" /end MEASUREMENT
/begin CHARACTERISTIC c_abc_inc_maf_egr_thr_obd "anti bounce counter increment for diagnosis instance MAF_EGR_THR_OBD" VALUE 0x84faa3 _REC_VAL_20_u1 255. _CNV_A_R_LINEAR_____0_CM 0. 255. DISPLAY_IDENTIFIER C_ABC_INC_MAF_EGR_THR_OBD FORMAT "%3.0" /end CHARACTERISTIC
/begin CHARACTERISTIC c_abc_max_maf_egr_thr_obd "maximum value of anti bounce counter for diagnosis instance MAF_EGR_THR_OBD" VALUE 0x84fb2f _REC_VAL_20_u1 255. _CNV_A_R_LINEAR_____0_CM 0. 255. DISPLAY_IDENTIFIER C_ABC_MAX_MAF_EGR_THR_OBD FORMAT "%3.0" /end CHARACTERISTIC
/begin CHARACTERISTIC c_abc_inc_maf_dif_egr_thr_obd "anti bounce counter increment for diagnosis instance MAF_DIF_EGR_THR_OBD" VALUE 0x84faa2 _REC_VAL_20_u1 255. _CNV_A_R_LINEAR_____0_CM 0. 255. DISPLAY_IDENTIFIER C_ABC_INC_MAF_DIF_EGR_THR_OBD FORMAT "%3.0" /end CHARACTERISTIC
/begin CHARACTERISTIC c_abc_max_maf_dif_egr_thr_obd "maximum value of anti bounce counter for diagnosis instance MAF_DIF_EGR_THR_OBD" VALUE 0x84fb2e _REC_VAL_20_u1 255. _CNV_A_R_LINEAR_____0_CM 0. 255. DISPLAY_IDENTIFIER C_ABC_MAX_MAF_DIF_EGR_THR_OBD FORMAT "%3.0" /end CHARACTERISTIC
/begin CHARACTERISTIC c_abc_inc_map_dif_egr_thr_obd "anti bounce counter increment for diagnosis instance MAP_DIF_EGR_THR_OBD" VALUE 0x84faa8 _REC_VAL_20_u1 255. _CNV_A_R_LINEAR_____0_CM 0. 255. DISPLAY_IDENTIFIER C_ABC_INC_MAP_DIF_EGR_THR_OBD FORMAT "%3.0" /end CHARACTERISTIC
/begin CHARACTERISTIC c_abc_max_map_dif_egr_thr_obd "maximum value of anti bounce counter for diagnosis instance MAP_DIF_EGR_THR_OBD" VALUE 0x84fb34 _REC_VAL_20_u1 255. _CNV_A_R_LINEAR_____0_CM 0. 255. DISPLAY_IDENTIFIER C_ABC_MAX_MAP_DIF_EGR_THR_OBD FORMAT "%3.0" /end CHARACTERISTIC
/begin MEASUREMENT t_egr_thr_obd "timer for open loop EGR system check" UWORD _CNV_A_R_LINEAR_____54_CM 1 0. 0. 41.9424 DISPLAY_IDENTIFIER T_EGR_THR_OBD ECU_ADDRESS 0x7fa64c BYTE_ORDER MSB_LAST FORMAT "%6.4" /end MEASUREMENT
/begin MEASUREMENT lv_egr_thr_obd "flag indicating if open loop EGR system check is active - to switch the GES-actuators to calibratable values" UBYTE _CNV_S_2_RANGE______11_CM 1 0. 0. 1. DISPLAY_IDENTIFIER LV_EGR_THR_OBD ECU_ADDRESS 0x7fb838 /end MEASUREMENT
/begin MEASUREMENT egrvpwm_obd "pulse width for the EGR valve during open loop EGR system check when LV_EGR_THR_OBD = 1" UWORD _CNV_A_R_LINEAR_____8_CM 1 0. 0. 99.99847412109381 DISPLAY_IDENTIFIER EGRVPWM_OBD ECU_ADDRESS 0x7f9870 BYTE_ORDER MSB_LAST FORMAT "%5.3" /end MEASUREMENT
/begin MEASUREMENT thrpwm_obd "pulse width for the EGR throttle during open loop EGR system check when LV_EGR_THR_OBD = 1" UWORD _CNV_A_R_LINEAR_____8_CM 1 0. 0. 99.99847412109381 DISPLAY_IDENTIFIER THRPWM_OBD ECU_ADDRESS 0x7f9872 BYTE_ORDER MSB_LAST FORMAT "%5.3" /end MEASUREMENT
/begin MEASUREMENT byppwm_obd "pulse width for the EGR bypass throttle during open loop EGR system check when LV_EGR_THR_OBD = 1" UWORD _CNV_A_R_LINEAR_____8_CM 1 0. 0. 99.99847412109381 DISPLAY_IDENTIFIER BYPPWM_OBD ECU_ADDRESS 0x7f9874 BYTE_ORDER MSB_LAST FORMAT "%5.3" /end MEASUREMENT
/begin MEASUREMENT bpapwm_obd "pulse width for the BPA during open loop EGR system check when LV_EGR_THR_OBD = 1" UWORD _CNV_A_R_LINEAR_____8_CM 1 0. 0. 99.99847412109381 DISPLAY_IDENTIFIER BPAPWM_OBD ECU_ADDRESS 0x7f9876 BYTE_ORDER MSB_LAST FORMAT "%5.3" /end MEASUREMENT
/begin MEASUREMENT ctr_maf_egr_thr_obd "ctr_maf_egr_thr_obd" UBYTE _CNV_A_R_LINEAR_____0_CM 1 0. 0. 255. DISPLAY_IDENTIFIER CTR_MAF_EGR_THR_OBD ECU_ADDRESS 0x7fbe04 FORMAT "%3.0" /end MEASUREMENT
/begin MEASUREMENT ctr_maf_dif_egr_thr_obd "ctr_maf_dif_egr_thr_obd" UBYTE _CNV_A_R_LINEAR_____0_CM 1 0. 0. 255. DISPLAY_IDENTIFIER CTR_MAF_DIF_EGR_THR_OBD ECU_ADDRESS 0x7fbe05 FORMAT "%3.0" /end MEASUREMENT
/begin MEASUREMENT ctr_map_dif_egr_thr_obd "ctr_map_dif_egr_thr_obd" UBYTE _CNV_A_R_LINEAR_____0_CM 1 0. 0. 255. DISPLAY_IDENTIFIER CTR_MAP_DIF_EGR_THR_OBD ECU_ADDRESS 0x7fbe06 FORMAT "%3.0" /end MEASUREMENT
/begin MEASUREMENT maf_egr_thr_obd "maf_egr_thr_obd" UWORD _CNV_A_R_LINEAR_____60_CM 1 0. 0. 1389. DISPLAY_IDENTIFIER MAF_EGR_THR_OBD ECU_ADDRESS 0x7fa64e BYTE_ORDER MSB_LAST FORMAT "%6.2" /end MEASUREMENT
/begin MEASUREMENT map_mes_egr_thr_obd "map_mes_egr_thr_obd" UWORD _CNV_A_R_LINEAR_____45_CM 1 0. 0. 5434. DISPLAY_IDENTIFIER MAP_MES_EGR_THR_OBD ECU_ADDRESS 0x7fa650 BYTE_ORDER MSB_LAST FORMAT "%6.2" /end MEASUREMENT
/begin MEASUREMENT lv_rst_diag_egr_thr_obd "flag if open loop EGR system check is to be done repeatedly - dependent on LC_RST_DIAG_EGR_THR_OBD" UBYTE _CNV_S_2_RANGE______11_CM 1 0. 0. 1. DISPLAY_IDENTIFIER LV_RST_DIAG_EGR_THR_OBD ECU_ADDRESS 0x7fb839 /end MEASUREMENT
/begin MEASUREMENT lv_inh_egr_thr_obd "inhibition flag for activation/disactivation of the open loop EGR system check" UBYTE _CNV_S_2_RANGE______11_CM 1 0. 0. 1. DISPLAY_IDENTIFIER LV_INH_EGR_THR_OBD ECU_ADDRESS 0x7fb83a /end MEASUREMENT
/begin CHARACTERISTIC c_t_egr_thr_obd_1 "c_t_egr_thr_obd_1" VALUE 0x85cc36 _REC_VAL_20_u2 41.9424 _CNV_A_R_LINEAR_____54_CM 0. 41.9424 DISPLAY_IDENTIFIER C_T_EGR_THR_OBD_1 FORMAT "%6.4" /end CHARACTERISTIC
/begin CHARACTERISTIC c_egrvpwm_egr_thr_obd_1 "c_egrvpwm_egr_thr_obd_1" VALUE 0x85c99c _REC_VAL_20_u2 99.99847412109381 _CNV_A_R_LINEAR_____8_CM 0. 99.99847412109381 DISPLAY_IDENTIFIER C_EGRVPWM_EGR_THR_OBD_1 FORMAT "%5.3" /end CHARACTERISTIC
/begin CHARACTERISTIC c_thrpwm_egr_thr_obd_1 "c_thrpwm_egr_thr_obd_1" VALUE 0x85cd0c _REC_VAL_20_u2 99.99847412109381 _CNV_A_R_LINEAR_____8_CM 0. 99.99847412109381 DISPLAY_IDENTIFIER C_THRPWM_EGR_THR_OBD_1 FORMAT "%5.3" /end CHARACTERISTIC
/begin CHARACTERISTIC c_byppwm_egr_thr_obd_1 "c_byppwm_egr_thr_obd_1" VALUE 0x85c8d4 _REC_VAL_20_u2 99.99847412109381 _CNV_A_R_LINEAR_____8_CM 0. 99.99847412109381 DISPLAY_IDENTIFIER C_BYPPWM_EGR_THR_OBD_1 FORMAT "%5.3" /end CHARACTERISTIC
/begin CHARACTERISTIC c_bpapwm_egr_thr_obd_1 "c_bpapwm_egr_thr_obd_1" VALUE 0x85c8ba _REC_VAL_20_u2 99.99847412109381 _CNV_A_R_LINEAR_____8_CM 0. 99.99847412109381 DISPLAY_IDENTIFIER C_BPAPWM_EGR_THR_OBD_1 FORMAT "%5.3" /end CHARACTERISTIC
/begin CHARACTERISTIC c_t_dly_egr_thr_obd "delay time after start of each diagnostic section" VALUE 0x85cc22 _REC_VAL_20_u2 41.9424 _CNV_A_R_LINEAR_____54_CM 0. 41.9424 DISPLAY_IDENTIFIER C_T_DLY_EGR_THR_OBD FORMAT "%6.4" /end CHARACTERISTIC
/begin CHARACTERISTIC c_maf_max_egr_thr_obd "c_maf_max_egr_thr_obd" VALUE 0x85caa4 _REC_VAL_20_u2 1389. _CNV_A_R_LINEAR_____60_CM 0. 1389. DISPLAY_IDENTIFIER C_MAF_MAX_EGR_THR_OBD FORMAT "%6.2" /end CHARACTERISTIC
/begin CHARACTERISTIC c_maf_min_egr_thr_obd "c_maf_min_egr_thr_obd" VALUE 0x85caa6 _REC_VAL_20_u2 1389. _CNV_A_R_LINEAR_____60_CM 0. 1389. DISPLAY_IDENTIFIER C_MAF_MIN_EGR_THR_OBD FORMAT "%6.2" /end CHARACTERISTIC
/begin CHARACTERISTIC c_t_egr_thr_obd_2 "c_t_egr_thr_obd_2" VALUE 0x85cc38 _REC_VAL_20_u2 41.9424 _CNV_A_R_LINEAR_____54_CM 0. 41.9424 DISPLAY_IDENTIFIER C_T_EGR_THR_OBD_2 FORMAT "%6.4" /end CHARACTERISTIC
/begin CHARACTERISTIC c_egrvpwm_egr_thr_obd_2 "c_egrvpwm_egr_thr_obd_2" VALUE 0x85c99e _REC_VAL_20_u2 99.99847412109381 _CNV_A_R_LINEAR_____8_CM 0. 99.99847412109381 DISPLAY_IDENTIFIER C_EGRVPWM_EGR_THR_OBD_2 FORMAT "%5.3" /end CHARACTERISTIC
/begin CHARACTERISTIC c_thrpwm_egr_thr_obd_2 "c_thrpwm_egr_thr_obd_2" VALUE 0x85cd0e _REC_VAL_20_u2 99.99847412109381 _CNV_A_R_LINEAR_____8_CM 0. 99.99847412109381 DISPLAY_IDENTIFIER C_THRPWM_EGR_THR_OBD_2 FORMAT "%5.3" /end CHARACTERISTIC
/begin CHARACTERISTIC c_byppwm_egr_thr_obd_2 "c_byppwm_egr_thr_obd_2" VALUE 0x85c8d6 _REC_VAL_20_u2 99.99847412109381 _CNV_A_R_LINEAR_____8_CM 0. 99.99847412109381 DISPLAY_IDENTIFIER C_BYPPWM_EGR_THR_OBD_2 FORMAT "%5.3" /end CHARACTERISTIC
/begin CHARACTERISTIC c_bpapwm_egr_thr_obd_2 "c_bpapwm_egr_thr_obd_2" VALUE 0x85c8bc _REC_VAL_20_u2 99.99847412109381 _CNV_A_R_LINEAR_____8_CM 0. 99.99847412109381 DISPLAY_IDENTIFIER C_BPAPWM_EGR_THR_OBD_2 FORMAT "%5.3" /end CHARACTERISTIC
/begin CHARACTERISTIC c_maf_dif_max_egr_thr_obd "c_maf_dif_max_egr_thr_obd" VALUE 0x85ca8e _REC_VAL_20_u2 1389. _CNV_A_R_LINEAR_____60_CM 0. 1389. DISPLAY_IDENTIFIER C_MAF_DIF_MAX_EGR_THR_OBD FORMAT "%6.2" /end CHARACTERISTIC
/begin CHARACTERISTIC c_maf_dif_min_egr_thr_obd "c_maf_dif_min_egr_thr_obd" VALUE 0x85ca90 _REC_VAL_20_u2 1389. _CNV_A_R_LINEAR_____60_CM 0. 1389. DISPLAY_IDENTIFIER C_MAF_DIF_MIN_EGR_THR_OBD FORMAT "%6.2" /end CHARACTERISTIC
/begin CHARACTERISTIC c_ctr_maf_egr_thr_obd "threshold for CTR_MAF_EGR_THR_OBD" VALUE 0x85c95f _REC_VAL_20_u1 255. _CNV_A_R_LINEAR_____0_CM 0. 255. DISPLAY_IDENTIFIER C_CTR_MAF_EGR_THR_OBD FORMAT "%3.0" /end CHARACTERISTIC
/begin CHARACTERISTIC c_ctr_maf_dif_egr_thr_obd "threshold for CTR_MAF_DIF_EGR_THR_OBD" VALUE 0x85c95e _REC_VAL_20_u1 255. _CNV_A_R_LINEAR_____0_CM 0. 255. DISPLAY_IDENTIFIER C_CTR_MAF_DIF_EGR_THR_OBD FORMAT "%3.0" /end CHARACTERISTIC
/begin CHARACTERISTIC c_t_egr_thr_obd_3 "c_t_egr_thr_obd_3" VALUE 0x85cc3a _REC_VAL_20_u2 41.9424 _CNV_A_R_LINEAR_____54_CM 0. 41.9424 DISPLAY_IDENTIFIER C_T_EGR_THR_OBD_3 FORMAT "%6.4" /end CHARACTERISTIC
/begin CHARACTERISTIC c_egrvpwm_egr_thr_obd_3 "c_egrvpwm_egr_thr_obd_3" VALUE 0x85c9a0 _REC_VAL_20_u2 99.99847412109381 _CNV_A_R_LINEAR_____8_CM 0. 99.99847412109381 DISPLAY_IDENTIFIER C_EGRVPWM_EGR_THR_OBD_3 FORMAT "%5.3" /end CHARACTERISTIC
/begin CHARACTERISTIC c_thrpwm_egr_thr_obd_3 "c_thrpwm_egr_thr_obd_3" VALUE 0x85cd10 _REC_VAL_20_u2 99.99847412109381 _CNV_A_R_LINEAR_____8_CM 0. 99.99847412109381 DISPLAY_IDENTIFIER C_THRPWM_EGR_THR_OBD_3 FORMAT "%5.3" /end CHARACTERISTIC
/begin CHARACTERISTIC c_byppwm_egr_thr_obd_3 "c_byppwm_egr_thr_obd_3" VALUE 0x85c8d8 _REC_VAL_20_u2 99.99847412109381 _CNV_A_R_LINEAR_____8_CM 0. 99.99847412109381 DISPLAY_IDENTIFIER C_BYPPWM_EGR_THR_OBD_3 FORMAT "%5.3" /end CHARACTERISTIC
/begin CHARACTERISTIC c_bpapwm_egr_thr_obd_3 "c_bpapwm_egr_thr_obd_3" VALUE 0x85c8be _REC_VAL_20_u2 99.99847412109381 _CNV_A_R_LINEAR_____8_CM 0. 99.99847412109381 DISPLAY_IDENTIFIER C_BPAPWM_EGR_THR_OBD_3 FORMAT "%5.3" /end CHARACTERISTIC
/begin CHARACTERISTIC c_map_mes_dif_max_egr_thr_obd "c_map_mes_dif_max_egr_thr_obd" VALUE 0x85cac2 _REC_VAL_20_u2 5434. _CNV_A_R_LINEAR_____45_CM 0. 5434. DISPLAY_IDENTIFIER C_MAP_MES_DIF_MAX_EGR_THR_OBD FORMAT "%6.2" /end CHARACTERISTIC
/begin CHARACTERISTIC c_map_mes_dif_min_egr_thr_obd "c_map_mes_dif_min_egr_thr_obd" VALUE 0x85cac4 _REC_VAL_20_u2 5434. _CNV_A_R_LINEAR_____45_CM 0. 5434. DISPLAY_IDENTIFIER C_MAP_MES_DIF_MIN_EGR_THR_OBD FORMAT "%6.2" /end CHARACTERISTIC
/begin CHARACTERISTIC c_ctr_map_dif_egr_thr_obd "threshold for CTR_MAP_DIF_EGR_THR_OBD" VALUE 0x85c962 _REC_VAL_20_u1 255. _CNV_A_R_LINEAR_____0_CM 0. 255. DISPLAY_IDENTIFIER C_CTR_MAP_DIF_EGR_THR_OBD FORMAT "%3.0" /end CHARACTERISTIC
/begin CHARACTERISTIC lc_rst_diag_egr_thr_obd "reset button to allow repeated performance of open loop EGR system check (usually only once per DC)" VALUE 0x85cea2 _REC_VAL_20_u1 1. _CNV_A_R_LINEAR_____0_CM 0. 1. DISPLAY_IDENTIFIER LC_RST_DIAG_EGR_THR_OBD FORMAT "%1.0" /end CHARACTERISTIC
/begin CHARACTERISTIC ip_fac_map_cor_egr_thr_obd__n "DIAG_EGR_OBD: correction facxtor for compensation of engine speed dependent influences on MAP" CURVE 0x8526de _REC_CUR_20_u2_u2 3.99998471 _CNV_A_R_LINEAR_____59_CM 0. 3.99998471 DISPLAY_IDENTIFIER IP_FAC_MAP_COR_EGR_THR_OBD__N FORMAT "%6.5"
 /begin AXIS_DESCR COM_AXIS n _CNV_A_R_LINEAR_____5_CM 2 0. 6375. FORMAT "%4.0" AXIS_PTS_REF ldp_n__ip_fac_map_egr_thr_obd /end AXIS_DESCR
/end CHARACTERISTIC
/begin AXIS_PTS ldp_n__ip_fac_map_egr_thr_obd "" 0x84193e n _REC_AXS_20_u2 6375. _CNV_A_R_LINEAR_____5_CM 2 0. 6375. FORMAT "%4.0" /end AXIS_PTS
/begin CHARACTERISTIC ip_fac_maf_egr_thr_obd "DIAG_EGR_OBD: ip_fac_maf_egr_thr_obd" MAP 0x85267e _REC_MAP_20_u2_u2_u1 3.99998471 _CNV_A_R_LINEAR_____59_CM 0. 3.99998471 DISPLAY_IDENTIFIER IP_FAC_MAF_EGR_THR_OBD FORMAT "%6.5"
 /begin AXIS_DESCR COM_AXIS amp _CNV_A_R_LINEAR_____45_CM 4 0. 5434. FORMAT "%6.2" AXIS_PTS_REF ldpm_amp__ip_fac_egr_thr_obd /end AXIS_DESCR
 /begin AXIS_DESCR COM_AXIS tia _CNV_A_R_LINEAR_____18_CM 4 -50. 205. FORMAT "%3.0" AXIS_PTS_REF ldpm_tia__ip_fac_egr_thr_obd /end AXIS_DESCR
/end CHARACTERISTIC
/begin AXIS_PTS ldpm_amp__ip_fac_egr_thr_obd "" 0x842b10 amp _REC_AXS_20_u2 5434. _CNV_A_R_LINEAR_____45_CM 4 0. 5434. FORMAT "%6.2" /end AXIS_PTS
/begin AXIS_PTS ldpm_tia__ip_fac_egr_thr_obd "" 0x84380d tia _REC_AXS_20_u1 255. _CNV_A_R_LINEAR_____18_CM 4 -50. 205. FORMAT "%3.0" /end AXIS_PTS
/begin CHARACTERISTIC ip_fac_map_egr_thr_obd "DIAG_EGR_OBD: open loop EGR system check: AMP and TIA correction for MAP_MES related thresholds" MAP 0x8526fa _REC_MAP_20_u2_u2_u1 3.99998471 _CNV_A_R_LINEAR_____59_CM 0. 3.99998471 DISPLAY_IDENTIFIER IP_FAC_MAP_EGR_THR_OBD FORMAT "%6.5"
 /begin AXIS_DESCR COM_AXIS amp _CNV_A_R_LINEAR_____45_CM 4 0. 5434. FORMAT "%6.2" AXIS_PTS_REF ldpm_amp__ip_fac_egr_thr_obd /end AXIS_DESCR
 /begin AXIS_DESCR COM_AXIS tia _CNV_A_R_LINEAR_____18_CM 4 -50. 205. FORMAT "%3.0" AXIS_PTS_REF ldpm_tia__ip_fac_egr_thr_obd /end AXIS_DESCR
/end CHARACTERISTIC
/begin CHARACTERISTIC c_tco_min_egr_thr_obd "minimum coolant temperature for activation of open loop EGR system check" VALUE 0x85ccbd _REC_VAL_20_u1 255. _CNV_A_R_LINEAR_____18_CM -50. 205. DISPLAY_IDENTIFIER C_TCO_MIN_EGR_THR_OBD FORMAT "%3.0" /end CHARACTERISTIC
/begin MEASUREMENT tq_loss_add "additional torque losses" SWORD _CNV_A_R_LINEAR_____52_CM 1 0. -1024. 1023.96875 DISPLAY_IDENTIFIER TQ_LOSS_ADD ECU_ADDRESS 0x7fa2a8 BYTE_ORDER MSB_LAST FORMAT "%6.2" /end MEASUREMENT
/begin MEASUREMENT tq_add_req "torque losses for driver request compensation" SWORD _CNV_A_R_LINEAR_____52_CM 1 0. -1024. 1023.96875 DISPLAY_IDENTIFIER TQ_ADD_REQ ECU_ADDRESS 0x7fa2aa BYTE_ORDER MSB_LAST FORMAT "%6.2" /end MEASUREMENT
/begin CHARACTERISTIC c_tq_add_conf "configuration of driver request compensation" VALUE 0x85cd2a _REC_VAL_20_u1 255. _CNV_A_R_LINEAR_____0_CM 0. 255. DISPLAY_IDENTIFIER C_TQ_ADD_CONF FORMAT "%3.0" /end CHARACTERISTIC
/begin CHARACTERISTIC ip_fac_tq_add__pv_av "TQ_FRADD: scaling factor for torque loss compensation" CURVE 0x852ad0 _REC_CUR_20_u2_u2 1. _CNV_A_R_LINEAR_____77_CM 0. 1. DISPLAY_IDENTIFIER IP_FAC_TQ_ADD__PV_AV FORMAT "%6.5"
 /begin AXIS_DESCR COM_AXIS pv_av _CNV_A_R_LINEAR_____78_CM 16 0. 100. FORMAT "%4.2" AXIS_PTS_REF ldpm_pv_av_ip_fac_tq_req /end AXIS_DESCR
/end CHARACTERISTIC
/begin MEASUREMENT gen_load "Generator load value (0-100%)" UBYTE _CNV_A_R_LINEAR_____79_CM 1 0. 0. 99.609375 DISPLAY_IDENTIFIER GEN_LOAD ECU_ADDRESS 0x7fbbf6 FORMAT "%4.1" /end MEASUREMENT
/begin MEASUREMENT fac_tq_req_driv "Scaling Factor for requested torque at clutch from driver" UWORD _CNV_A_R_LINEAR_____48_CM 1 0. 0. 1.9999696 DISPLAY_IDENTIFIER FAC_TQ_REQ_DRIV ECU_ADDRESS 0x7fa288 BYTE_ORDER MSB_LAST FORMAT "%6.5" /end MEASUREMENT
/begin MEASUREMENT lv_fac_tq_req_dri_low "scaling factor from low gear map" UBYTE _CNV_S_2_RANGE______11_CM 1 0. 0. 1. DISPLAY_IDENTIFIER LV_FAC_TQ_REQ_DRI_LOW ECU_ADDRESS 0x7fbbd9 /end MEASUREMENT
/begin MEASUREMENT n_fil "filtered engine speed" UWORD _CNV_A_R_LINEAR_____5_CM 1 0. 0. 6375. DISPLAY_IDENTIFIER N_FIL ECU_ADDRESS 0x7fa28a BYTE_ORDER MSB_LAST FORMAT "%4.0" /end MEASUREMENT
/begin CHARACTERISTIC c_dri_fac_tq_req "C_DRI_FAC_TQ_REQ" VALUE 0x85c983 _REC_VAL_20_u1 255. _CNV_A_R_LINEAR_____0_CM 0. 255. DISPLAY_IDENTIFIER C_DRI_FAC_TQ_REQ FORMAT "%3.0" /end CHARACTERISTIC
/begin CHARACTERISTIC c_crlc_n "correlation constant for N for driver request" VALUE 0x85c8fe _REC_VAL_20_u2 0.9999874 _CNV_A_R_LINEAR_____87_CM 0. 0.9999874 DISPLAY_IDENTIFIER C_CRLC_N FORMAT "%6.5" /end CHARACTERISTIC
/begin CHARACTERISTIC ip_fac_tq_req_dri_h__n__pv_av "TQCLFAC: scaling factor for torque request (high gear)" MAP 0x852c4c _REC_MAP_20_u2_u2_u2 1.9999696 _CNV_A_R_LINEAR_____48_CM 0. 1.9999696 DISPLAY_IDENTIFIER IP_FAC_TQ_REQ_DRI_H__N__PV_AV FORMAT "%6.5"
 /begin AXIS_DESCR COM_AXIS n_fil _CNV_A_R_LINEAR_____5_CM 16 0. 6375. FORMAT "%4.0" AXIS_PTS_REF ldpm_n_ip_fac_tq_req /end AXIS_DESCR
 /begin AXIS_DESCR COM_AXIS pv_av _CNV_A_R_LINEAR_____78_CM 16 0. 100. FORMAT "%4.2" AXIS_PTS_REF ldpm_pv_av_ip_fac_tq_req /end AXIS_DESCR
/end CHARACTERISTIC
/begin AXIS_PTS ldpm_n_ip_fac_tq_req "scaling factor for torque request (high gear)" 0x84309a n_fil _REC_AXS_20_u2 6375. _CNV_A_R_LINEAR_____5_CM 16 0. 6375. FORMAT "%4.0" /end AXIS_PTS
/begin AXIS_PTS ldpm_pv_av_ip_fac_tq_req "scaling factor for torque request (high gear)" 0x843742 pv_av _REC_AXS_20_u2 100. _CNV_A_R_LINEAR_____78_CM 16 0. 100. FORMAT "%4.2" /end AXIS_PTS
/begin CHARACTERISTIC ip_fac_tq_req_dri_l__n__pv_av "TQCLFAC: scaling factor for torque request (low gear)" MAP 0x852e4c _REC_MAP_20_u2_u2_u2 1.9999696 _CNV_A_R_LINEAR_____48_CM 0. 1.9999696 DISPLAY_IDENTIFIER IP_FAC_TQ_REQ_DRI_L__N__PV_AV FORMAT "%6.5"
 /begin AXIS_DESCR COM_AXIS n_fil _CNV_A_R_LINEAR_____5_CM 16 0. 6375. FORMAT "%4.0" AXIS_PTS_REF ldpm_n_ip_fac_tq_req /end AXIS_DESCR
 /begin AXIS_DESCR COM_AXIS pv_av _CNV_A_R_LINEAR_____78_CM 16 0. 100. FORMAT "%4.2" AXIS_PTS_REF ldpm_pv_av_ip_fac_tq_req /end AXIS_DESCR
/end CHARACTERISTIC
/begin MEASUREMENT tq_ltc_sub "torque request after load transient correction" SWORD _CNV_A_R_LINEAR_____52_CM 1 0. -1024. 1023.96875 DISPLAY_IDENTIFIER TQ_LTC_SUB ECU_ADDRESS 0x7f97d4 BYTE_ORDER MSB_LAST FORMAT "%6.2" /end MEASUREMENT
/begin MEASUREMENT tqi_ltc_sub "indicated torque request after load transient correction" SWORD _CNV_A_R_LINEAR_____52_CM 1 0. -1024. 1023.96875 DISPLAY_IDENTIFIER TQI_LTC_SUB ECU_ADDRESS 0x7f97d6 BYTE_ORDER MSB_LAST FORMAT "%6.2" /end MEASUREMENT
/begin MEASUREMENT tq_ltc_lim "torque request input of load transient correction" SWORD _CNV_A_R_LINEAR_____52_CM 1 0. -1024. 1023.96875 DISPLAY_IDENTIFIER TQ_LTC_LIM ECU_ADDRESS 0x7fa5d4 BYTE_ORDER MSB_LAST FORMAT "%6.2" /end MEASUREMENT
/begin MEASUREMENT tq_ltc "torque calculated during load transient correction" SWORD _CNV_A_R_LINEAR_____52_CM 1 0. -1024. 1023.96875 DISPLAY_IDENTIFIER TQ_LTC ECU_ADDRESS 0x7fa5d6 BYTE_ORDER MSB_LAST FORMAT "%6.2" /end MEASUREMENT
/begin MEASUREMENT lv_act_ltc "LTC is active" UBYTE _CNV_S_2_RANGE______11_CM 1 0. 0. 1. DISPLAY_IDENTIFIER LV_ACT_LTC ECU_ADDRESS 0x7fb6d1 /end MEASUREMENT
/begin CHARACTERISTIC lc_tq_lim_ltc_act "logical constant 'torque limitation before LTC active'" VALUE 0x850175 _REC_VAL_20_u1 1. _CNV_A_R_LINEAR_____0_CM 0. 1. DISPLAY_IDENTIFIER LC_TQ_LIM_LTC_ACT FORMAT "%1.0" /end CHARACTERISTIC
/begin CHARACTERISTIC c_tq_ltc_thd_add_down_2 "increase threshold down 2 from TQ_LOSS" VALUE 0x850060 _REC_VAL_20_u2 1023.96875 _CNV_A_R_LINEAR_____52_CM 0. 1023.96875 DISPLAY_IDENTIFIER C_TQ_LTC_THD_ADD_DOWN_2 FORMAT "%6.2" /end CHARACTERISTIC
/begin CHARACTERISTIC c_tq_ltc_thd_down_2 "threshold LTC down 2" VALUE 0x850062 _REC_VAL_20_s2 2047.96875 _CNV_A_R_LINEAR_____52_CM -1024. 1023.96875 DISPLAY_IDENTIFIER C_TQ_LTC_THD_DOWN_2 FORMAT "%6.2" /end CHARACTERISTIC
/begin CHARACTERISTIC c_n_32_ltc_min "minimal engine speed LTC active" VALUE 0x84fddd _REC_VAL_20_u1 8160. _CNV_A_R_LINEAR_____55_CM 0. 8160. DISPLAY_IDENTIFIER C_N_32_LTC_MIN FORMAT "%4.0" /end CHARACTERISTIC
/begin CHARACTERISTIC lc_ltc_on "switch LTC on" VALUE 0x850152 _REC_VAL_20_u1 1. _CNV_A_R_LINEAR_____0_CM 0. 1. DISPLAY_IDENTIFIER LC_LTC_ON FORMAT "%1.0" /end CHARACTERISTIC
/begin CHARACTERISTIC lc_ltc_dri_di "switch LTC disabled by gear" VALUE 0x850150 _REC_VAL_20_u1 1. _CNV_A_R_LINEAR_____0_CM 0. 1. DISPLAY_IDENTIFIER LC_LTC_DRI_DI FORMAT "%1.0" /end CHARACTERISTIC
/begin CHARACTERISTIC lc_ltc_clu_di "switch LTC disabled by clutch" VALUE 0x85014f _REC_VAL_20_u1 1. _CNV_A_R_LINEAR_____0_CM 0. 1. DISPLAY_IDENTIFIER LC_LTC_CLU_DI FORMAT "%1.0" /end CHARACTERISTIC
/begin CHARACTERISTIC lc_ltc_is_ovs "switch idle speed request oversteer" VALUE 0x850151 _REC_VAL_20_u1 1. _CNV_A_R_LINEAR_____0_CM 0. 1. DISPLAY_IDENTIFIER LC_LTC_IS_OVS FORMAT "%1.0" /end CHARACTERISTIC
/begin CHARACTERISTIC c_n_32_ltc_max "maximal engine speed LTC active" VALUE 0x84fddc _REC_VAL_20_u1 8160. _CNV_A_R_LINEAR_____55_CM 0. 8160. DISPLAY_IDENTIFIER C_N_32_LTC_MAX FORMAT "%4.0" /end CHARACTERISTIC
/begin MEASUREMENT tq_tcs_req "" SWORD _CNV_A_R_LINEAR_____52_CM 1 0. -1024. 1023.96875 DISPLAY_IDENTIFIER TQ_TCS_REQ ECU_ADDRESS 0x7fa2d8 BYTE_ORDER MSB_LAST FORMAT "%7.2" /end MEASUREMENT
/begin MEASUREMENT lv_tcs_plaus "" UBYTE _CNV_S_2_RANGE______11_CM 1 0. 0. 1. DISPLAY_IDENTIFIER LV_TCS_PLAUS ECU_ADDRESS 0x7fbbea /end MEASUREMENT
/begin MEASUREMENT lv_tq_tcs_req_dec "" UBYTE _CNV_S_2_RANGE______11_CM 1 0. 0. 1. DISPLAY_IDENTIFIER LV_TQ_TCS_REQ_DEC ECU_ADDRESS 0x7fbbe9 /end MEASUREMENT
/begin MEASUREMENT tq_lgrd_neg_diag_tcs "" SWORD _CNV_A_R_LINEAR_____89_CM 1 0. -1024. 1023.96875 DISPLAY_IDENTIFIER TQ_LGRD_NEG_DIAG_TCS ECU_ADDRESS 0x7fa2da BYTE_ORDER MSB_LAST FORMAT "%7.2" /end MEASUREMENT
/begin MEASUREMENT tq_lgrd_pos_diag_tcs "" SWORD _CNV_A_R_LINEAR_____89_CM 1 0. -1024. 1023.96875 DISPLAY_IDENTIFIER TQ_LGRD_POS_DIAG_TCS ECU_ADDRESS 0x7fa2dc BYTE_ORDER MSB_LAST FORMAT "%7.2" /end MEASUREMENT
/begin MEASUREMENT lv_req_tcs "" UBYTE _CNV_S_2_RANGE______11_CM 1 0. 0. 1. DISPLAY_IDENTIFIER LV_REQ_TCS ECU_ADDRESS 0x7fbfd3 /end MEASUREMENT
/begin MEASUREMENT lv_tq_tcs_req_inc "" UBYTE _CNV_S_2_RANGE______11_CM 1 0. 0. 1. DISPLAY_IDENTIFIER LV_TQ_TCS_REQ_INC ECU_ADDRESS 0x7fbbe8 /end MEASUREMENT
/begin CHARACTERISTIC c_lgrd_tq_neg_diag_tcs "" VALUE 0x84fd8a _REC_VAL_20_s2 1024. _CNV_A_R_LINEAR_____89_CM -1024. 0. DISPLAY_IDENTIFIER C_LGRD_TQ_NEG_DIAG_TCS FORMAT "%7.2" /end CHARACTERISTIC
/begin CHARACTERISTIC c_lgrd_tq_pos_diag_tcs "" VALUE 0x84fd8c _REC_VAL_20_s2 1023.96875 _CNV_A_R_LINEAR_____89_CM 0. 1023.96875 DISPLAY_IDENTIFIER C_LGRD_TQ_POS_DIAG_TCS FORMAT "%7.2" /end CHARACTERISTIC
/begin MEASUREMENT lv_etcu_ena "logical variable for gearshift intervention enabling" UBYTE _CNV_S_2_RANGE______11_CM 1 0. 0. 1. DISPLAY_IDENTIFIER LV_ETCU_ENA ECU_ADDRESS 0x7fbfb7 /end MEASUREMENT
/begin MEASUREMENT lv_t_lim_etcu "time limitation enabled" UBYTE _CNV_S_2_RANGE______11_CM 1 0. 0. 1. DISPLAY_IDENTIFIER LV_T_LIM_ETCU ECU_ADDRESS 0x7fbfb8 /end MEASUREMENT
/begin MEASUREMENT lv_tq_inc_sum_etcu "limit of inc. tq integral" UBYTE _CNV_S_2_RANGE______11_CM 1 0. 0. 1. DISPLAY_IDENTIFIER LV_TQ_INC_SUM_ETCU ECU_ADDRESS 0x7fbfb9 /end MEASUREMENT
/begin MEASUREMENT tq_inc_sum_etcu "integral of increasing torque" UWORD _CNV_A_R_LINEAR_____90_CM 1 0. 0. 16383.75 DISPLAY_IDENTIFIER TQ_INC_SUM_ETCU ECU_ADDRESS 0x7fb490 BYTE_ORDER MSB_LAST FORMAT "%6.1" /end MEASUREMENT
/begin MEASUREMENT lv_tq_etcu_req_dec "LV_TQ_ETCU_REQ_DEC" UBYTE _CNV_S_2_RANGE______11_CM 1 0. 0. 1. DISPLAY_IDENTIFIER LV_TQ_ETCU_REQ_DEC ECU_ADDRESS 0x7fbfba /end MEASUREMENT
/begin MEASUREMENT lv_tq_etcu_req_inc "LV_TQ_ETCU_REQ_INC" UBYTE _CNV_S_2_RANGE______11_CM 1 0. 0. 1. DISPLAY_IDENTIFIER LV_TQ_ETCU_REQ_INC ECU_ADDRESS 0x7fbfbb /end MEASUREMENT
/begin MEASUREMENT lv_etcu_inc_lih "increase demand incl. limp home" UBYTE _CNV_S_2_RANGE______11_CM 1 0. 0. 1. DISPLAY_IDENTIFIER LV_ETCU_INC_LIH ECU_ADDRESS 0x7fbbdf /end MEASUREMENT
/begin MEASUREMENT lv_etcu_dec_lih "decrease demand incl. limp home" UBYTE _CNV_S_2_RANGE______11_CM 1 0. 0. 1. DISPLAY_IDENTIFIER LV_ETCU_DEC_LIH ECU_ADDRESS 0x7fbbe0 /end MEASUREMENT
/begin MEASUREMENT tq_req_etcu_lih "Torque request incl. limp home" SWORD _CNV_A_R_LINEAR_____52_CM 1 0. -1024. 1023.96875 DISPLAY_IDENTIFIER TQ_REQ_ETCU_LIH ECU_ADDRESS 0x7fb492 BYTE_ORDER MSB_LAST FORMAT "%6.2" /end MEASUREMENT
/begin MEASUREMENT lv_etcu_hold "LV_ETCU_HOLD" UBYTE _CNV_S_2_RANGE______11_CM 1 0. 0. 1. DISPLAY_IDENTIFIER LV_ETCU_HOLD ECU_ADDRESS 0x7fbfbc /end MEASUREMENT
/begin MEASUREMENT lv_etcu_ramp "LV_ETCU_RAMP" UBYTE _CNV_S_2_RANGE______11_CM 1 0. 0. 1. DISPLAY_IDENTIFIER LV_ETCU_RAMP ECU_ADDRESS 0x7fbfbd /end MEASUREMENT
/begin MEASUREMENT t_etcu_hold "T_ETCU_HOLD" UWORD _CNV_A_R_LINEAR_____56_CM 1 0. 0. 655.35 DISPLAY_IDENTIFIER T_ETCU_HOLD ECU_ADDRESS 0x7fb494 BYTE_ORDER MSB_LAST FORMAT "%5.2" /end MEASUREMENT
/begin MEASUREMENT tq_etcu_inter "TQ_ETCU_INTER" SWORD _CNV_A_R_LINEAR_____52_CM 1 0. -1024. 1023.96875 DISPLAY_IDENTIFIER TQ_ETCU_INTER ECU_ADDRESS 0x7fb496 BYTE_ORDER MSB_LAST FORMAT "%6.2" /end MEASUREMENT
/begin MEASUREMENT tq_etcu_dif "torque reduction for gearshift intervention" SWORD _CNV_A_R_LINEAR_____52_CM 1 0. -1024. 1023.96875 DISPLAY_IDENTIFIER TQ_ETCU_DIF ECU_ADDRESS 0x7fa2a4 BYTE_ORDER MSB_LAST FORMAT "%6.2" /end MEASUREMENT
/begin MEASUREMENT n_sp_amt "engine speed setpoint for ETCU" UWORD _CNV_A_R_LINEAR_____5_CM 1 0. 0. 6375. DISPLAY_IDENTIFIER N_SP_AMT ECU_ADDRESS 0x7fa2a6 BYTE_ORDER MSB_LAST FORMAT "%4.0" /end MEASUREMENT
/begin MEASUREMENT lv_amt_act "N-control demand for ETCU" UBYTE _CNV_S_2_RANGE______11_CM 1 0. 0. 1. DISPLAY_IDENTIFIER LV_AMT_ACT ECU_ADDRESS 0x7fbbdd /end MEASUREMENT
/begin MEASUREMENT lv_tq_etcu_act "ETCU intervention active" UBYTE _CNV_S_2_RANGE______11_CM 1 0. 0. 1. DISPLAY_IDENTIFIER LV_TQ_ETCU_ACT ECU_ADDRESS 0x7fbbde /end MEASUREMENT
/begin MEASUREMENT lv_tq_etcu_req_min "LV_ETCU_REQ_MIN" UBYTE _CNV_S_2_RANGE______11_CM 1 0. 0. 1. DISPLAY_IDENTIFIER LV_TQ_ETCU_REQ_MIN ECU_ADDRESS 0x7fbbe1 /end MEASUREMENT
/begin MEASUREMENT lv_tq_etcu_req_max "LV_ETCU_REQ_MAX" UBYTE _CNV_S_2_RANGE______11_CM 1 0. 0. 1. DISPLAY_IDENTIFIER LV_TQ_ETCU_REQ_MAX ECU_ADDRESS 0x7fbbe2 /end MEASUREMENT
/begin MEASUREMENT lv_etcu_inc "increasing or N-controlled ETCU intervention active and not in limp home mode" UBYTE _CNV_S_2_RANGE______11_CM 1 0. 0. 1. DISPLAY_IDENTIFIER LV_ETCU_INC ECU_ADDRESS 0x7fbbe3 /end MEASUREMENT
/begin MEASUREMENT lv_etcu_ena_lih "LV_ETCU_ENA_LIH" UBYTE _CNV_S_2_RANGE______11_CM 1 0. 0. 1. DISPLAY_IDENTIFIER LV_ETCU_ENA_LIH ECU_ADDRESS 0x7fbfbe /end MEASUREMENT
/begin MEASUREMENT lv_etcu_ramp_end "LV_ETCU_RAMP_END" UBYTE _CNV_S_2_RANGE______11_CM 1 0. 0. 1. DISPLAY_IDENTIFIER LV_ETCU_RAMP_END ECU_ADDRESS 0x7fbfbf /end MEASUREMENT
/begin MEASUREMENT tqi_egs_sub "TQI_EGS_SUB" SWORD _CNV_A_R_LINEAR_____52_CM 1 0. -1024. 1023.96875 DISPLAY_IDENTIFIER TQI_EGS_SUB ECU_ADDRESS 0x7fa2a2 BYTE_ORDER MSB_LAST FORMAT "%6.2" /end MEASUREMENT
/begin MEASUREMENT tq_egs_sub "TQ_EGS_SUB" SWORD _CNV_A_R_LINEAR_____52_CM 1 0. -1024. 1023.96875 DISPLAY_IDENTIFIER TQ_EGS_SUB ECU_ADDRESS 0x7fa2a0 BYTE_ORDER MSB_LAST FORMAT "%6.2" /end MEASUREMENT
/begin MEASUREMENT lv_t_etcu_max "LV_T_ETCU_MAX" UBYTE _CNV_S_2_RANGE______11_CM 1 0. 0. 1. DISPLAY_IDENTIFIER LV_T_ETCU_MAX ECU_ADDRESS 0x7fbbe4 /end MEASUREMENT
/begin MEASUREMENT t_etcu "T_ETCU" UWORD _CNV_A_R_LINEAR_____56_CM 1 0. 0. 655.35 DISPLAY_IDENTIFIER T_ETCU ECU_ADDRESS 0x7fb498 BYTE_ORDER MSB_LAST FORMAT "%5.2" /end MEASUREMENT
/begin MEASUREMENT lv_t_etcu_inc_max "LV_T_ETCU_INC_MAX" UBYTE _CNV_S_2_RANGE______11_CM 1 0. 0. 1. DISPLAY_IDENTIFIER LV_T_ETCU_INC_MAX ECU_ADDRESS 0x7fbfc0 /end MEASUREMENT
/begin MEASUREMENT lv_etcu_inc_inh "LV_ETCU_INC_INH" UBYTE _CNV_S_2_RANGE______11_CM 1 0. 0. 1. DISPLAY_IDENTIFIER LV_ETCU_INC_INH ECU_ADDRESS 0x7fbfc1 /end MEASUREMENT
/begin MEASUREMENT lv_tq_inc_shift "LV_TQ_INC_SHIFT" UBYTE _CNV_S_2_RANGE______11_CM 1 0. 0. 1. DISPLAY_IDENTIFIER LV_TQ_INC_SHIFT ECU_ADDRESS 0x7fbfc2 /end MEASUREMENT
/begin MEASUREMENT t_etcu_inc "T_ETCU_INC" UWORD _CNV_A_R_LINEAR_____56_CM 1 0. 0. 655.35 DISPLAY_IDENTIFIER T_ETCU_INC ECU_ADDRESS 0x7fb49a BYTE_ORDER MSB_LAST FORMAT "%5.2" /end MEASUREMENT
/begin MEASUREMENT lv_cmd_inh_etcu "command for ETCU inhibit" UBYTE _CNV_S_2_RANGE______11_CM 1 0. 0. 1. DISPLAY_IDENTIFIER LV_CMD_INH_ETCU ECU_ADDRESS 0x7fbfc3 /end MEASUREMENT
/begin MEASUREMENT lv_req_shift "shifting process request" UBYTE _CNV_S_2_RANGE______11_CM 1 0. 0. 1. DISPLAY_IDENTIFIER LV_REQ_SHIFT ECU_ADDRESS 0x7fbfc4 /end MEASUREMENT
/begin MEASUREMENT dri_old_etcu "Gear before shifting process" UBYTE _CNV_A_R_LINEAR_____0_CM 1 0. 0. 6. DISPLAY_IDENTIFIER DRI_OLD_ETCU ECU_ADDRESS 0x7fbfb4 FORMAT "%1.0" /end MEASUREMENT
/begin MEASUREMENT dri_new_etcu "Gear after shifting process" UBYTE _CNV_A_R_LINEAR_____0_CM 1 0. 0. 6. DISPLAY_IDENTIFIER DRI_NEW_ETCU ECU_ADDRESS 0x7fbfb5 FORMAT "%1.0" /end MEASUREMENT
/begin MEASUREMENT t_max_etcu "max. time for shifting process" UWORD _CNV_A_R_LINEAR_____56_CM 1 0. 0. 655.35 DISPLAY_IDENTIFIER T_MAX_ETCU ECU_ADDRESS 0x7fb49c BYTE_ORDER MSB_LAST FORMAT "%5.2" /end MEASUREMENT
/begin CHARACTERISTIC lc_etcu_di_is "switch ETCU disabled by LV_IS" VALUE 0x85012b _REC_VAL_20_u1 1. _CNV_A_R_LINEAR_____0_CM 0. 1. DISPLAY_IDENTIFIER LC_ETCU_DI_IS FORMAT "%1.0" /end CHARACTERISTIC
/begin CHARACTERISTIC lc_t_max_inh_etcu "switch ETCU time limit inhibit" VALUE 0x85016a _REC_VAL_20_u1 1. _CNV_A_R_LINEAR_____0_CM 0. 1. DISPLAY_IDENTIFIER LC_T_MAX_INH_ETCU FORMAT "%1.0" /end CHARACTERISTIC
/begin CHARACTERISTIC c_tq_inc_sum_max_etcu "C_TQ_INC_SUM_MAX_ETCU" VALUE 0x850058 _REC_VAL_20_u2 16383.75 _CNV_A_R_LINEAR_____90_CM 0. 16383.75 DISPLAY_IDENTIFIER C_TQ_INC_SUM_MAX_ETCU FORMAT "%6.1" /end CHARACTERISTIC
/begin CHARACTERISTIC c_t_dly_diag_etcu_dec "delay time for ramp activation at decreasing" VALUE 0x84ff64 _REC_VAL_20_u2 655.35 _CNV_A_R_LINEAR_____56_CM 0. 655.35 DISPLAY_IDENTIFIER C_T_DLY_DIAG_ETCU_DEC FORMAT "%5.2" /end CHARACTERISTIC
/begin CHARACTERISTIC c_lgrd_tqi_neg_diag_etcu "Decrementation step for TQ_ETCU_INTER at ERROR" VALUE 0x84fd92 _REC_VAL_20_s2 1024. _CNV_A_R_LINEAR_____89_CM -1024. 0. DISPLAY_IDENTIFIER C_LGRD_TQI_NEG_DIAG_ETCU FORMAT "%3.2" /end CHARACTERISTIC
/begin CHARACTERISTIC c_lgrd_tqi_pos_diag_etcu "Incrementation step for TQ_ETCU_INTER at ERROR" VALUE 0x84fd96 _REC_VAL_20_u2 1023.96875 _CNV_A_R_LINEAR_____89_CM 0. 1023.96875 DISPLAY_IDENTIFIER C_LGRD_TQI_POS_DIAG_ETCU FORMAT "%6.2" /end CHARACTERISTIC
/begin CHARACTERISTIC c_lgrd_tqi_neg_inh_etcu "Decrementation step for TQ_ETCU_INTER at inhibit" VALUE 0x84fd94 _REC_VAL_20_s2 1024. _CNV_A_R_LINEAR_____89_CM -1024. 0. DISPLAY_IDENTIFIER C_LGRD_TQI_NEG_INH_ETCU FORMAT "%3.2" /end CHARACTERISTIC
/begin CHARACTERISTIC c_lgrd_tqi_pos_inh_etcu "Incrementation step for TQ_ETCU_INTER at inhibit" VALUE 0x84fd98 _REC_VAL_20_u2 1023.96875 _CNV_A_R_LINEAR_____89_CM 0. 1023.96875 DISPLAY_IDENTIFIER C_LGRD_TQI_POS_INH_ETCU FORMAT "%6.2" /end CHARACTERISTIC
/begin CHARACTERISTIC c_tq_dif_tol_etcu "max. allowed torque for differerential torque intervention" VALUE 0x850056 _REC_VAL_20_u2 1023.96875 _CNV_A_R_LINEAR_____52_CM 0. 1023.96875 DISPLAY_IDENTIFIER C_TQ_DIF_TOL_ETCU FORMAT "%6.2" /end CHARACTERISTIC
/begin CHARACTERISTIC c_tq_dif_bol_etcu "min. allowed torque for differential torque intervention" VALUE 0x850054 _REC_VAL_20_s2 1024. _CNV_A_R_LINEAR_____52_CM -1024. 0. DISPLAY_IDENTIFIER C_TQ_DIF_BOL_ETCU FORMAT "%3.2" /end CHARACTERISTIC
/begin CHARACTERISTIC c_t_max_tq_inc_etcu "C_T_MAX_TQ_INC_ETCU" VALUE 0x84ffca _REC_VAL_20_u2 655.35 _CNV_A_R_LINEAR_____56_CM 0. 655.35 DISPLAY_IDENTIFIER C_T_MAX_TQ_INC_ETCU FORMAT "%5.2" /end CHARACTERISTIC
/begin CHARACTERISTIC lc_t_max_etcu_rst "switch shifting process timer reset" VALUE 0x850169 _REC_VAL_20_u1 1. _CNV_A_R_LINEAR_____0_CM 0. 1. DISPLAY_IDENTIFIER LC_T_MAX_ETCU_RST FORMAT "%1.0" /end CHARACTERISTIC
/begin CHARACTERISTIC id_t_max_dri__dri_old__dri_new "TQETCU: ID_T_MAX_DRI" MAP 0x844d84 _REC_MAP_20_u2_u1_u1 655.35 _CNV_A_R_LINEAR_____56_CM 0. 655.35 DISPLAY_IDENTIFIER ID_T_MAX_DRI__DRI_OLD__DRI_NEW FORMAT "%5.2"
 /begin AXIS_DESCR COM_AXIS dri_old_etcu _CNV_A_R_LINEAR_____0_CM 7 0. 6. FORMAT "%1.0" AXIS_PTS_REF ldp_dri_old_etcu_id_t_max_dri /end AXIS_DESCR
 /begin AXIS_DESCR COM_AXIS dri_new_etcu _CNV_A_R_LINEAR_____0_CM 7 0. 6. FORMAT "%1.0" AXIS_PTS_REF ldp_dri_new_etcu_id_t_max_dri /end AXIS_DESCR
/end CHARACTERISTIC
/begin AXIS_PTS ldp_dri_old_etcu_id_t_max_dri "" 0x84162b dri_old_etcu _REC_AXS_20_u1 6. _CNV_A_R_LINEAR_____0_CM 7 0. 6. FORMAT "%1.0" /end AXIS_PTS
/begin AXIS_PTS ldp_dri_new_etcu_id_t_max_dri "" 0x841623 dri_new_etcu _REC_AXS_20_u1 6. _CNV_A_R_LINEAR_____0_CM 7 0. 6. FORMAT "%1.0" /end AXIS_PTS
/begin MEASUREMENT tq_dif_aj "o v" SWORD _CNV_A_R_LINEAR_____52_CM 1 0. -1024. 1023.96875 DISPLAY_IDENTIFIER TQ_DIF_AJ ECU_ADDRESS 0x7f97ca BYTE_ORDER MSB_LAST FORMAT "%6.2" /end MEASUREMENT
/begin MEASUREMENT lv_req_aj "o v" UBYTE _CNV_S_2_RANGE______11_CM 1 0. 0. 1. DISPLAY_IDENTIFIER LV_REQ_AJ ECU_ADDRESS 0x7fb6cf /end MEASUREMENT
/begin MEASUREMENT lv_act_aj "o v" UBYTE _CNV_S_2_RANGE______11_CM 1 0. 0. 1. DISPLAY_IDENTIFIER LV_ACT_AJ ECU_ADDRESS 0x7fb6d0 /end MEASUREMENT
/begin CHARACTERISTIC lc_lpf_2_aj_off "" VALUE 0x85ce85 _REC_VAL_20_u1 1. _CNV_A_R_LINEAR_____0_CM 0. 1. DISPLAY_IDENTIFIER LC_LPF_2_AJ_OFF FORMAT "%1.0" /end CHARACTERISTIC
/begin CHARACTERISTIC lc_lpf_aj_on "" VALUE 0x85ce87 _REC_VAL_20_u1 1. _CNV_A_R_LINEAR_____0_CM 0. 1. DISPLAY_IDENTIFIER LC_LPF_AJ_ON FORMAT "%1.0" /end CHARACTERISTIC
/begin CHARACTERISTIC lc_lpf_3_aj_off "" VALUE 0x85ce86 _REC_VAL_20_u1 1. _CNV_A_R_LINEAR_____0_CM 0. 1. DISPLAY_IDENTIFIER LC_LPF_3_AJ_OFF FORMAT "%1.0" /end CHARACTERISTIC
/begin CHARACTERISTIC c_n_min_aj "" VALUE 0x85cb32 _REC_VAL_20_u2 6375. _CNV_A_R_LINEAR_____5_CM 0. 6375. DISPLAY_IDENTIFIER C_N_MIN_AJ FORMAT "%4.0" /end CHARACTERISTIC
/begin CHARACTERISTIC c_n_max_aj "" VALUE 0x85cb10 _REC_VAL_20_u2 6375. _CNV_A_R_LINEAR_____5_CM 0. 6375. DISPLAY_IDENTIFIER C_N_MAX_AJ FORMAT "%4.0" /end CHARACTERISTIC
/begin CHARACTERISTIC lc_aj_on "" VALUE 0x85ce4b _REC_VAL_20_u1 1. _CNV_A_R_LINEAR_____0_CM 0. 1. DISPLAY_IDENTIFIER LC_AJ_ON FORMAT "%1.0" /end CHARACTERISTIC
/begin CHARACTERISTIC lc_aj_is_ovs "" VALUE 0x85ce4a _REC_VAL_20_u1 1. _CNV_A_R_LINEAR_____0_CM 0. 1. DISPLAY_IDENTIFIER LC_AJ_IS_OVS FORMAT "%1.0" /end CHARACTERISTIC
/begin CHARACTERISTIC c_t_act_max_aj "" VALUE 0x85cbec _REC_VAL_20_u2 4.19424 _CNV_A_R_LINEAR_____64_CM 0. 4.19424 DISPLAY_IDENTIFIER C_T_ACT_MAX_AJ FORMAT "%6.5" /end CHARACTERISTIC
/begin CHARACTERISTIC id_frq_cut_aj__dri "TQ_AJ: cut-off frequency of the low pass filter" CURVE 0x850328 _REC_CUR_20_u2_u1 65.535 _CNV_A_R_LINEAR_____91_CM 0. 65.535 DISPLAY_IDENTIFIER ID_FRQ_CUT_AJ__DRI FORMAT "%5.3"
 /begin AXIS_DESCR COM_AXIS dri _CNV_A_R_LINEAR_____0_CM 7 0. 6. FORMAT "%1.0" AXIS_PTS_REF ldpm_dri_aj /end AXIS_DESCR
/end CHARACTERISTIC
/begin AXIS_PTS ldpm_dri_aj "" 0x842b4e dri _REC_AXS_20_u1 6. _CNV_A_R_LINEAR_____0_CM 7 0. 6. FORMAT "%1.0" /end AXIS_PTS
/begin MEASUREMENT tq_dif "torque intervention of anti jerk or shifting in process" SWORD _CNV_A_R_LINEAR_____52_CM 1 0. -1024. 1023.96875 DISPLAY_IDENTIFIER TQ_DIF ECU_ADDRESS 0x7fb4ca BYTE_ORDER MSB_LAST FORMAT "%6.2" /end MEASUREMENT
/begin MEASUREMENT lv_gs_dif_act "logical variable for active torque reduction for shifting in process" UBYTE _CNV_S_2_RANGE______11_CM 1 0. 0. 1. DISPLAY_IDENTIFIER LV_GS_DIF_ACT ECU_ADDRESS 0x7fbbe7 /end MEASUREMENT
/begin MEASUREMENT tqi_sp "Setpoint indicated engine torque" SWORD _CNV_A_R_LINEAR_____52_CM 1 0. -1024. 1023.96875 DISPLAY_IDENTIFIER TQI_SP ECU_ADDRESS 0x7fa2d2 BYTE_ORDER MSB_LAST FORMAT "%6.2" /end MEASUREMENT
/begin MEASUREMENT tq_sp_clu "torque at clutch setpoint" SWORD _CNV_A_R_LINEAR_____52_CM 1 0. -1024. 1023.96875 DISPLAY_IDENTIFIER TQ_SP_CLU ECU_ADDRESS 0x7fa2d4 BYTE_ORDER MSB_LAST FORMAT "%6.2" /end MEASUREMENT
/begin MEASUREMENT tqi_sp_grd "Gradient setpoint torque" SWORD _CNV_A_R_LINEAR_____92_CM 1 0. -1024. 1023.96875 DISPLAY_IDENTIFIER TQI_SP_GRD ECU_ADDRESS 0x7fa2d6 BYTE_ORDER MSB_LAST FORMAT "%6.2" /end MEASUREMENT
/begin CHARACTERISTIC c_t_egs_dly "delay for shifting in torque reduction" VALUE 0x85cc3c _REC_VAL_20_u1 2550. _CNV_A_R_LINEAR_____93_CM 0. 2550. DISPLAY_IDENTIFIER C_T_EGS_DLY FORMAT "%4.0" /end CHARACTERISTIC
/begin CHARACTERISTIC lc_tqi_slm_act "switch for high priority smoke limitation" VALUE 0x85cec4 _REC_VAL_20_u1 1. _CNV_A_R_LINEAR_____0_CM 0. 1. DISPLAY_IDENTIFIER LC_TQI_SLM_ACT FORMAT "%1.0" /end CHARACTERISTIC
/begin CHARACTERISTIC lc_tqi_max_act "switch for high priority torque limitation" VALUE 0x85cec2 _REC_VAL_20_u1 1. _CNV_A_R_LINEAR_____0_CM 0. 1. DISPLAY_IDENTIFIER LC_TQI_MAX_ACT FORMAT "%1.0" /end CHARACTERISTIC
/begin CHARACTERISTIC ip_tq_add_lim2__n "TQI_SP: torque offset for anti jerk limitation" CURVE 0x85b6d0 _REC_CUR_20_u2_u2 2047.96875 _CNV_A_R_LINEAR_____86_CM -1024. 1023.96875 DISPLAY_IDENTIFIER IP_TQ_ADD_LIM2__N FORMAT "%6.2"
 /begin AXIS_DESCR COM_AXIS n _CNV_A_R_LINEAR_____5_CM 6 0. 6375. FORMAT "%4.0" AXIS_PTS_REF ldp_n_ip_tq_add_lim2 /end AXIS_DESCR
/end CHARACTERISTIC
/begin AXIS_PTS ldp_n_ip_tq_add_lim2 "" 0x841eec n _REC_AXS_20_u2 6375. _CNV_A_R_LINEAR_____5_CM 6 0. 6375. FORMAT "%4.0" /end AXIS_PTS
/begin MEASUREMENT tqi_tar "Target indicated torque without LTC and AJ" SWORD _CNV_A_R_LINEAR_____52_CM 1 0. -1024. 1023.96875 DISPLAY_IDENTIFIER TQI_TAR ECU_ADDRESS 0x7fa2c0 BYTE_ORDER MSB_LAST FORMAT "%6.2" /end MEASUREMENT
/begin MEASUREMENT tqi_req_egr "Driver request without LTC, AJ and smoke limitation" SWORD _CNV_A_R_LINEAR_____52_CM 1 0. -1024. 1023.96875 DISPLAY_IDENTIFIER TQI_REQ_EGR ECU_ADDRESS 0x7fa2c2 BYTE_ORDER MSB_LAST FORMAT "%6.2" /end MEASUREMENT
/begin MEASUREMENT tqi_grd_tar "Target indicated torque without LTC and AJ gradient" SWORD _CNV_A_R_LINEAR_____94_CM 1 0. -32768. 32767. DISPLAY_IDENTIFIER TQI_GRD_TAR ECU_ADDRESS 0x7fa2c4 BYTE_ORDER MSB_LAST FORMAT "%5.0" /end MEASUREMENT
/begin MEASUREMENT tqi_grd_req_egr "Driver request without LTC, AJ and smoke limitation gradient" SWORD _CNV_A_R_LINEAR_____94_CM 1 0. -32768. 32767. DISPLAY_IDENTIFIER TQI_GRD_REQ_EGR ECU_ADDRESS 0x7fa2c6 BYTE_ORDER MSB_LAST FORMAT "%5.0" /end MEASUREMENT
/begin MEASUREMENT tqi_lim_min "TQI_LIM_MIN" SWORD _CNV_A_R_LINEAR_____52_CM 1 0. -1024. 1023.96875 DISPLAY_IDENTIFIER TQI_LIM_MIN ECU_ADDRESS 0x7fa2c8 BYTE_ORDER MSB_LAST FORMAT "%6.2" /end MEASUREMENT
/begin MEASUREMENT tqi_lim_min1 "TQI_LIM_MIN" SWORD _CNV_A_R_LINEAR_____52_CM 1 0. -1024. 1023.96875 DISPLAY_IDENTIFIER TQI_LIM_MIN1 ECU_ADDRESS 0x7fa2ca BYTE_ORDER MSB_LAST FORMAT "%6.2" /end MEASUREMENT
/begin MEASUREMENT tqi_req_fast "Indicated Torque Request" SWORD _CNV_A_R_LINEAR_____52_CM 1 0. -1024. 1023.96875 DISPLAY_IDENTIFIER TQI_REQ_FAST ECU_ADDRESS 0x7fa2cc BYTE_ORDER MSB_LAST FORMAT "%6.2" /end MEASUREMENT
/begin MEASUREMENT lv_tqi_lim_act "logical variable for limitation intervention" UBYTE _CNV_S_2_RANGE______11_CM 1 0. 0. 1. DISPLAY_IDENTIFIER LV_TQI_LIM_ACT ECU_ADDRESS 0x7fbbe6 /end MEASUREMENT
/begin MEASUREMENT tq_req_fast "Torque Request at clutch" SWORD _CNV_A_R_LINEAR_____52_CM 1 0. -1024. 1023.96875 DISPLAY_IDENTIFIER TQ_REQ_FAST ECU_ADDRESS 0x7fa2ce BYTE_ORDER MSB_LAST FORMAT "%6.2" /end MEASUREMENT
/begin MEASUREMENT tq_lim_min "Maximum limitation torque at clutch" SWORD _CNV_A_R_LINEAR_____52_CM 1 0. -1024. 1023.96875 DISPLAY_IDENTIFIER TQ_LIM_MIN ECU_ADDRESS 0x7fa2d0 BYTE_ORDER MSB_LAST FORMAT "%6.2" /end MEASUREMENT
/begin MEASUREMENT mf_tot "total fuel mass" UWORD _CNV_A_R_LINEAR_____38_CM 1 0. 0. 262.14 DISPLAY_IDENTIFIER MF_TOT ECU_ADDRESS 0x7fa284 BYTE_ORDER MSB_LAST /end MEASUREMENT
/begin MEASUREMENT mf_tot_grd "difference between mf_tot_new and mf_tot_old" SWORD _CNV_A_R_LINEAR_____38_CM 1 0. -131.072 131.068 DISPLAY_IDENTIFIER MF_TOT_GRD ECU_ADDRESS 0x7fa286 BYTE_ORDER MSB_LAST /end MEASUREMENT
/begin MEASUREMENT tqi_tql "Torque for torque limitation" SWORD _CNV_A_R_LINEAR_____52_CM 1 0. -1024. 1023.96875 DISPLAY_IDENTIFIER TQI_TQL ECU_ADDRESS 0x7f9d0a BYTE_ORDER MSB_LAST FORMAT "%6.2" /end MEASUREMENT
/begin MEASUREMENT tqi_tql_bas "Basic torque for torque limitation" SWORD _CNV_A_R_LINEAR_____52_CM 1 0. -1024. 1023.96875 DISPLAY_IDENTIFIER TQI_TQL_BAS ECU_ADDRESS 0x7fa9dc BYTE_ORDER MSB_LAST FORMAT "%6.2" /end MEASUREMENT
/begin MEASUREMENT tqi_add_tql "TQL increase at start" SWORD _CNV_A_R_LINEAR_____52_CM 1 0. -1024. 1023.96875 DISPLAY_IDENTIFIER TQI_ADD_TQL ECU_ADDRESS 0x7fa9de BYTE_ORDER MSB_LAST FORMAT "%6.2" /end MEASUREMENT
/begin MEASUREMENT tqi_tql_bpr "Torque for boiling protection" SWORD _CNV_A_R_LINEAR_____52_CM 1 0. -1024. 1023.96875 DISPLAY_IDENTIFIER TQI_TQL_BPR ECU_ADDRESS 0x7fa9e0 BYTE_ORDER MSB_LAST FORMAT "%6.2" /end MEASUREMENT
/begin MEASUREMENT tqi_tql_amp "Torque for torque limitation from AMP" SWORD _CNV_A_R_LINEAR_____52_CM 1 0. -1024. 1023.96875 DISPLAY_IDENTIFIER TQI_TQL_AMP ECU_ADDRESS 0x7fa9e2 BYTE_ORDER MSB_LAST FORMAT "%6.2" /end MEASUREMENT
/begin CHARACTERISTIC lc_swi_temp_tql "switch for torque limitation temperature selection" VALUE 0x85ceab _REC_VAL_20_u1 1. _CNV_A_R_LINEAR_____0_CM 0. 1. DISPLAY_IDENTIFIER LC_SWI_TEMP_TQL FORMAT "%1.0" /end CHARACTERISTIC
/begin CHARACTERISTIC ip_tqi_tql_bas "MFTQLM: Basic torque for torque limitation" CURVE 0x85c3c4 _REC_CUR_20_u2_u2 2047.96875 _CNV_A_R_LINEAR_____86_CM -1024. 1023.96875 DISPLAY_IDENTIFIER IP_TQI_TQL_BAS FORMAT "%6.2"
 /begin AXIS_DESCR COM_AXIS n _CNV_A_R_LINEAR_____5_CM 20 0. 6375. FORMAT "%4.0" AXIS_PTS_REF ldpm_n_ip_tqi_bas /end AXIS_DESCR
/end CHARACTERISTIC
/begin AXIS_PTS ldpm_n_ip_tqi_bas "" 0x8435ca n _REC_AXS_20_u2 6375. _CNV_A_R_LINEAR_____5_CM 20 0. 6375. FORMAT "%4.0" /end AXIS_PTS
/begin CHARACTERISTIC ip_fac_tqi_add_tql "MFTQLM: TQL increase factor on T_AST" CURVE 0x8530a0 _REC_CUR_20_u2_u2 1. _CNV_A_R_LINEAR_____77_CM 0. 1. DISPLAY_IDENTIFIER IP_FAC_TQI_ADD_TQL FORMAT "%6.5"
 /begin AXIS_DESCR COM_AXIS t_ast _CNV_A_R_LINEAR_____19_CM 4 0. 6553.5 FORMAT "%5.1" AXIS_PTS_REF ldp_t_ast_ip_fac_tqi_add_tql /end AXIS_DESCR
/end CHARACTERISTIC
/begin AXIS_PTS ldp_t_ast_ip_fac_tqi_add_tql "" 0x8421ee t_ast _REC_AXS_20_u2 6553.5 _CNV_A_R_LINEAR_____19_CM 4 0. 6553.5 FORMAT "%5.1" /end AXIS_PTS
/begin CHARACTERISTIC ip_fac_tqi_tql_bpr "MFTQLM: vehicle speed correction boiling protection" CURVE 0x8530b0 _REC_CUR_20_u1_u1 3.984375 _CNV_A_R_LINEAR_____95_CM 0. 3.984375 DISPLAY_IDENTIFIER IP_FAC_TQI_TQL_BPR FORMAT "%3.2"
 /begin AXIS_DESCR COM_AXIS vs _CNV_A_R_LINEAR_____34_CM 6 0. 255. FORMAT "%3.0" AXIS_PTS_REF ldp_vs_ip_fac_tqi_tql_bpr /end AXIS_DESCR
/end CHARACTERISTIC
/begin AXIS_PTS ldp_vs_ip_fac_tqi_tql_bpr "" 0x842ac0 vs _REC_AXS_20_u1 255. _CNV_A_R_LINEAR_____34_CM 6 0. 255. FORMAT "%3.0" /end AXIS_PTS
/begin CHARACTERISTIC ip_fac_tqi_tql_amp "MFTQLM: TIA correction for ambient pressure torque limitation" CURVE 0x8530a8 _REC_CUR_20_u1_u1 3.984375 _CNV_A_R_LINEAR_____95_CM 0. 3.984375 DISPLAY_IDENTIFIER IP_FAC_TQI_TQL_AMP FORMAT "%3.2"
 /begin AXIS_DESCR COM_AXIS tia _CNV_A_R_LINEAR_____18_CM 8 -50. 205. FORMAT "%3.0" AXIS_PTS_REF ldp_tia_ip_fac_tqi_tql_amp /end AXIS_DESCR
/end CHARACTERISTIC
/begin AXIS_PTS ldp_tia_ip_fac_tqi_tql_amp "" 0x84258c tia _REC_AXS_20_u1 255. _CNV_A_R_LINEAR_____18_CM 8 -50. 205. FORMAT "%3.0" /end AXIS_PTS
/begin CHARACTERISTIC ip_tqi_add_tql_st "MFTQLM: TQL increase for start" MAP 0x85ba9c _REC_MAP_20_u2_u2_u1 2047.96875 _CNV_A_R_LINEAR_____86_CM -1024. 1023.96875 DISPLAY_IDENTIFIER IP_TQI_ADD_TQL_ST FORMAT "%6.2"
 /begin AXIS_DESCR COM_AXIS n _CNV_A_R_LINEAR_____5_CM 6 0. 6375. FORMAT "%4.0" AXIS_PTS_REF ldp_n_ip_tqi_add_tql /end AXIS_DESCR
 /begin AXIS_DESCR COM_AXIS tco _CNV_A_R_LINEAR_____18_CM 8 -50. 205. FORMAT "%3.0" AXIS_PTS_REF ldp_tco_ip_tqi_tql /end AXIS_DESCR
/end CHARACTERISTIC
/begin AXIS_PTS ldp_n_ip_tqi_add_tql "" 0x841f08 n _REC_AXS_20_u2 6375. _CNV_A_R_LINEAR_____5_CM 6 0. 6375. FORMAT "%4.0" /end AXIS_PTS
/begin AXIS_PTS ldp_tco_ip_tqi_tql "" 0x84240a tco _REC_AXS_20_u1 255. _CNV_A_R_LINEAR_____18_CM 8 -50. 205. FORMAT "%3.0" /end AXIS_PTS
/begin CHARACTERISTIC ip_tqi_tql_bpr "MFTQLM: boiling protection map" MAP 0x85c3ec _REC_MAP_20_u2_u2_u1 2047.96875 _CNV_A_R_LINEAR_____86_CM -1024. 1023.96875 DISPLAY_IDENTIFIER IP_TQI_TQL_BPR FORMAT "%6.2"
 /begin AXIS_DESCR COM_AXIS n _CNV_A_R_LINEAR_____5_CM 6 0. 6375. FORMAT "%4.0" AXIS_PTS_REF ldp_n_ip_tqi_tql_bpr /end AXIS_DESCR
 /begin AXIS_DESCR COM_AXIS tco _CNV_A_R_LINEAR_____18_CM 8 -50. 205. FORMAT "%3.0" AXIS_PTS_REF ldp_tco_ip_tqi_tql /end AXIS_DESCR
/end CHARACTERISTIC
/begin AXIS_PTS ldp_n_ip_tqi_tql_bpr "" 0x841f74 n _REC_AXS_20_u2 6375. _CNV_A_R_LINEAR_____5_CM 6 0. 6375. FORMAT "%4.0" /end AXIS_PTS
/begin CHARACTERISTIC ip_tqi_tql_amp "MFTQLM: Ambient pressure torque limitation map" MAP 0x85c37c _REC_MAP_20_u2_u2_u2 2047.96875 _CNV_A_R_LINEAR_____86_CM -1024. 1023.96875 DISPLAY_IDENTIFIER IP_TQI_TQL_AMP FORMAT "%6.2"
 /begin AXIS_DESCR COM_AXIS n _CNV_A_R_LINEAR_____5_CM 6 0. 6375. FORMAT "%4.0" AXIS_PTS_REF ldpm_n_ip_tqi_tql /end AXIS_DESCR
 /begin AXIS_DESCR COM_AXIS amp _CNV_A_R_LINEAR_____45_CM 6 0. 5434. FORMAT "%6.2" AXIS_PTS_REF ldp_amp_ip_tqi_tql_amp /end AXIS_DESCR
/end CHARACTERISTIC
/begin AXIS_PTS ldpm_n_ip_tqi_tql "" 0x843704 n _REC_AXS_20_u2 6375. _CNV_A_R_LINEAR_____5_CM 6 0. 6375. FORMAT "%4.0" /end AXIS_PTS
/begin AXIS_PTS ldp_amp_ip_tqi_tql_amp "" 0x84132e amp _REC_AXS_20_u2 5434. _CNV_A_R_LINEAR_____45_CM 6 0. 5434. FORMAT "%6.2" /end AXIS_PTS
/begin MEASUREMENT sum_tqi_lih "event counter for torque limitation request for safety" UWORD _CNV_A_R_LINEAR_____0_CM 1 0. 0. 65535. DISPLAY_IDENTIFIER SUM_TQI_LIH ECU_ADDRESS 0x7fa2e8 BYTE_ORDER MSB_LAST FORMAT "%5.0" /end MEASUREMENT
/begin MEASUREMENT lv_tqi_lih_intv_act "logical value for torque limitation demand for safety" UBYTE _CNV_S_2_RANGE______11_CM 1 0. 0. 1. DISPLAY_IDENTIFIER LV_TQI_LIH_INTV_ACT ECU_ADDRESS 0x7fbbf1 /end MEASUREMENT
/begin MEASUREMENT lv_tqi_mon_intv_act "logical value for torque limitation demand for monitoring" UBYTE _CNV_S_2_RANGE______11_CM 1 0. 0. 1. DISPLAY_IDENTIFIER LV_TQI_MON_INTV_ACT ECU_ADDRESS 0x7fbbf2 /end MEASUREMENT
/begin MEASUREMENT tqi_lih_1 "Requested indicated Torque limitation for safety 1" SWORD _CNV_A_R_LINEAR_____52_CM 1 0. -1024. 1023.96875 DISPLAY_IDENTIFIER TQI_LIH_1 ECU_ADDRESS 0x7fa2e4 BYTE_ORDER MSB_LAST FORMAT "%6.2" /end MEASUREMENT
/begin MEASUREMENT tqi_lih "Requested indicated Torque limitation after gradient limitation" SWORD _CNV_A_R_LINEAR_____52_CM 1 0. -1024. 1023.96875 DISPLAY_IDENTIFIER TQI_LIH ECU_ADDRESS 0x7fa2e6 BYTE_ORDER MSB_LAST FORMAT "%6.2" /end MEASUREMENT
/begin CHARACTERISTIC lc_clr_sum_tqi_lih "clear switch for SUM_TQI_LIH" VALUE 0x85ce5d _REC_VAL_20_u1 1. _CNV_A_R_LINEAR_____0_CM 0. 1. DISPLAY_IDENTIFIER LC_CLR_SUM_TQI_LIH FORMAT "%1.0" /end CHARACTERISTIC
/begin CHARACTERISTIC lc_tqi_lih_inh "switch for safety torque limitation inhibition" VALUE 0x85cec1 _REC_VAL_20_u1 1. _CNV_A_R_LINEAR_____0_CM 0. 1. DISPLAY_IDENTIFIER LC_TQI_LIH_INH FORMAT "%1.0" /end CHARACTERISTIC
/begin CHARACTERISTIC lc_tqi_mon_inh "switch for monitoring torque limitation inhibition" VALUE 0x85cec3 _REC_VAL_20_u1 1. _CNV_A_R_LINEAR_____0_CM 0. 1. DISPLAY_IDENTIFIER LC_TQI_MON_INH FORMAT "%1.0" /end CHARACTERISTIC
/begin CHARACTERISTIC c_n_max_is_plaus "Maximum N for plausible IS intervention" VALUE 0x85cb22 _REC_VAL_20_u2 6375. _CNV_A_R_LINEAR_____5_CM 0. 6375. DISPLAY_IDENTIFIER C_N_MAX_IS_PLAUS FORMAT "%4.0" /end CHARACTERISTIC
/begin CHARACTERISTIC c_ofs_tq_mon "Offset for low monitoring limitation" VALUE 0x85cb58 _REC_VAL_20_u2 1023.96875 _CNV_A_R_LINEAR_____52_CM 0. 1023.96875 DISPLAY_IDENTIFIER C_OFS_TQ_MON FORMAT "%6.2" /end CHARACTERISTIC
/begin CHARACTERISTIC c_tqi_lih_pas "TQI_LIH for passive limitation" VALUE 0x85cd40 _REC_VAL_20_u2 1023.96875 _CNV_A_R_LINEAR_____52_CM 0. 1023.96875 DISPLAY_IDENTIFIER C_TQI_LIH_PAS FORMAT "%6.2" /end CHARACTERISTIC
/begin CHARACTERISTIC c_tqi_lih_grd_inc "TQI_LIH positive gradient limitation" VALUE 0x85cd3e _REC_VAL_20_u2 1023.96875 _CNV_A_R_LINEAR_____92_CM 0. 1023.96875 DISPLAY_IDENTIFIER C_TQI_LIH_GRD_INC FORMAT "%6.2" /end CHARACTERISTIC
/begin CHARACTERISTIC c_tqi_lih_grd_dec "TQI_LIH negative gradient limitation" VALUE 0x85cd3c _REC_VAL_20_u2 1023.96875 _CNV_A_R_LINEAR_____92_CM 0. 1023.96875 DISPLAY_IDENTIFIER C_TQI_LIH_GRD_DEC FORMAT "%6.2" /end CHARACTERISTIC
/begin CHARACTERISTIC c_lgrd_tqi_mon_dec "Negative gradient limitation for monitoring limitation" VALUE 0x85ca4e _REC_VAL_20_u2 1023.96875 _CNV_A_R_LINEAR_____92_CM 0. 1023.96875 DISPLAY_IDENTIFIER C_LGRD_TQI_MON_DEC FORMAT "%6.2" /end CHARACTERISTIC
/begin CHARACTERISTIC c_lgrd_tqi_mon_inc "Positive gradient limitation for monitoring limitation" VALUE 0x85ca50 _REC_VAL_20_u2 1023.96875 _CNV_A_R_LINEAR_____92_CM 0. 1023.96875 DISPLAY_IDENTIFIER C_LGRD_TQI_MON_INC FORMAT "%6.2" /end CHARACTERISTIC
/begin CHARACTERISTIC ip_tqi_lih__n "TQ_LIH: torque limitation for safety" CURVE 0x85c0b4 _REC_CUR_20_u2_u2 2047.96875 _CNV_A_R_LINEAR_____86_CM -1024. 1023.96875 DISPLAY_IDENTIFIER IP_TQI_LIH__N FORMAT "%6.2"
 /begin AXIS_DESCR COM_AXIS n _CNV_A_R_LINEAR_____5_CM 16 0. 6375. FORMAT "%4.0" AXIS_PTS_REF ldp_n_ip_tqi_lih /end AXIS_DESCR
/end CHARACTERISTIC
/begin AXIS_PTS ldp_n_ip_tqi_lih "" 0x841f16 n _REC_AXS_20_u2 6375. _CNV_A_R_LINEAR_____5_CM 16 0. 6375. FORMAT "%4.0" /end AXIS_PTS
/begin CHARACTERISTIC ip_tqi_mon "TQ_LIH: torque limitation for monitoring error" MAP 0x85c0d4 _REC_MAP_20_u2_u2_u1 2047.96875 _CNV_A_R_LINEAR_____86_CM -1024. 1023.96875 DISPLAY_IDENTIFIER IP_TQI_MON FORMAT "%6.2"
 /begin AXIS_DESCR COM_AXIS n _CNV_A_R_LINEAR_____5_CM 16 0. 6375. FORMAT "%4.0" AXIS_PTS_REF ldp_n_ip_tqi_mon /end AXIS_DESCR
 /begin AXIS_DESCR COM_AXIS dri _CNV_A_R_LINEAR_____0_CM 16 0. 15. FORMAT "%2.0" AXIS_PTS_REF ldp_dri_ip_tqi_mon /end AXIS_DESCR
/end CHARACTERISTIC
/begin AXIS_PTS ldp_n_ip_tqi_mon "" 0x841f38 n _REC_AXS_20_u2 6375. _CNV_A_R_LINEAR_____5_CM 16 0. 6375. FORMAT "%4.0" /end AXIS_PTS
/begin AXIS_PTS ldp_dri_ip_tqi_mon "" 0x841612 dri _REC_AXS_20_u1 15. _CNV_A_R_LINEAR_____0_CM 16 0. 15. FORMAT "%2.0" /end AXIS_PTS
/begin MEASUREMENT t1_dt1_aj "o v" UWORD _CNV_A_R_LINEAR_____64_CM 1 0. 0. 4.19424 DISPLAY_IDENTIFIER T1_DT1_AJ ECU_ADDRESS 0x7f97cc BYTE_ORDER MSB_LAST FORMAT "%6.5" /end MEASUREMENT
/begin MEASUREMENT kr_dt1_aj "o v" SWORD _CNV_A_R_LINEAR_____132_CM 1 0. -32. 31.99902344 DISPLAY_IDENTIFIER KR_DT1_AJ ECU_ADDRESS 0x7f97ce BYTE_ORDER MSB_LAST FORMAT "%6.4" /end MEASUREMENT
/begin MEASUREMENT n_aj "o v" UWORD _CNV_A_R_LINEAR_____5_CM 1 0. 0. 6375. DISPLAY_IDENTIFIER N_AJ ECU_ADDRESS 0x7f97d0 BYTE_ORDER MSB_LAST FORMAT "%4.0" /end MEASUREMENT
/begin MEASUREMENT pv_av_grd_aj "o v" UWORD _CNV_A_R_LINEAR_____78_CM 1 0. 0. 100. DISPLAY_IDENTIFIER PV_AV_GRD_AJ ECU_ADDRESS 0x7f97d2 BYTE_ORDER MSB_LAST FORMAT "%4.2" /end MEASUREMENT
/begin CHARACTERISTIC lc_n_pred_on_aj "" VALUE 0x85ce95 _REC_VAL_20_u1 1. _CNV_A_R_LINEAR_____0_CM 0. 1. DISPLAY_IDENTIFIER LC_N_PRED_ON_AJ FORMAT "%1.0" /end CHARACTERISTIC
/begin CHARACTERISTIC c_t1_pv_av_grd_aj "" VALUE 0x85cbe0 _REC_VAL_20_u2 4.19424 _CNV_A_R_LINEAR_____64_CM 0. 4.19424 DISPLAY_IDENTIFIER C_T1_PV_AV_GRD_AJ FORMAT "%6.5" /end CHARACTERISTIC
/begin CHARACTERISTIC ip_fac_aj__pv_av "TQ_AJPA: reduction of anti-jerk at low pedalvalue" CURVE 0x8523ca _REC_CUR_20_u1_u2 0.99609375 _CNV_A_R_LINEAR_____29_CM 0. 0.99609375 DISPLAY_IDENTIFIER IP_FAC_AJ__PV_AV FORMAT "%4.3"
 /begin AXIS_DESCR COM_AXIS pv_av_grd_aj _CNV_A_R_LINEAR_____78_CM 3 0. 100. FORMAT "%4.2" AXIS_PTS_REF ldp_pv_av_ip_fac_aj /end AXIS_DESCR
/end CHARACTERISTIC
/begin AXIS_PTS ldp_pv_av_ip_fac_aj "" 0x8420d6 pv_av_grd_aj _REC_AXS_20_u2 100. _CNV_A_R_LINEAR_____78_CM 3 0. 100. FORMAT "%4.2" /end AXIS_PTS
/begin CHARACTERISTIC ip_fac_tq_dif_aj__dri__n "TQ_AJPA: intensity of anti-jerk intervention" MAP 0x852af0 _REC_MAP_20_u2_u1_u2 63.9990234375 _CNV_A_R_LINEAR_____133_CM -32. 31.9990234375 DISPLAY_IDENTIFIER IP_FAC_TQ_DIF_AJ__DRI__N FORMAT "%6.4"
 /begin AXIS_DESCR COM_AXIS dri _CNV_A_R_LINEAR_____0_CM 7 0. 6. FORMAT "%1.0" AXIS_PTS_REF ldpm_dri_aj /end AXIS_DESCR
 /begin AXIS_DESCR COM_AXIS n_aj _CNV_A_R_LINEAR_____5_CM 6 0. 6375. FORMAT "%4.0" AXIS_PTS_REF ldpm_n_ip_fac_aj /end AXIS_DESCR
/end CHARACTERISTIC
/begin AXIS_PTS ldpm_n_ip_fac_aj "" 0x84307e n_aj _REC_AXS_20_u2 6375. _CNV_A_R_LINEAR_____5_CM 6 0. 6375. FORMAT "%4.0" /end AXIS_PTS
/begin CHARACTERISTIC ip_fac_tq_dif_aj_is__dri__n "TQ_AJPA: intensity of anti-jerk intervention at idle" MAP 0x852b44 _REC_MAP_20_u2_u1_u2 63.9990234375 _CNV_A_R_LINEAR_____133_CM -32. 31.9990234375 DISPLAY_IDENTIFIER IP_FAC_TQ_DIF_AJ_IS__DRI__N FORMAT "%6.4"
 /begin AXIS_DESCR COM_AXIS dri _CNV_A_R_LINEAR_____0_CM 7 0. 6. FORMAT "%1.0" AXIS_PTS_REF ldpm_dri_aj /end AXIS_DESCR
 /begin AXIS_DESCR COM_AXIS n_aj _CNV_A_R_LINEAR_____5_CM 6 0. 6375. FORMAT "%4.0" AXIS_PTS_REF ldpm_n_ip_fac_aj_is /end AXIS_DESCR
/end CHARACTERISTIC
/begin AXIS_PTS ldpm_n_ip_fac_aj_is "" 0x84308c n_aj _REC_AXS_20_u2 6375. _CNV_A_R_LINEAR_____5_CM 6 0. 6375. FORMAT "%4.0" /end AXIS_PTS
/begin CHARACTERISTIC ip_t1_aj__dri__n "TQ_AJPA: timeconstant for both DT1-filter" MAP 0x85af72 _REC_MAP_20_u2_u1_u2 4.19424 _CNV_A_R_LINEAR_____64_CM 0. 4.19424 DISPLAY_IDENTIFIER IP_T1_AJ__DRI__N FORMAT "%6.5"
 /begin AXIS_DESCR COM_AXIS dri _CNV_A_R_LINEAR_____0_CM 7 0. 6. FORMAT "%1.0" AXIS_PTS_REF ldpm_dri_aj /end AXIS_DESCR
 /begin AXIS_DESCR COM_AXIS n_aj _CNV_A_R_LINEAR_____5_CM 6 0. 6375. FORMAT "%4.0" AXIS_PTS_REF ldpm_n_ip_fac_aj /end AXIS_DESCR
/end CHARACTERISTIC
/begin CHARACTERISTIC ip_t1_aj_is__dri__n "TQ_AJPA: timeconstant for both DT1-filter at idle" MAP 0x85afc6 _REC_MAP_20_u2_u1_u2 4.19424 _CNV_A_R_LINEAR_____64_CM 0. 4.19424 DISPLAY_IDENTIFIER IP_T1_AJ_IS__DRI__N FORMAT "%6.5"
 /begin AXIS_DESCR COM_AXIS dri _CNV_A_R_LINEAR_____0_CM 7 0. 6. FORMAT "%1.0" AXIS_PTS_REF ldpm_dri_aj /end AXIS_DESCR
 /begin AXIS_DESCR COM_AXIS n_aj _CNV_A_R_LINEAR_____5_CM 6 0. 6375. FORMAT "%4.0" AXIS_PTS_REF ldpm_n_ip_fac_aj_is /end AXIS_DESCR
/end CHARACTERISTIC
/begin CHARACTERISTIC c_abc_inc_acp_mes_rng "" VALUE 0x84fa6d _REC_VAL_20_u1 255. _CNV_A_R_LINEAR_____0_CM 0. 255. DISPLAY_IDENTIFIER C_ABC_INC_ACP_MES_RNG FORMAT "%3.0" /end CHARACTERISTIC
/begin CHARACTERISTIC c_abc_max_acp_mes_rng "" VALUE 0x84faf9 _REC_VAL_20_u1 255. _CNV_A_R_LINEAR_____0_CM 0. 255. DISPLAY_IDENTIFIER C_ABC_MAX_ACP_MES_RNG FORMAT "%3.0" /end CHARACTERISTIC
/begin CHARACTERISTIC c_abc_inc_acp_mes_grd "" VALUE 0x84fa6c _REC_VAL_20_u1 255. _CNV_A_R_LINEAR_____0_CM 0. 255. DISPLAY_IDENTIFIER C_ABC_INC_ACP_MES_GRD FORMAT "%3.0" /end CHARACTERISTIC
/begin CHARACTERISTIC c_abc_max_acp_mes_grd "" VALUE 0x84faf8 _REC_VAL_20_u1 255. _CNV_A_R_LINEAR_____0_CM 0. 255. DISPLAY_IDENTIFIER C_ABC_MAX_ACP_MES_GRD FORMAT "%3.0" /end CHARACTERISTIC
/begin MEASUREMENT lv_err_acp_mes "Global error flag for ACP_MES" UBYTE _CNV_S_2_RANGE______11_CM 1 0. 0. 1. DISPLAY_IDENTIFIER LV_ERR_ACP_MES ECU_ADDRESS 0x7fb83c /end MEASUREMENT
/begin CHARACTERISTIC c_abc_inc_ducy_alter_pwm_rng "" VALUE 0x84fa93 _REC_VAL_20_u1 255. _CNV_A_R_LINEAR_____0_CM 0. 255. DISPLAY_IDENTIFIER C_ABC_INC_DUCY_ALTER_PWM_RNG FORMAT "%3.0" /end CHARACTERISTIC
/begin CHARACTERISTIC c_abc_max_ducy_alter_pwm_rng "" VALUE 0x84fb1f _REC_VAL_20_u1 255. _CNV_A_R_LINEAR_____0_CM 0. 255. DISPLAY_IDENTIFIER C_ABC_MAX_DUCY_ALTER_PWM_RNG FORMAT "%3.0" /end CHARACTERISTIC
/begin CHARACTERISTIC c_abc_inc_ducy_alter_pwm_grd "" VALUE 0x84fa92 _REC_VAL_20_u1 255. _CNV_A_R_LINEAR_____0_CM 0. 255. DISPLAY_IDENTIFIER C_ABC_INC_DUCY_ALTER_PWM_GRD FORMAT "%3.0" /end CHARACTERISTIC
/begin CHARACTERISTIC c_abc_max_ducy_alter_pwm_grd "" VALUE 0x84fb1e _REC_VAL_20_u1 255. _CNV_A_R_LINEAR_____0_CM 0. 255. DISPLAY_IDENTIFIER C_ABC_MAX_DUCY_ALTER_PWM_GRD FORMAT "%3.0" /end CHARACTERISTIC
/begin CHARACTERISTIC c_ducy_alter_pwm_max_diag "generator load signal maximum value" VALUE 0x85c988 _REC_VAL_20_u2 100. _CNV_A_R_LINEAR_____134_CM 0. 100. DISPLAY_IDENTIFIER C_DUCY_ALTER_PWM_MAX_DIAG FORMAT "%4.0" /end CHARACTERISTIC
/begin CHARACTERISTIC c_ducy_alter_pwm_min_diag "generator load signal minimum value" VALUE 0x85c98a _REC_VAL_20_u2 100. _CNV_A_R_LINEAR_____134_CM 0. 100. DISPLAY_IDENTIFIER C_DUCY_ALTER_PWM_MIN_DIAG FORMAT "%4.0" /end CHARACTERISTIC
/begin CHARACTERISTIC c_ducy_alter_pwm_grd_diag "threshold for error detection" VALUE 0x85c986 _REC_VAL_20_u2 100. _CNV_A_R_LINEAR_____134_CM 0. 100. DISPLAY_IDENTIFIER C_DUCY_ALTER_PWM_GRD_DIAG FORMAT "%4.0" /end CHARACTERISTIC
/begin MEASUREMENT lv_err_ducy_alter_pwm "" UBYTE _CNV_S_2_RANGE______23_CM 1 0. 0. 1. DISPLAY_IDENTIFIER LV_ERR_DUCY_ALTER_PWM ECU_ADDRESS 0x7fb83e /end MEASUREMENT
/begin MEASUREMENT lv_err_altpwm_mes "" UBYTE _CNV_S_2_RANGE______23_CM 1 0. 0. 1. DISPLAY_IDENTIFIER LV_ERR_ALTPWM_MES ECU_ADDRESS 0x7fb83f /end MEASUREMENT
/begin MEASUREMENT lv_err_tia_mes "Global error flag for ACP_MES" UBYTE _CNV_S_2_RANGE______11_CM 1 0. 0. 1. DISPLAY_IDENTIFIER LV_ERR_TIA_MES ECU_ADDRESS 0x7fb841 /end MEASUREMENT
/begin MEASUREMENT tqe_dif_raw "v" SWORD _CNV_A_R_LINEAR_____52_CM 1 0. -1024. 1023.96875 DISPLAY_IDENTIFIER TQE_DIF_RAW ECU_ADDRESS 0x7fb4d4 BYTE_ORDER MSB_LAST FORMAT "%6.2" /end MEASUREMENT
/begin MEASUREMENT tqe_fil_dif "v" SWORD _CNV_A_R_LINEAR_____52_CM 1 0. -1024. 1023.96875 DISPLAY_IDENTIFIER TQE_FIL_DIF ECU_ADDRESS 0x7fb4d6 BYTE_ORDER MSB_LAST FORMAT "%6.2" /end MEASUREMENT
/begin MEASUREMENT tqe_sp_raw "v" SWORD _CNV_A_R_LINEAR_____52_CM 1 0. -1024. 1023.96875 DISPLAY_IDENTIFIER TQE_SP_RAW ECU_ADDRESS 0x7fb4d8 BYTE_ORDER MSB_LAST FORMAT "%6.2" /end MEASUREMENT
/begin MEASUREMENT tqe_sp_clc "v" SWORD _CNV_A_R_LINEAR_____52_CM 1 0. -1024. 1023.96875 DISPLAY_IDENTIFIER TQE_SP_CLC ECU_ADDRESS 0x7fb4da BYTE_ORDER MSB_LAST FORMAT "%6.2" /end MEASUREMENT
/begin MEASUREMENT tqe_sp "o v" SWORD _CNV_A_R_LINEAR_____52_CM 1 0. -1024. 1023.96875 DISPLAY_IDENTIFIER TQE_SP ECU_ADDRESS 0x7fa2ec BYTE_ORDER MSB_LAST FORMAT "%6.2" /end MEASUREMENT
/begin MEASUREMENT tqe_dif "o v" SWORD _CNV_A_R_LINEAR_____52_CM 1 0. -1024. 1023.96875 DISPLAY_IDENTIFIER TQE_DIF ECU_ADDRESS 0x7fa2ee BYTE_ORDER MSB_LAST FORMAT "%6.2" /end MEASUREMENT
/begin CHARACTERISTIC lc_tqe_clc_act "" VALUE 0x85cec0 _REC_VAL_20_u1 1. _CNV_A_R_LINEAR_____0_CM 0. 1. DISPLAY_IDENTIFIER LC_TQE_CLC_ACT FORMAT "%1.0" /end CHARACTERISTIC
/begin CHARACTERISTIC c_fac_tqe "" VALUE 0x85ca22 _REC_VAL_20_u1 0.255 _CNV_A_R_LINEAR_____319_CM 0. 0.255 DISPLAY_IDENTIFIER C_FAC_TQE FORMAT "%4.3" /end CHARACTERISTIC
/begin CHARACTERISTIC ip_crlc_tqe_sp__tqe_fil_dif "TQE: correlation constant for filtering of the effective engine torque" CURVE 0x851d32 _REC_CUR_20_u2_u2 0.9999847412109381 _CNV_A_R_LINEAR_____137_CM 0. 0.9999847412109381 DISPLAY_IDENTIFIER IP_CRLC_TQE_SP__TQE_FIL_DIF FORMAT "%6.5"
 /begin AXIS_DESCR COM_AXIS tqe_fil_dif _CNV_A_R_LINEAR_____86_CM 8 -1024. 1023.96875 FORMAT "%6.2" AXIS_PTS_REF ldp_tqe_fil_dif_ip_crlc_tqe_sp /end AXIS_DESCR
/end CHARACTERISTIC
/begin AXIS_PTS ldp_tqe_fil_dif_ip_crlc_tqe_sp "" 0x8425c4 tqe_fil_dif _REC_AXS_20_u2 2047.96875 _CNV_A_R_LINEAR_____86_CM 8 -1024. 1023.96875 FORMAT "%6.2" /end AXIS_PTS
/begin MEASUREMENT tq_lim_gb_prot_raw "Torque limitation for gearbox protection after gradient limiter" SWORD _CNV_A_R_LINEAR_____52_CM 1 0. -1024. 1023.96875 DISPLAY_IDENTIFIER TQ_LIM_GB_PROT_RAW ECU_ADDRESS 0x7fb4dc BYTE_ORDER MSB_LAST FORMAT "%6.2" /end MEASUREMENT
/begin MEASUREMENT tq_lim_gb_prot "Torque limitation for gearbox protection" SWORD _CNV_A_R_LINEAR_____52_CM 1 0. -1024. 1023.96875 DISPLAY_IDENTIFIER TQ_LIM_GB_PROT ECU_ADDRESS 0x7fa2f0 BYTE_ORDER MSB_LAST FORMAT "%6.2" /end MEASUREMENT
/begin MEASUREMENT tqi_lim_gb_prot "Indicated torque limitation for gearbox protection" SWORD _CNV_A_R_LINEAR_____52_CM 1 0. -1024. 1023.96875 DISPLAY_IDENTIFIER TQI_LIM_GB_PROT ECU_ADDRESS 0x7fa2f2 BYTE_ORDER MSB_LAST FORMAT "%6.2" /end MEASUREMENT
/begin CHARACTERISTIC c_dri_mid "threshold from middle to high gear" VALUE 0x84fc9d _REC_VAL_20_u1 15. _CNV_A_R_LINEAR_____0_CM 0. 15. DISPLAY_IDENTIFIER C_DRI_MID FORMAT "%2.0" /end CHARACTERISTIC
/begin CHARACTERISTIC c_dri_l "threshold from low to middle gear" VALUE 0x84fc9c _REC_VAL_20_u1 15. _CNV_A_R_LINEAR_____0_CM 0. 15. DISPLAY_IDENTIFIER C_DRI_L FORMAT "%2.0" /end CHARACTERISTIC
/begin CHARACTERISTIC c_lgrd_tq_err_tq_gb_prot "Gradient limitation for the TQ_LIM_GB_PROT with error" VALUE 0x84fd84 _REC_VAL_20_u2 1023.96875 _CNV_A_R_LINEAR_____52_CM 0. 1023.96875 DISPLAY_IDENTIFIER C_LGRD_TQ_ERR_TQ_GB_PROT FORMAT "%6.2" /end CHARACTERISTIC
/begin CHARACTERISTIC c_lgrd_tq_lim_gb_prot "Gradient limitation for the TQ_LIM_GB_PROT" VALUE 0x84fd86 _REC_VAL_20_u2 1023.96875 _CNV_A_R_LINEAR_____52_CM 0. 1023.96875 DISPLAY_IDENTIFIER C_LGRD_TQ_LIM_GB_PROT FORMAT "%6.2" /end CHARACTERISTIC
/begin CHARACTERISTIC c_sf_conf_gb_gb_prot "Calibratable gearbox configuration" VALUE 0x84feee _REC_VAL_20_u1 255. _CNV_A_R_LINEAR_____0_CM 0. 255. DISPLAY_IDENTIFIER C_SF_CONF_GB_GB_PROT FORMAT "%3.0" /end CHARACTERISTIC
/begin CHARACTERISTIC lc_sf_conf_gb_man "Allows setting a gearbox configuration for the gearbox protection" VALUE 0x850161 _REC_VAL_20_u1 1. _CNV_A_R_LINEAR_____0_CM 0. 1. DISPLAY_IDENTIFIER LC_SF_CONF_GB_MAN FORMAT "%1.0" /end CHARACTERISTIC
/begin CHARACTERISTIC c_fac_tqe_dif_gb_prot "factor for actual engine torque for gear protection limitation" VALUE 0x84fd54 _REC_VAL_20_u2 1.9999696 _CNV_A_R_LINEAR_____48_CM 0. 1.9999696 DISPLAY_IDENTIFIER C_FAC_TQE_DIF_GB_PROT FORMAT "%6.5" /end CHARACTERISTIC
/begin CHARACTERISTIC ip_tq_gb_prot_h__n "TQGBP: Maximum torque for gearbox protection in high gears" CURVE 0x84f75a _REC_CUR_20_u2_u2 2047.96875 _CNV_A_R_LINEAR_____86_CM -1024. 1023.96875 DISPLAY_IDENTIFIER IP_TQ_GB_PROT_H__N FORMAT "%6.2"
 /begin AXIS_DESCR COM_AXIS n _CNV_A_R_LINEAR_____5_CM 20 0. 6375. FORMAT "%4.0" AXIS_PTS_REF ldpm_n_ip_tqi_gb_prot /end AXIS_DESCR
/end CHARACTERISTIC
/begin AXIS_PTS ldpm_n_ip_tqi_gb_prot "" 0x8436da n _REC_AXS_20_u2 6375. _CNV_A_R_LINEAR_____5_CM 20 0. 6375. FORMAT "%4.0" /end AXIS_PTS
/begin CHARACTERISTIC ip_tq_gb_prot_l__n "TQGBP: Maximum torque for gearbox protection in low gears" CURVE 0x84f782 _REC_CUR_20_u2_u2 2047.96875 _CNV_A_R_LINEAR_____86_CM -1024. 1023.96875 DISPLAY_IDENTIFIER IP_TQ_GB_PROT_L__N FORMAT "%6.2"
 /begin AXIS_DESCR COM_AXIS n _CNV_A_R_LINEAR_____5_CM 20 0. 6375. FORMAT "%4.0" AXIS_PTS_REF ldpm_n_ip_tqi_gb_prot /end AXIS_DESCR
/end CHARACTERISTIC
/begin CHARACTERISTIC ip_tq_gb_prot_mid__n "TQGBP: Maximum torque for gearbox protection in medium gears" CURVE 0x84f7aa _REC_CUR_20_u2_u2 2047.96875 _CNV_A_R_LINEAR_____86_CM -1024. 1023.96875 DISPLAY_IDENTIFIER IP_TQ_GB_PROT_MID__N FORMAT "%6.2"
 /begin AXIS_DESCR COM_AXIS n _CNV_A_R_LINEAR_____5_CM 20 0. 6375. FORMAT "%4.0" AXIS_PTS_REF ldpm_n_ip_tqi_gb_prot /end AXIS_DESCR
/end CHARACTERISTIC
/begin CHARACTERISTIC ip_tq_gb_prot_rvl_n "TQGBP: Maximum torque for gearbox protection in reverse gears" CURVE 0x84f7d2 _REC_CUR_20_u2_u2 2047.96875 _CNV_A_R_LINEAR_____86_CM -1024. 1023.96875 DISPLAY_IDENTIFIER IP_TQ_GB_PROT_RVL_N FORMAT "%6.2"
 /begin AXIS_DESCR COM_AXIS n _CNV_A_R_LINEAR_____5_CM 20 0. 6375. FORMAT "%4.0" AXIS_PTS_REF ldpm_n_ip_gb_prot /end AXIS_DESCR
/end CHARACTERISTIC
/begin AXIS_PTS ldpm_n_ip_gb_prot "" 0x8430bc n _REC_AXS_20_u2 6375. _CNV_A_R_LINEAR_____5_CM 20 0. 6375. FORMAT "%4.0" /end AXIS_PTS
/begin CHARACTERISTIC ip_tq_gb_prot_err__n "TQGBP: Maximum torque at flywheel for gearbox protection when CAN error" CURVE 0x84f732 _REC_CUR_20_u2_u2 2047.96875 _CNV_A_R_LINEAR_____86_CM -1024. 1023.96875 DISPLAY_IDENTIFIER IP_TQ_GB_PROT_ERR__N FORMAT "%6.2"
 /begin AXIS_DESCR COM_AXIS n _CNV_A_R_LINEAR_____5_CM 20 0. 6375. FORMAT "%4.0" AXIS_PTS_REF ldpm_n_ip_gb_prot /end AXIS_DESCR
/end CHARACTERISTIC
/begin CHARACTERISTIC ip_tq_min_gb_prot "TQGBP: Minimum torque at clutch for the gearbox protection" CURVE 0x84f8c2 _REC_CUR_20_u2_u2 2047.96875 _CNV_A_R_LINEAR_____86_CM -1024. 1023.96875 DISPLAY_IDENTIFIER IP_TQ_MIN_GB_PROT FORMAT "%6.2"
 /begin AXIS_DESCR COM_AXIS n _CNV_A_R_LINEAR_____5_CM 6 0. 6375. FORMAT "%4.0" AXIS_PTS_REF ldp_n_ip_tq_min_gb_prot /end AXIS_DESCR
/end CHARACTERISTIC
/begin AXIS_PTS ldp_n_ip_tq_min_gb_prot "" 0x841efa n _REC_AXS_20_u2 6375. _CNV_A_R_LINEAR_____5_CM 6 0. 6375. FORMAT "%4.0" /end AXIS_PTS
/begin CHARACTERISTIC c_t_dly_diag_gs "delay time for activation of ramp function" VALUE 0x84ff66 _REC_VAL_20_u1 2.55 _CNV_A_R_LINEAR_____226_CM 0. 2.55 DISPLAY_IDENTIFIER C_T_DLY_DIAG_GS FORMAT "%4.2" /end CHARACTERISTIC
/begin CHARACTERISTIC c_tqi_gs_slow_hys "additional hysteresis for TQI_GS_REQ to use TQI_GS_SLOW_DEC" VALUE 0x85006e _REC_VAL_20_u1 0.498046875 _CNV_A_R_LINEAR_____338_CM 0. 0.498046875 DISPLAY_IDENTIFIER C_TQI_GS_SLOW_HYS FORMAT "%5.3" /end CHARACTERISTIC
/begin MEASUREMENT lv_tcu_disable "logical variable for disabling GS intervention due to EMS error" UBYTE _CNV_S_2_RANGE__0___85_CM 1 0. 0. 1. DISPLAY_IDENTIFIER LV_TCU_DISABLE ECU_ADDRESS 0x7fbbf3 BIT_MASK 0x1 /end MEASUREMENT
/begin MEASUREMENT lv_gs_ena "logical variable for GS intervention enabling" UBYTE _CNV_S_2_RANGE__0___85_CM 1 0. 0. 1. DISPLAY_IDENTIFIER LV_GS_ENA ECU_ADDRESS 0x7fbbf4 BIT_MASK 0x1 /end MEASUREMENT
/begin MEASUREMENT tqi_gs_fast_inc "torque increment for fast torque intervention during gear shift" UWORD _CNV_A_R_LINEAR_____52_CM 1 0. 0. 1023.96875 DISPLAY_IDENTIFIER TQI_GS_FAST_INC ECU_ADDRESS 0x7fa2f6 BYTE_ORDER MSB_LAST FORMAT "%7.2" /end MEASUREMENT
/begin MEASUREMENT tqi_gs_slow_dec "torque decrement for slow torque intervention during gear shift" UWORD _CNV_A_R_LINEAR_____52_CM 1 0. 0. 1023.96875 DISPLAY_IDENTIFIER TQI_GS_SLOW_DEC ECU_ADDRESS 0x7fa2f8 BYTE_ORDER MSB_LAST FORMAT "%7.2" /end MEASUREMENT
/begin MEASUREMENT tqi_gs_slow_inc "torque increment for slow torque intervention during gear shift" UWORD _CNV_A_R_LINEAR_____52_CM 1 0. 0. 1023.96875 DISPLAY_IDENTIFIER TQI_GS_SLOW_INC ECU_ADDRESS 0x7fa2fa BYTE_ORDER MSB_LAST FORMAT "%7.2" /end MEASUREMENT
/begin MEASUREMENT lv_gs_dec_act "logical variable for torque intervention due to gear shift" UBYTE _CNV_S_2_RANGE__0___85_CM 1 0. 0. 1. DISPLAY_IDENTIFIER LV_GS_DEC_ACT ECU_ADDRESS 0x7fbbf5 BIT_MASK 0x1 /end MEASUREMENT
/begin MEASUREMENT tqi_gs_fast_dec "torque decrement for fast torque intervention during gear shift" UWORD _CNV_A_R_LINEAR_____52_CM 1 0. 0. 1023.96875 DISPLAY_IDENTIFIER TQI_GS_FAST_DEC ECU_ADDRESS 0x7fa2f4 BYTE_ORDER MSB_LAST FORMAT "%7.2" /end MEASUREMENT
/begin MEASUREMENT tqi_gs_bol "Bottom limit for GS torque request to avoid engine stall" UWORD _CNV_A_R_LINEAR_____52_CM 1 0. 0. 1023.96875 DISPLAY_IDENTIFIER TQI_GS_BOL ECU_ADDRESS 0x7fa2fc BYTE_ORDER MSB_LAST FORMAT "%7.2" /end MEASUREMENT
/begin CHARACTERISTIC c_lgrd_tqi_inc_diag_gs "limitation gradient for controlled reset in case of emergency operation" VALUE 0x84fd90 _REC_VAL_20_u2 1023.96875 _CNV_A_R_LINEAR_____339_CM 0. 1023.96875 DISPLAY_IDENTIFIER C_LGRD_TQI_INC_DIAG_GS FORMAT "%7.2" /end CHARACTERISTIC
/begin CHARACTERISTIC c_n_sp_is_ratio_max_gs_lim "Maximum threshold for N / N_SP_IS relation to activate TQI_GS_REQ limitation( to avoid engine stall by GS intervention)" VALUE 0x84fe22 _REC_VAL_20_u2 7.9998779296875 _CNV_A_R_LINEAR_____340_CM 0. 7.9998779296875 DISPLAY_IDENTIFIER C_N_SP_IS_RATIO_MAX_GS_LIM FORMAT "%6.4" /end CHARACTERISTIC
/begin AXIS_PTS ldp_n__lgrd_tqi_gs_bol "" 0x84408c n _REC_AXS_20_u2 8160. _CNV_A_R_LINEAR_____154_CM 4 0. 8160. FORMAT "%4.0" /end AXIS_PTS
/begin CHARACTERISTIC ip_lgrd_tqi_gs_bol "Change limitation to avoid torque jumps after activation of TQI_GS_REQ limitation" CURVE 0x84855c _REC_CUR_20_u2_u2 1023.96875 _CNV_A_R_LINEAR_____52_CM 0. 1023.96875 DISPLAY_IDENTIFIER IP_LGRD_TQI_GS_BOL FORMAT "%7.2"
 /begin AXIS_DESCR COM_AXIS n _CNV_A_R_LINEAR_____154_CM 4 0. 8160. FORMAT "%4.0" AXIS_PTS_REF ldp_n__lgrd_tqi_gs_bol /end AXIS_DESCR
/end CHARACTERISTIC
/begin MEASUREMENT lv_msr_ena "Logical variable for MSR intervention enabling" UBYTE _CNV_S_2_RANGE__0___85_CM 1 0. 0. 1. DISPLAY_IDENTIFIER LV_MSR_ENA ECU_ADDRESS 0x7fbbd0 BIT_MASK 0x1 /end MEASUREMENT
/begin CHARACTERISTIC c_vs_min_msr "Minimum vehicle speed for MSR activation (default 10 km/h)" VALUE 0x8500fe _REC_VAL_20_u1 255. _CNV_A_R_LINEAR_____245_CM 0. 255. DISPLAY_IDENTIFIER C_VS_MIN_MSR FORMAT "%3.0" /end CHARACTERISTIC
/begin MEASUREMENT tqi_msr_fast "Value for fast torque intervention due to MSR" SWORD _CNV_A_R_LINEAR_____52_CM 1 0. 0. 1023.96875 DISPLAY_IDENTIFIER TQI_MSR_FAST ECU_ADDRESS 0x7fa27c BYTE_ORDER MSB_LAST FORMAT "%7.2" /end MEASUREMENT
/begin MEASUREMENT tqi_msr_slow "Value for slow torque intervention due to MSR" SWORD _CNV_A_R_LINEAR_____52_CM 1 0. 0. 1023.96875 DISPLAY_IDENTIFIER TQI_MSR_SLOW ECU_ADDRESS 0x7fa27e BYTE_ORDER MSB_LAST FORMAT "%7.2" /end MEASUREMENT
/begin MEASUREMENT lv_msr "Logical variable for torque intervention due to MSR" UBYTE _CNV_S_2_RANGE__0___85_CM 1 0. 0. 1. DISPLAY_IDENTIFIER LV_MSR ECU_ADDRESS 0x7fbbd1 BIT_MASK 0x1 /end MEASUREMENT
/begin MEASUREMENT tq_msr_int "MSR requested torque x zeit" UWORD _CNV_A_R_LINEAR_____227_CM 1 0. 0. 655.35 DISPLAY_IDENTIFIER TQ_MSR_INT ECU_ADDRESS 0x7fa27a BYTE_ORDER MSB_LAST FORMAT "%6.2" /end MEASUREMENT
/begin MEASUREMENT lv_msr_nplau "Bool for non plausible MSR torque request" UBYTE _CNV_S_2_RANGE__0___85_CM 1 0. 0. 1. DISPLAY_IDENTIFIER LV_MSR_NPLAU ECU_ADDRESS 0x7fbbd3 BIT_MASK 0x1 /end MEASUREMENT
/begin CHARACTERISTIC c_tq_msr_int_max "Theshold for MSR intervention is not plausible (default 100 Nms)" VALUE 0x850064 _REC_VAL_20_u2 655.35 _CNV_A_R_LINEAR_____227_CM 0. 655.35 DISPLAY_IDENTIFIER C_TQ_MSR_INT_MAX FORMAT "%6.2" /end CHARACTERISTIC
/begin MEASUREMENT lv_msr_ena_can_cnt "Flag for MSR CAN-counter (1= o.k.; 0 = failure)" UBYTE _CNV_S_2_RANGE__0___85_CM 1 0. 0. 1. DISPLAY_IDENTIFIER LV_MSR_ENA_CAN_CNT ECU_ADDRESS 0x7fbbd4 BIT_MASK 0x1 /end MEASUREMENT
/begin CHARACTERISTIC c_t_max_tcs1_miss "Maximum time for missing TCS1 CAN-counter message" VALUE 0x84ffc4 _REC_VAL_20_u1 2.55 _CNV_A_R_LINEAR_____226_CM 0. 2.55 DISPLAY_IDENTIFIER C_T_MAX_TCS1_MISS FORMAT "%4.2" /end CHARACTERISTIC
/begin MEASUREMENT lv_msr_act "Logical variable for torque intervention due to MSR" UBYTE _CNV_S_2_RANGE__0___85_CM 1 0. 0. 1. DISPLAY_IDENTIFIER LV_MSR_ACT ECU_ADDRESS 0x7fbbd2 BIT_MASK 0x1 /end MEASUREMENT
/begin MEASUREMENT lv_tcs_disable "Logical variable for disabling TCS/MSR intervention due to EMS error" UBYTE _CNV_S_2_RANGE__0___85_CM 1 0. 0. 1. DISPLAY_IDENTIFIER LV_TCS_DISABLE ECU_ADDRESS 0x7fbbd5 BIT_MASK 0x1 /end MEASUREMENT
/begin MEASUREMENT lv_asr_ena "Logical variable for TCS intervention enabling" UBYTE _CNV_S_2_RANGE__0___85_CM 1 0. 0. 1. DISPLAY_IDENTIFIER LV_ASR_ENA ECU_ADDRESS 0x7fbbd6 BIT_MASK 0x1 /end MEASUREMENT
/begin MEASUREMENT tqi_asr_fast "Value for fast torque intervention due to ASR" SWORD _CNV_A_R_LINEAR_____52_CM 1 0. 0. 1023.96875 DISPLAY_IDENTIFIER TQI_ASR_FAST ECU_ADDRESS 0x7fa280 BYTE_ORDER MSB_LAST FORMAT "%7.2" /end MEASUREMENT
/begin MEASUREMENT tqi_asr_slow "Value for slow torque intervention due to ASR" SWORD _CNV_A_R_LINEAR_____52_CM 1 0. 0. 1023.96875 DISPLAY_IDENTIFIER TQI_ASR_SLOW ECU_ADDRESS 0x7fa282 BYTE_ORDER MSB_LAST FORMAT "%7.2" /end MEASUREMENT
/begin MEASUREMENT lv_asr "Logical variable for torque intervention due to ASR" UBYTE _CNV_S_2_RANGE__0___85_CM 1 0. 0. 1. DISPLAY_IDENTIFIER LV_ASR ECU_ADDRESS 0x7fbbd7 BIT_MASK 0x1 /end MEASUREMENT
/begin MEASUREMENT lv_asr_act "Logical variable for torque intervention due to ASR" UBYTE _CNV_S_2_RANGE__0___85_CM 1 0. 0. 1. DISPLAY_IDENTIFIER LV_ASR_ACT ECU_ADDRESS 0x7fbbd8 BIT_MASK 0x1 /end MEASUREMENT
/begin CHARACTERISTIC c_lgrd_tqi_inc_diag_asr "Limiting gradient for ASR emergency ramp function (default  1,2 Nm/20ms)" VALUE 0x84fd8e _REC_VAL_20_s2 1023.96875 _CNV_A_R_LINEAR_____341_CM 0. 1023.96875 DISPLAY_IDENTIFIER C_LGRD_TQI_INC_DIAG_ASR FORMAT "%7.2" /end CHARACTERISTIC
/begin CHARACTERISTIC c_t_dly_diag_asr "Delay time for activation of ASR emergency ramp function (default 0s)" VALUE 0x84ff63 _REC_VAL_20_u1 2.55 _CNV_A_R_LINEAR_____226_CM 0. 2.55 DISPLAY_IDENTIFIER C_T_DLY_DIAG_ASR FORMAT "%4.2" /end CHARACTERISTIC
/begin CHARACTERISTIC c_n_sp_is_ratio_max_asr_lim "Maximum threshold for N/N_SP_IS relation to activate TQI_ASR_REQ_ ... limitation ( To avoid engine stall by ASR)" VALUE 0x84fe20 _REC_VAL_20_u2 7.9998779296875 _CNV_A_R_LINEAR_____340_CM 0. 7.9998779296875 DISPLAY_IDENTIFIER C_N_SP_IS_RATIO_MAX_ASR_LIM FORMAT "%6.4" /end CHARACTERISTIC
/begin CHARACTERISTIC ip_lgrd_tqi_asr_bol "Change limitation to avoid torque jumps after activation of TQI_ASR_REQ_ ... limitation" CURVE 0x848554 _REC_CUR_20_u2_u2 1023.96875 _CNV_A_R_LINEAR_____52_CM 0. 1023.96875 DISPLAY_IDENTIFIER IP_LGRD_TQI_ASR_BOL FORMAT "%7.2"
 /begin AXIS_DESCR COM_AXIS n _CNV_A_R_LINEAR_____154_CM 4 0. 8160. FORMAT "%4.0" AXIS_PTS_REF ldp_n__lgrd_tqi_asr_bol /end AXIS_DESCR
/end CHARACTERISTIC
/begin AXIS_PTS ldp_n__lgrd_tqi_asr_bol "" 0x844082 n _REC_AXS_20_u2 8160. _CNV_A_R_LINEAR_____154_CM 4 0. 8160. FORMAT "%4.0" /end AXIS_PTS
/begin MEASUREMENT lv_slm_bol_act "Flag indicating if the blue smoke limitation is active" UBYTE _CNV_S_2_RANGE______11_CM 1 0. 0. 1. DISPLAY_IDENTIFIER LV_SLM_BOL_ACT ECU_ADDRESS 0x7fbbe5 /end MEASUREMENT
/begin MEASUREMENT tqi_min "Indicated Engine Torque of Idle Speed Controller" SWORD _CNV_A_R_LINEAR_____52_CM 1 0. -1024. 1023.96875 DISPLAY_IDENTIFIER TQI_MIN ECU_ADDRESS 0x7fa2b0 BYTE_ORDER MSB_LAST FORMAT "%6.2" /end MEASUREMENT
/begin MEASUREMENT tq_ltc_dif_up "torque increment during positive transient" SWORD _CNV_A_R_LINEAR_____52_CM 1 0. -1024. 1023.96875 DISPLAY_IDENTIFIER TQ_LTC_DIF_UP ECU_ADDRESS 0x7f97d8 BYTE_ORDER MSB_LAST FORMAT "%6.2" /end MEASUREMENT
/begin MEASUREMENT tq_ltc_thd_up "torque threshold for positive transient" SWORD _CNV_A_R_LINEAR_____52_CM 1 0. -1024. 1023.96875 DISPLAY_IDENTIFIER TQ_LTC_THD_UP ECU_ADDRESS 0x7f97da BYTE_ORDER MSB_LAST FORMAT "%6.2" /end MEASUREMENT
/begin MEASUREMENT tq_ltc_dif_down "torque decrement during negative transient" SWORD _CNV_A_R_LINEAR_____52_CM 1 0. -1024. 1023.96875 DISPLAY_IDENTIFIER TQ_LTC_DIF_DOWN ECU_ADDRESS 0x7f97dc BYTE_ORDER MSB_LAST FORMAT "%6.2" /end MEASUREMENT
/begin MEASUREMENT tq_ltc_thd_down_1 "upper torque threshold for negative transient" SWORD _CNV_A_R_LINEAR_____52_CM 1 0. -1024. 1023.96875 DISPLAY_IDENTIFIER TQ_LTC_THD_DOWN_1 ECU_ADDRESS 0x7f97de BYTE_ORDER MSB_LAST FORMAT "%6.2" /end MEASUREMENT
/begin CHARACTERISTIC c_ctr_dri_up_dly_ltc "number of calculations (10ms) to delay the gear detection" VALUE 0x85c952 _REC_VAL_20_u1 255. _CNV_A_R_LINEAR_____0_CM 0. 255. DISPLAY_IDENTIFIER C_CTR_DRI_UP_DLY_LTC FORMAT "%3.0" /end CHARACTERISTIC
/begin CHARACTERISTIC ip_tq_ltc_thd_down_1__n__dri "TQ_LTCP: threshold LTC down 1" MAP 0x85b784 _REC_MAP_20_u2_u2_u1 2047.96875 _CNV_A_R_LINEAR_____86_CM -1024. 1023.96875 DISPLAY_IDENTIFIER IP_TQ_LTC_THD_DOWN_1__N__DRI FORMAT "%6.2"
 /begin AXIS_DESCR COM_AXIS n _CNV_A_R_LINEAR_____5_CM 6 0. 6375. FORMAT "%4.0" AXIS_PTS_REF ldpm_n_ip_tq_ltc /end AXIS_DESCR
 /begin AXIS_DESCR COM_AXIS dri _CNV_A_R_LINEAR_____0_CM 7 0. 6. FORMAT "%1.0" AXIS_PTS_REF ldpm_dri_ip_tq_ltc /end AXIS_DESCR
/end CHARACTERISTIC
/begin AXIS_PTS ldpm_n_ip_tq_ltc "threshold LTC down 1" 0x8435a2 n _REC_AXS_20_u2 6375. _CNV_A_R_LINEAR_____5_CM 6 0. 6375. FORMAT "%4.0" /end AXIS_PTS
/begin AXIS_PTS ldpm_dri_ip_tq_ltc "threshold LTC down 1" 0x842b5e dri _REC_AXS_20_u1 6. _CNV_A_R_LINEAR_____0_CM 7 0. 6. FORMAT "%1.0" /end AXIS_PTS
/begin CHARACTERISTIC ip_tq_ltc_thd_up__n__dri "TQ_LTCP: threshold LTC up" MAP 0x85b7d8 _REC_MAP_20_u2_u2_u1 2047.96875 _CNV_A_R_LINEAR_____86_CM -1024. 1023.96875 DISPLAY_IDENTIFIER IP_TQ_LTC_THD_UP__N__DRI FORMAT "%6.2"
 /begin AXIS_DESCR COM_AXIS n _CNV_A_R_LINEAR_____5_CM 6 0. 6375. FORMAT "%4.0" AXIS_PTS_REF ldpm_n_ip_tq_ltc /end AXIS_DESCR
 /begin AXIS_DESCR COM_AXIS dri _CNV_A_R_LINEAR_____0_CM 7 0. 6. FORMAT "%1.0" AXIS_PTS_REF ldpm_dri_ip_tq_ltc /end AXIS_DESCR
/end CHARACTERISTIC
/begin CHARACTERISTIC ip_fac_tq_up__n__dri "TQ_LTCP: scaling factor for torque limitation at low N and torque increase" MAP 0x85304c _REC_MAP_20_u2_u2_u1 1.9999696 _CNV_A_R_LINEAR_____48_CM 0. 1.9999696 DISPLAY_IDENTIFIER IP_FAC_TQ_UP__N__DRI FORMAT "%6.5"
 /begin AXIS_DESCR COM_AXIS n _CNV_A_R_LINEAR_____5_CM 6 0. 6375. FORMAT "%4.0" AXIS_PTS_REF ldpm_n_ip_tq_ltc /end AXIS_DESCR
 /begin AXIS_DESCR COM_AXIS dri _CNV_A_R_LINEAR_____0_CM 7 0. 6. FORMAT "%1.0" AXIS_PTS_REF ldpm_dri_ip_tq_ltc /end AXIS_DESCR
/end CHARACTERISTIC
/begin CHARACTERISTIC ip_tq_dif_up__tq_sp_clu__dri "TQ_LTCP: torque increment for transient up" MAP 0x85b730 _REC_MAP_20_u2_u2_u1 1023.96875 _CNV_A_R_LINEAR_____52_CM 0. 1023.96875 DISPLAY_IDENTIFIER IP_TQ_DIF_UP__TQ_SP_CLU__DRI FORMAT "%6.2"
 /begin AXIS_DESCR COM_AXIS tq_sp_clu _CNV_A_R_LINEAR_____86_CM 6 -1024. 1023.96875 FORMAT "%6.2" AXIS_PTS_REF ldpm_tq_sp_clu_ip_tq_dif_up /end AXIS_DESCR
 /begin AXIS_DESCR COM_AXIS dri _CNV_A_R_LINEAR_____0_CM 7 0. 6. FORMAT "%1.0" AXIS_PTS_REF ldpm_dri_ip_tq_ltc /end AXIS_DESCR
/end CHARACTERISTIC
/begin AXIS_PTS ldpm_tq_sp_clu_ip_tq_dif_up "torque increment for transient up" 0x84382a tq_sp_clu _REC_AXS_20_u2 2047.96875 _CNV_A_R_LINEAR_____86_CM 6 -1024. 1023.96875 FORMAT "%6.2" /end AXIS_PTS
/begin CHARACTERISTIC ip_fac_tq_dif_up__pv_av__n "TQ_LTCP: scaling factor for the torque gradient up" MAP 0x852bc8 _REC_MAP_20_u2_u2_u2 3.99998471 _CNV_A_R_LINEAR_____59_CM 0. 3.99998471 DISPLAY_IDENTIFIER IP_FAC_TQ_DIF_UP__PV_AV__N FORMAT "%6.5"
 /begin AXIS_DESCR COM_AXIS pv_av _CNV_A_R_LINEAR_____78_CM 4 0. 100. FORMAT "%4.2" AXIS_PTS_REF ldpm_pv_av_ip_fac_tq_dif /end AXIS_DESCR
 /begin AXIS_DESCR COM_AXIS n _CNV_A_R_LINEAR_____5_CM 6 0. 6375. FORMAT "%4.0" AXIS_PTS_REF ldpm_n_ip_tq_ltc /end AXIS_DESCR
/end CHARACTERISTIC
/begin AXIS_PTS ldpm_pv_av_ip_fac_tq_dif "scaling factor for the torque gradient up" 0x843738 pv_av _REC_AXS_20_u2 100. _CNV_A_R_LINEAR_____78_CM 4 0. 100. FORMAT "%4.2" /end AXIS_PTS
/begin CHARACTERISTIC ip_fac_tq_down__n__dri "TQ_LTCP: scaling factor for torque limitation at low N and torque decrease" MAP 0x852bf8 _REC_MAP_20_u2_u2_u1 1.9999696 _CNV_A_R_LINEAR_____48_CM 0. 1.9999696 DISPLAY_IDENTIFIER IP_FAC_TQ_DOWN__N__DRI FORMAT "%6.5"
 /begin AXIS_DESCR COM_AXIS n _CNV_A_R_LINEAR_____5_CM 6 0. 6375. FORMAT "%4.0" AXIS_PTS_REF ldpm_n_ip_tq_ltc /end AXIS_DESCR
 /begin AXIS_DESCR COM_AXIS dri _CNV_A_R_LINEAR_____0_CM 7 0. 6. FORMAT "%1.0" AXIS_PTS_REF ldpm_dri_ip_tq_ltc /end AXIS_DESCR
/end CHARACTERISTIC
/begin CHARACTERISTIC ip_tq_dif_down__tq_sp_clu__dri "TQ_LTCP: torque decrement for transient down" MAP 0x85b6dc _REC_MAP_20_u2_u2_u1 1023.96875 _CNV_A_R_LINEAR_____52_CM 0. 1023.96875 DISPLAY_IDENTIFIER IP_TQ_DIF_DOWN__TQ_SP_CLU__DRI FORMAT "%6.2"
 /begin AXIS_DESCR COM_AXIS tq_sp_clu _CNV_A_R_LINEAR_____86_CM 6 -1024. 1023.96875 FORMAT "%6.2" AXIS_PTS_REF ldpm_tq_sp_clu_ip_tq_dif_down /end AXIS_DESCR
 /begin AXIS_DESCR COM_AXIS dri _CNV_A_R_LINEAR_____0_CM 7 0. 6. FORMAT "%1.0" AXIS_PTS_REF ldpm_dri_ip_tq_ltc /end AXIS_DESCR
/end CHARACTERISTIC
/begin AXIS_PTS ldpm_tq_sp_clu_ip_tq_dif_down "torque decrement for transient down" 0x84381c tq_sp_clu _REC_AXS_20_u2 2047.96875 _CNV_A_R_LINEAR_____86_CM 6 -1024. 1023.96875 FORMAT "%6.2" /end AXIS_PTS
/begin CHARACTERISTIC ip_fac_tq_dif_down__pv_av__n "TQ_LTCP: scaling factor for the torque gradient down" MAP 0x852b98 _REC_MAP_20_u2_u2_u2 3.99998471 _CNV_A_R_LINEAR_____59_CM 0. 3.99998471 DISPLAY_IDENTIFIER IP_FAC_TQ_DIF_DOWN__PV_AV__N FORMAT "%6.5"
 /begin AXIS_DESCR COM_AXIS pv_av _CNV_A_R_LINEAR_____78_CM 4 0. 100. FORMAT "%4.2" AXIS_PTS_REF ldpm_pv_av_ip_fac_tq_dif /end AXIS_DESCR
 /begin AXIS_DESCR COM_AXIS n _CNV_A_R_LINEAR_____5_CM 6 0. 6375. FORMAT "%4.0" AXIS_PTS_REF ldpm_n_ip_tq_ltc /end AXIS_DESCR
/end CHARACTERISTIC
/begin CHARACTERISTIC c_vb_min_vb_diag "Minimale Batteriespannung zur diagnose" VALUE 0x8500f1 _REC_VAL_20_u1 25.8984375 _CNV_A_R_LINEAR_____349_CM 0. 25.8984375 DISPLAY_IDENTIFIER C_VB_MIN_VB_DIAG FORMAT "%9.6" /end CHARACTERISTIC
/begin CHARACTERISTIC c_n_min_vb_diag "Minimale Drehzahl zur diagnose der Batteriespannung" VALUE 0x84fdfa _REC_VAL_20_u1 8160. _CNV_A_R_LINEAR_____81_CM 0. 8160. DISPLAY_IDENTIFIER C_N_MIN_VB_DIAG FORMAT "%4.0" /end CHARACTERISTIC
/begin CHARACTERISTIC c_abc_inc_vb "Inkrement Entprellzaehler" VALUE 0x84faf4 _REC_VAL_20_u1 255. _CNV_A_R_LINEAR_____1_CM 0. 255. DISPLAY_IDENTIFIER C_ABC_INC_VB FORMAT "%3.0" /end CHARACTERISTIC
/begin CHARACTERISTIC c_abc_max_vb "Maximum Entprellzaehler" VALUE 0x84fb80 _REC_VAL_20_u1 254. _CNV_A_R_LINEAR_____1_CM 1. 255. DISPLAY_IDENTIFIER C_ABC_MAX_VB FORMAT "%3.0" /end CHARACTERISTIC
/begin MEASUREMENT lv_err_vb "Fehler Batteriespannung entprellt" UBYTE _CNV_S_2_RANGE__0___85_CM 1 0. 0. 1. DISPLAY_IDENTIFIER LV_ERR_VB ECU_ADDRESS 0x7fb934 BIT_MASK 0x1 /end MEASUREMENT
/begin CHARACTERISTIC c_abc_inc_tco_1_2_plaus "anti bounce counter increment for diagnosis instance TCO_1_2_PLAUS" VALUE 0x84fad0 _REC_VAL_20_u1 255. _CNV_A_R_LINEAR_____0_CM 0. 255. DISPLAY_IDENTIFIER C_ABC_INC_TCO_1_2_PLAUS FORMAT "%3.0" /end CHARACTERISTIC
/begin CHARACTERISTIC c_abc_max_tco_1_2_plaus "maximum value of anti bounce counter for diagnosis instance TCO_1_2_PLAUS" VALUE 0x84fb5c _REC_VAL_20_u1 255. _CNV_A_R_LINEAR_____0_CM 0. 255. DISPLAY_IDENTIFIER C_ABC_MAX_TCO_1_2_PLAUS FORMAT "%3.0" /end CHARACTERISTIC
/begin MEASUREMENT sf_rng_tco_1_2_plaus "Status flag used to select the allowed range of the difference of TCO_1_MES and TCO_2_MES" UBYTE _CNV_S_3_TCO_range_350_CM 1 0. 0. 2. DISPLAY_IDENTIFIER SF_RNG_TCO_1_2_PLAUS ECU_ADDRESS 0x7fbe09 /end MEASUREMENT
/begin CHARACTERISTIC c_temp_1_2_tco_1_2_plaus_cold "c_temp_1_2_tco_1_2_plaus_cold" VALUE 0x85ccca _REC_VAL_20_u1 255. _CNV_A_R_LINEAR_____18_CM -50. 205. DISPLAY_IDENTIFIER C_TEMP_1_2_TCO_1_2_PLAUS_COLD FORMAT "%3.0" /end CHARACTERISTIC
/begin CHARACTERISTIC c_temp_1_2_tco_1_2_plaus_wup "c_temp_1_2_tco_1_2_plaus_wup" VALUE 0x85cccc _REC_VAL_20_u1 255. _CNV_A_R_LINEAR_____18_CM -50. 205. DISPLAY_IDENTIFIER C_TEMP_1_2_TCO_1_2_PLAUS_WUP FORMAT "%3.0" /end CHARACTERISTIC
/begin CHARACTERISTIC c_temp_1_2_tco_1_2_plaus_hot "Maximal difference TCO_1_MES - TCO_2_MES" VALUE 0x85cccb _REC_VAL_20_u1 255. _CNV_A_R_LINEAR_____18_CM -50. 205. DISPLAY_IDENTIFIER C_TEMP_1_2_TCO_1_2_PLAUS_HOT FORMAT "%3.0" /end CHARACTERISTIC
/begin CHARACTERISTIC c_temp_2_1_tco_1_2_plaus_cold "c_temp_2_1_tco_1_2_plaus_cold" VALUE 0x85cccd _REC_VAL_20_u1 255. _CNV_A_R_LINEAR_____18_CM -50. 205. DISPLAY_IDENTIFIER C_TEMP_2_1_TCO_1_2_PLAUS_COLD FORMAT "%3.0" /end CHARACTERISTIC
/begin CHARACTERISTIC c_temp_2_1_tco_1_2_plaus_wup "c_temp_2_1_tco_1_2_plaus_wup" VALUE 0x85cccf _REC_VAL_20_u1 255. _CNV_A_R_LINEAR_____18_CM -50. 205. DISPLAY_IDENTIFIER C_TEMP_2_1_TCO_1_2_PLAUS_WUP FORMAT "%3.0" /end CHARACTERISTIC
/begin CHARACTERISTIC c_temp_2_1_tco_1_2_plaus_hot "Maximal difference TCO_2_MES - TCO_1_MES" VALUE 0x85ccce _REC_VAL_20_u1 255. _CNV_A_R_LINEAR_____18_CM -50. 205. DISPLAY_IDENTIFIER C_TEMP_2_1_TCO_1_2_PLAUS_HOT FORMAT "%3.0" /end CHARACTERISTIC
/begin CHARACTERISTIC c_temp_cold_max_tco_1_2_plaus "Temperature threshold to use range COLD" VALUE 0x85ccd0 _REC_VAL_20_u1 255. _CNV_A_R_LINEAR_____18_CM -50. 205. DISPLAY_IDENTIFIER C_TEMP_COLD_MAX_TCO_1_2_PLAUS FORMAT "%3.0" /end CHARACTERISTIC
/begin CHARACTERISTIC c_temp_hot_min_tco_1_2_plaus "Temperature threshold to use range HOT" VALUE 0x85ccda _REC_VAL_20_u1 255. _CNV_A_R_LINEAR_____18_CM -50. 205. DISPLAY_IDENTIFIER C_TEMP_HOT_MIN_TCO_1_2_PLAUS FORMAT "%3.0" /end CHARACTERISTIC
/begin CHARACTERISTIC c_abc_inc_maf_0_rng "anti bounce counter increment for diagnosis instance MAF_0_RNG" VALUE 0x84faa0 _REC_VAL_20_u1 255. _CNV_A_R_LINEAR_____0_CM 0. 255. DISPLAY_IDENTIFIER C_ABC_INC_MAF_0_RNG FORMAT "%3.0" /end CHARACTERISTIC
/begin CHARACTERISTIC c_abc_max_maf_0_rng "maximum value of anti bounce counter for diagnosis instance MAF_0_RNG" VALUE 0x84fb2c _REC_VAL_20_u1 255. _CNV_A_R_LINEAR_____0_CM 0. 255. DISPLAY_IDENTIFIER C_ABC_MAX_MAF_0_RNG FORMAT "%3.0" /end CHARACTERISTIC
/begin CHARACTERISTIC c_maf_kgh_mes_max_diag "maximum threshold for range check of MAF" VALUE 0x85ca9c _REC_VAL_20_u2 153.59765625 _CNV_A_R_LINEAR_____110_CM 0. 1023.984375 DISPLAY_IDENTIFIER C_MAF_KGH_MES_MAX_DIAG FORMAT "%7.2" /end CHARACTERISTIC
/begin CHARACTERISTIC c_maf_kgh_mes_min_diag "minimum threshold for range check of MAF" VALUE 0x85ca9e _REC_VAL_20_u2 153.59765625 _CNV_A_R_LINEAR_____110_CM 0. 1023.984375 DISPLAY_IDENTIFIER C_MAF_KGH_MES_MIN_DIAG FORMAT "%7.2" /end CHARACTERISTIC
/begin CHARACTERISTIC c_n_min_maf_kgh_mes_diag "minimal  engine speed threshold for MAF_KGH_MES_MAX check" VALUE 0x85cb38 _REC_VAL_20_u2 6375. _CNV_A_R_LINEAR_____5_CM 0. 6375. DISPLAY_IDENTIFIER C_N_MIN_MAF_KGH_MES_DIAG FORMAT "%4.0" /end CHARACTERISTIC
/begin CHARACTERISTIC c_abc_inc_maf_kgh_plaus "" VALUE 0x84faa4 _REC_VAL_20_u1 255. _CNV_A_R_LINEAR_____0_CM 0. 255. DISPLAY_IDENTIFIER C_ABC_INC_MAF_KGH_PLAUS FORMAT "%3.0" /end CHARACTERISTIC
/begin CHARACTERISTIC c_abc_max_maf_kgh_plaus "" VALUE 0x84fb30 _REC_VAL_20_u1 255. _CNV_A_R_LINEAR_____0_CM 0. 255. DISPLAY_IDENTIFIER C_ABC_MAX_MAF_KGH_PLAUS FORMAT "%3.0" /end CHARACTERISTIC
/begin MEASUREMENT t_dly_maf_kgh_plaus "" UWORD _CNV_A_R_LINEAR_____56_CM 1 0. 0. 655.35 DISPLAY_IDENTIFIER T_DLY_MAF_KGH_PLAUS ECU_ADDRESS 0x7fa640 BYTE_ORDER MSB_LAST FORMAT "%5.2" /end MEASUREMENT
/begin MEASUREMENT ctr_maf_kgh_plaus "" UBYTE _CNV_A_R_LINEAR_____0_CM 1 0. 0. 255. DISPLAY_IDENTIFIER CTR_MAF_KGH_PLAUS ECU_ADDRESS 0x7fbdfe FORMAT "%3.0" /end MEASUREMENT
/begin CHARACTERISTIC c_tqi_sp_maf_plaus "" VALUE 0x85cd44 _REC_VAL_20_s2 2047.96875 _CNV_A_R_LINEAR_____52_CM -1024. 1023.96875 DISPLAY_IDENTIFIER C_TQI_SP_MAF_PLAUS FORMAT "%6.2" /end CHARACTERISTIC
/begin CHARACTERISTIC c_ctl_lim_egrv_maf_plaus "" VALUE 0x85c942 _REC_VAL_20_s2 199.996948242 _CNV_A_R_LINEAR_____12_CM -100. 99.996948242 DISPLAY_IDENTIFIER C_CTL_LIM_EGRV_MAF_PLAUS FORMAT "%5.3" /end CHARACTERISTIC
/begin CHARACTERISTIC c_tia_min_maf_plaus "" VALUE 0x85cd23 _REC_VAL_20_u1 255. _CNV_A_R_LINEAR_____18_CM -50. 205. DISPLAY_IDENTIFIER C_TIA_MIN_MAF_PLAUS FORMAT "%3.0" /end CHARACTERISTIC
/begin CHARACTERISTIC c_tia_max_maf_plaus "" VALUE 0x85cd22 _REC_VAL_20_u1 255. _CNV_A_R_LINEAR_____18_CM -50. 205. DISPLAY_IDENTIFIER C_TIA_MAX_MAF_PLAUS FORMAT "%3.0" /end CHARACTERISTIC
/begin CHARACTERISTIC c_n_min_maf_plaus "" VALUE 0x85cb3a _REC_VAL_20_u2 6375. _CNV_A_R_LINEAR_____5_CM 0. 6375. DISPLAY_IDENTIFIER C_N_MIN_MAF_PLAUS FORMAT "%4.0" /end CHARACTERISTIC
/begin CHARACTERISTIC c_n_max_maf_plaus "" VALUE 0x85cb24 _REC_VAL_20_u2 6375. _CNV_A_R_LINEAR_____5_CM 0. 6375. DISPLAY_IDENTIFIER C_N_MAX_MAF_PLAUS FORMAT "%4.0" /end CHARACTERISTIC
/begin CHARACTERISTIC c_ratio_mf_tot_grd_maf_plaus "" VALUE 0x85cb86 _REC_VAL_20_u2 99.972117 _CNV_A_R_LINEAR_____204_CM 0. 99.972117 DISPLAY_IDENTIFIER C_RATIO_MF_TOT_GRD_MAF_PLAUS FORMAT "%5.3" /end CHARACTERISTIC
/begin CHARACTERISTIC c_maf_kgh_min_maf_plaus "" VALUE 0x85caa0 _REC_VAL_20_s2 512. _CNV_A_R_LINEAR_____351_CM -512. 0. DISPLAY_IDENTIFIER C_MAF_KGH_MIN_MAF_PLAUS FORMAT "%3.2" /end CHARACTERISTIC
/begin CHARACTERISTIC c_maf_kgh_max_maf_plaus "" VALUE 0x85ca9a _REC_VAL_20_s2 511.984 _CNV_A_R_LINEAR_____352_CM 0. 511.984 DISPLAY_IDENTIFIER C_MAF_KGH_MAX_MAF_PLAUS FORMAT "%5.2" /end CHARACTERISTIC
/begin CHARACTERISTIC c_fac_maf_kgh_plaus_diag "" VALUE 0x85c9ee _REC_VAL_20_u1 3.984375 _CNV_A_R_LINEAR_____95_CM 0. 3.984375 DISPLAY_IDENTIFIER C_FAC_MAF_KGH_PLAUS_DIAG FORMAT "%3.2" /end CHARACTERISTIC
/begin CHARACTERISTIC c_t_dly_maf_kgh_plaus_diag "" VALUE 0x85cc2c _REC_VAL_20_u2 655.35 _CNV_A_R_LINEAR_____56_CM 0. 655.35 DISPLAY_IDENTIFIER C_T_DLY_MAF_KGH_PLAUS_DIAG FORMAT "%5.2" /end CHARACTERISTIC
/begin CHARACTERISTIC c_ctr_maf_kgh_plaus_diag "" VALUE 0x85c960 _REC_VAL_20_u1 255. _CNV_A_R_LINEAR_____0_CM 0. 255. DISPLAY_IDENTIFIER C_CTR_MAF_KGH_PLAUS_DIAG FORMAT "%3.0" /end CHARACTERISTIC
/begin CHARACTERISTIC c_n_grd_h_res_maf_plaus "" VALUE 0x85cb08 _REC_VAL_20_s2 8191. _CNV_A_R_LINEAR_____353_CM -4096. 4095. DISPLAY_IDENTIFIER C_N_GRD_H_RES_MAF_PLAUS FORMAT "%4.0" /end CHARACTERISTIC
/begin CHARACTERISTIC c_cfb_pcv_mes_max_diag "" VALUE 0x85c8e0 _REC_VAL_20_u4 3.25 _CNV_A_R_LINEAR_____380_CM 0. 3.25 DISPLAY_IDENTIFIER C_CFB_PCV_MES_MAX_DIAG /end CHARACTERISTIC
/begin CHARACTERISTIC c_cfb_vcv_mes_max_diag "" VALUE 0x85c8e4 _REC_VAL_20_u4 3.25 _CNV_A_R_LINEAR_____380_CM 0. 3.25 DISPLAY_IDENTIFIER C_CFB_VCV_MES_MAX_DIAG /end CHARACTERISTIC
/begin CHARACTERISTIC c_v_cfb_pcv_max_diag "" VALUE 0x85cd64 _REC_VAL_20_u2 4.9951171875 _CNV_A_R_LINEAR_____28_CM 0. 4.9951171875 DISPLAY_IDENTIFIER C_V_CFB_PCV_MAX_DIAG FORMAT "%3.2" /end CHARACTERISTIC
/begin CHARACTERISTIC c_v_cfb_pcv_min_diag "" VALUE 0x85cd66 _REC_VAL_20_u2 4.9951171875 _CNV_A_R_LINEAR_____28_CM 0. 4.9951171875 DISPLAY_IDENTIFIER C_V_CFB_PCV_MIN_DIAG FORMAT "%3.2" /end CHARACTERISTIC
/begin CHARACTERISTIC c_v_cfb_vcv_max_diag "" VALUE 0x85cd68 _REC_VAL_20_u2 4.9951171875 _CNV_A_R_LINEAR_____28_CM 0. 4.9951171875 DISPLAY_IDENTIFIER C_V_CFB_VCV_MAX_DIAG FORMAT "%3.2" /end CHARACTERISTIC
/begin CHARACTERISTIC c_v_cfb_vcv_min_diag "" VALUE 0x85cd6a _REC_VAL_20_u2 4.9951171875 _CNV_A_R_LINEAR_____28_CM 0. 4.9951171875 DISPLAY_IDENTIFIER C_V_CFB_VCV_MIN_DIAG FORMAT "%3.2" /end CHARACTERISTIC
/begin MEASUREMENT cfb_vcv_mes "" UWORD _CNV_A_R_LINEAR_____380_CM 1 0. 0. 3.25 DISPLAY_IDENTIFIER CFB_VCV_MES ECU_ADDRESS 0x7fa318 BYTE_ORDER MSB_LAST FORMAT "%3.2" /end MEASUREMENT
/begin MEASUREMENT v_cfb_pcv "" UWORD _CNV_A_R_LINEAR_____28_CM 1 0. 0. 4.9951171875 DISPLAY_IDENTIFIER V_CFB_PCV ECU_ADDRESS 0x7fb4e8 BYTE_ORDER MSB_LAST FORMAT "%3.2" /end MEASUREMENT
/begin MEASUREMENT v_cfb_vcv "" UWORD _CNV_A_R_LINEAR_____28_CM 1 0. 0. 4.9951171875 DISPLAY_IDENTIFIER V_CFB_VCV ECU_ADDRESS 0x7fb4e6 BYTE_ORDER MSB_LAST FORMAT "%3.2" /end MEASUREMENT
/begin AXIS_PTS ldp_vb_ip_pcv_min_diag "" 0x842a8b vb _REC_AXS_20_u1 28.8 _CNV_A_R_LINEAR_____43_CM 4 0. 28.8 FORMAT "%4.2" /end AXIS_PTS
/begin CHARACTERISTIC ip_pcv_min_diag__vb "DIAG_PCV:threshold for inhibition of OL detection" CURVE 0x858102 _REC_CUR_20_u2_u1 99.99847412109381 _CNV_A_R_LINEAR_____8_CM 0. 99.99847412109381 DISPLAY_IDENTIFIER IP_PCV_MIN_DIAG__VB
 /begin AXIS_DESCR COM_AXIS vb _CNV_A_R_LINEAR_____43_CM 4 0. 28.8 FORMAT "%4.2" AXIS_PTS_REF ldp_vb_ip_pcv_min_diag /end AXIS_DESCR
/end CHARACTERISTIC
/begin CHARACTERISTIC c_abc_inc_bpa "" VALUE 0x85c83a _REC_VAL_20_u1 255. _CNV_A_R_LINEAR_____0_CM 0. 255. DISPLAY_IDENTIFIER C_ABC_INC_BPA FORMAT "%3.0" /end CHARACTERISTIC
/begin CHARACTERISTIC c_abc_inc_gl_rly_dps "" VALUE 0x85c840 _REC_VAL_20_u1 255. _CNV_A_R_LINEAR_____0_CM 0. 255. DISPLAY_IDENTIFIER C_ABC_INC_GL_RLY_DPS FORMAT "%3.0" /end CHARACTERISTIC
/begin CHARACTERISTIC c_abc_inc_pcv_1 "" VALUE 0x85c843 _REC_VAL_20_u1 255. _CNV_A_R_LINEAR_____0_CM 0. 255. DISPLAY_IDENTIFIER C_ABC_INC_PCV_1 FORMAT "%3.0" /end CHARACTERISTIC
/begin CHARACTERISTIC c_abc_inc_pcv_2 "" VALUE 0x85c844 _REC_VAL_20_u1 255. _CNV_A_R_LINEAR_____0_CM 0. 255. DISPLAY_IDENTIFIER C_ABC_INC_PCV_2 FORMAT "%3.0" /end CHARACTERISTIC
/begin CHARACTERISTIC c_abc_inc_pcv_3 "" VALUE 0x85c845 _REC_VAL_20_u1 255. _CNV_A_R_LINEAR_____0_CM 0. 255. DISPLAY_IDENTIFIER C_ABC_INC_PCV_3 FORMAT "%3.0" /end CHARACTERISTIC
/begin CHARACTERISTIC c_abc_inc_vcv_1 "" VALUE 0x85c84c _REC_VAL_20_u1 255. _CNV_A_R_LINEAR_____0_CM 0. 255. DISPLAY_IDENTIFIER C_ABC_INC_VCV_1 FORMAT "%3.0" /end CHARACTERISTIC
/begin CHARACTERISTIC c_abc_inc_vcv_2 "" VALUE 0x85c84d _REC_VAL_20_u1 255. _CNV_A_R_LINEAR_____0_CM 0. 255. DISPLAY_IDENTIFIER C_ABC_INC_VCV_2 FORMAT "%3.0" /end CHARACTERISTIC
/begin CHARACTERISTIC c_abc_inc_vcv_3 "" VALUE 0x85c84e _REC_VAL_20_u1 255. _CNV_A_R_LINEAR_____0_CM 0. 255. DISPLAY_IDENTIFIER C_ABC_INC_VCV_3 FORMAT "%3.0" /end CHARACTERISTIC
/begin CHARACTERISTIC c_abc_max_bpa "" VALUE 0x85c84f _REC_VAL_20_u1 255. _CNV_A_R_LINEAR_____0_CM 0. 255. DISPLAY_IDENTIFIER C_ABC_MAX_BPA FORMAT "%3.0" /end CHARACTERISTIC
/begin CHARACTERISTIC c_abc_max_gl_rly_dps "" VALUE 0x85c855 _REC_VAL_20_u1 255. _CNV_A_R_LINEAR_____0_CM 0. 255. DISPLAY_IDENTIFIER C_ABC_MAX_GL_RLY_DPS FORMAT "%3.0" /end CHARACTERISTIC
/begin CHARACTERISTIC c_abc_max_pcv_1 "" VALUE 0x85c858 _REC_VAL_20_u1 255. _CNV_A_R_LINEAR_____0_CM 0. 255. DISPLAY_IDENTIFIER C_ABC_MAX_PCV_1 FORMAT "%3.0" /end CHARACTERISTIC
/begin CHARACTERISTIC c_abc_max_pcv_2 "" VALUE 0x85c859 _REC_VAL_20_u1 255. _CNV_A_R_LINEAR_____0_CM 0. 255. DISPLAY_IDENTIFIER C_ABC_MAX_PCV_2 FORMAT "%3.0" /end CHARACTERISTIC
/begin CHARACTERISTIC c_abc_max_pcv_3 "" VALUE 0x85c85a _REC_VAL_20_u1 255. _CNV_A_R_LINEAR_____0_CM 0. 255. DISPLAY_IDENTIFIER C_ABC_MAX_PCV_3 FORMAT "%3.0" /end CHARACTERISTIC
/begin CHARACTERISTIC c_abc_max_vcv_1 "" VALUE 0x85c862 _REC_VAL_20_u1 255. _CNV_A_R_LINEAR_____0_CM 0. 255. DISPLAY_IDENTIFIER C_ABC_MAX_VCV_1 FORMAT "%3.0" /end CHARACTERISTIC
/begin CHARACTERISTIC c_abc_max_vcv_2 "" VALUE 0x85c863 _REC_VAL_20_u1 255. _CNV_A_R_LINEAR_____0_CM 0. 255. DISPLAY_IDENTIFIER C_ABC_MAX_VCV_2 FORMAT "%3.0" /end CHARACTERISTIC
/begin CHARACTERISTIC c_abc_max_vcv_3 "" VALUE 0x85c864 _REC_VAL_20_u1 255. _CNV_A_R_LINEAR_____0_CM 0. 255. DISPLAY_IDENTIFIER C_ABC_MAX_VCV_3 FORMAT "%3.0" /end CHARACTERISTIC
/begin MEASUREMENT lv_wal_2_act_req "" UBYTE _CNV_S_2_RANGE______3_CM 1 0. 0. 1. DISPLAY_IDENTIFIER LV_WAL_2_ACT_REQ ECU_ADDRESS 0x7fc48d /end MEASUREMENT
/begin MEASUREMENT lv_wal_1_act_req "" UBYTE _CNV_S_2_RANGE______3_CM 1 0. 0. 1. DISPLAY_IDENTIFIER LV_WAL_1_ACT_REQ ECU_ADDRESS 0x7fc48c /end MEASUREMENT
/begin MEASUREMENT lv_mil_act_req "" UBYTE _CNV_S_2_RANGE______3_CM 1 0. 0. 1. DISPLAY_IDENTIFIER LV_MIL_ACT_REQ ECU_ADDRESS 0x7fc48e /end MEASUREMENT
/begin MEASUREMENT lv_fuel_warn "" UBYTE _CNV_S_2_RANGE______11_CM 1 0. 0. 1. DISPLAY_IDENTIFIER LV_FUEL_WARN ECU_ADDRESS 0x7fbc13 /end MEASUREMENT
/begin CHARACTERISTIC c_vb_nom "" VALUE 0x85ce1a _REC_VAL_20_u1 28.8 _CNV_A_R_LINEAR_____43_CM 0. 28.8 DISPLAY_IDENTIFIER C_VB_NOM FORMAT "%4.2" /end CHARACTERISTIC
/begin AXIS_PTS ldp_frq_maf_id_maf_x "" 0x8416f3 v_maf_x _REC_AXS_20_u1 15. _CNV_A_R_LINEAR_____0_CM 16 0. 15. FORMAT "%2.0" /end AXIS_PTS
/begin AXIS_PTS ldp_frq_maf_id_maf_y "" 0x841704 v_maf_y _REC_AXS_20_u1 15. _CNV_A_R_LINEAR_____0_CM 16 0. 15. FORMAT "%2.0" /end AXIS_PTS
/begin CHARACTERISTIC id_maf_frq_tab "mass air flow" MAP 0x850336 _REC_MAP_20_u2_u1_u1 1023.984375 _CNV_A_R_LINEAR_____110_CM 0. 1023.984375 DISPLAY_IDENTIFIER ID_MAF_FRQ_TAB FORMAT "%7.2"
 /begin AXIS_DESCR COM_AXIS v_maf_x _CNV_A_R_LINEAR_____0_CM 16 0. 15. FORMAT "%2.0" AXIS_PTS_REF ldp_frq_maf_id_maf_x /end AXIS_DESCR
 /begin AXIS_DESCR COM_AXIS v_maf_y _CNV_A_R_LINEAR_____0_CM 16 0. 15. FORMAT "%2.0" AXIS_PTS_REF ldp_frq_maf_id_maf_y /end AXIS_DESCR
/end CHARACTERISTIC
/begin CHARACTERISTIC c_t_low_maf_frq_0_min "" VALUE 0x85cc56 _REC_VAL_20_u2 262143. _CNV_A_R_LINEAR_____384_CM 0. 262143. DISPLAY_IDENTIFIER C_T_LOW_MAF_FRQ_0_MIN FORMAT "%6.0" /end CHARACTERISTIC
/begin CHARACTERISTIC c_t_low_maf_frq_0_max "" VALUE 0x85cc54 _REC_VAL_20_u2 262143. _CNV_A_R_LINEAR_____384_CM 0. 262143. DISPLAY_IDENTIFIER C_T_LOW_MAF_FRQ_0_MAX FORMAT "%6.0" /end CHARACTERISTIC
/begin CHARACTERISTIC c_maf_frq_0_bas_max "" VALUE 0x85ca92 _REC_VAL_20_u2 65535. _CNV_A_R_LINEAR_____385_CM 0. 65535. DISPLAY_IDENTIFIER C_MAF_FRQ_0_BAS_MAX FORMAT "%5.0" /end CHARACTERISTIC
/begin CHARACTERISTIC c_maf_frq_0_bas_min "" VALUE 0x85ca94 _REC_VAL_20_u2 65535. _CNV_A_R_LINEAR_____385_CM 0. 65535. DISPLAY_IDENTIFIER C_MAF_FRQ_0_BAS_MIN FORMAT "%5.0" /end CHARACTERISTIC
/begin CHARACTERISTIC c_maf_frq_bas_max_ip "" VALUE 0x85ca96 _REC_VAL_20_u2 65535. _CNV_A_R_LINEAR_____385_CM 0. 65535. DISPLAY_IDENTIFIER C_MAF_FRQ_BAS_MAX_IP FORMAT "%5.0" /end CHARACTERISTIC
/begin MEASUREMENT lv_err_frq_maf_frq_0 "" UBYTE _CNV_S_2_RANGE______23_CM 1 0. 0. 1. DISPLAY_IDENTIFIER LV_ERR_FRQ_MAF_FRQ_0 ECU_ADDRESS 0x7fce68 /end MEASUREMENT
/begin AXIS_PTS ldp_v_t_atic20_ip_t_atic20 "" 0x8429fc v_t_atic20 _REC_AXS_20_u1 4.482421875 _CNV_A_R_LINEAR_____368_CM 16 0. 4.98046875 FORMAT "%4.2" /end AXIS_PTS
/begin AXIS_PTS ldp_v_t_lc_ip_t_lc "" 0x842a0d v_t_lc _REC_AXS_20_u1 4.482421875 _CNV_A_R_LINEAR_____368_CM 16 0. 4.98046875 FORMAT "%4.2" /end AXIS_PTS
/begin CHARACTERISTIC ip_t_atic20__v_t_atic20 "TECU temperature atic20" CURVE 0x85b050 _REC_CUR_20_u1_u1 255. _CNV_A_R_LINEAR_____18_CM -50. 205. DISPLAY_IDENTIFIER IP_T_ATIC20__V_T_ATIC20 FORMAT "%5.1"
 /begin AXIS_DESCR COM_AXIS v_t_atic20 _CNV_A_R_LINEAR_____368_CM 16 0. 4.98046875 FORMAT "%4.2" AXIS_PTS_REF ldp_v_t_atic20_ip_t_atic20 /end AXIS_DESCR
/end CHARACTERISTIC
/begin CHARACTERISTIC ip_t_lc__v_t_lc "TECU temperature lc" CURVE 0x85b0a6 _REC_CUR_20_u1_u1 255. _CNV_A_R_LINEAR_____18_CM -50. 205. DISPLAY_IDENTIFIER IP_T_LC__V_T_LC FORMAT "%5.1"
 /begin AXIS_DESCR COM_AXIS v_t_lc _CNV_A_R_LINEAR_____368_CM 16 0. 4.98046875 FORMAT "%4.2" AXIS_PTS_REF ldp_v_t_lc_ip_t_lc /end AXIS_DESCR
/end CHARACTERISTIC
/begin CHARACTERISTIC c_vb_max_diag "Maximum threshold for battery voltage fault detection. Typical value: 17,5V" VALUE 0x85ce0f _REC_VAL_20_u1 28.8 _CNV_A_R_LINEAR_____43_CM 0. 28.8 DISPLAY_IDENTIFIER C_VB_MAX_DIAG FORMAT "%3.1" /end CHARACTERISTIC
/begin CHARACTERISTIC c_vb_min_diag "Minimum threshold for battery voltage fault detection. Typical value: 7V" VALUE 0x85ce14 _REC_VAL_20_u1 28.8 _CNV_A_R_LINEAR_____43_CM 0. 28.8 DISPLAY_IDENTIFIER C_VB_MIN_DIAG FORMAT "%3.1" /end CHARACTERISTIC
/begin CHARACTERISTIC c_vb_min_jump "threshold voltage for jump start recognition" VALUE 0x85ce15 _REC_VAL_20_u1 28.8 _CNV_A_R_LINEAR_____43_CM 0. 28.8 DISPLAY_IDENTIFIER C_VB_MIN_JUMP FORMAT "%3.1" /end CHARACTERISTIC
/begin CHARACTERISTIC c_vb_min_obd1 "threshold voltage for deactivation of OBD1 diagnostic" VALUE 0x85ce17 _REC_VAL_20_u1 28.8 _CNV_A_R_LINEAR_____43_CM 0. 28.8 DISPLAY_IDENTIFIER C_VB_MIN_OBD1 FORMAT "%3.1" /end CHARACTERISTIC
/begin CHARACTERISTIC c_vb_min_obd2 "threshold voltage for deactivation of OBD2 diagnostic" VALUE 0x85ce18 _REC_VAL_20_u1 28.8 _CNV_A_R_LINEAR_____43_CM 0. 28.8 DISPLAY_IDENTIFIER C_VB_MIN_OBD2 FORMAT "%3.1" /end CHARACTERISTIC
/begin MEASUREMENT lv_cdn_vb_obd1 "status of diagnostics release" UBYTE _CNV_S_2_RANGE______23_CM 1 0. 0. 1. DISPLAY_IDENTIFIER LV_CDN_VB_OBD1 ECU_ADDRESS 0x7fbb4c /end MEASUREMENT
/begin MEASUREMENT lv_cdn_vb_obd2 "status of diagnostics release" UBYTE _CNV_S_2_RANGE______23_CM 1 0. 0. 1. DISPLAY_IDENTIFIER LV_CDN_VB_OBD2 ECU_ADDRESS 0x7fbb4d /end MEASUREMENT
/begin MEASUREMENT lv_igk "Main wake-up detection" UBYTE _CNV_S_2_RANGE______23_CM 1 0. 0. 1. DISPLAY_IDENTIFIER LV_IGK ECU_ADDRESS 0x7fbb4a /end MEASUREMENT
/begin MEASUREMENT vb "computed battery voltage" UBYTE _CNV_A_R_LINEAR_____43_CM 1 0. 0. 28.8 DISPLAY_IDENTIFIER VB ECU_ADDRESS 0x7fbb48 FORMAT "%3.1" /end MEASUREMENT
/begin MEASUREMENT v_igk "computed battery voltage" UBYTE _CNV_A_R_LINEAR_____43_CM 1 0. 0. 28.8 DISPLAY_IDENTIFIER V_IGK ECU_ADDRESS 0x7fbb49 FORMAT "%3.1" /end MEASUREMENT
/begin MEASUREMENT pcv "" UWORD _CNV_A_R_LINEAR_____8_CM 1 0. 0. 99.99847412109381 DISPLAY_IDENTIFIER PCV ECU_ADDRESS 0x7fa0dc BYTE_ORDER MSB_LAST FORMAT "%7.3" /end MEASUREMENT
/begin CHARACTERISTIC c_abc_inc_spi_qps "anti bounce counter increment for diagnosis instance SPI_QPS" VALUE 0x84facd _REC_VAL_20_u1 255. _CNV_A_R_LINEAR_____0_CM 0. 255. DISPLAY_IDENTIFIER C_ABC_INC_SPI_QPS FORMAT "%3.0" /end CHARACTERISTIC
/begin CHARACTERISTIC c_abc_max_spi_qps "maximum value of anti bounce counter for diagnosis instance SPI_QPS" VALUE 0x84fb59 _REC_VAL_20_u1 255. _CNV_A_R_LINEAR_____0_CM 0. 255. DISPLAY_IDENTIFIER C_ABC_MAX_SPI_QPS FORMAT "%3.0" /end CHARACTERISTIC
/begin CHARACTERISTIC c_abc_inc_spi_oct "anti bounce counter increment for diagnosis instance SPI_OCT" VALUE 0x84facc _REC_VAL_20_u1 255. _CNV_A_R_LINEAR_____0_CM 0. 255. DISPLAY_IDENTIFIER C_ABC_INC_SPI_OCT FORMAT "%3.0" /end CHARACTERISTIC
/begin CHARACTERISTIC c_abc_max_spi_oct "maximum value of anti bounce counter for diagnosis instance SPI_OCT" VALUE 0x84fb58 _REC_VAL_20_u1 255. _CNV_A_R_LINEAR_____0_CM 0. 255. DISPLAY_IDENTIFIER C_ABC_MAX_SPI_OCT FORMAT "%3.0" /end CHARACTERISTIC
/begin CHARACTERISTIC c_abc_inc_spi_mps "anti bounce counter increment for diagnosis instance SPI_MPS" VALUE 0x84facb _REC_VAL_20_u1 255. _CNV_A_R_LINEAR_____0_CM 0. 255. DISPLAY_IDENTIFIER C_ABC_INC_SPI_MPS FORMAT "%3.0" /end CHARACTERISTIC
/begin CHARACTERISTIC c_abc_max_spi_mps "maximum value of anti bounce counter for diagnosis instance SPI_MPS" VALUE 0x84fb57 _REC_VAL_20_u1 255. _CNV_A_R_LINEAR_____0_CM 0. 255. DISPLAY_IDENTIFIER C_ABC_MAX_SPI_MPS FORMAT "%3.0" /end CHARACTERISTIC
/begin MEASUREMENT lv_spi_err_qps "daisy chain failure information QPS" UBYTE _CNV_S_2_RANGE______23_CM 1 0. 0. 1. DISPLAY_IDENTIFIER LV_SPI_ERR_QPS ECU_ADDRESS 0x7fbe18 /end MEASUREMENT
/begin MEASUREMENT lv_spi_err_oct "daisy chain failure information OCT" UBYTE _CNV_S_2_RANGE______23_CM 1 0. 0. 1. DISPLAY_IDENTIFIER LV_SPI_ERR_OCT ECU_ADDRESS 0x7fbe19 /end MEASUREMENT
/begin MEASUREMENT lv_spi_err_mps "daisy chain failure information MPS" UBYTE _CNV_S_2_RANGE______23_CM 1 0. 0. 1. DISPLAY_IDENTIFIER LV_SPI_ERR_MPS ECU_ADDRESS 0x7fbe1a /end MEASUREMENT
/begin CHARACTERISTIC c_egrvpwm_min_diag "minimal duty cycle of the PWM signal" VALUE 0x85c9a4 _REC_VAL_20_s2 199.996948242 _CNV_A_R_LINEAR_____12_CM -100. 99.996948242 DISPLAY_IDENTIFIER C_EGRVPWM_MIN_DIAG FORMAT "%5.3" /end CHARACTERISTIC
/begin CHARACTERISTIC c_egrvpwm_max_diag "maximal duty cycle of the PWM signal" VALUE 0x85c9a2 _REC_VAL_20_s2 199.996948242 _CNV_A_R_LINEAR_____12_CM -100. 99.996948242 DISPLAY_IDENTIFIER C_EGRVPWM_MAX_DIAG FORMAT "%5.3" /end CHARACTERISTIC
/begin MEASUREMENT lv_err_det_spi_dps_egrv "SPI error detected for the diagnostic power stage of the EGR valve(s)" UBYTE _CNV_S_2_RANGE______11_CM 1 0. 0. 1. DISPLAY_IDENTIFIER LV_ERR_DET_SPI_DPS_EGRV ECU_ADDRESS 0x7fb849 /end MEASUREMENT
/begin CHARACTERISTIC c_abc_inc_egrv_0 "anti bounce counter increment for diagnosis instance EGRV_0" VALUE 0x84fa9a _REC_VAL_20_u1 255. _CNV_A_R_LINEAR_____0_CM 0. 255. DISPLAY_IDENTIFIER C_ABC_INC_EGRV_0 FORMAT "%3.0" /end CHARACTERISTIC
/begin CHARACTERISTIC c_abc_max_egrv_0 "maximum value of anti bounce counter for diagnosis instance EGRV_0" VALUE 0x84fb26 _REC_VAL_20_u1 255. _CNV_A_R_LINEAR_____0_CM 0. 255. DISPLAY_IDENTIFIER C_ABC_MAX_EGRV_0 FORMAT "%3.0" /end CHARACTERISTIC
/begin MEASUREMENT lv_err_pps_cyl[0] "electrical fault on one cylinder - debounced" UBYTE _CNV_S_2_RANGE______23_CM 1 0. 0. 1. DISPLAY_IDENTIFIER LV_ERR_PPS_CYL_0_ ECU_ADDRESS 0x7fb813 /end MEASUREMENT
/begin MEASUREMENT lv_err_pps_cyl[1] "electrical fault on one cylinder - debounced" UBYTE _CNV_S_2_RANGE______23_CM 1 0. 0. 1. DISPLAY_IDENTIFIER LV_ERR_PPS_CYL_1_ ECU_ADDRESS 0x7fb814 /end MEASUREMENT
/begin MEASUREMENT lv_err_pps_cyl[2] "electrical fault on one cylinder - debounced" UBYTE _CNV_S_2_RANGE______23_CM 1 0. 0. 1. DISPLAY_IDENTIFIER LV_ERR_PPS_CYL_2_ ECU_ADDRESS 0x7fb815 /end MEASUREMENT
/begin MEASUREMENT lv_err_pps_cyl[3] "electrical fault on one cylinder - debounced" UBYTE _CNV_S_2_RANGE______23_CM 1 0. 0. 1. DISPLAY_IDENTIFIER LV_ERR_PPS_CYL_3_ ECU_ADDRESS 0x7fb816 /end MEASUREMENT
/begin MEASUREMENT lv_err_det_pps_cyl[0] "electrical fault on one cylinder - status of this diagnosis cycle" UBYTE _CNV_S_2_RANGE______23_CM 1 0. 0. 1. DISPLAY_IDENTIFIER LV_ERR_DET_PPS_CYL_0_ ECU_ADDRESS 0x7fb817 /end MEASUREMENT
/begin MEASUREMENT lv_err_det_pps_cyl[1] "electrical fault on one cylinder - status of this diagnosis cycle" UBYTE _CNV_S_2_RANGE______23_CM 1 0. 0. 1. DISPLAY_IDENTIFIER LV_ERR_DET_PPS_CYL_1_ ECU_ADDRESS 0x7fb818 /end MEASUREMENT
/begin MEASUREMENT lv_err_det_pps_cyl[2] "electrical fault on one cylinder - status of this diagnosis cycle" UBYTE _CNV_S_2_RANGE______23_CM 1 0. 0. 1. DISPLAY_IDENTIFIER LV_ERR_DET_PPS_CYL_2_ ECU_ADDRESS 0x7fb819 /end MEASUREMENT
/begin MEASUREMENT lv_err_det_pps_cyl[3] "electrical fault on one cylinder - status of this diagnosis cycle" UBYTE _CNV_S_2_RANGE______23_CM 1 0. 0. 1. DISPLAY_IDENTIFIER LV_ERR_DET_PPS_CYL_3_ ECU_ADDRESS 0x7fb81a /end MEASUREMENT
/begin MEASUREMENT lv_err_pps_cbk[0] "electrical fault on one bank - debounced" UBYTE _CNV_S_2_RANGE______23_CM 1 0. 0. 1. DISPLAY_IDENTIFIER LV_ERR_PPS_CBK_0_ ECU_ADDRESS 0x7fb81b /end MEASUREMENT
/begin MEASUREMENT lv_err_det_pps_cbk[0] "electrical fault on one bank - status of this diagnosis cycle" UBYTE _CNV_S_2_RANGE______23_CM 1 0. 0. 1. DISPLAY_IDENTIFIER LV_ERR_DET_PPS_CBK_0_ ECU_ADDRESS 0x7fb81c /end MEASUREMENT
/begin MEASUREMENT lv_err_pps "general electrical fault debounced" UBYTE _CNV_S_2_RANGE______23_CM 1 0. 0. 1. DISPLAY_IDENTIFIER LV_ERR_PPS ECU_ADDRESS 0x7fb81d /end MEASUREMENT
/begin MEASUREMENT lv_err_det_pps "general electrical fault status of the last diagnosis cycle" UBYTE _CNV_S_2_RANGE______23_CM 1 0. 0. 1. DISPLAY_IDENTIFIER LV_ERR_DET_PPS ECU_ADDRESS 0x7fb81e /end MEASUREMENT
/begin MEASUREMENT t_ini_tout_pps[0] "Timer for PPS initialisation timeout" UBYTE _CNV_A_R_LINEAR_____56_CM 1 0. 0. 2.55 DISPLAY_IDENTIFIER T_INI_TOUT_PPS_0_ ECU_ADDRESS 0x7fbdea FORMAT "%3.2" /end MEASUREMENT
/begin MEASUREMENT lv_inh_diag_pps_oc "Inhibition of PPS_OC Diagnostic while warmup" UBYTE _CNV_S_2_RANGE______23_CM 1 0. 0. 1. DISPLAY_IDENTIFIER LV_INH_DIAG_PPS_OC ECU_ADDRESS 0x7fbded /end MEASUREMENT
/begin MEASUREMENT lv_ini_pps[0] "PPS[NC_GRP_NR] flag for initialisation done" UBYTE _CNV_S_2_RANGE______23_CM 1 0. 0. 1. DISPLAY_IDENTIFIER LV_INI_PPS_0_ ECU_ADDRESS 0x7fb81f /end MEASUREMENT
/begin MEASUREMENT state_pps_diag_ini[0] "Initialisation diagnostic information from ATIC63" UBYTE _CNV_S_12_STATE_PPS__534_CM 1 0. 0. 11. DISPLAY_IDENTIFIER STATE_PPS_DIAG_INI_0_ ECU_ADDRESS 0x7fbdeb /end MEASUREMENT
/begin MEASUREMENT cyl_nr_pps_diag "Number of cylinder, for which current diagnosis is done" UBYTE _CNV_A_R_LINEAR_____0_CM 1 0. 0. 255. DISPLAY_IDENTIFIER CYL_NR_PPS_DIAG ECU_ADDRESS 0x7fbdec FORMAT "%3.0" /end MEASUREMENT
/begin MEASUREMENT lv_v_cha_rng_l "Underrun of lower threshold for V_CHA range" UBYTE _CNV_S_2_RANGE______23_CM 1 0. 0. 1. DISPLAY_IDENTIFIER LV_V_CHA_RNG_L ECU_ADDRESS 0x7fbdee /end MEASUREMENT
/begin MEASUREMENT lv_v_cha_rng_h "Exeeding of upper threshold for V_CHA range" UBYTE _CNV_S_2_RANGE______23_CM 1 0. 0. 1. DISPLAY_IDENTIFIER LV_V_CHA_RNG_H ECU_ADDRESS 0x7fbdef /end MEASUREMENT
/begin MEASUREMENT lv_v_inj_rng_l "Underrun of lower threshold for V_INJ range" UBYTE _CNV_S_2_RANGE______23_CM 1 0. 0. 1. DISPLAY_IDENTIFIER LV_V_INJ_RNG_L ECU_ADDRESS 0x7fbdf0 /end MEASUREMENT
/begin MEASUREMENT lv_v_inj_rng_h "Exeeding of upper threshold for V_INJ range" UBYTE _CNV_S_2_RANGE______23_CM 1 0. 0. 1. DISPLAY_IDENTIFIER LV_V_INJ_RNG_H ECU_ADDRESS 0x7fbdf1 /end MEASUREMENT
/begin MEASUREMENT lv_pps_prot_swi_act[0] "Protection switch" UBYTE _CNV_S_2_RANGE______23_CM 1 0. 0. 1. DISPLAY_IDENTIFIER LV_PPS_PROT_SWI_ACT_0_ ECU_ADDRESS 0x7fbdf2 /end MEASUREMENT
/begin CHARACTERISTIC c_v_cha_min "Lower limit for range check of charge" VALUE 0x85008a _REC_VAL_20_u2 5. _CNV_A_R_LINEAR_____361_CM 0. 5. DISPLAY_IDENTIFIER C_V_CHA_MIN FORMAT "%4.1" /end CHARACTERISTIC
/begin CHARACTERISTIC c_v_cha_max "Upper limit for range check of charge" VALUE 0x850088 _REC_VAL_20_u2 5. _CNV_A_R_LINEAR_____361_CM 0. 5. DISPLAY_IDENTIFIER C_V_CHA_MAX FORMAT "%4.1" /end CHARACTERISTIC
/begin CHARACTERISTIC c_v_inj_min "Lower limit for range check of voltage" VALUE 0x8500b2 _REC_VAL_20_u2 255. _CNV_A_R_LINEAR_____121_CM 0. 255. DISPLAY_IDENTIFIER C_V_INJ_MIN FORMAT "%4.1" /end CHARACTERISTIC
/begin CHARACTERISTIC c_v_inj_max "Upper limit for range check of voltage" VALUE 0x8500b0 _REC_VAL_20_u2 255. _CNV_A_R_LINEAR_____121_CM 0. 255. DISPLAY_IDENTIFIER C_V_INJ_MAX FORMAT "%4.1" /end CHARACTERISTIC
/begin CHARACTERISTIC c_t_ini_pps_max "maximum time for initialisation timeout" VALUE 0x84ff9c _REC_VAL_20_u1 2.55 _CNV_A_R_LINEAR_____56_CM 0. 2.55 DISPLAY_IDENTIFIER C_T_INI_PPS_MAX FORMAT "%3.2" /end CHARACTERISTIC
/begin CHARACTERISTIC c_t_pps_wup "minimal warmup time" VALUE 0x84ffe4 _REC_VAL_20_u1 25.5 _CNV_A_R_LINEAR_____19_CM 0. 25.5 DISPLAY_IDENTIFIER C_T_PPS_WUP FORMAT "%3.1" /end CHARACTERISTIC
/begin CHARACTERISTIC c_tco_min_hot "Minimum coolant temperature for warm injector recognition" VALUE 0x850021 _REC_VAL_20_u1 255. _CNV_A_R_LINEAR_____18_CM -50. 205. DISPLAY_IDENTIFIER C_TCO_MIN_HOT FORMAT "%3.0" /end CHARACTERISTIC
/begin CHARACTERISTIC c_v_inj_f_max "Max. injector voltage in phase F" VALUE 0x8500ae _REC_VAL_20_u1 255. _CNV_A_R_LINEAR_____535_CM 0. 255. DISPLAY_IDENTIFIER C_V_INJ_F_MAX FORMAT "%4.1" /end CHARACTERISTIC
/begin CHARACTERISTIC c_v_cha_cal_thd_0 "First threshold for calibration mode" VALUE 0x850080 _REC_VAL_20_u2 5. _CNV_A_R_LINEAR_____361_CM 0. 5. DISPLAY_IDENTIFIER C_V_CHA_CAL_THD_0 FORMAT "%3.2" /end CHARACTERISTIC
/begin CHARACTERISTIC c_v_cha_cal_thd_1 "Second threshold for calibration mode" VALUE 0x850082 _REC_VAL_20_u2 5. _CNV_A_R_LINEAR_____361_CM 0. 5. DISPLAY_IDENTIFIER C_V_CHA_CAL_THD_1 FORMAT "%3.2" /end CHARACTERISTIC
/begin CHARACTERISTIC c_v_cha_cal_thd_2 "Third threshold for calibration mode" VALUE 0x850084 _REC_VAL_20_u2 5. _CNV_A_R_LINEAR_____361_CM 0. 5. DISPLAY_IDENTIFIER C_V_CHA_CAL_THD_2 FORMAT "%3.2" /end CHARACTERISTIC
/begin CHARACTERISTIC c_v_cha_cal_thd_3 "Fourth threshold for calibration mode" VALUE 0x850086 _REC_VAL_20_u2 5. _CNV_A_R_LINEAR_____361_CM 0. 5. DISPLAY_IDENTIFIER C_V_CHA_CAL_THD_3 FORMAT "%3.2" /end CHARACTERISTIC
/begin CHARACTERISTIC c_v_inj_min_scg "Threshold for SCG recognition" VALUE 0x8500b6 _REC_VAL_20_u2 255. _CNV_A_R_LINEAR_____121_CM 0. 255. DISPLAY_IDENTIFIER C_V_INJ_MIN_SCG FORMAT "%4.1" /end CHARACTERISTIC
/begin CHARACTERISTIC c_v_inj_min_scb "threshold for SCB recognition" VALUE 0x8500b4 _REC_VAL_20_u2 255. _CNV_A_R_LINEAR_____121_CM 0. 255. DISPLAY_IDENTIFIER C_V_INJ_MIN_SCB FORMAT "%4.1" /end CHARACTERISTIC
/begin CHARACTERISTIC c_pps_spi_diag_mask "bitwise enable of SPI diagnostic information (enable = 1)" VALUE 0x84febe _REC_VAL_20_u1 255. _CNV_A_R_LINEAR_____0_CM 0. 255. DISPLAY_IDENTIFIER C_PPS_SPI_DIAG_MASK FORMAT "%3.0" /end CHARACTERISTIC
/begin CHARACTERISTIC c_pps_spi_prog_mask "bitwise enable of SPI program status information (enable = 1)" VALUE 0x84febf _REC_VAL_20_u1 255. _CNV_A_R_LINEAR_____0_CM 0. 255. DISPLAY_IDENTIFIER C_PPS_SPI_PROG_MASK FORMAT "%3.0" /end CHARACTERISTIC
/begin MEASUREMENT lf_inj_act[0] "Injection state (cylinder individual)" UWORD _CNV_A_R_LINEAR_____0_CM 1 0. 0. 65535. DISPLAY_IDENTIFIER LF_INJ_ACT_0_ ECU_ADDRESS 0x7fa628 BYTE_ORDER MSB_LAST FORMAT "%5.0" /end MEASUREMENT
/begin MEASUREMENT lf_inj_act[1] "Injection state (cylinder individual)" UWORD _CNV_A_R_LINEAR_____0_CM 1 0. 0. 65535. DISPLAY_IDENTIFIER LF_INJ_ACT_1_ ECU_ADDRESS 0x7fa62a BYTE_ORDER MSB_LAST FORMAT "%5.0" /end MEASUREMENT
/begin MEASUREMENT lf_inj_act[2] "Injection state (cylinder individual)" UWORD _CNV_A_R_LINEAR_____0_CM 1 0. 0. 65535. DISPLAY_IDENTIFIER LF_INJ_ACT_2_ ECU_ADDRESS 0x7fa62c BYTE_ORDER MSB_LAST FORMAT "%5.0" /end MEASUREMENT
/begin MEASUREMENT lf_inj_act[3] "Injection state (cylinder individual)" UWORD _CNV_A_R_LINEAR_____0_CM 1 0. 0. 65535. DISPLAY_IDENTIFIER LF_INJ_ACT_3_ ECU_ADDRESS 0x7fa62e BYTE_ORDER MSB_LAST FORMAT "%5.0" /end MEASUREMENT
/begin MEASUREMENT lf_seq_act[0] "Sequence state (cylinder individual)" UWORD _CNV_A_R_LINEAR_____0_CM 1 0. 0. 65535. DISPLAY_IDENTIFIER LF_SEQ_ACT_0_ ECU_ADDRESS 0x7fa630 BYTE_ORDER MSB_LAST FORMAT "%5.0" /end MEASUREMENT
/begin MEASUREMENT lf_seq_act[1] "Sequence state (cylinder individual)" UWORD _CNV_A_R_LINEAR_____0_CM 1 0. 0. 65535. DISPLAY_IDENTIFIER LF_SEQ_ACT_1_ ECU_ADDRESS 0x7fa632 BYTE_ORDER MSB_LAST FORMAT "%5.0" /end MEASUREMENT
/begin MEASUREMENT lf_seq_act[2] "Sequence state (cylinder individual)" UWORD _CNV_A_R_LINEAR_____0_CM 1 0. 0. 65535. DISPLAY_IDENTIFIER LF_SEQ_ACT_2_ ECU_ADDRESS 0x7fa634 BYTE_ORDER MSB_LAST FORMAT "%5.0" /end MEASUREMENT
/begin MEASUREMENT lf_seq_act[3] "Sequence state (cylinder individual)" UWORD _CNV_A_R_LINEAR_____0_CM 1 0. 0. 65535. DISPLAY_IDENTIFIER LF_SEQ_ACT_3_ ECU_ADDRESS 0x7fa636 BYTE_ORDER MSB_LAST FORMAT "%5.0" /end MEASUREMENT
/begin CHARACTERISTIC c_abc_inc_pps_ini_0 "anti bounce counter increment for diagnosis instance PPS_INI_0" VALUE 0x84fab1 _REC_VAL_20_u1 255. _CNV_A_R_LINEAR_____0_CM 0. 255. DISPLAY_IDENTIFIER C_ABC_INC_PPS_INI_0 FORMAT "%3.0" /end CHARACTERISTIC
/begin CHARACTERISTIC c_abc_max_pps_ini_0 "maximum value of anti bounce counter for diagnosis instance PPS_INI_0" VALUE 0x84fb3d _REC_VAL_20_u1 255. _CNV_A_R_LINEAR_____0_CM 0. 255. DISPLAY_IDENTIFIER C_ABC_MAX_PPS_INI_0 FORMAT "%3.0" /end CHARACTERISTIC
/begin CHARACTERISTIC c_abc_inc_pps_ini_tout_0 "anti bounce counter increment for diagnosis instance PPS_INI_TOUT_0" VALUE 0x84fab2 _REC_VAL_20_u1 255. _CNV_A_R_LINEAR_____0_CM 0. 255. DISPLAY_IDENTIFIER C_ABC_INC_PPS_INI_TOUT_0 FORMAT "%3.0" /end CHARACTERISTIC
/begin CHARACTERISTIC c_abc_max_pps_ini_tout_0 "maximum value of anti bounce counter for diagnosis instance PPS_INI_TOUT_0" VALUE 0x84fb3e _REC_VAL_20_u1 255. _CNV_A_R_LINEAR_____0_CM 0. 255. DISPLAY_IDENTIFIER C_ABC_MAX_PPS_INI_TOUT_0 FORMAT "%3.0" /end CHARACTERISTIC
/begin CHARACTERISTIC c_abc_inc_pps_plaus_0 "anti bounce counter increment for diagnosis instance PPS_PLAUS_0" VALUE 0x84fab7 _REC_VAL_20_u1 255. _CNV_A_R_LINEAR_____0_CM 0. 255. DISPLAY_IDENTIFIER C_ABC_INC_PPS_PLAUS_0 FORMAT "%3.0" /end CHARACTERISTIC
/begin CHARACTERISTIC c_abc_max_pps_plaus_0 "maximum value of anti bounce counter for diagnosis instance PPS_PLAUS_0" VALUE 0x84fb43 _REC_VAL_20_u1 255. _CNV_A_R_LINEAR_____0_CM 0. 255. DISPLAY_IDENTIFIER C_ABC_MAX_PPS_PLAUS_0 FORMAT "%3.0" /end CHARACTERISTIC
/begin CHARACTERISTIC c_abc_inc_pps_cal_0 "anti bounce counter increment for diagnosis instance PPS_CAL_0" VALUE 0x84faaf _REC_VAL_20_u1 255. _CNV_A_R_LINEAR_____0_CM 0. 255. DISPLAY_IDENTIFIER C_ABC_INC_PPS_CAL_0 FORMAT "%3.0" /end CHARACTERISTIC
/begin CHARACTERISTIC c_abc_max_pps_cal_0 "maximum value of anti bounce counter for diagnosis instance PPS_CAL_0" VALUE 0x84fb3b _REC_VAL_20_u1 255. _CNV_A_R_LINEAR_____0_CM 0. 255. DISPLAY_IDENTIFIER C_ABC_MAX_PPS_CAL_0 FORMAT "%3.0" /end CHARACTERISTIC
/begin CHARACTERISTIC c_abc_inc_pps_v_inj_0 "anti bounce counter increment for diagnosis instance PPS_V_INJ_0" VALUE 0x84fabe _REC_VAL_20_u1 255. _CNV_A_R_LINEAR_____0_CM 0. 255. DISPLAY_IDENTIFIER C_ABC_INC_PPS_V_INJ_0 FORMAT "%3.0" /end CHARACTERISTIC
/begin CHARACTERISTIC c_abc_max_pps_v_inj_0 "maximum value of anti bounce counter for diagnosis instance PPS_V_INJ_0" VALUE 0x84fb4a _REC_VAL_20_u1 255. _CNV_A_R_LINEAR_____0_CM 0. 255. DISPLAY_IDENTIFIER C_ABC_MAX_PPS_V_INJ_0 FORMAT "%3.0" /end CHARACTERISTIC
/begin CHARACTERISTIC c_abc_inc_pps_wdt_0 "anti bounce counter increment for diagnosis instance PPS_WDT_0" VALUE 0x84fabf _REC_VAL_20_u1 255. _CNV_A_R_LINEAR_____0_CM 0. 255. DISPLAY_IDENTIFIER C_ABC_INC_PPS_WDT_0 FORMAT "%3.0" /end CHARACTERISTIC
/begin CHARACTERISTIC c_abc_max_pps_wdt_0 "maximum value of anti bounce counter for diagnosis instance PPS_WDT_0" VALUE 0x84fb4b _REC_VAL_20_u1 255. _CNV_A_R_LINEAR_____0_CM 0. 255. DISPLAY_IDENTIFIER C_ABC_MAX_PPS_WDT_0 FORMAT "%3.0" /end CHARACTERISTIC
/begin CHARACTERISTIC c_abc_inc_pps_fsm_0 "anti bounce counter increment for diagnosis instance PPS_FSM_0" VALUE 0x84fab0 _REC_VAL_20_u1 255. _CNV_A_R_LINEAR_____0_CM 0. 255. DISPLAY_IDENTIFIER C_ABC_INC_PPS_FSM_0 FORMAT "%3.0" /end CHARACTERISTIC
/begin CHARACTERISTIC c_abc_max_pps_fsm_0 "maximum value of anti bounce counter for diagnosis instance PPS_FSM_0" VALUE 0x84fb3c _REC_VAL_20_u1 255. _CNV_A_R_LINEAR_____0_CM 0. 255. DISPLAY_IDENTIFIER C_ABC_MAX_PPS_FSM_0 FORMAT "%3.0" /end CHARACTERISTIC
/begin CHARACTERISTIC c_abc_inc_pps_oc_0 "anti bounce counter increment for diagnosis instance PPS_OC_0" VALUE 0x84fab3 _REC_VAL_20_u1 255. _CNV_A_R_LINEAR_____0_CM 0. 255. DISPLAY_IDENTIFIER C_ABC_INC_PPS_OC_0 FORMAT "%3.0" /end CHARACTERISTIC
/begin CHARACTERISTIC c_abc_max_pps_oc_0 "maximum value of anti bounce counter for diagnosis instance PPS_OC_0" VALUE 0x84fb3f _REC_VAL_20_u1 255. _CNV_A_R_LINEAR_____0_CM 0. 255. DISPLAY_IDENTIFIER C_ABC_MAX_PPS_OC_0 FORMAT "%3.0" /end CHARACTERISTIC
/begin CHARACTERISTIC c_abc_inc_pps_oc_1 "anti bounce counter increment for diagnosis instance PPS_OC_0" VALUE 0x84fab4 _REC_VAL_20_u1 255. _CNV_A_R_LINEAR_____0_CM 0. 255. DISPLAY_IDENTIFIER C_ABC_INC_PPS_OC_1 FORMAT "%3.0" /end CHARACTERISTIC
/begin CHARACTERISTIC c_abc_max_pps_oc_1 "maximum value of anti bounce counter for diagnosis instance PPS_OC_0" VALUE 0x84fb40 _REC_VAL_20_u1 255. _CNV_A_R_LINEAR_____0_CM 0. 255. DISPLAY_IDENTIFIER C_ABC_MAX_PPS_OC_1 FORMAT "%3.0" /end CHARACTERISTIC
/begin CHARACTERISTIC c_abc_inc_pps_oc_2 "anti bounce counter increment for diagnosis instance PPS_OC_0" VALUE 0x84fab5 _REC_VAL_20_u1 255. _CNV_A_R_LINEAR_____0_CM 0. 255. DISPLAY_IDENTIFIER C_ABC_INC_PPS_OC_2 FORMAT "%3.0" /end CHARACTERISTIC
/begin CHARACTERISTIC c_abc_max_pps_oc_2 "maximum value of anti bounce counter for diagnosis instance PPS_OC_0" VALUE 0x84fb41 _REC_VAL_20_u1 255. _CNV_A_R_LINEAR_____0_CM 0. 255. DISPLAY_IDENTIFIER C_ABC_MAX_PPS_OC_2 FORMAT "%3.0" /end CHARACTERISTIC
/begin CHARACTERISTIC c_abc_inc_pps_oc_3 "anti bounce counter increment for diagnosis instance PPS_OC_0" VALUE 0x84fab6 _REC_VAL_20_u1 255. _CNV_A_R_LINEAR_____0_CM 0. 255. DISPLAY_IDENTIFIER C_ABC_INC_PPS_OC_3 FORMAT "%3.0" /end CHARACTERISTIC
/begin CHARACTERISTIC c_abc_max_pps_oc_3 "maximum value of anti bounce counter for diagnosis instance PPS_OC_0" VALUE 0x84fb42 _REC_VAL_20_u1 255. _CNV_A_R_LINEAR_____0_CM 0. 255. DISPLAY_IDENTIFIER C_ABC_MAX_PPS_OC_3 FORMAT "%3.0" /end CHARACTERISTIC
/begin CHARACTERISTIC c_abc_inc_pps_sc_h_l_0 "anti bounce counter increment for diagnosis instance PPS_SC_H_L_1" VALUE 0x84fab9 _REC_VAL_20_u1 255. _CNV_A_R_LINEAR_____0_CM 0. 255. DISPLAY_IDENTIFIER C_ABC_INC_PPS_SC_H_L_0 FORMAT "%3.0" /end CHARACTERISTIC
/begin CHARACTERISTIC c_abc_max_pps_sc_h_l_0 "maximum value of anti bounce counter for diagnosis instance PPS_SC_H_L_1" VALUE 0x84fb45 _REC_VAL_20_u1 255. _CNV_A_R_LINEAR_____0_CM 0. 255. DISPLAY_IDENTIFIER C_ABC_MAX_PPS_SC_H_L_0 FORMAT "%3.0" /end CHARACTERISTIC
/begin CHARACTERISTIC c_abc_inc_pps_sc_h_l_1 "anti bounce counter increment for diagnosis instance PPS_SC_H_L_1" VALUE 0x84faba _REC_VAL_20_u1 255. _CNV_A_R_LINEAR_____0_CM 0. 255. DISPLAY_IDENTIFIER C_ABC_INC_PPS_SC_H_L_1 FORMAT "%3.0" /end CHARACTERISTIC
/begin CHARACTERISTIC c_abc_max_pps_sc_h_l_1 "maximum value of anti bounce counter for diagnosis instance PPS_SC_H_L_1" VALUE 0x84fb46 _REC_VAL_20_u1 255. _CNV_A_R_LINEAR_____0_CM 0. 255. DISPLAY_IDENTIFIER C_ABC_MAX_PPS_SC_H_L_1 FORMAT "%3.0" /end CHARACTERISTIC
/begin CHARACTERISTIC c_abc_inc_pps_sc_h_l_2 "anti bounce counter increment for diagnosis instance PPS_SC_H_L_1" VALUE 0x84fabb _REC_VAL_20_u1 255. _CNV_A_R_LINEAR_____0_CM 0. 255. DISPLAY_IDENTIFIER C_ABC_INC_PPS_SC_H_L_2 FORMAT "%3.0" /end CHARACTERISTIC
/begin CHARACTERISTIC c_abc_max_pps_sc_h_l_2 "maximum value of anti bounce counter for diagnosis instance PPS_SC_H_L_1" VALUE 0x84fb47 _REC_VAL_20_u1 255. _CNV_A_R_LINEAR_____0_CM 0. 255. DISPLAY_IDENTIFIER C_ABC_MAX_PPS_SC_H_L_2 FORMAT "%3.0" /end CHARACTERISTIC
/begin CHARACTERISTIC c_abc_inc_pps_sc_h_l_3 "anti bounce counter increment for diagnosis instance PPS_SC_H_L_1" VALUE 0x84fabc _REC_VAL_20_u1 255. _CNV_A_R_LINEAR_____0_CM 0. 255. DISPLAY_IDENTIFIER C_ABC_INC_PPS_SC_H_L_3 FORMAT "%3.0" /end CHARACTERISTIC
/begin CHARACTERISTIC c_abc_max_pps_sc_h_l_3 "maximum value of anti bounce counter for diagnosis instance PPS_SC_H_L_1" VALUE 0x84fb48 _REC_VAL_20_u1 255. _CNV_A_R_LINEAR_____0_CM 0. 255. DISPLAY_IDENTIFIER C_ABC_MAX_PPS_SC_H_L_3 FORMAT "%3.0" /end CHARACTERISTIC
/begin CHARACTERISTIC c_abc_inc_pps_sc_h_0 "anti bounce counter increment for diagnosis instance PPS_SC_H_0" VALUE 0x84fab8 _REC_VAL_20_u1 255. _CNV_A_R_LINEAR_____0_CM 0. 255. DISPLAY_IDENTIFIER C_ABC_INC_PPS_SC_H_0 FORMAT "%3.0" /end CHARACTERISTIC
/begin CHARACTERISTIC c_abc_max_pps_sc_h_0 "maximum value of anti bounce counter for diagnosis instance PPS_SC_H_0" VALUE 0x84fb44 _REC_VAL_20_u1 255. _CNV_A_R_LINEAR_____0_CM 0. 255. DISPLAY_IDENTIFIER C_ABC_MAX_PPS_SC_H_0 FORMAT "%3.0" /end CHARACTERISTIC
/begin CHARACTERISTIC c_abc_inc_pps_sc_l_0 "anti bounce counter increment for diagnosis instance PPS_SC_L_0" VALUE 0x84fabd _REC_VAL_20_u1 255. _CNV_A_R_LINEAR_____0_CM 0. 255. DISPLAY_IDENTIFIER C_ABC_INC_PPS_SC_L_0 FORMAT "%3.0" /end CHARACTERISTIC
/begin CHARACTERISTIC c_abc_max_pps_sc_l_0 "maximum value of anti bounce counter for diagnosis instance PPS_SC_L_0" VALUE 0x84fb49 _REC_VAL_20_u1 255. _CNV_A_R_LINEAR_____0_CM 0. 255. DISPLAY_IDENTIFIER C_ABC_MAX_PPS_SC_L_0 FORMAT "%3.0" /end CHARACTERISTIC
/begin CHARACTERISTIC c_abc_inc_v_tfu_rng "anti bounce counter increment for diagnosis instance V_TFU_RNG" VALUE 0x84faef _REC_VAL_20_u1 255. _CNV_A_R_LINEAR_____0_CM 0. 255. DISPLAY_IDENTIFIER C_ABC_INC_V_TFU_RNG FORMAT "%3.0" /end CHARACTERISTIC
/begin CHARACTERISTIC c_abc_max_v_tfu_rng "maximum value of anti bounce counter for diagnosis instance V_TFU_RNG" VALUE 0x84fb7b _REC_VAL_20_u1 255. _CNV_A_R_LINEAR_____0_CM 0. 255. DISPLAY_IDENTIFIER C_ABC_MAX_V_TFU_RNG FORMAT "%3.0" /end CHARACTERISTIC
/begin CHARACTERISTIC c_abc_inc_tfu_mes_grd "anti bounce counter increment for diagnosis instance TFU_MES_GRD" VALUE 0x84fad5 _REC_VAL_20_u1 255. _CNV_A_R_LINEAR_____0_CM 0. 255. DISPLAY_IDENTIFIER C_ABC_INC_TFU_MES_GRD FORMAT "%3.0" /end CHARACTERISTIC
/begin CHARACTERISTIC c_abc_max_tfu_mes_grd "maximum value of anti bounce counter for diagnosis instance TFU_MES_GRD" VALUE 0x84fb61 _REC_VAL_20_u1 255. _CNV_A_R_LINEAR_____0_CM 0. 255. DISPLAY_IDENTIFIER C_ABC_MAX_TFU_MES_GRD FORMAT "%3.0" /end CHARACTERISTIC
/begin CHARACTERISTIC c_abc_inc_tfu_mes_plaus "anti bounce counter increment for diagnosis instance TFU_MES_PLAUS" VALUE 0x84fad6 _REC_VAL_20_u1 255. _CNV_A_R_LINEAR_____0_CM 0. 255. DISPLAY_IDENTIFIER C_ABC_INC_TFU_MES_PLAUS FORMAT "%3.0" /end CHARACTERISTIC
/begin CHARACTERISTIC c_abc_max_tfu_mes_plaus "maximum value of anti bounce counter for diagnosis instance TFU_MES_PLAUS" VALUE 0x84fb62 _REC_VAL_20_u1 255. _CNV_A_R_LINEAR_____0_CM 0. 255. DISPLAY_IDENTIFIER C_ABC_MAX_TFU_MES_PLAUS FORMAT "%3.0" /end CHARACTERISTIC
/begin MEASUREMENT lv_err_tfu_mes "global TFU_MES error flag" UBYTE _CNV_S_2_RANGE______23_CM 1 0. 0. 1. DISPLAY_IDENTIFIER LV_ERR_TFU_MES ECU_ADDRESS 0x7fb84a /end MEASUREMENT
/begin MEASUREMENT lv_rst_diag_tfu_mes_plaus "reset of TFU plausibility diagnosis" UBYTE _CNV_S_2_RANGE______11_CM 1 0. 0. 1. DISPLAY_IDENTIFIER LV_RST_DIAG_TFU_MES_PLAUS ECU_ADDRESS 0x7fbe29 /end MEASUREMENT
/begin MEASUREMENT tfu_mes_st_diag "measured fuel temperature at start" UBYTE _CNV_A_R_LINEAR_____18_CM 1 0. -50. 205. DISPLAY_IDENTIFIER TFU_MES_ST_DIAG ECU_ADDRESS 0x7fbe28 FORMAT "%3.0" /end MEASUREMENT
/begin MEASUREMENT t_v_tfu_rng_diag "timer for TFU range check" UWORD _CNV_A_R_LINEAR_____19_CM 1 0. 0. 6553.5 DISPLAY_IDENTIFIER T_V_TFU_RNG_DIAG ECU_ADDRESS 0x7fa65a BYTE_ORDER MSB_LAST FORMAT "%5.1" /end MEASUREMENT
/begin CHARACTERISTIC c_v_tfu_max_diag "V_TFU maximum threshold for error detection" VALUE 0x8500c0 _REC_VAL_20_u2 4.9951171875 _CNV_A_R_LINEAR_____28_CM 0. 4.9951171875 DISPLAY_IDENTIFIER C_V_TFU_MAX_DIAG FORMAT "%3.2" /end CHARACTERISTIC
/begin CHARACTERISTIC c_v_tfu_min_diag "V_TFU minimum threshold for error detection" VALUE 0x8500c2 _REC_VAL_20_u2 4.9951171875 _CNV_A_R_LINEAR_____28_CM 0. 4.9951171875 DISPLAY_IDENTIFIER C_V_TFU_MIN_DIAG FORMAT "%3.2" /end CHARACTERISTIC
/begin CHARACTERISTIC c_tfu_mes_grd_diag "TFU_MES_GRD threshold for error detection" VALUE 0x850033 _REC_VAL_20_u1 255. _CNV_A_R_LINEAR_____238_CM 0. 255. DISPLAY_IDENTIFIER C_TFU_MES_GRD_DIAG FORMAT "%3.0" /end CHARACTERISTIC
/begin CHARACTERISTIC c_tfu_mes_st_diag "TFU_MES_ST threshold for TFU_MES plausibility check" VALUE 0x850034 _REC_VAL_20_u1 255. _CNV_A_R_LINEAR_____18_CM -50. 205. DISPLAY_IDENTIFIER C_TFU_MES_ST_DIAG FORMAT "%3.0" /end CHARACTERISTIC
/begin CHARACTERISTIC c_t_ast_tfu_diag "T_AST threshold for TFU_MES plausibility check" VALUE 0x84ff28 _REC_VAL_20_u2 6553.5 _CNV_A_R_LINEAR_____19_CM 0. 6553.5 DISPLAY_IDENTIFIER C_T_AST_TFU_DIAG FORMAT "%5.1" /end CHARACTERISTIC
/begin CHARACTERISTIC c_tfu_plaus_inc_diag "increment of TFU_MES_ST_DIAG for TFU_MES plausibilty" VALUE 0x850035 _REC_VAL_20_u1 255. _CNV_A_R_LINEAR_____20_CM 0. 255. DISPLAY_IDENTIFIER C_TFU_PLAUS_INC_DIAG FORMAT "%3.0" /end CHARACTERISTIC
/begin CHARACTERISTIC c_n_v_tfu_rng_diag "engine speed threshold for diagnostic instance V_TFU_RNG" VALUE 0x84fe38 _REC_VAL_20_u2 6375. _CNV_A_R_LINEAR_____5_CM 0. 6375. DISPLAY_IDENTIFIER C_N_V_TFU_RNG_DIAG FORMAT "%4.0" /end CHARACTERISTIC
/begin CHARACTERISTIC c_tqi_sp_v_tfu_rng_diag "indicated torque setpoint threshold for diagnostic instance V_TFU_RNG" VALUE 0x85007a _REC_VAL_20_s2 2047.96875 _CNV_A_R_LINEAR_____52_CM -1024. 1023.96875 DISPLAY_IDENTIFIER C_TQI_SP_V_TFU_RNG_DIAG FORMAT "%6.2" /end CHARACTERISTIC
/begin CHARACTERISTIC c_t_max_v_tfu_rng_diag "time delay for diagnostic instance V_TFU_RNG" VALUE 0x84ffcc _REC_VAL_20_u2 6553.5 _CNV_A_R_LINEAR_____19_CM 0. 6553.5 DISPLAY_IDENTIFIER C_T_MAX_V_TFU_RNG_DIAG FORMAT "%5.1" /end CHARACTERISTIC
/begin MEASUREMENT lv_tq_is_ad_act "logical variable for activation of torque idle speed adaption" UBYTE _CNV_S_2_RANGE______11_CM 1 0. 0. 1. DISPLAY_IDENTIFIER LV_TQ_IS_AD_ACT ECU_ADDRESS 0x7fbfe8 /end MEASUREMENT
/begin MEASUREMENT lv_is_ad_cnd_tco "flag 'TCO valid for torque loss adaption'" UBYTE _CNV_S_2_RANGE______11_CM 1 0. 0. 1. DISPLAY_IDENTIFIER LV_IS_AD_CND_TCO ECU_ADDRESS 0x7fbfe9 /end MEASUREMENT
/begin MEASUREMENT lv_dly_ad_is "flag 'N_DIF settled' for torque loss adaption" UBYTE _CNV_S_2_RANGE______11_CM 1 0. 0. 1. DISPLAY_IDENTIFIER LV_DLY_AD_IS ECU_ADDRESS 0x7fbfea /end MEASUREMENT
/begin MEASUREMENT tq_dif_is_ad_l "stored TQ_LOSS adaption torque at low TCO range (without ACC and CONV)" SLONG _CNV_A_R_LINEAR_____394_CM 1 0. -1024. 1023.96875 DISPLAY_IDENTIFIER TQ_DIF_IS_AD_L ECU_ADDRESS 0x7f876c BYTE_ORDER MSB_LAST FORMAT "%11.7" /end MEASUREMENT
/begin MEASUREMENT tq_dif_is_ad_mid "stored TQ_LOSS adaption torque at middle TCO range (without ACC and CONV)" SLONG _CNV_A_R_LINEAR_____394_CM 1 0. -1024. 1023.96875 DISPLAY_IDENTIFIER TQ_DIF_IS_AD_MID ECU_ADDRESS 0x7f8770 BYTE_ORDER MSB_LAST FORMAT "%11.7" /end MEASUREMENT
/begin MEASUREMENT tq_dif_is_ad_h "stored TQ_LOSS adaption torque at high TCO range (without ACC and CONV)" SLONG _CNV_A_R_LINEAR_____394_CM 1 0. -1024. 1023.96875 DISPLAY_IDENTIFIER TQ_DIF_IS_AD_H ECU_ADDRESS 0x7f8774 BYTE_ORDER MSB_LAST FORMAT "%11.7" /end MEASUREMENT
/begin MEASUREMENT fac_tq_is_ad_conv_inter "stored adaption factor for converter torque" SLONG _CNV_A_R_LINEAR_____563_CM 1 0. -2.44e-004 2.44e-004 DISPLAY_IDENTIFIER FAC_TQ_IS_AD_CONV_INTER ECU_ADDRESS 0x7f8780 BYTE_ORDER MSB_LAST FORMAT "%14.13" /end MEASUREMENT
/begin MEASUREMENT tq_dif_is_ad_acc_conv_inter "stored TQ_LOSS_ACC adaption torque including CONV" SLONG _CNV_A_R_LINEAR_____394_CM 1 0. -1024. 1023.96875 DISPLAY_IDENTIFIER TQ_DIF_IS_AD_ACC_CONV_INTER ECU_ADDRESS 0x7f8778 BYTE_ORDER MSB_LAST FORMAT "%11.7" /end MEASUREMENT
/begin MEASUREMENT tq_dif_is_ad_acc_inter "stored TQ_LOSS_ACC adaption torque without CONV" SLONG _CNV_A_R_LINEAR_____394_CM 1 0. -1024. 1023.96875 DISPLAY_IDENTIFIER TQ_DIF_IS_AD_ACC_INTER ECU_ADDRESS 0x7f877c BYTE_ORDER MSB_LAST FORMAT "%11.7" /end MEASUREMENT
/begin MEASUREMENT lv_first_tq_is_ad_end "flag for 'first TQ_LOSS adaption finished'" UBYTE _CNV_S_2_RANGE______11_CM 1 0. 0. 1. DISPLAY_IDENTIFIER LV_FIRST_TQ_IS_AD_END ECU_ADDRESS 0x7fbbf9 /end MEASUREMENT
/begin MEASUREMENT nr_tco_rng_is_ad "number of actual TCO range for TQ_LOSS adaption" UBYTE _CNV_A_R_LINEAR_____0_CM 1 0. 0. 6. DISPLAY_IDENTIFIER NR_TCO_RNG_IS_AD ECU_ADDRESS 0x7fbfe7 FORMAT "%1.0" /end MEASUREMENT
/begin MEASUREMENT lv_calib_tco_is_ad_vld "flag for 'TCO range calibration valid'" UBYTE _CNV_S_2_RANGE______11_CM 1 0. 0. 1. DISPLAY_IDENTIFIER LV_CALIB_TCO_IS_AD_VLD ECU_ADDRESS 0x7fbfeb /end MEASUREMENT
/begin MEASUREMENT tco_h_res_fil "filtered TCO for smooth interpolation of TQ_DIF_IS_AD" UWORD _CNV_A_R_LINEAR_____564_CM 1 0. -50. 205. DISPLAY_IDENTIFIER TCO_H_RES_FIL ECU_ADDRESS 0x7fb4de BYTE_ORDER MSB_LAST /end MEASUREMENT
/begin MEASUREMENT tq_dif_is_ad "TQ_LOSS adaption torque (without ACC and CONV)" SWORD _CNV_A_R_LINEAR_____52_CM 1 0. -1024. 1023.96875 DISPLAY_IDENTIFIER TQ_DIF_IS_AD ECU_ADDRESS 0x7fa308 BYTE_ORDER MSB_LAST FORMAT "%6.2" /end MEASUREMENT
/begin MEASUREMENT tq_dif_is_ad_acc "TQ_LOSS_ACC adaption torque" SWORD _CNV_A_R_LINEAR_____52_CM 1 0. -1024. 1023.96875 DISPLAY_IDENTIFIER TQ_DIF_IS_AD_ACC ECU_ADDRESS 0x7fa30a BYTE_ORDER MSB_LAST FORMAT "%6.2" /end MEASUREMENT
/begin MEASUREMENT fac_tq_is_ad_conv "adaption factor for converter torque" SWORD _CNV_A_R_LINEAR_____565_CM 1 0. -2.44e-004 2.43992e-004 DISPLAY_IDENTIFIER FAC_TQ_IS_AD_CONV ECU_ADDRESS 0x7fa30c BYTE_ORDER MSB_LAST FORMAT "%10.9" /end MEASUREMENT
/begin MEASUREMENT lv_dis_ad_clu "logical variable to disable clutch adaption of ETCU" UBYTE _CNV_S_2_RANGE______11_CM 1 0. 0. 1. DISPLAY_IDENTIFIER LV_DIS_AD_CLU ECU_ADDRESS 0x7fbbfa /end MEASUREMENT
/begin CHARACTERISTIC lc_tq_is_ad_ena_bls "torque loss adaption enabled by brake" VALUE 0x85ceb9 _REC_VAL_20_u1 1. _CNV_A_R_LINEAR_____0_CM 0. 1. DISPLAY_IDENTIFIER LC_TQ_IS_AD_ENA_BLS FORMAT "%1.0" /end CHARACTERISTIC
/begin CHARACTERISTIC lc_tq_is_ad_ena_cs "torque loss adaption enabled by clutch" VALUE 0x85ceba _REC_VAL_20_u1 1. _CNV_A_R_LINEAR_____0_CM 0. 1. DISPLAY_IDENTIFIER LC_TQ_IS_AD_ENA_CS FORMAT "%1.0" /end CHARACTERISTIC
/begin CHARACTERISTIC lc_tq_is_ad_man "switch for manual torque loss adaption" VALUE 0x85cebb _REC_VAL_20_u1 1. _CNV_A_R_LINEAR_____0_CM 0. 1. DISPLAY_IDENTIFIER LC_TQ_IS_AD_MAN FORMAT "%1.0" /end CHARACTERISTIC
/begin CHARACTERISTIC lc_tq_is_ad_man_act "switch for activation of manual torque loss adaption" VALUE 0x85cebc _REC_VAL_20_u1 1. _CNV_A_R_LINEAR_____0_CM 0. 1. DISPLAY_IDENTIFIER LC_TQ_IS_AD_MAN_ACT FORMAT "%1.0" /end CHARACTERISTIC
/begin CHARACTERISTIC c_n_delta "max. deviation fo engine speed from N_SP_IS" VALUE 0x85cb00 _REC_VAL_20_u2 6375. _CNV_A_R_LINEAR_____5_CM 0. 6375. DISPLAY_IDENTIFIER C_N_DELTA FORMAT "%4.0" /end CHARACTERISTIC
/begin CHARACTERISTIC c_t_dly_is_ad "delay for shifting in torque reduction" VALUE 0x85cc2a _REC_VAL_20_u1 31.96875 _CNV_A_R_LINEAR_____566_CM 0. 31.96875 DISPLAY_IDENTIFIER C_T_DLY_IS_AD FORMAT "%3.1" /end CHARACTERISTIC
/begin CHARACTERISTIC c_fac_tq_is_ad "Calib. parameter, LV_ACC=0, LV_DT=0" VALUE 0x85ca18 _REC_VAL_20_u2 0.1 _CNV_A_R_LINEAR_____567_CM 0. 0.1 DISPLAY_IDENTIFIER C_FAC_TQ_IS_AD FORMAT "%7.6" /end CHARACTERISTIC
/begin CHARACTERISTIC c_tq_is_ad_delta "limitation for engine torque loss adaptation" VALUE 0x85cd30 _REC_VAL_20_u2 1023.96875 _CNV_A_R_LINEAR_____52_CM 0. 1023.96875 DISPLAY_IDENTIFIER C_TQ_IS_AD_DELTA FORMAT "%6.2" /end CHARACTERISTIC
/begin CHARACTERISTIC c_fac_tq_is_ad_conv "Calib. parameter, LV_ACC=0, LV_DT=1" VALUE 0x85ca1e _REC_VAL_20_u2 4.88e-004 _CNV_A_R_LINEAR_____568_CM 0. 4.88e-004 DISPLAY_IDENTIFIER C_FAC_TQ_IS_AD_CONV FORMAT "%10.9" /end CHARACTERISTIC
/begin CHARACTERISTIC c_fac_tq_is_ad_conv_delta "limitation for converter torque adaptation factor" VALUE 0x85ca20 _REC_VAL_20_u2 2.43992e-004 _CNV_A_R_LINEAR_____569_CM 0. 2.43992e-004 DISPLAY_IDENTIFIER C_FAC_TQ_IS_AD_CONV_DELTA FORMAT "%10.9" /end CHARACTERISTIC
/begin CHARACTERISTIC c_fac_tq_is_ad_acc_conv "Calib. parameter, LV_ACC=1, LV_DT=1" VALUE 0x85ca1c _REC_VAL_20_u2 0.1 _CNV_A_R_LINEAR_____567_CM 0. 0.1 DISPLAY_IDENTIFIER C_FAC_TQ_IS_AD_ACC_CONV FORMAT "%7.6" /end CHARACTERISTIC
/begin CHARACTERISTIC c_tq_is_ad_acc_conv_delta "limitation for ACC and converter torque adaptation" VALUE 0x85cd2c _REC_VAL_20_u2 1023.96875 _CNV_A_R_LINEAR_____52_CM 0. 1023.96875 DISPLAY_IDENTIFIER C_TQ_IS_AD_ACC_CONV_DELTA FORMAT "%6.2" /end CHARACTERISTIC
/begin CHARACTERISTIC c_fac_tq_is_ad_acc "Calib. parameter, LV_ACC=1, LV_DT=0" VALUE 0x85ca1a _REC_VAL_20_u2 0.1 _CNV_A_R_LINEAR_____567_CM 0. 0.1 DISPLAY_IDENTIFIER C_FAC_TQ_IS_AD_ACC FORMAT "%7.6" /end CHARACTERISTIC
/begin CHARACTERISTIC c_tq_is_ad_acc_delta "limitation for ACC torque adaptation" VALUE 0x85cd2e _REC_VAL_20_u2 1023.96875 _CNV_A_R_LINEAR_____52_CM 0. 1023.96875 DISPLAY_IDENTIFIER C_TQ_IS_AD_ACC_DELTA FORMAT "%6.2" /end CHARACTERISTIC
/begin CHARACTERISTIC c_tq_is_ad_first_ad_end "max. torque for detection of end of first TQ_LOSS adaption" VALUE 0x85cd32 _REC_VAL_20_u2 1023.96875 _CNV_A_R_LINEAR_____52_CM 0. 1023.96875 DISPLAY_IDENTIFIER C_TQ_IS_AD_FIRST_AD_END FORMAT "%6.2" /end CHARACTERISTIC
/begin CHARACTERISTIC c_t_ast_is_ad_first_ad_end "min. time after start for detection of end of first TQ_LOSS adaption" VALUE 0x85cc0e _REC_VAL_20_u2 6553.5 _CNV_A_R_LINEAR_____19_CM 0. 6553.5 DISPLAY_IDENTIFIER C_T_AST_IS_AD_FIRST_AD_END FORMAT "%5.1" /end CHARACTERISTIC
/begin CHARACTERISTIC c_tco_is_ad_h_max "max. temperature limit for torque loss adaptation at high TCO range" VALUE 0x85ccb1 _REC_VAL_20_u1 255. _CNV_A_R_LINEAR_____18_CM -50. 205. DISPLAY_IDENTIFIER C_TCO_IS_AD_H_MAX FORMAT "%3.0" /end CHARACTERISTIC
/begin CHARACTERISTIC c_tco_is_ad_h_min "min. temperature limit for torque loss adaptation at high TCO range" VALUE 0x85ccb2 _REC_VAL_20_u1 255. _CNV_A_R_LINEAR_____18_CM -50. 205. DISPLAY_IDENTIFIER C_TCO_IS_AD_H_MIN FORMAT "%3.0" /end CHARACTERISTIC
/begin CHARACTERISTIC c_tco_is_ad_l_max "max. temperature limit for torque loss adaptation at low TCO range" VALUE 0x85ccb3 _REC_VAL_20_u1 255. _CNV_A_R_LINEAR_____18_CM -50. 205. DISPLAY_IDENTIFIER C_TCO_IS_AD_L_MAX FORMAT "%3.0" /end CHARACTERISTIC
/begin CHARACTERISTIC c_tco_is_ad_l_min "min. temperature limit for torque loss adaptation at low TCO range" VALUE 0x85ccb4 _REC_VAL_20_u1 255. _CNV_A_R_LINEAR_____18_CM -50. 205. DISPLAY_IDENTIFIER C_TCO_IS_AD_L_MIN FORMAT "%3.0" /end CHARACTERISTIC
/begin CHARACTERISTIC c_tco_is_ad_mid_max "max. temperature limit for torque loss adaptation at middle TCO range" VALUE 0x85ccb5 _REC_VAL_20_u1 255. _CNV_A_R_LINEAR_____18_CM -50. 205. DISPLAY_IDENTIFIER C_TCO_IS_AD_MID_MAX FORMAT "%3.0" /end CHARACTERISTIC
/begin CHARACTERISTIC c_tco_is_ad_mid_min "min. temperature limit for torque loss adaptation at middle TCO range" VALUE 0x85ccb6 _REC_VAL_20_u1 255. _CNV_A_R_LINEAR_____18_CM -50. 205. DISPLAY_IDENTIFIER C_TCO_IS_AD_MID_MIN FORMAT "%3.0" /end CHARACTERISTIC
/begin CHARACTERISTIC c_crlc_tco_h_res_fil "correlation constant for smoothing TCO for interpolation" VALUE 0x85c908 _REC_VAL_20_u2 0.9999847412109381 _CNV_A_R_LINEAR_____14_CM 0. 0.9999847412109381 DISPLAY_IDENTIFIER C_CRLC_TCO_H_RES_FIL FORMAT "%6.5" /end CHARACTERISTIC
/begin CHARACTERISTIC c_crlc_tq_dif_is_ad_acc "correlation constant for smoothing ACC-adaptation values" VALUE 0x85c90a _REC_VAL_20_u2 0.9999847412109381 _CNV_A_R_LINEAR_____14_CM 0. 0.9999847412109381 DISPLAY_IDENTIFIER C_CRLC_TQ_DIF_IS_AD_ACC FORMAT "%6.5" /end CHARACTERISTIC
/begin MEASUREMENT lv_err_dip_pf_mes "global error flag" UBYTE _CNV_S_2_RANGE______23_CM 1 0. 0. 1. DISPLAY_IDENTIFIER LV_ERR_DIP_PF_MES ECU_ADDRESS 0x7fb84b /end MEASUREMENT
/begin MEASUREMENT t_dip_pf_mes_es "timer for diagnostic condition for diagnostic instance DIP_PF_MES_ES" UBYTE _CNV_A_R_LINEAR_____19_CM 1 0. 0. 25.5 DISPLAY_IDENTIFIER T_DIP_PF_MES_ES ECU_ADDRESS 0x7fa65c FORMAT "%5.1" /end MEASUREMENT
/begin CHARACTERISTIC c_v_dip_pf_min_diag "minimum threshold for diagnostic instance V_DIP_PF" VALUE 0x8500a8 _REC_VAL_20_u2 4.9951171875 _CNV_A_R_LINEAR_____28_CM 0. 4.9951171875 DISPLAY_IDENTIFIER C_V_DIP_PF_MIN_DIAG FORMAT "%4.3" /end CHARACTERISTIC
/begin CHARACTERISTIC c_v_dip_pf_max_diag "maximum threshold for diagnostic instance V_DIP_PF" VALUE 0x8500a6 _REC_VAL_20_u2 4.9951171875 _CNV_A_R_LINEAR_____28_CM 0. 4.9951171875 DISPLAY_IDENTIFIER C_V_DIP_PF_MAX_DIAG FORMAT "%4.3" /end CHARACTERISTIC
/begin CHARACTERISTIC c_dip_pf_mes_grd_diag "Gradient threshold for diagnostic instance DIP_PF_MES_GRD" VALUE 0x84fc0c _REC_VAL_20_u2 5434. _CNV_A_R_LINEAR_____347_CM 0. 5434. DISPLAY_IDENTIFIER C_DIP_PF_MES_GRD_DIAG FORMAT "%6.2" /end CHARACTERISTIC
/begin CHARACTERISTIC c_dip_pf_mes_es_diag "differential pressure threshold for diagnostic instance DIP_PF_MES_ES" VALUE 0x84fc0a _REC_VAL_20_u2 5434. _CNV_A_R_LINEAR_____45_CM 0. 5434. DISPLAY_IDENTIFIER C_DIP_PF_MES_ES_DIAG FORMAT "%6.2" /end CHARACTERISTIC
/begin CHARACTERISTIC c_tac_max_dip_pf_mes_es_diag "temperature after catalyst maximal threshold for diagnostic instance DIP_PF_MES_ES" VALUE 0x850002 _REC_VAL_20_u2 1024. _CNV_A_R_LINEAR_____51_CM 0. 1024. DISPLAY_IDENTIFIER C_TAC_MAX_DIP_PF_MES_ES_DIAG FORMAT "%3.0" /end CHARACTERISTIC
/begin CHARACTERISTIC c_tac_min_dip_pf_mes_es_diag "temperature after catalyst minimal threshold for diagnostic instance DIP_PF_MES_ES" VALUE 0x850006 _REC_VAL_20_u2 1024. _CNV_A_R_LINEAR_____51_CM 0. 1024. DISPLAY_IDENTIFIER C_TAC_MIN_DIP_PF_MES_ES_DIAG FORMAT "%3.0" /end CHARACTERISTIC
/begin CHARACTERISTIC c_t_max_dip_pf_mes_es "timer threshold for diagnostic condition for diagnostic instance DIP_PF_MES_ES" VALUE 0x84ffbb _REC_VAL_20_u1 25.4 _CNV_A_R_LINEAR_____19_CM 0. 25.4 DISPLAY_IDENTIFIER C_T_MAX_DIP_PF_MES_ES FORMAT "%5.1" /end CHARACTERISTIC
/begin MEASUREMENT lv_err_vcc_dip_pf "LV_ERR_VCC_DIP_PF error flag" UBYTE _CNV_S_2_RANGE______23_CM 1 0. 0. 1. DISPLAY_IDENTIFIER LV_ERR_VCC_DIP_PF ECU_ADDRESS 0x7fb84c /end MEASUREMENT
/begin CHARACTERISTIC c_abc_inc_v_dip_pf_rng "anti bounce counter increment for diagnosis instance V_DIP_PF_RNG" VALUE 0x84fae2 _REC_VAL_20_u1 255. _CNV_A_R_LINEAR_____0_CM 0. 255. DISPLAY_IDENTIFIER C_ABC_INC_V_DIP_PF_RNG FORMAT "%3.0" /end CHARACTERISTIC
/begin CHARACTERISTIC c_abc_max_v_dip_pf_rng "maximum value of anti bounce counter for diagnosis instance V_DIP_PF_RNG" VALUE 0x84fb6e _REC_VAL_20_u1 255. _CNV_A_R_LINEAR_____0_CM 0. 255. DISPLAY_IDENTIFIER C_ABC_MAX_V_DIP_PF_RNG FORMAT "%3.0" /end CHARACTERISTIC
/begin CHARACTERISTIC c_abc_inc_dip_pf_mes_es "anti bounce counter increment for diagnosis instance DIP_PF_MES_ES" VALUE 0x84fa90 _REC_VAL_20_u1 255. _CNV_A_R_LINEAR_____0_CM 0. 255. DISPLAY_IDENTIFIER C_ABC_INC_DIP_PF_MES_ES FORMAT "%3.0" /end CHARACTERISTIC
/begin CHARACTERISTIC c_abc_max_dip_pf_mes_es "maximum value of anti bounce counter for diagnosis instance DIP_PF_MES_ES" VALUE 0x84fb1c _REC_VAL_20_u1 255. _CNV_A_R_LINEAR_____0_CM 0. 255. DISPLAY_IDENTIFIER C_ABC_MAX_DIP_PF_MES_ES FORMAT "%3.0" /end CHARACTERISTIC
/begin CHARACTERISTIC c_abc_inc_dip_pf_mes_grd "anti bounce counter increment for diagnosis instance DIP_PF_MES_GRD" VALUE 0x84fa91 _REC_VAL_20_u1 255. _CNV_A_R_LINEAR_____0_CM 0. 255. DISPLAY_IDENTIFIER C_ABC_INC_DIP_PF_MES_GRD FORMAT "%3.0" /end CHARACTERISTIC
/begin CHARACTERISTIC c_abc_max_dip_pf_mes_grd "maximum value of anti bounce counter for diagnosis instance DIP_PF_MES_GRD" VALUE 0x84fb1d _REC_VAL_20_u1 255. _CNV_A_R_LINEAR_____0_CM 0. 255. DISPLAY_IDENTIFIER C_ABC_MAX_DIP_PF_MES_GRD FORMAT "%3.0" /end CHARACTERISTIC
/begin MEASUREMENT lv_err_teg_tur_up_mes "global error flag" UBYTE _CNV_S_2_RANGE______23_CM 1 0. 0. 1. DISPLAY_IDENTIFIER LV_ERR_TEG_TUR_UP_MES ECU_ADDRESS 0x7fb84d /end MEASUREMENT
/begin MEASUREMENT ctr_v_teg_tur_up_rng_up "conter for TEG_TUR_UP range check dependent on torque request and engine speed" UWORD _CNV_A_R_LINEAR_____0_CM 1 0. 0. 65535. DISPLAY_IDENTIFIER CTR_V_TEG_TUR_UP_RNG_UP ECU_ADDRESS 0x7fa660 BYTE_ORDER MSB_LAST FORMAT "%4.1" /end MEASUREMENT
/begin MEASUREMENT lv_v_teg_tur_up_rng_up "diagnostic condition for diagnostic instance V_TEG_TUR_UP_RNG" UBYTE _CNV_S_2_RANGE______11_CM 1 0. 0. 1. DISPLAY_IDENTIFIER LV_V_TEG_TUR_UP_RNG_UP ECU_ADDRESS 0x7fbe2a /end MEASUREMENT
/begin CHARACTERISTIC c_abc_inc_v_teg_tur_up_rng "anti bounce counter increment for diagnosis instance V_TEG_TUR_UP_RNG" VALUE 0x84faee _REC_VAL_20_u1 255. _CNV_A_R_LINEAR_____0_CM 0. 255. DISPLAY_IDENTIFIER C_ABC_INC_V_TEG_TUR_UP_RNG FORMAT "%3.0" /end CHARACTERISTIC
/begin CHARACTERISTIC c_abc_max_v_teg_tur_up_rng "anti bounce counter maximum for diagnosis instance V_TEG_TUR_UP_RNG" VALUE 0x84fb7a _REC_VAL_20_u1 255. _CNV_A_R_LINEAR_____0_CM 0. 255. DISPLAY_IDENTIFIER C_ABC_MAX_V_TEG_TUR_UP_RNG FORMAT "%3.0" /end CHARACTERISTIC
/begin CHARACTERISTIC c_abc_inc_teg_tur_up_mes_grd "anti bounce counter increment for diagnosis instance TEG_TUR_UP_MES_GRD" VALUE 0x84fad4 _REC_VAL_20_u1 255. _CNV_A_R_LINEAR_____0_CM 0. 255. DISPLAY_IDENTIFIER C_ABC_INC_TEG_TUR_UP_MES_GRD FORMAT "%3.0" /end CHARACTERISTIC
/begin CHARACTERISTIC c_abc_max_teg_tur_up_mes_grd "anti bounce counter maximum for diagnosis instance TEG_TUR_UP_MES_GRD" VALUE 0x84fb60 _REC_VAL_20_u1 255. _CNV_A_R_LINEAR_____0_CM 0. 255. DISPLAY_IDENTIFIER C_ABC_MAX_TEG_TUR_UP_MES_GRD FORMAT "%3.0" /end CHARACTERISTIC
/begin CHARACTERISTIC c_v_teg_tur_up_max_diag "TEG_TUR_UP maximum voltage threshold for diagnostic instance V_TEG_TUR_UP_RNG (related to minimal " VALUE 0x8500bc _REC_VAL_20_u2 4.9951171875 _CNV_A_R_LINEAR_____28_CM 0. 4.9951171875 DISPLAY_IDENTIFIER C_V_TEG_TUR_UP_MAX_DIAG FORMAT "%3.2" /end CHARACTERISTIC
/begin CHARACTERISTIC c_v_teg_tur_up_min_diag "TEG_TUR_UP minimum voltage threshold for diagnostic instance V_TEG_TUR_UP_RNG (related to maximal " VALUE 0x8500be _REC_VAL_20_u2 4.9951171875 _CNV_A_R_LINEAR_____28_CM 0. 4.9951171875 DISPLAY_IDENTIFIER C_V_TEG_TUR_UP_MIN_DIAG FORMAT "%3.2" /end CHARACTERISTIC
/begin CHARACTERISTIC c_n_v_teg_tur_up_rng_diag "engine speed threshold for diagnostic instance V_TEG_TUR_UP_RNG" VALUE 0x84fe36 _REC_VAL_20_u2 8160. _CNV_A_R_LINEAR_____5_CM 0. 8160. DISPLAY_IDENTIFIER C_N_V_TEG_TUR_UP_RNG_DIAG FORMAT "%4.0" /end CHARACTERISTIC
/begin CHARACTERISTIC c_tqi_sp_v_teg_tur_up_rng_diag "torque setpoint threshold for diagnostic instance V_TEG_TUR_UP_RNG" VALUE 0x850078 _REC_VAL_20_s2 2047.96875 _CNV_A_R_LINEAR_____52_CM -1024. 1023.96875 DISPLAY_IDENTIFIER C_TQI_SP_V_TEG_TUR_UP_RNG_DIAG FORMAT "%6.2" /end CHARACTERISTIC
/begin CHARACTERISTIC c_ctr_max_v_teg_tur_up_rng_up "counter maximum for check of upper voltage limit in error instance V_TEG_TUR_UP_RNG" VALUE 0x84fc02 _REC_VAL_20_u2 65535. _CNV_A_R_LINEAR_____0_CM 0. 65535. DISPLAY_IDENTIFIER C_CTR_MAX_V_TEG_TUR_UP_RNG_UP FORMAT "%5.0" /end CHARACTERISTIC
/begin CHARACTERISTIC c_ctr_inc_v_teg_tur_up_rng_up "counter increment for check of upper voltage limit in instance V_TEG_TUR_UP_RNG" VALUE 0x84fbff _REC_VAL_20_u1 255. _CNV_A_R_LINEAR_____0_CM 0. 255. DISPLAY_IDENTIFIER C_CTR_INC_V_TEG_TUR_UP_RNG_UP FORMAT "%3.0" /end CHARACTERISTIC
/begin CHARACTERISTIC c_teg_tur_up_mes_grd_diag "gradient threshold for diagnostic instance TEG_TUR_UP_MES_GRD " VALUE 0x85002c _REC_VAL_20_u2 1023.984375 _CNV_A_R_LINEAR_____53_CM 0. 1023.984375 DISPLAY_IDENTIFIER C_TEG_TUR_UP_MES_GRD_DIAG FORMAT "%6.2" /end CHARACTERISTIC
/begin COMPU_METHOD _CNV_A_R_LINEAR_____0_CM "" RAT_FUNC "%6.3" "[-]" COEFFS 0 1. 0. 0 0 1 /end COMPU_METHOD
/begin COMPU_METHOD _CNV_A_R_LINEAR_____1_CM "" RAT_FUNC "%6.3" "-" COEFFS 0 1. 0. 0 0 1 /end COMPU_METHOD
/begin COMPU_METHOD _CNV_S_2_RANGE______3_CM "" TAB_VERB "%6.3" "[-]" COMPU_TAB_REF _CNV_S_2_RANGE______3 /end COMPU_METHOD
/begin COMPU_VTAB _CNV_S_2_RANGE______3 "" TAB_VERB 2 0 "" 1 "1" /end COMPU_VTAB
/begin COMPU_METHOD _CNV_A_R_LINEAR_____5_CM "" RAT_FUNC "%6.3" "[rpm]" COEFFS 0 1. 0. 0 0 1 /end COMPU_METHOD
/begin COMPU_METHOD _CNV_A_R_LINEAR_____8_CM "" RAT_FUNC "%6.3" "[%]" COEFFS 0 655.3599999999997 0. 0 0 1 /end COMPU_METHOD
/begin COMPU_METHOD _CNV_S_2_RANGE______11_CM "" TAB_VERB "%6.3" "[-]" COMPU_TAB_REF _CNV_S_2_RANGE______11 /end COMPU_METHOD
/begin COMPU_VTAB _CNV_S_2_RANGE______11 "" TAB_VERB 2 0 "0" 1 "1" /end COMPU_VTAB
/begin COMPU_METHOD _CNV_A_R_LINEAR_____12_CM "" RAT_FUNC "%6.3" "[%]" COEFFS 0 327.6800000003072 3.071909304708242e-008 0 0 1 /end COMPU_METHOD
/begin COMPU_METHOD _CNV_A_R_LINEAR_____14_CM "" RAT_FUNC "%6.3" "[-]" COEFFS 0 65535.99999999996 0. 0 0 1 /end COMPU_METHOD
/begin COMPU_METHOD _CNV_A_R_LINEAR_____16_CM "" RAT_FUNC "%6.3" "[s]" COEFFS 0 1. 0. 0 0 1 /end COMPU_METHOD
/begin COMPU_METHOD _CNV_A_R_LINEAR_____18_CM "" RAT_FUNC "%6.3" "[°C]" COEFFS 0 1. 50. 0 0 1 /end COMPU_METHOD
/begin COMPU_METHOD _CNV_A_R_LINEAR_____19_CM "" RAT_FUNC "%6.3" "[s]" COEFFS 0 10. 0. 0 0 1 /end COMPU_METHOD
/begin COMPU_METHOD _CNV_A_R_LINEAR_____20_CM "" RAT_FUNC "%6.3" "[°C]" COEFFS 0 1. 0. 0 0 1 /end COMPU_METHOD
/begin COMPU_METHOD _CNV_S_2_RANGE______23_CM "" TAB_VERB "%6.3" "[-]" COMPU_TAB_REF _CNV_S_2_RANGE______23 /end COMPU_METHOD
/begin COMPU_VTAB _CNV_S_2_RANGE______23 "" TAB_VERB 2 0 "passive" 1 "active" /end COMPU_VTAB
/begin COMPU_METHOD _CNV_A_R_LINEAR_____28_CM "" RAT_FUNC "%6.3" "[V]" COEFFS 0 204.8 0. 0 0 1 /end COMPU_METHOD
/begin COMPU_METHOD _CNV_A_R_LINEAR_____29_CM "" RAT_FUNC "%6.3" "[-]" COEFFS 0 256. 0. 0 0 1 /end COMPU_METHOD
/begin COMPU_METHOD _CNV_A_R_LINEAR_____34_CM "" RAT_FUNC "%6.3" "[km/h]" COEFFS 0 1. 0. 0 0 1 /end COMPU_METHOD
/begin COMPU_METHOD _CNV_A_R_LINEAR_____37_CM "" RAT_FUNC "%6.3" "[%]" COEFFS 0 2.550102004080163 0. 0 0 1 /end COMPU_METHOD
/begin COMPU_METHOD _CNV_A_R_LINEAR_____38_CM "" RAT_FUNC "%6.3" "[mg/stk]" COEFFS 0 250. 0. 0 0 1 /end COMPU_METHOD
/begin COMPU_METHOD _CNV_A_R_LINEAR_____43_CM "" RAT_FUNC "%6.3" "[V]" COEFFS 0 8.854166666666666 0. 0 0 1 /end COMPU_METHOD
/begin COMPU_METHOD _CNV_A_R_LINEAR_____45_CM "" RAT_FUNC "%6.3" "[hPa]" COEFFS 0 12.06017666543982 0. 0 0 1 /end COMPU_METHOD
/begin COMPU_METHOD _CNV_A_R_LINEAR_____46_CM "" RAT_FUNC "%6.3" "[%]" COEFFS 0 327.6800000003072 3.071967512372036e-008 0 0 1 /end COMPU_METHOD
/begin COMPU_METHOD _CNV_A_R_LINEAR_____48_CM "" RAT_FUNC "%6.3" "[-]" COEFFS 0 32767.99807357072 0. 0 0 1 /end COMPU_METHOD
/begin COMPU_METHOD _CNV_A_R_LINEAR_____50_CM "" RAT_FUNC "%6.3" "[mg/stk]" COEFFS 0 1000. 0. 0 0 1 /end COMPU_METHOD
/begin COMPU_METHOD _CNV_A_R_LINEAR_____51_CM "" RAT_FUNC "%6.3" "[°C]" COEFFS 0 63.9990234375 0. 0 0 1 /end COMPU_METHOD
/begin COMPU_METHOD _CNV_A_R_LINEAR_____52_CM "" RAT_FUNC "%6.3" "[Nm]" COEFFS 0 32. 0. 0 0 1 /end COMPU_METHOD
/begin COMPU_METHOD _CNV_A_R_LINEAR_____53_CM "" RAT_FUNC "%6.3" "[°C/100ms]" COEFFS 0 64. 0. 0 0 1 /end COMPU_METHOD
/begin COMPU_METHOD _CNV_A_R_LINEAR_____54_CM "" RAT_FUNC "%6.3" "[s]" COEFFS 0 1562.5 0. 0 0 1 /end COMPU_METHOD
/begin COMPU_METHOD _CNV_A_R_LINEAR_____55_CM "" RAT_FUNC "%6.3" "[rpm]" COEFFS 0 3.125e-002 0. 0 0 1 /end COMPU_METHOD
/begin COMPU_METHOD _CNV_A_R_LINEAR_____56_CM "" RAT_FUNC "%6.3" "[s]" COEFFS 0 100. 0. 0 0 1 /end COMPU_METHOD
/begin COMPU_METHOD _CNV_A_R_LINEAR_____59_CM "" RAT_FUNC "%6.3" "[-]" COEFFS 0 16383.81262712377 0. 0 0 1 /end COMPU_METHOD
/begin COMPU_METHOD _CNV_A_R_LINEAR_____60_CM "" RAT_FUNC "%6.3" "[mg/stk]" COEFFS 0 47.18142548596112 0. 0 0 1 /end COMPU_METHOD
/begin COMPU_METHOD _CNV_A_R_LINEAR_____64_CM "" RAT_FUNC "%6.3" "[s]" COEFFS 0 15625. 0. 0 0 1 /end COMPU_METHOD
/begin COMPU_METHOD _CNV_A_R_LINEAR_____77_CM "" RAT_FUNC "%6.3" "[-]" COEFFS 0 32768. 0. 0 0 1 /end COMPU_METHOD
/begin COMPU_METHOD _CNV_A_R_LINEAR_____78_CM "" RAT_FUNC "%6.3" "[%]" COEFFS 0 10.23 0. 0 0 1 /end COMPU_METHOD
/begin COMPU_METHOD _CNV_A_R_LINEAR_____79_CM "" RAT_FUNC "%6.3" "[%]" COEFFS 0 2.56 0. 0 0 1 /end COMPU_METHOD
/begin COMPU_METHOD _CNV_A_R_LINEAR_____81_CM "" RAT_FUNC "%6.3" "rpm" COEFFS 0 3.125e-002 0. 0 0 1 /end COMPU_METHOD
/begin COMPU_METHOD _CNV_S_2_RANGE__0___85_CM "" TAB_VERB "%6.3" "-" COMPU_TAB_REF _CNV_S_2_RANGE__0___85 /end COMPU_METHOD
/begin COMPU_VTAB _CNV_S_2_RANGE__0___85 "" TAB_VERB 2 0 "0" 1 "1" /end COMPU_VTAB
/begin COMPU_METHOD _CNV_A_R_LINEAR_____86_CM "" RAT_FUNC "%6.3" "[Nm]" COEFFS 0 32. 32768. 0 0 1 /end COMPU_METHOD
/begin COMPU_METHOD _CNV_A_R_LINEAR_____87_CM "" RAT_FUNC "%6.3" "[-]" COEFFS 0 65535.82575140447 0. 0 0 1 /end COMPU_METHOD
/begin COMPU_METHOD _CNV_A_R_LINEAR_____89_CM "" RAT_FUNC "%6.3" "[Nm/10ms]" COEFFS 0 32. 0. 0 0 1 /end COMPU_METHOD
/begin COMPU_METHOD _CNV_A_R_LINEAR_____90_CM "" RAT_FUNC "%6.3" "[Nm]" COEFFS 0 4. 0. 0 0 1 /end COMPU_METHOD
/begin COMPU_METHOD _CNV_A_R_LINEAR_____91_CM "" RAT_FUNC "%6.3" "[Hz]" COEFFS 0 1000. 0. 0 0 1 /end COMPU_METHOD
/begin COMPU_METHOD _CNV_A_R_LINEAR_____92_CM "" RAT_FUNC "%6.3" "[Nm/s]" COEFFS 0 32. 0. 0 0 1 /end COMPU_METHOD
/begin COMPU_METHOD _CNV_A_R_LINEAR_____93_CM "" RAT_FUNC "%6.3" "[ms]" COEFFS 0 0.1 0. 0 0 1 /end COMPU_METHOD
/begin COMPU_METHOD _CNV_A_R_LINEAR_____94_CM "" RAT_FUNC "%6.3" "[Nm/s]" COEFFS 0 1. 0. 0 0 1 /end COMPU_METHOD
/begin COMPU_METHOD _CNV_A_R_LINEAR_____95_CM "" RAT_FUNC "%6.3" "[-]" COEFFS 0 64. 0. 0 0 1 /end COMPU_METHOD
/begin COMPU_METHOD _CNV_A_R_LINEAR_____110_CM "" RAT_FUNC "%6.3" "[kg/h]" COEFFS 0 64. 0. 0 0 1 /end COMPU_METHOD
/begin COMPU_METHOD _CNV_A_R_LINEAR_____121_CM "" RAT_FUNC "%6.3" "[V]" COEFFS 0 4.011764705882353 0. 0 0 1 /end COMPU_METHOD
/begin COMPU_METHOD _CNV_A_R_LINEAR_____132_CM "" RAT_FUNC "%6.3" "[-]" COEFFS 0 1023.999999959999 -1.280019205296412e-006 0 0 1 /end COMPU_METHOD
/begin COMPU_METHOD _CNV_A_R_LINEAR_____133_CM "" RAT_FUNC "%6.3" "[-]" COEFFS 0 1024. 32768. 0 0 1 /end COMPU_METHOD
/begin COMPU_METHOD _CNV_A_R_LINEAR_____134_CM "" RAT_FUNC "%6.3" "[%]" COEFFS 0 655.35 0. 0 0 1 /end COMPU_METHOD
/begin COMPU_METHOD _CNV_A_R_LINEAR_____137_CM "" RAT_FUNC "%6.3" "-" COEFFS 0 65535.99999999996 0. 0 0 1 /end COMPU_METHOD
/begin COMPU_METHOD _CNV_A_R_LINEAR_____154_CM "" RAT_FUNC "%6.3" "rpm" COEFFS 0 1. 0. 0 0 1 /end COMPU_METHOD
/begin COMPU_METHOD _CNV_A_R_LINEAR_____204_CM "" RAT_FUNC "%6.3" "[%]" COEFFS 0 327.7613897082924 0. 0 0 1 /end COMPU_METHOD
/begin COMPU_METHOD _CNV_A_R_LINEAR_____226_CM "" RAT_FUNC "%6.3" "s" COEFFS 0 100. 0. 0 0 1 /end COMPU_METHOD
/begin COMPU_METHOD _CNV_A_R_LINEAR_____227_CM "" RAT_FUNC "%6.3" "Nms" COEFFS 0 100. 0. 0 0 1 /end COMPU_METHOD
/begin COMPU_METHOD _CNV_A_R_LINEAR_____238_CM "" RAT_FUNC "%6.3" "[°C/100ms]" COEFFS 0 1. 0. 0 0 1 /end COMPU_METHOD
/begin COMPU_METHOD _CNV_A_R_LINEAR_____245_CM "" RAT_FUNC "%6.3" "km/h" COEFFS 0 1. 0. 0 0 1 /end COMPU_METHOD
/begin COMPU_METHOD _CNV_A_R_LINEAR_____319_CM "" RAT_FUNC "%6.3" "[kg*m^2*min]" COEFFS 0 1000. 0. 0 0 1 /end COMPU_METHOD
/begin COMPU_METHOD _CNV_A_R_LINEAR_____338_CM "" RAT_FUNC "%6.3" "-" COEFFS 0 512. 0. 0 0 1 /end COMPU_METHOD
/begin COMPU_METHOD _CNV_A_R_LINEAR_____339_CM "" RAT_FUNC "%6.3" "[Nm/20ms]" COEFFS 0 32. 0. 0 0 1 /end COMPU_METHOD
/begin COMPU_METHOD _CNV_A_R_LINEAR_____340_CM "" RAT_FUNC "%6.3" "-" COEFFS 0 8192. 0. 0 0 1 /end COMPU_METHOD
/begin COMPU_METHOD _CNV_A_R_LINEAR_____341_CM "" RAT_FUNC "%6.3" "Nm/20ms" COEFFS 0 32. 0. 0 0 1 /end COMPU_METHOD
/begin COMPU_METHOD _CNV_A_R_LINEAR_____347_CM "" RAT_FUNC "%6.3" "[hPa/100ms]" COEFFS 0 12.06017666543982 0. 0 0 1 /end COMPU_METHOD
/begin COMPU_METHOD _CNV_A_R_LINEAR_____349_CM "Battery voltage" RAT_FUNC "%6.3" "V" COEFFS 0 9.846153846153847 0. 0 0 1 /end COMPU_METHOD
/begin COMPU_METHOD _CNV_S_3_TCO_range_350_CM "" TAB_VERB "%6.3" "[-]" COMPU_TAB_REF _CNV_S_3_TCO_range_350 /end COMPU_METHOD
/begin COMPU_VTAB _CNV_S_3_TCO_range_350 "" TAB_VERB 3 0 "COLD" 1 "WUP" 2 "HOT" /end COMPU_VTAB
/begin COMPU_METHOD _CNV_A_R_LINEAR_____351_CM "" RAT_FUNC "%6.3" "[kg/h]" COEFFS 0 64.00002343786623 1.20001875111484e-002 0 0 1 /end COMPU_METHOD
/begin COMPU_METHOD _CNV_A_R_LINEAR_____352_CM "" RAT_FUNC "%6.3" "[kg/h]" COEFFS 0 64.00002343786622 1.200018750386101e-002 0 0 1 /end COMPU_METHOD
/begin COMPU_METHOD _CNV_A_R_LINEAR_____353_CM "" RAT_FUNC "%6.3" "[rpm/s]" COEFFS 0 1. 0. 0 0 1 /end COMPU_METHOD
/begin COMPU_METHOD _CNV_A_R_LINEAR_____361_CM "" RAT_FUNC "%6.3" "[V]" COEFFS 0 204.6 0. 0 0 1 /end COMPU_METHOD
/begin COMPU_METHOD _CNV_A_R_LINEAR_____368_CM "" RAT_FUNC "%6.3" "[V]" COEFFS 0 51.2 0. 0 0 1 /end COMPU_METHOD
/begin COMPU_METHOD _CNV_A_R_LINEAR_____380_CM "" RAT_FUNC "%6.3" "[A]" COEFFS 0 314.7692307692308 0. 0 0 1 /end COMPU_METHOD
/begin COMPU_METHOD _CNV_A_R_LINEAR_____384_CM "" RAT_FUNC "%6.3" "[us]" COEFFS 0 0.2499971389661368 0. 0 0 1 /end COMPU_METHOD
/begin COMPU_METHOD _CNV_A_R_LINEAR_____385_CM "" RAT_FUNC "%6.3" "[Hz]" COEFFS 0 1. 0. 0 0 1 /end COMPU_METHOD
/begin COMPU_METHOD _CNV_A_R_LINEAR_____394_CM "" RAT_FUNC "%6.3" "[Nm]" COEFFS 0 2097184. 32768. 0 0 1 /end COMPU_METHOD
/begin COMPU_METHOD _CNV_S_12_STATE_PPS__534_CM "" TAB_VERB "%6.3" "[-]" COMPU_TAB_REF _CNV_S_12_STATE_PPS__534 /end COMPU_METHOD
/begin COMPU_VTAB _CNV_S_12_STATE_PPS__534 "" TAB_VERB 12 0 "INI_PRDR" 1 "INI_RST" 2 "reserved" 3 "INI_SPI" 4 "reserved" 5 "INI_BOOST" 6 "reserved" 7 "INI_PLS_TEST" 8 "reserved" 9 "reserved" 10 "reserved" 11 "INI_DONE" /end COMPU_VTAB
/begin COMPU_METHOD _CNV_A_R_LINEAR_____535_CM "" RAT_FUNC "%6.3" "[V]" COEFFS 0 1. 0. 0 0 1 /end COMPU_METHOD
/begin COMPU_METHOD _CNV_A_R_LINEAR_____563_CM "" RAT_FUNC "%6.3" "[Nm/rpm^2]" COEFFS 0 8801162489754.098 -0.5000002384185791 0 0 1 /end COMPU_METHOD
/begin COMPU_METHOD _CNV_A_R_LINEAR_____564_CM "" RAT_FUNC "%6.3" "[°C]" COEFFS 0 257. 12850. 0 0 1 /end COMPU_METHOD
/begin COMPU_METHOD _CNV_A_R_LINEAR_____565_CM "" RAT_FUNC "%6.3" "[Nm/rpm^2]" COEFFS 0 134295234.3481041 3.7180937390076e-002 0 0 1 /end COMPU_METHOD
/begin COMPU_METHOD _CNV_A_R_LINEAR_____566_CM "" RAT_FUNC "%6.3" "[s]" COEFFS 0 7.976539589442815 0. 0 0 1 /end COMPU_METHOD
/begin COMPU_METHOD _CNV_A_R_LINEAR_____567_CM "" RAT_FUNC "%6.3" "[-]" COEFFS 0 655350. 0. 0 0 1 /end COMPU_METHOD
/begin COMPU_METHOD _CNV_A_R_LINEAR_____568_CM "" RAT_FUNC "%6.3" "[1/(rpm^2)]" COEFFS 0 134293032.7868853 0. 0 0 1 /end COMPU_METHOD
/begin COMPU_METHOD _CNV_A_R_LINEAR_____569_CM "" RAT_FUNC "%6.3" "[Nm/rpm^2]" COEFFS 0 134295386.7339913 0. 0 0 1 /end COMPU_METHOD
/begin RECORD_LAYOUT _REC_VAL_20_u1 FNC_VALUES 1 UBYTE COLUMN_DIR DIRECT /end RECORD_LAYOUT
/begin RECORD_LAYOUT _REC_AXS_20_u2 NO_AXIS_PTS_X 1 UWORD AXIS_PTS_X 2 UWORD INDEX_INCR DIRECT /end RECORD_LAYOUT
/begin RECORD_LAYOUT _REC_MAP_20_u2_u2_u2 FNC_VALUES 1 UWORD COLUMN_DIR DIRECT /end RECORD_LAYOUT
/begin RECORD_LAYOUT _REC_VAL_20_u2 FNC_VALUES 1 UWORD COLUMN_DIR DIRECT /end RECORD_LAYOUT
/begin RECORD_LAYOUT _REC_VAL_20_s2 FNC_VALUES 1 SWORD COLUMN_DIR DIRECT /end RECORD_LAYOUT
/begin RECORD_LAYOUT _REC_AXS_20_u1 NO_AXIS_PTS_X 1 UBYTE AXIS_PTS_X 2 UBYTE INDEX_INCR DIRECT /end RECORD_LAYOUT
/begin RECORD_LAYOUT _REC_CUR_20_u2_u2 FNC_VALUES 1 UWORD COLUMN_DIR DIRECT /end RECORD_LAYOUT
/begin RECORD_LAYOUT _REC_CUR_20_u2_u1 FNC_VALUES 1 UWORD COLUMN_DIR DIRECT /end RECORD_LAYOUT
/begin RECORD_LAYOUT _REC_MAP_20_u2_u1_u1 FNC_VALUES 1 UWORD COLUMN_DIR DIRECT /end RECORD_LAYOUT
/begin RECORD_LAYOUT _REC_MAP_20_u2_u2_u1 FNC_VALUES 1 UWORD COLUMN_DIR DIRECT /end RECORD_LAYOUT
/begin RECORD_LAYOUT _REC_CUR_20_u1_u2 FNC_VALUES 1 UBYTE COLUMN_DIR DIRECT /end RECORD_LAYOUT
/begin RECORD_LAYOUT _REC_CUR_20_u1_u1 FNC_VALUES 1 UBYTE COLUMN_DIR DIRECT /end RECORD_LAYOUT
/begin RECORD_LAYOUT _REC_MAP_20_u2_u1_u2 FNC_VALUES 1 UWORD COLUMN_DIR DIRECT /end RECORD_LAYOUT
/begin RECORD_LAYOUT _REC_VAL_20_u4 FNC_VALUES 1 ULONG COLUMN_DIR DIRECT /end RECORD_LAYOUT
/begin FUNCTION DIAG_MAF_0 ""
 /begin DEF_CHARACTERISTIC c_abc_inc_maf_0_rng c_abc_max_maf_0_rng c_maf_kgh_mes_max_diag c_maf_kgh_mes_min_diag c_n_min_maf_kgh_mes_diag /end DEF_CHARACTERISTIC
/end FUNCTION
/begin FUNCTION DIAG_MAF_PLAD ""
 /begin DEF_CHARACTERISTIC c_abc_inc_maf_kgh_plaus c_abc_max_maf_kgh_plaus c_tqi_sp_maf_plaus c_ctl_lim_egrv_maf_plaus c_tia_min_maf_plaus c_tia_max_maf_plaus c_n_min_maf_plaus c_n_max_maf_plaus c_ratio_mf_tot_grd_maf_plaus c_maf_kgh_min_maf_plaus c_maf_kgh_max_maf_plaus c_fac_maf_kgh_plaus_diag c_t_dly_maf_kgh_plaus_diag c_ctr_maf_kgh_plaus_diag c_n_grd_h_res_maf_plaus /end DEF_CHARACTERISTIC
 /begin OUT_MEASUREMENT t_dly_maf_kgh_plaus ctr_maf_kgh_plaus /end OUT_MEASUREMENT
/end FUNCTION
/begin FUNCTION DIAG_AEGRCTLD_0 "EGR Control Diagnosis"
 /begin DEF_CHARACTERISTIC c_abc_inc_egr_ctl_min c_abc_max_egr_ctl_min c_abc_inc_egr_ctl_max c_abc_max_egr_ctl_max c_egr_dif_min_diag c_egr_dif_max_diag ip_ctr_max_egr_ctl_min__n ip_ctr_max_egr_ctl_max__n ldpm_n_ip_ctr_max_egr_ctl_diag /end DEF_CHARACTERISTIC
 /begin OUT_MEASUREMENT ctr_egr_ctl_min ctr_egr_ctl_max /end OUT_MEASUREMENT
/end FUNCTION
/begin FUNCTION DIAG_ALTER "" /end FUNCTION
/begin FUNCTION DIAG_AALTDIAG "Generator Load Signal Diagnostics"
 /begin DEF_CHARACTERISTIC c_abc_inc_ducy_alter_pwm_rng c_abc_max_ducy_alter_pwm_rng c_abc_inc_ducy_alter_pwm_grd c_abc_max_ducy_alter_pwm_grd c_ducy_alter_pwm_max_diag c_ducy_alter_pwm_min_diag c_ducy_alter_pwm_grd_diag /end DEF_CHARACTERISTIC
 /begin OUT_MEASUREMENT lv_err_ducy_alter_pwm lv_err_altpwm_mes /end OUT_MEASUREMENT
/end FUNCTION
/begin FUNCTION DIAG_AAC_INPDIAG "Air Conditioning Pressure (ACP) Diagnostics" /begin OUT_MEASUREMENT lv_err_acp_mes lv_err_tia_mes /end OUT_MEASUREMENT /end FUNCTION
/begin FUNCTION DIAG_ACP "Air Conditioning Pressure (ACP) Diagnostics (Appl. Inc.)"
 /begin DEF_CHARACTERISTIC c_abc_inc_acp_mes_rng c_abc_max_acp_mes_rng c_abc_inc_acp_mes_grd c_abc_max_acp_mes_grd /end DEF_CHARACTERISTIC
/end FUNCTION
/begin FUNCTION DIAG_AINJDIAG "Piezo Power Stage Diagnosis"
 /begin DEF_CHARACTERISTIC c_v_cha_min c_v_cha_max c_v_inj_min c_v_inj_max c_t_ini_pps_max c_t_pps_wup c_tco_min_hot c_v_inj_f_max c_v_cha_cal_thd_0 c_v_cha_cal_thd_1 c_v_cha_cal_thd_2 c_v_cha_cal_thd_3 c_v_inj_min_scg c_v_inj_min_scb c_pps_spi_diag_mask c_pps_spi_prog_mask /end DEF_CHARACTERISTIC
 /begin OUT_MEASUREMENT lv_err_pps_cyl[0] lv_err_pps_cyl[1] lv_err_pps_cyl[2] lv_err_pps_cyl[3] lv_err_det_pps_cyl[0] lv_err_det_pps_cyl[1] lv_err_det_pps_cyl[2] lv_err_det_pps_cyl[3] lv_err_pps_cbk[0] lv_err_det_pps_cbk[0] lv_err_pps lv_err_det_pps t_ini_tout_pps[0] lv_inh_diag_pps_oc lv_ini_pps[0] state_pps_diag_ini[0] cyl_nr_pps_diag lv_v_cha_rng_l lv_v_cha_rng_h lv_v_inj_rng_l lv_v_inj_rng_h lv_pps_prot_swi_act[0] /end OUT_MEASUREMENT
/end FUNCTION
/begin FUNCTION DIAG_AINJDIAG_I "Application Incidences for Piezo Power Stage Diagnosis"
 /begin DEF_CHARACTERISTIC c_abc_inc_pps_ini_0 c_abc_max_pps_ini_0 c_abc_inc_pps_ini_tout_0 c_abc_max_pps_ini_tout_0 c_abc_inc_pps_plaus_0 c_abc_max_pps_plaus_0 c_abc_inc_pps_cal_0 c_abc_max_pps_cal_0 c_abc_inc_pps_v_inj_0 c_abc_max_pps_v_inj_0 c_abc_inc_pps_wdt_0 c_abc_max_pps_wdt_0 c_abc_inc_pps_fsm_0 c_abc_max_pps_fsm_0 c_abc_inc_pps_oc_0 c_abc_max_pps_oc_0 c_abc_inc_pps_oc_1 c_abc_max_pps_oc_1 c_abc_inc_pps_oc_2 c_abc_max_pps_oc_2 c_abc_inc_pps_oc_3 c_abc_max_pps_oc_3 c_abc_inc_pps_sc_h_l_0 c_abc_max_pps_sc_h_l_0 c_abc_inc_pps_sc_h_l_1 c_abc_max_pps_sc_h_l_1 c_abc_inc_pps_sc_h_l_2 c_abc_max_pps_sc_h_l_2 c_abc_inc_pps_sc_h_l_3 c_abc_max_pps_sc_h_l_3 c_abc_inc_pps_sc_h_0 c_abc_max_pps_sc_h_0 c_abc_inc_pps_sc_l_0 c_abc_max_pps_sc_l_0 /end DEF_CHARACTERISTIC
 /begin OUT_MEASUREMENT lf_inj_act[0] lf_inj_act[1] lf_inj_act[2] lf_inj_act[3] lf_seq_act[0] lf_seq_act[1] lf_seq_act[2] lf_seq_act[3] /end OUT_MEASUREMENT
/end FUNCTION
/begin FUNCTION DIAG_AVB "Battery Voltage Diagnosis"
 /begin DEF_CHARACTERISTIC c_vb_max_diag c_vb_min_diag c_vb_min_jump c_vb_min_obd1 c_vb_min_obd2 /end DEF_CHARACTERISTIC
 /begin OUT_MEASUREMENT lv_cdn_vb_obd1 lv_cdn_vb_obd2 lv_igk vb v_igk /end OUT_MEASUREMENT
/end FUNCTION
/begin FUNCTION DIAG_ASPIDIAG "SPI - Bus Diagnosis"
 /begin DEF_CHARACTERISTIC c_abc_inc_spi_qps c_abc_max_spi_qps c_abc_inc_spi_oct c_abc_max_spi_oct c_abc_inc_spi_mps c_abc_max_spi_mps /end DEF_CHARACTERISTIC
 /begin OUT_MEASUREMENT lv_spi_err_qps lv_spi_err_oct lv_spi_err_mps /end OUT_MEASUREMENT
/end FUNCTION
/begin FUNCTION DIAG_AEGRVDHB "EGR Valve Diagnostics"
 /begin DEF_CHARACTERISTIC c_egrvpwm_min_diag c_egrvpwm_max_diag c_abc_inc_egrv_0 c_abc_max_egrv_0 /end DEF_CHARACTERISTIC
 /begin OUT_MEASUREMENT lv_err_det_spi_dps_egrv /end OUT_MEASUREMENT
/end FUNCTION
/begin FUNCTION DIAG_ATFUDIAG "Diagnostics of Fuel Temperature Sensor"
 /begin DEF_CHARACTERISTIC c_abc_inc_v_tfu_rng c_abc_max_v_tfu_rng c_abc_inc_tfu_mes_grd c_abc_max_tfu_mes_grd c_abc_inc_tfu_mes_plaus c_abc_max_tfu_mes_plaus c_v_tfu_max_diag c_v_tfu_min_diag c_tfu_mes_grd_diag c_tfu_mes_st_diag c_t_ast_tfu_diag c_tfu_plaus_inc_diag c_n_v_tfu_rng_diag c_tqi_sp_v_tfu_rng_diag c_t_max_v_tfu_rng_diag /end DEF_CHARACTERISTIC
 /begin OUT_MEASUREMENT lv_err_tfu_mes lv_rst_diag_tfu_mes_plaus tfu_mes_st_diag t_v_tfu_rng_diag /end OUT_MEASUREMENT
/end FUNCTION
/begin FUNCTION DIAG_ATACDIAG ""
 /begin DEF_CHARACTERISTIC c_abc_inc_v_tac_rng c_abc_max_v_tac_rng c_abc_inc_tac_mes_grd c_abc_max_tac_mes_grd c_v_tac_max_diag c_v_tac_min_diag c_n_v_tac_rng_diag c_tqi_sp_v_tac_rng_diag c_ctr_max_v_tac_rng_up c_ctr_inc_v_tac_rng_up c_tac_mes_grd_diag /end DEF_CHARACTERISTIC
 /begin OUT_MEASUREMENT ctr_v_tac_rng_up lv_v_tac_rng_up lv_err_tac_mes /end OUT_MEASUREMENT
/end FUNCTION
/begin FUNCTION DIAG_ADIPDIAG "Differential Pressure Sensor for particulate filter"
 /begin DEF_CHARACTERISTIC c_v_dip_pf_min_diag c_v_dip_pf_max_diag c_dip_pf_mes_grd_diag c_dip_pf_mes_es_diag c_tac_max_dip_pf_mes_es_diag c_tac_min_dip_pf_mes_es_diag c_t_max_dip_pf_mes_es c_abc_inc_v_dip_pf_rng c_abc_max_v_dip_pf_rng c_abc_inc_dip_pf_mes_es c_abc_max_dip_pf_mes_es c_abc_inc_dip_pf_mes_grd c_abc_max_dip_pf_mes_grd /end DEF_CHARACTERISTIC
 /begin OUT_MEASUREMENT lv_err_dip_pf_mes t_dip_pf_mes_es lv_err_vcc_dip_pf /end OUT_MEASUREMENT
/end FUNCTION
/begin FUNCTION DIAG_ATEGTURD "Exhaust Gas Temperature upstream turbine Sensor Diagnostics"
 /begin DEF_CHARACTERISTIC c_abc_inc_v_teg_tur_up_rng c_abc_max_v_teg_tur_up_rng c_abc_inc_teg_tur_up_mes_grd c_abc_max_teg_tur_up_mes_grd c_v_teg_tur_up_max_diag c_v_teg_tur_up_min_diag c_n_v_teg_tur_up_rng_diag c_tqi_sp_v_teg_tur_up_rng_diag c_ctr_max_v_teg_tur_up_rng_up c_ctr_inc_v_teg_tur_up_rng_up c_teg_tur_up_mes_grd_diag /end DEF_CHARACTERISTIC
 /begin OUT_MEASUREMENT lv_err_teg_tur_up_mes ctr_v_teg_tur_up_rng_up lv_v_teg_tur_up_rng_up /end OUT_MEASUREMENT
/end FUNCTION
/begin FUNCTION C_A_TQ "" /begin SUB_FUNCTION TQ_LTC TQ_AJPA TQ_AJ /end SUB_FUNCTION /end FUNCTION
/begin FUNCTION TQ_LTC "" /end FUNCTION
/begin FUNCTION TQ_AJPA ""
 /begin DEF_CHARACTERISTIC lc_n_pred_on_aj c_t1_pv_av_grd_aj ip_fac_aj__pv_av ldp_pv_av_ip_fac_aj ip_fac_tq_dif_aj__dri__n ldpm_n_ip_fac_aj ip_fac_tq_dif_aj_is__dri__n ldpm_n_ip_fac_aj_is ip_t1_aj__dri__n ip_t1_aj_is__dri__n /end DEF_CHARACTERISTIC
 /begin OUT_MEASUREMENT t1_dt1_aj kr_dt1_aj n_aj pv_av_grd_aj /end OUT_MEASUREMENT
/end FUNCTION
/begin FUNCTION TQ_AJ ""
 /begin DEF_CHARACTERISTIC lc_lpf_2_aj_off lc_lpf_aj_on lc_lpf_3_aj_off c_n_min_aj c_n_max_aj lc_aj_on lc_aj_is_ovs c_t_act_max_aj id_frq_cut_aj__dri /end DEF_CHARACTERISTIC
 /begin OUT_MEASUREMENT tq_dif_aj lv_req_aj lv_act_aj /end OUT_MEASUREMENT
/end FUNCTION
/begin FUNCTION VW_Hidden ""
 /begin DEF_CHARACTERISTIC c_abc_max_var_cod c_abc_inc_v_tpc_rng c_abc_max_v_tpc_rng c_abc_inc_tpc_mes_plaus c_abc_max_tpc_mes_plaus c_v_tpc_max_diag c_v_tpc_min_diag c_n_v_tpc_rng_diag c_mf_tot_v_tpc_rng_diag c_t_max_v_tpc_rng_diag c_tco_tpc_mes_plaus_diag c_tpc_mes_plaus_diag c_n_thd_byp_ect c_pwm_byp_ect_min c_tco_hys_byp_ect_warm c_tco_hys_byp_ect_hot c_tco_add_ect ip_tco_ect__pwm_ect ldp_pwm_ect_ip_tco_ect c_t_per_exv_cold c_t_act_exv_cold c_t_act_exv_warm c_cfb_pcv_mes_max_diag c_cfb_vcv_mes_max_diag c_v_cfb_pcv_max_diag c_v_cfb_pcv_min_diag c_v_cfb_vcv_max_diag c_v_cfb_vcv_min_diag ldp_vb_ip_pcv_min_diag ip_pcv_min_diag__vb c_abc_inc_bpa c_abc_inc_gl_rly_dps c_abc_inc_pcv_1 c_abc_inc_pcv_2 c_abc_inc_pcv_3 c_abc_inc_vcv_1 c_abc_inc_vcv_2 c_abc_inc_vcv_3 c_abc_max_bpa c_abc_max_gl_rly_dps c_abc_max_pcv_1 c_abc_max_pcv_2 c_abc_max_pcv_3 c_abc_max_vcv_1 c_abc_max_vcv_2 c_abc_max_vcv_3 c_vb_nom ldp_frq_maf_id_maf_x ldp_frq_maf_id_maf_y id_maf_frq_tab c_t_low_maf_frq_0_min c_t_low_maf_frq_0_max c_maf_frq_0_bas_max c_maf_frq_0_bas_min c_maf_frq_bas_max_ip ldp_v_t_atic20_ip_t_atic20 ldp_v_t_lc_ip_t_lc ip_t_atic20__v_t_atic20 ip_t_lc__v_t_lc /end DEF_CHARACTERISTIC
 /begin OUT_MEASUREMENT lv_err_tpc_mes t_v_tpc_rng_diag pwm_byp_ect lv_exv pwm_ect_ctl cfb_vcv_mes v_cfb_pcv v_cfb_vcv lv_fuel_warn lv_err_frq_maf_frq_0 pcv /end OUT_MEASUREMENT
/end FUNCTION
/begin FUNCTION C_B_OBD ""
 /begin SUB_FUNCTION OBD_AOBDFSD OBD_AOBDEGR OBD_ATCOPLAD OBD_Battery_Voltage_Diag OBD_ERRMEM /end SUB_FUNCTION
/end FUNCTION
/begin FUNCTION OBD_AOBDFSD ""
 /begin DEF_CHARACTERISTIC c_abc_inc_mf_is_obd c_abc_max_mf_is_obd lc_mf_is_obd_rst c_t_dly_mf_is_obd c_ctr_mf_is_obd c_mf_is_max_obd c_mf_is_min_obd /end DEF_CHARACTERISTIC
 /begin OUT_MEASUREMENT t_dly_mf_is_obd ctr_mf_is_max_obd ctr_mf_is_min_obd mf_is_max_obd mf_is_min_obd /end OUT_MEASUREMENT
/end FUNCTION
/begin FUNCTION OBD_AOBDEGR ""
 /begin DEF_CHARACTERISTIC c_abc_inc_maf_egr_thr_obd c_abc_max_maf_egr_thr_obd c_abc_inc_maf_dif_egr_thr_obd c_abc_max_maf_dif_egr_thr_obd c_abc_inc_map_dif_egr_thr_obd c_abc_max_map_dif_egr_thr_obd c_t_egr_thr_obd_1 c_egrvpwm_egr_thr_obd_1 c_thrpwm_egr_thr_obd_1 c_byppwm_egr_thr_obd_1 c_bpapwm_egr_thr_obd_1 c_t_dly_egr_thr_obd c_maf_max_egr_thr_obd c_maf_min_egr_thr_obd c_t_egr_thr_obd_2 c_egrvpwm_egr_thr_obd_2 c_thrpwm_egr_thr_obd_2 c_byppwm_egr_thr_obd_2 c_bpapwm_egr_thr_obd_2 c_maf_dif_max_egr_thr_obd c_maf_dif_min_egr_thr_obd c_ctr_maf_egr_thr_obd c_ctr_maf_dif_egr_thr_obd c_t_egr_thr_obd_3 c_egrvpwm_egr_thr_obd_3 c_thrpwm_egr_thr_obd_3 c_byppwm_egr_thr_obd_3 c_bpapwm_egr_thr_obd_3 c_map_mes_dif_max_egr_thr_obd c_map_mes_dif_min_egr_thr_obd c_ctr_map_dif_egr_thr_obd lc_rst_diag_egr_thr_obd ip_fac_map_cor_egr_thr_obd__n ldp_n__ip_fac_map_egr_thr_obd ip_fac_maf_egr_thr_obd ldpm_amp__ip_fac_egr_thr_obd ldpm_tia__ip_fac_egr_thr_obd ip_fac_map_egr_thr_obd c_tco_min_egr_thr_obd /end DEF_CHARACTERISTIC
 /begin OUT_MEASUREMENT t_egr_thr_obd lv_egr_thr_obd egrvpwm_obd thrpwm_obd byppwm_obd bpapwm_obd ctr_maf_egr_thr_obd ctr_maf_dif_egr_thr_obd ctr_map_dif_egr_thr_obd maf_egr_thr_obd map_mes_egr_thr_obd lv_rst_diag_egr_thr_obd lv_inh_egr_thr_obd /end OUT_MEASUREMENT
/end FUNCTION
/begin FUNCTION OBD_ATCOPLAD "Coolant Temperature Plausibility of two Sensors"
 /begin DEF_CHARACTERISTIC c_abc_inc_tco_1_2_plaus c_abc_max_tco_1_2_plaus c_temp_1_2_tco_1_2_plaus_cold c_temp_1_2_tco_1_2_plaus_wup c_temp_1_2_tco_1_2_plaus_hot c_temp_2_1_tco_1_2_plaus_cold c_temp_2_1_tco_1_2_plaus_wup c_temp_2_1_tco_1_2_plaus_hot c_temp_cold_max_tco_1_2_plaus c_temp_hot_min_tco_1_2_plaus /end DEF_CHARACTERISTIC
 /begin OUT_MEASUREMENT sf_rng_tco_1_2_plaus /end OUT_MEASUREMENT
/end FUNCTION
/begin FUNCTION OBD_Battery_Voltage_Diag "Batteriespannung (VB)" /begin DEF_CHARACTERISTIC c_vb_min_vb_diag c_n_min_vb_diag c_abc_inc_vb c_abc_max_vb /end DEF_CHARACTERISTIC /begin OUT_MEASUREMENT lv_err_vb /end OUT_MEASUREMENT /end FUNCTION
/begin FUNCTION OBD_ERRMEM "" /begin OUT_MEASUREMENT lv_wal_2_act_req lv_wal_1_act_req lv_mil_act_req /end OUT_MEASUREMENT /end FUNCTION
/begin FUNCTION C_D_TQ ""
 /begin SUB_FUNCTION TQ_ATQCLFAC TQ_ATQ_ESPI TQ_ATQ_LTCP TQ_ATQIMIN TQ_ATQ2MF TQ_ATQI_SP TQ_ATQ_LIH TQ_ATQ_LTC TQ_ATQGBP TQ_ATQETCU /end SUB_FUNCTION
/end FUNCTION
/begin FUNCTION TQ_ATQCLFAC ""
 /begin DEF_CHARACTERISTIC c_dri_fac_tq_req c_crlc_n ip_fac_tq_req_dri_h__n__pv_av ldpm_n_ip_fac_tq_req ldpm_pv_av_ip_fac_tq_req ip_fac_tq_req_dri_l__n__pv_av /end DEF_CHARACTERISTIC
 /begin OUT_MEASUREMENT fac_tq_req_driv lv_fac_tq_req_dri_low n_fil /end OUT_MEASUREMENT
/end FUNCTION
/begin FUNCTION TQ_ATQ_ESPI "" /begin DEF_CHARACTERISTIC c_lgrd_tq_neg_diag_tcs c_lgrd_tq_pos_diag_tcs /end DEF_CHARACTERISTIC
 /begin OUT_MEASUREMENT tq_tcs_req lv_tcs_plaus lv_tq_tcs_req_dec tq_lgrd_neg_diag_tcs tq_lgrd_pos_diag_tcs lv_req_tcs lv_tq_tcs_req_inc /end OUT_MEASUREMENT
/end FUNCTION
/begin FUNCTION TQ_ATQ_LTCP ""
 /begin DEF_CHARACTERISTIC c_ctr_dri_up_dly_ltc ip_tq_ltc_thd_down_1__n__dri ldpm_n_ip_tq_ltc ldpm_dri_ip_tq_ltc ip_tq_ltc_thd_up__n__dri ip_fac_tq_up__n__dri ip_tq_dif_up__tq_sp_clu__dri ldpm_tq_sp_clu_ip_tq_dif_up ip_fac_tq_dif_up__pv_av__n ldpm_pv_av_ip_fac_tq_dif ip_fac_tq_down__n__dri ip_tq_dif_down__tq_sp_clu__dri ldpm_tq_sp_clu_ip_tq_dif_down ip_fac_tq_dif_down__pv_av__n /end DEF_CHARACTERISTIC
 /begin OUT_MEASUREMENT tq_ltc_dif_up tq_ltc_thd_up tq_ltc_dif_down tq_ltc_thd_down_1 /end OUT_MEASUREMENT
/end FUNCTION
/begin FUNCTION TQ_ATQIMIN "Minimum Indicated Torque" /begin OUT_MEASUREMENT lv_slm_bol_act tqi_min /end OUT_MEASUREMENT /end FUNCTION
/begin FUNCTION TQ_ATQ2MF "" /begin OUT_MEASUREMENT mf_tot mf_tot_grd /end OUT_MEASUREMENT /end FUNCTION
/begin FUNCTION TQ_ATQI_SP "Coordination of Torque Setpoint"
 /begin DEF_CHARACTERISTIC c_t_egs_dly lc_tqi_slm_act lc_tqi_max_act ip_tq_add_lim2__n ldp_n_ip_tq_add_lim2 /end DEF_CHARACTERISTIC
 /begin OUT_MEASUREMENT tq_dif lv_gs_dif_act tqi_sp tq_sp_clu tqi_sp_grd /end OUT_MEASUREMENT
/end FUNCTION
/begin FUNCTION TQ_ATQ_LIH "Requested Torque for limp home"
 /begin DEF_CHARACTERISTIC lc_clr_sum_tqi_lih lc_tqi_lih_inh lc_tqi_mon_inh c_n_max_is_plaus c_ofs_tq_mon c_tqi_lih_pas c_tqi_lih_grd_inc c_tqi_lih_grd_dec c_lgrd_tqi_mon_dec c_lgrd_tqi_mon_inc ip_tqi_lih__n ldp_n_ip_tqi_lih ip_tqi_mon ldp_n_ip_tqi_mon ldp_dri_ip_tqi_mon /end DEF_CHARACTERISTIC
 /begin OUT_MEASUREMENT sum_tqi_lih lv_tqi_lih_intv_act lv_tqi_mon_intv_act tqi_lih_1 tqi_lih /end OUT_MEASUREMENT
/end FUNCTION
/begin FUNCTION TQ_ATQ_LTC "Load Transient Correction General"
 /begin DEF_CHARACTERISTIC lc_tq_lim_ltc_act c_tq_ltc_thd_add_down_2 c_tq_ltc_thd_down_2 c_n_32_ltc_min lc_ltc_on lc_ltc_dri_di lc_ltc_clu_di lc_ltc_is_ovs c_n_32_ltc_max /end DEF_CHARACTERISTIC
 /begin OUT_MEASUREMENT tq_ltc_sub tqi_ltc_sub tq_ltc_lim tq_ltc lv_act_ltc /end OUT_MEASUREMENT
/end FUNCTION
/begin FUNCTION TQ_ATQGBP "Torque limitation for Gearbox protection"
 /begin DEF_CHARACTERISTIC c_dri_mid c_dri_l c_lgrd_tq_err_tq_gb_prot c_lgrd_tq_lim_gb_prot c_sf_conf_gb_gb_prot lc_sf_conf_gb_man c_fac_tqe_dif_gb_prot ip_tq_gb_prot_h__n ldpm_n_ip_tqi_gb_prot ip_tq_gb_prot_l__n ip_tq_gb_prot_mid__n ip_tq_gb_prot_rvl_n ldpm_n_ip_gb_prot ip_tq_gb_prot_err__n ip_tq_min_gb_prot ldp_n_ip_tq_min_gb_prot /end DEF_CHARACTERISTIC
 /begin OUT_MEASUREMENT tq_lim_gb_prot_raw tq_lim_gb_prot tqi_lim_gb_prot /end OUT_MEASUREMENT
/end FUNCTION
/begin FUNCTION TQ_ATQETCU "Torque Request for Gear Shift Intervention"
 /begin DEF_CHARACTERISTIC lc_etcu_di_is lc_t_max_inh_etcu c_tq_inc_sum_max_etcu c_t_dly_diag_etcu_dec c_lgrd_tqi_neg_diag_etcu c_lgrd_tqi_pos_diag_etcu c_lgrd_tqi_neg_inh_etcu c_lgrd_tqi_pos_inh_etcu c_tq_dif_tol_etcu c_tq_dif_bol_etcu c_t_max_tq_inc_etcu lc_t_max_etcu_rst id_t_max_dri__dri_old__dri_new ldp_dri_old_etcu_id_t_max_dri ldp_dri_new_etcu_id_t_max_dri /end DEF_CHARACTERISTIC
 /begin OUT_MEASUREMENT lv_etcu_ena lv_t_lim_etcu lv_tq_inc_sum_etcu tq_inc_sum_etcu lv_tq_etcu_req_dec lv_tq_etcu_req_inc lv_etcu_inc_lih lv_etcu_dec_lih tq_req_etcu_lih lv_etcu_hold lv_etcu_ramp t_etcu_hold tq_etcu_inter tq_etcu_dif n_sp_amt lv_amt_act lv_tq_etcu_act lv_tq_etcu_req_min lv_tq_etcu_req_max lv_etcu_inc lv_etcu_ena_lih lv_etcu_ramp_end tqi_egs_sub tq_egs_sub lv_t_etcu_max t_etcu lv_t_etcu_inc_max lv_etcu_inc_inh lv_tq_inc_shift t_etcu_inc lv_cmd_inh_etcu lv_req_shift dri_old_etcu dri_new_etcu t_max_etcu /end OUT_MEASUREMENT
/end FUNCTION
/begin FUNCTION C_D_TORQUE ""
 /begin SUB_FUNCTION TORQUE_ATQ_ALT TORQUE_ATQFRADD TORQUE_ATQE TORQUE_ATQALTAI TORQUE_ATQI_REQ TORQUE_AMFTQLM TORQUE_ATQDIFAD /end SUB_FUNCTION
/end FUNCTION
/begin FUNCTION TORQUE_ATQ_ALT "" /end FUNCTION
/begin FUNCTION TORQUE_ATQFRADD "" /begin DEF_CHARACTERISTIC c_tq_add_conf ip_fac_tq_add__pv_av /end DEF_CHARACTERISTIC /begin OUT_MEASUREMENT tq_loss_add tq_add_req /end OUT_MEASUREMENT /end FUNCTION
/begin FUNCTION TORQUE_ATQE ""
 /begin DEF_CHARACTERISTIC lc_tqe_clc_act c_fac_tqe ip_crlc_tqe_sp__tqe_fil_dif ldp_tqe_fil_dif_ip_crlc_tqe_sp /end DEF_CHARACTERISTIC
 /begin OUT_MEASUREMENT tqe_dif_raw tqe_fil_dif tqe_sp_raw tqe_sp_clc tqe_sp tqe_dif /end OUT_MEASUREMENT
/end FUNCTION
/begin FUNCTION TORQUE_ATQALTAI "" /begin OUT_MEASUREMENT gen_load /end OUT_MEASUREMENT /end FUNCTION
/begin FUNCTION TORQUE_ATQI_REQ "Minimal-Maximal Torque Request Selection"
 /begin OUT_MEASUREMENT tqi_tar tqi_req_egr tqi_grd_tar tqi_grd_req_egr tqi_lim_min tqi_lim_min1 tqi_req_fast lv_tqi_lim_act tq_req_fast tq_lim_min /end OUT_MEASUREMENT
/end FUNCTION
/begin FUNCTION TORQUE_AMFTQLM "Torque Limitation"
 /begin DEF_CHARACTERISTIC lc_swi_temp_tql ip_tqi_tql_bas ldpm_n_ip_tqi_bas ip_fac_tqi_add_tql ldp_t_ast_ip_fac_tqi_add_tql ip_fac_tqi_tql_bpr ldp_vs_ip_fac_tqi_tql_bpr ip_fac_tqi_tql_amp ldp_tia_ip_fac_tqi_tql_amp ip_tqi_add_tql_st ldp_n_ip_tqi_add_tql ldp_tco_ip_tqi_tql ip_tqi_tql_bpr ldp_n_ip_tqi_tql_bpr ip_tqi_tql_amp ldpm_n_ip_tqi_tql ldp_amp_ip_tqi_tql_amp /end DEF_CHARACTERISTIC
 /begin OUT_MEASUREMENT tqi_tql tqi_tql_bas tqi_add_tql tqi_tql_bpr tqi_tql_amp /end OUT_MEASUREMENT
/end FUNCTION
/begin FUNCTION TORQUE_ATQDIFAD ""
 /begin DEF_CHARACTERISTIC lc_tq_is_ad_ena_bls lc_tq_is_ad_ena_cs lc_tq_is_ad_man lc_tq_is_ad_man_act c_n_delta c_t_dly_is_ad c_fac_tq_is_ad c_tq_is_ad_delta c_fac_tq_is_ad_conv c_fac_tq_is_ad_conv_delta c_fac_tq_is_ad_acc_conv c_tq_is_ad_acc_conv_delta c_fac_tq_is_ad_acc c_tq_is_ad_acc_delta c_tq_is_ad_first_ad_end c_t_ast_is_ad_first_ad_end c_tco_is_ad_h_max c_tco_is_ad_h_min c_tco_is_ad_l_max c_tco_is_ad_l_min c_tco_is_ad_mid_max c_tco_is_ad_mid_min c_crlc_tco_h_res_fil c_crlc_tq_dif_is_ad_acc /end DEF_CHARACTERISTIC
 /begin OUT_MEASUREMENT lv_tq_is_ad_act lv_is_ad_cnd_tco lv_dly_ad_is tq_dif_is_ad_l tq_dif_is_ad_mid tq_dif_is_ad_h fac_tq_is_ad_conv_inter tq_dif_is_ad_acc_conv_inter tq_dif_is_ad_acc_inter lv_first_tq_is_ad_end nr_tco_rng_is_ad lv_calib_tco_is_ad_vld tco_h_res_fil tq_dif_is_ad tq_dif_is_ad_acc fac_tq_is_ad_conv lv_dis_ad_clu /end OUT_MEASUREMENT
/end FUNCTION
/begin FUNCTION C_D_TQM ""
 /begin SUB_FUNCTION TQM_Torque_Request_For_Gear_Shift TQM_Torque_Request_for_Traction_Control_TCS TQM_TQ_Loss_And_Reserve_ACC TQM_TQ_Loss_Alternator /end SUB_FUNCTION
/end FUNCTION
/begin FUNCTION TQM_Torque_Request_For_Gear_Shift ""
 /begin DEF_CHARACTERISTIC c_t_dly_diag_gs c_tqi_gs_slow_hys c_lgrd_tqi_inc_diag_gs c_n_sp_is_ratio_max_gs_lim ldp_n__lgrd_tqi_gs_bol ip_lgrd_tqi_gs_bol /end DEF_CHARACTERISTIC
 /begin OUT_MEASUREMENT lv_tcu_disable lv_gs_ena tqi_gs_fast_inc tqi_gs_slow_dec tqi_gs_slow_inc lv_gs_dec_act tqi_gs_fast_dec tqi_gs_bol /end OUT_MEASUREMENT
/end FUNCTION
/begin FUNCTION TQM_Torque_Request_for_Traction_Control_TCS ""
 /begin DEF_CHARACTERISTIC c_vs_min_msr c_tq_msr_int_max c_t_max_tcs1_miss c_lgrd_tqi_inc_diag_asr c_t_dly_diag_asr c_n_sp_is_ratio_max_asr_lim ip_lgrd_tqi_asr_bol ldp_n__lgrd_tqi_asr_bol /end DEF_CHARACTERISTIC
 /begin OUT_MEASUREMENT lv_msr_ena tqi_msr_fast tqi_msr_slow lv_msr tq_msr_int lv_msr_nplau lv_msr_ena_can_cnt lv_msr_act lv_tcs_disable lv_asr_ena tqi_asr_fast tqi_asr_slow lv_asr lv_asr_act /end OUT_MEASUREMENT
/end FUNCTION
/end MODULE
/end PROJECT
