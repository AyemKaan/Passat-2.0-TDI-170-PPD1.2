ASAP2_VERSION 1 41
/begin PROJECT SN0 "SIMOS PPD"
/begin HEADER "_default_HeaderComment" PROJECT_NO PRJ_NUM /end HEADER
/begin MODULE _default_ModuleName "_default_ModuleLongIdentifier"
/begin MOD_COMMON "_default_ModCommonComment" DEPOSIT ABSOLUTE BYTE_ORDER MSB_FIRST ALIGNMENT_BYTE 1 ALIGNMENT_WORD 2 ALIGNMENT_LONG 4 ALIGNMENT_FLOAT32_IEEE 4 ALIGNMENT_FLOAT64_IEEE 8 /end MOD_COMMON
/begin MEASUREMENT ar_pi_egr "output of the EGR- controller" SWORD _CNV_A_R_LINEAR_____158_CM 1 0. -78.08139 78.079008 DISPLAY_IDENTIFIER AR_PI_EGR ECU_ADDRESS 0x7fa774 BYTE_ORDER MSB_LAST FORMAT "%5.3" /end MEASUREMENT
/begin MEASUREMENT egr_mmv_ctl "actual EGR- ratio for backup solution" UWORD _CNV_A_R_LINEAR_____8_CM 1 0. 0. 99.99847412109381 DISPLAY_IDENTIFIER EGR_MMV_CTL ECU_ADDRESS 0x7fa776 BYTE_ORDER MSB_LAST FORMAT "%5.3" /end MEASUREMENT
/begin MEASUREMENT lv_egr_ctl_sub "back up solution active" UBYTE _CNV_S_2_RANGE______11_CM 1 0. 0. 1. DISPLAY_IDENTIFIER LV_EGR_CTL_SUB ECU_ADDRESS 0x7fb86e /end MEASUREMENT
/begin MEASUREMENT egr_sp_mmv_ctl "EGR- ratio setpoint for backup solution" UWORD _CNV_A_R_LINEAR_____8_CM 1 0. 0. 99.99847412109381 DISPLAY_IDENTIFIER EGR_SP_MMV_CTL ECU_ADDRESS 0x7fa778 BYTE_ORDER MSB_LAST FORMAT "%5.3" /end MEASUREMENT
/begin MEASUREMENT egr_sp_mmv_out "EGR- ratio setpoint behind intervention for backup solution" UWORD _CNV_A_R_LINEAR_____8_CM 1 0. 0. 99.99847412109381 DISPLAY_IDENTIFIER EGR_SP_MMV_OUT ECU_ADDRESS 0x7fa77a BYTE_ORDER MSB_LAST FORMAT "%5.3" /end MEASUREMENT
/begin MEASUREMENT egr_mmv_out "actual EGR- ratio behind intervention for backup solution" UWORD _CNV_A_R_LINEAR_____8_CM 1 0. 0. 99.99847412109381 DISPLAY_IDENTIFIER EGR_MMV_OUT ECU_ADDRESS 0x7fa77c BYTE_ORDER MSB_LAST FORMAT "%5.3" /end MEASUREMENT
/begin MEASUREMENT egr_dif "EGR ratio deviation" SWORD _CNV_A_R_LINEAR_____12_CM 1 0. -100. 99.996948242 DISPLAY_IDENTIFIER EGR_DIF ECU_ADDRESS 0x7f98f6 BYTE_ORDER MSB_LAST FORMAT "%5.3" /end MEASUREMENT
/begin MEASUREMENT mafpwm "controller output for backup solution" UWORD _CNV_A_R_LINEAR_____136_CM 1 0. 0. 99.9969482421875 DISPLAY_IDENTIFIER MAFPWM ECU_ADDRESS 0x7f98f8 BYTE_ORDER MSB_LAST FORMAT "%5.3" /end MEASUREMENT
/begin MEASUREMENT mafpwm_pi "output of the PI- controller (backup solution)" SWORD _CNV_A_R_LINEAR_____12_CM 1 0. -100. 99.996948242 DISPLAY_IDENTIFIER MAFPWM_PI ECU_ADDRESS 0x7f98fa BYTE_ORDER MSB_LAST FORMAT "%5.3" /end MEASUREMENT
/begin MEASUREMENT ar_byp_ctl_the "theor. cross section of the bypass throttle" UWORD _CNV_A_R_LINEAR_____7_CM 1 0. 0. 78.08 DISPLAY_IDENTIFIER AR_BYP_CTL_THE ECU_ADDRESS 0x7f98fc BYTE_ORDER MSB_LAST FORMAT "%5.3" /end MEASUREMENT
/begin MEASUREMENT ar_thr_ctl_the "theor. cross section of the EGR- throttle" UWORD _CNV_A_R_LINEAR_____7_CM 1 0. 0. 78.08 DISPLAY_IDENTIFIER AR_THR_CTL_THE ECU_ADDRESS 0x7f98fe BYTE_ORDER MSB_LAST FORMAT "%5.3" /end MEASUREMENT
/begin MEASUREMENT fac_ar_byp_egr_ctl "Factor to correct the cross section of the bypass- throttle" UWORD _CNV_A_R_LINEAR_____14_CM 1 0. 0. 0.9999847412109381 DISPLAY_IDENTIFIER FAC_AR_BYP_EGR_CTL ECU_ADDRESS 0x7f9900 BYTE_ORDER MSB_LAST FORMAT "%6.5" /end MEASUREMENT
/begin MEASUREMENT fac_ar_thr_egr_ctl "Factor to correct the cross section of the EGR- throttle" UWORD _CNV_A_R_LINEAR_____14_CM 1 0. 0. 0.9999847412109381 DISPLAY_IDENTIFIER FAC_AR_THR_EGR_CTL ECU_ADDRESS 0x7f9902 BYTE_ORDER MSB_LAST FORMAT "%6.5" /end MEASUREMENT
/begin MEASUREMENT ar_thr_ico_ctl_the "theor. cross section of the intercooler throttle" UWORD _CNV_A_R_LINEAR_____7_CM 1 0. 0. 78.08 DISPLAY_IDENTIFIER AR_THR_ICO_CTL_THE ECU_ADDRESS 0x7f9904 BYTE_ORDER MSB_LAST FORMAT "%5.3" /end MEASUREMENT
/begin MEASUREMENT ar_egrv_ctl_the "theor. cross section of the EGR- valve" UWORD _CNV_A_R_LINEAR_____7_CM 1 0. 0. 78.08 DISPLAY_IDENTIFIER AR_EGRV_CTL_THE ECU_ADDRESS 0x7f9906 BYTE_ORDER MSB_LAST FORMAT "%5.3" /end MEASUREMENT
/begin MEASUREMENT lv_egr_ctl_thr "flag for an active EGR control with the throttle" UBYTE _CNV_S_2_RANGE______11_CM 1 0. 0. 1. DISPLAY_IDENTIFIER LV_EGR_CTL_THR ECU_ADDRESS 0x7fbe64 /end MEASUREMENT
/begin MEASUREMENT ar_pi_egr_max "upper limit for the EGR- controller" SWORD _CNV_A_R_LINEAR_____158_CM 1 0. -78.08139 78.079008 DISPLAY_IDENTIFIER AR_PI_EGR_MAX ECU_ADDRESS 0x7fa77e BYTE_ORDER MSB_LAST FORMAT "%5.3" /end MEASUREMENT
/begin MEASUREMENT ar_pi_egr_min "lower limit for the EGR- controller" SWORD _CNV_A_R_LINEAR_____158_CM 1 0. -78.08139 78.079008 DISPLAY_IDENTIFIER AR_PI_EGR_MIN ECU_ADDRESS 0x7fa780 BYTE_ORDER MSB_LAST FORMAT "%5.3" /end MEASUREMENT
/begin MEASUREMENT ar_pi_egr_min_lim "lower limit for the EGR- controller, absolut" SWORD _CNV_A_R_LINEAR_____158_CM 1 0. -78.08139 78.079008 DISPLAY_IDENTIFIER AR_PI_EGR_MIN_LIM ECU_ADDRESS 0x7fa782 BYTE_ORDER MSB_LAST FORMAT "%5.3" /end MEASUREMENT
/begin MEASUREMENT ar_pi_egr_min_dif "lower limit for the EGR- controller, gradient" SWORD _CNV_A_R_LINEAR_____158_CM 1 0. -78.08139 78.079008 DISPLAY_IDENTIFIER AR_PI_EGR_MIN_DIF ECU_ADDRESS 0x7fa784 BYTE_ORDER MSB_LAST FORMAT "%5.3" /end MEASUREMENT
/begin MEASUREMENT ar_pi_egr_min_bas "lower limit for the EGR- controller" SWORD _CNV_A_R_LINEAR_____158_CM 1 0. -78.08139 78.079008 DISPLAY_IDENTIFIER AR_PI_EGR_MIN_BAS ECU_ADDRESS 0x7fa786 BYTE_ORDER MSB_LAST FORMAT "%5.3" /end MEASUREMENT
/begin MEASUREMENT ar_pi_egr_max_lim "upper limit for the EGR- controller, absolut" SWORD _CNV_A_R_LINEAR_____158_CM 1 0. -78.08139 78.079008 DISPLAY_IDENTIFIER AR_PI_EGR_MAX_LIM ECU_ADDRESS 0x7fa788 BYTE_ORDER MSB_LAST FORMAT "%5.3" /end MEASUREMENT
/begin MEASUREMENT ar_pi_egr_max_dif "upper limit for the EGR- controller, gradient" SWORD _CNV_A_R_LINEAR_____158_CM 1 0. -78.08139 78.079008 DISPLAY_IDENTIFIER AR_PI_EGR_MAX_DIF ECU_ADDRESS 0x7fa78a BYTE_ORDER MSB_LAST FORMAT "%5.3" /end MEASUREMENT
/begin MEASUREMENT ar_pi_egr_max_bas "upper limit for the EGR- controller" SWORD _CNV_A_R_LINEAR_____158_CM 1 0. -78.08139 78.079008 DISPLAY_IDENTIFIER AR_PI_EGR_MAX_BAS ECU_ADDRESS 0x7fa78c BYTE_ORDER MSB_LAST FORMAT "%5.3" /end MEASUREMENT
/begin MEASUREMENT mafpwm_pi_min "lower limit for the controller output" SWORD _CNV_A_R_LINEAR_____12_CM 1 0. -100. 99.996948242 DISPLAY_IDENTIFIER MAFPWM_PI_MIN ECU_ADDRESS 0x7fa78e BYTE_ORDER MSB_LAST FORMAT "%5.3" /end MEASUREMENT
/begin MEASUREMENT mafpwm_pi_max "upper limit for the controller output" SWORD _CNV_A_R_LINEAR_____12_CM 1 0. -100. 99.996948242 DISPLAY_IDENTIFIER MAFPWM_PI_MAX ECU_ADDRESS 0x7fa790 BYTE_ORDER MSB_LAST FORMAT "%5.3" /end MEASUREMENT
/begin MEASUREMENT fac_mafpwm_pi_dt1 "output of the DT1-function for dynamic MAF controller output limitation" SWORD _CNV_A_R_LINEAR_____12_CM 1 0. -100. 99.996948242 DISPLAY_IDENTIFIER FAC_MAFPWM_PI_DT1 ECU_ADDRESS 0x7fa792 BYTE_ORDER MSB_LAST FORMAT "%5.3" /end MEASUREMENT
/begin MEASUREMENT lv_mafpwm_thd_thr "activ controller parameters for the EGR- throttle" UBYTE _CNV_S_2_RANGE______11_CM 1 0. 0. 1. DISPLAY_IDENTIFIER LV_MAFPWM_THD_THR ECU_ADDRESS 0x7fbe65 /end MEASUREMENT
/begin MEASUREMENT kr_pi_egr "gain for the EGR- controller" UWORD _CNV_A_R_LINEAR_____159_CM 1 0. 0. 3.123208 DISPLAY_IDENTIFIER KR_PI_EGR ECU_ADDRESS 0x7fa794 BYTE_ORDER MSB_LAST FORMAT "%6.5" /end MEASUREMENT
/begin MEASUREMENT tn_pi_egr "integral action time for the EGR- controller" UWORD _CNV_A_R_LINEAR_____64_CM 1 0. 0. 4.19424 DISPLAY_IDENTIFIER TN_PI_EGR ECU_ADDRESS 0x7fa796 BYTE_ORDER MSB_LAST FORMAT "%6.5" /end MEASUREMENT
/begin CHARACTERISTIC lc_egr_ctl_sub "button for back up EGR strategy" VALUE 0x85ce74 _REC_VAL_20_u1 1. _CNV_A_R_LINEAR_____0_CM 0. 1. DISPLAY_IDENTIFIER LC_EGR_CTL_SUB FORMAT "%1.0" /end CHARACTERISTIC
/begin CHARACTERISTIC c_maf_cyl_sub "air mass flow value used to define EGR_SUB" VALUE 0x85ca8c _REC_VAL_20_u2 1389. _CNV_A_R_LINEAR_____60_CM 0. 1389. DISPLAY_IDENTIFIER C_MAF_CYL_SUB FORMAT "%6.2" /end CHARACTERISTIC
/begin CHARACTERISTIC lc_thr_3 "number of throttles" VALUE 0x85ceb3 _REC_VAL_20_u1 1. _CNV_A_R_LINEAR_____0_CM 0. 1. DISPLAY_IDENTIFIER LC_THR_3 FORMAT "%1.0" /end CHARACTERISTIC
/begin CHARACTERISTIC c_t_ramp_fac_ar_thr_byp "time to change between the two throttles" VALUE 0x85cc6e _REC_VAL_20_u2 65.535 _CNV_A_R_LINEAR_____73_CM 0. 65.535 DISPLAY_IDENTIFIER C_T_RAMP_FAC_AR_THR_BYP FORMAT "%5.3" /end CHARACTERISTIC
/begin CHARACTERISTIC c_ar_egrv_max_dif "max. PI-gradient for the EGR- valve" VALUE 0x85c8a0 _REC_VAL_20_u2 78.08 _CNV_A_R_LINEAR_____7_CM 0. 78.08 DISPLAY_IDENTIFIER C_AR_EGRV_MAX_DIF FORMAT "%5.3" /end CHARACTERISTIC
/begin CHARACTERISTIC c_ar_thr_max_dif "max. PI-gradient for the EGR- throttle" VALUE 0x85c8a8 _REC_VAL_20_u2 78.08 _CNV_A_R_LINEAR_____7_CM 0. 78.08 DISPLAY_IDENTIFIER C_AR_THR_MAX_DIF FORMAT "%5.3" /end CHARACTERISTIC
/begin CHARACTERISTIC c_ar_thr_max_the "theoretic max. cross section of the EGR- throttle" VALUE 0x85c8aa _REC_VAL_20_u2 78.08 _CNV_A_R_LINEAR_____7_CM 0. 78.08 DISPLAY_IDENTIFIER C_AR_THR_MAX_THE FORMAT "%5.3" /end CHARACTERISTIC
/begin CHARACTERISTIC c_ar_thr_min_the "theoretic min. cross section of the EGR- throttle" VALUE 0x85c8ac _REC_VAL_20_u2 78.08 _CNV_A_R_LINEAR_____7_CM 0. 78.08 DISPLAY_IDENTIFIER C_AR_THR_MIN_THE FORMAT "%5.3" /end CHARACTERISTIC
/begin CHARACTERISTIC c_mafpwm_pi_dif "limit for EGR-controller output" VALUE 0x85cab2 _REC_VAL_20_u2 99.9969482421875 _CNV_A_R_LINEAR_____136_CM 0. 99.9969482421875 DISPLAY_IDENTIFIER C_MAFPWM_PI_DIF FORMAT "%5.3" /end CHARACTERISTIC
/begin CHARACTERISTIC c_mafpwm_max "maximal limit for MAF-controller output" VALUE 0x85caaa _REC_VAL_20_u2 99.9969482421875 _CNV_A_R_LINEAR_____136_CM 0. 99.9969482421875 DISPLAY_IDENTIFIER C_MAFPWM_MAX FORMAT "%5.3" /end CHARACTERISTIC
/begin CHARACTERISTIC c_mafpwm_min "lower limit for MAF-controller output" VALUE 0x85caac _REC_VAL_20_u2 99.9969482421875 _CNV_A_R_LINEAR_____136_CM 0. 99.9969482421875 DISPLAY_IDENTIFIER C_MAFPWM_MIN FORMAT "%5.3" /end CHARACTERISTIC
/begin CHARACTERISTIC lc_mafpwm_pi_dt1 "button to activate the dynamic MAF controller output limitation" VALUE 0x85ce8b _REC_VAL_20_u1 1. _CNV_A_R_LINEAR_____0_CM 0. 1. DISPLAY_IDENTIFIER LC_MAFPWM_PI_DT1 FORMAT "%1.0" /end CHARACTERISTIC
/begin CHARACTERISTIC c_tn_mafpwm_pi_dt1 "time value for dynamic MAF controller output limitation" VALUE 0x85cd24 _REC_VAL_20_u2 4.19424 _CNV_A_R_LINEAR_____64_CM 0. 4.19424 DISPLAY_IDENTIFIER C_TN_MAFPWM_PI_DT1 FORMAT "%6.5" /end CHARACTERISTIC
/begin CHARACTERISTIC c_kr_mafpwm_pi_dt1_tqi "gain for dynamic MAF controller output limitation" VALUE 0x85ca44 _REC_VAL_20_s2 1.99997 _CNV_A_R_LINEAR_____160_CM -1. 0.99997 DISPLAY_IDENTIFIER C_KR_MAFPWM_PI_DT1_TQI FORMAT "%6.5" /end CHARACTERISTIC
/begin CHARACTERISTIC c_mafpwm_thd_thr "threshold for usage of throttle parameters" VALUE 0x85cab4 _REC_VAL_20_u2 99.9969482421875 _CNV_A_R_LINEAR_____136_CM 0. 99.9969482421875 DISPLAY_IDENTIFIER C_MAFPWM_THD_THR FORMAT "%5.3" /end CHARACTERISTIC
/begin CHARACTERISTIC c_mafpwm_hys_thr "hysteresis for usage of throttle parameters" VALUE 0x85caa8 _REC_VAL_20_u2 99.9969482421875 _CNV_A_R_LINEAR_____136_CM 0. 99.9969482421875 DISPLAY_IDENTIFIER C_MAFPWM_HYS_THR FORMAT "%5.3" /end CHARACTERISTIC
/begin CHARACTERISTIC ip_fac_kr_pi_egr__egr_dif "GE_ECTL: factor for the gain-value of the PI-controller" CURVE 0x852540 _REC_CUR_20_u2_u2 3.99998471 _CNV_A_R_LINEAR_____59_CM 0. 3.99998471 DISPLAY_IDENTIFIER IP_FAC_KR_PI_EGR__EGR_DIF FORMAT "%6.5"
 /begin AXIS_DESCR COM_AXIS egr_dif _CNV_A_R_LINEAR_____161_CM 6 -100. 99.99694820000001 FORMAT "%5.3" AXIS_PTS_REF ldpm_egr_dif_ip_fac_pi_egr /end AXIS_DESCR
/end CHARACTERISTIC
/begin AXIS_PTS ldpm_egr_dif_ip_fac_pi_egr "" 0x842b6e egr_dif _REC_AXS_20_u2 199.9969482 _CNV_A_R_LINEAR_____161_CM 6 -100. 99.99694820000001 FORMAT "%5.3" /end AXIS_PTS
/begin CHARACTERISTIC ip_fac_tn_pi_egr__egr_dif "GE_ECTL: factor for the time-value of the PI-controller" CURVE 0x852ab8 _REC_CUR_20_u2_u2 3.99998471 _CNV_A_R_LINEAR_____59_CM 0. 3.99998471 DISPLAY_IDENTIFIER IP_FAC_TN_PI_EGR__EGR_DIF FORMAT "%6.5"
 /begin AXIS_DESCR COM_AXIS egr_dif _CNV_A_R_LINEAR_____161_CM 6 -100. 99.99694820000001 FORMAT "%5.3" AXIS_PTS_REF ldpm_egr_dif_ip_fac_pi_egr /end AXIS_DESCR
/end CHARACTERISTIC
/begin CHARACTERISTIC ip_mafpwm_pi_max_dt1__n__fac "GE_ECTL: maximum value for dynamic MAF controller output limitation" MAP 0x854396 _REC_MAP_20_u2_u2_u2 199.9969482 _CNV_A_R_LINEAR_____161_CM -100. 99.99694820000001 DISPLAY_IDENTIFIER IP_MAFPWM_PI_MAX_DT1__N__FAC FORMAT "%5.3"
 /begin AXIS_DESCR COM_AXIS n _CNV_A_R_LINEAR_____5_CM 16 0. 6375. FORMAT "%4.0" AXIS_PTS_REF ldpm_n_ip_mafpwm_pi_dt1 /end AXIS_DESCR
 /begin AXIS_DESCR COM_AXIS egr_dif _CNV_A_R_LINEAR_____161_CM 10 -100. 99.99694820000001 FORMAT "%5.3" AXIS_PTS_REF ldpm_fac_ip_mafpwm_pi_dt1 /end AXIS_DESCR
/end CHARACTERISTIC
/begin AXIS_PTS ldpm_n_ip_mafpwm_pi_dt1 "" 0x8431b6 n _REC_AXS_20_u2 6375. _CNV_A_R_LINEAR_____5_CM 16 0. 6375. FORMAT "%4.0" /end AXIS_PTS
/begin AXIS_PTS ldpm_fac_ip_mafpwm_pi_dt1 "" 0x842b7c egr_dif _REC_AXS_20_u2 199.9969482 _CNV_A_R_LINEAR_____161_CM 10 -100. 99.99694820000001 FORMAT "%5.3" /end AXIS_PTS
/begin CHARACTERISTIC ip_mafpwm_pi_min_dt1__n__fac "GE_ECTL: minimum value for dynamic MAF controller output limitation" MAP 0x8546d6 _REC_MAP_20_u2_u2_u2 199.9969482 _CNV_A_R_LINEAR_____161_CM -100. 99.99694820000001 DISPLAY_IDENTIFIER IP_MAFPWM_PI_MIN_DT1__N__FAC FORMAT "%5.3"
 /begin AXIS_DESCR COM_AXIS n _CNV_A_R_LINEAR_____5_CM 16 0. 6375. FORMAT "%4.0" AXIS_PTS_REF ldpm_n_ip_mafpwm_pi_dt1 /end AXIS_DESCR
 /begin AXIS_DESCR COM_AXIS egr_dif _CNV_A_R_LINEAR_____161_CM 10 -100. 99.99694820000001 FORMAT "%5.3" AXIS_PTS_REF ldpm_fac_ip_mafpwm_pi_dt1 /end AXIS_DESCR
/end CHARACTERISTIC
/begin CHARACTERISTIC ip_mafpwm_pi_min "GE_ECTL: minimum value for EGR controller output" MAP 0x8544d6 _REC_MAP_20_u2_u2_u2 199.9969482 _CNV_A_R_LINEAR_____161_CM -100. 99.99694820000001 DISPLAY_IDENTIFIER IP_MAFPWM_PI_MIN FORMAT "%5.3"
 /begin AXIS_DESCR COM_AXIS n _CNV_A_R_LINEAR_____5_CM 16 0. 6375. FORMAT "%4.0" AXIS_PTS_REF ldpm_n_ip_mafpwm_pi_lim /end AXIS_DESCR
 /begin AXIS_DESCR COM_AXIS tqi_egr _CNV_A_R_LINEAR_____52_CM 16 0. 1023.96875 FORMAT "%6.2" AXIS_PTS_REF ldpm_tqi_ip_mafpwm_pi_lim /end AXIS_DESCR
/end CHARACTERISTIC
/begin AXIS_PTS ldpm_n_ip_mafpwm_pi_lim "" 0x8431d8 n _REC_AXS_20_u2 6375. _CNV_A_R_LINEAR_____5_CM 16 0. 6375. FORMAT "%4.0" /end AXIS_PTS
/begin AXIS_PTS ldpm_tqi_ip_mafpwm_pi_lim "" 0x843a1a tqi_egr _REC_AXS_20_u2 1023.96875 _CNV_A_R_LINEAR_____52_CM 16 0. 1023.96875 FORMAT "%6.2" /end AXIS_PTS
/begin CHARACTERISTIC ip_mafpwm_pi_max "GE_ECTL: maximum value for EGR controller output" MAP 0x854196 _REC_MAP_20_u2_u2_u2 199.9969482 _CNV_A_R_LINEAR_____161_CM -100. 99.99694820000001 DISPLAY_IDENTIFIER IP_MAFPWM_PI_MAX FORMAT "%5.3"
 /begin AXIS_DESCR COM_AXIS n _CNV_A_R_LINEAR_____5_CM 16 0. 6375. FORMAT "%4.0" AXIS_PTS_REF ldpm_n_ip_mafpwm_pi_lim /end AXIS_DESCR
 /begin AXIS_DESCR COM_AXIS tqi_egr _CNV_A_R_LINEAR_____52_CM 16 0. 1023.96875 FORMAT "%6.2" AXIS_PTS_REF ldpm_tqi_ip_mafpwm_pi_lim /end AXIS_DESCR
/end CHARACTERISTIC
/begin CHARACTERISTIC ip_kr_pi_thr "GE_ECTL: gain value for EGR controlling with the EGR- throttle" MAP 0x85368e _REC_MAP_20_u2_u2_u2 3.123208 _CNV_A_R_LINEAR_____159_CM 0. 3.123208 DISPLAY_IDENTIFIER IP_KR_PI_THR FORMAT "%6.5"
 /begin AXIS_DESCR COM_AXIS n _CNV_A_R_LINEAR_____5_CM 6 0. 6375. FORMAT "%4.0" AXIS_PTS_REF ldpm_n_ip_pi_egr /end AXIS_DESCR
 /begin AXIS_DESCR COM_AXIS tqi_egr _CNV_A_R_LINEAR_____52_CM 6 0. 1023.96875 FORMAT "%6.2" AXIS_PTS_REF ldpm_tqi_ip_kr_pi_egr /end AXIS_DESCR
/end CHARACTERISTIC
/begin AXIS_PTS ldpm_n_ip_pi_egr "" 0x843414 n _REC_AXS_20_u2 6375. _CNV_A_R_LINEAR_____5_CM 6 0. 6375. FORMAT "%4.0" /end AXIS_PTS
/begin AXIS_PTS ldpm_tqi_ip_kr_pi_egr "" 0x84393c tqi_egr _REC_AXS_20_u2 1023.96875 _CNV_A_R_LINEAR_____52_CM 6 0. 1023.96875 FORMAT "%6.2" /end AXIS_PTS
/begin CHARACTERISTIC ip_kr_pi_egrv "GE_ECTL: gain value for EGR controlling with the EGR- valve" MAP 0x8534a6 _REC_MAP_20_u2_u2_u2 3.123208 _CNV_A_R_LINEAR_____159_CM 0. 3.123208 DISPLAY_IDENTIFIER IP_KR_PI_EGRV FORMAT "%6.5"
 /begin AXIS_DESCR COM_AXIS n _CNV_A_R_LINEAR_____5_CM 6 0. 6375. FORMAT "%4.0" AXIS_PTS_REF ldpm_n_ip_pi_egr /end AXIS_DESCR
 /begin AXIS_DESCR COM_AXIS tqi_egr _CNV_A_R_LINEAR_____52_CM 6 0. 1023.96875 FORMAT "%6.2" AXIS_PTS_REF ldpm_tqi_ip_kr_pi_egr /end AXIS_DESCR
/end CHARACTERISTIC
/begin CHARACTERISTIC ip_kr_pi_sub_thr "GE_ECTL: gain value for EGR controlling with the EGR- throttle_a" MAP 0x853646 _REC_MAP_20_u2_u2_u2 3.123208 _CNV_A_R_LINEAR_____159_CM 0. 3.123208 DISPLAY_IDENTIFIER IP_KR_PI_SUB_THR FORMAT "%6.5"
 /begin AXIS_DESCR COM_AXIS n _CNV_A_R_LINEAR_____5_CM 6 0. 6375. FORMAT "%4.0" AXIS_PTS_REF ldpm_n_ip_pi_egr /end AXIS_DESCR
 /begin AXIS_DESCR COM_AXIS tqi_egr _CNV_A_R_LINEAR_____52_CM 6 0. 1023.96875 FORMAT "%6.2" AXIS_PTS_REF ldpm_tqi_ip_kr_pi_egr /end AXIS_DESCR
/end CHARACTERISTIC
/begin CHARACTERISTIC ip_kr_pi_sub_egrv "GE_ECTL: gain value for EGR controlling with the EGR- valve_a" MAP 0x8535fe _REC_MAP_20_u2_u2_u2 3.123208 _CNV_A_R_LINEAR_____159_CM 0. 3.123208 DISPLAY_IDENTIFIER IP_KR_PI_SUB_EGRV FORMAT "%6.5"
 /begin AXIS_DESCR COM_AXIS n _CNV_A_R_LINEAR_____5_CM 6 0. 6375. FORMAT "%4.0" AXIS_PTS_REF ldpm_n_ip_pi_egr /end AXIS_DESCR
 /begin AXIS_DESCR COM_AXIS tqi_egr _CNV_A_R_LINEAR_____52_CM 6 0. 1023.96875 FORMAT "%6.2" AXIS_PTS_REF ldpm_tqi_ip_kr_pi_egr /end AXIS_DESCR
/end CHARACTERISTIC
/begin CHARACTERISTIC ip_tn_pi_thr "GE_ECTL: integral action time for EGR controlling with the EGR- throttle" MAP 0x85b676 _REC_MAP_20_u2_u2_u2 4.19424 _CNV_A_R_LINEAR_____64_CM 0. 4.19424 DISPLAY_IDENTIFIER IP_TN_PI_THR FORMAT "%6.5"
 /begin AXIS_DESCR COM_AXIS n _CNV_A_R_LINEAR_____5_CM 6 0. 6375. FORMAT "%4.0" AXIS_PTS_REF ldpm_n_ip_pi_egr /end AXIS_DESCR
 /begin AXIS_DESCR COM_AXIS tqi_egr _CNV_A_R_LINEAR_____52_CM 6 0. 1023.96875 FORMAT "%6.2" AXIS_PTS_REF ldpm_tqi_ip_kr_pi_egr /end AXIS_DESCR
/end CHARACTERISTIC
/begin CHARACTERISTIC ip_tn_pi_egrv "GE_ECTL: integral action time for EGR controlling with the EGR- valve" MAP 0x85b48e _REC_MAP_20_u2_u2_u2 4.19424 _CNV_A_R_LINEAR_____64_CM 0. 4.19424 DISPLAY_IDENTIFIER IP_TN_PI_EGRV FORMAT "%6.5"
 /begin AXIS_DESCR COM_AXIS n _CNV_A_R_LINEAR_____5_CM 6 0. 6375. FORMAT "%4.0" AXIS_PTS_REF ldpm_n_ip_pi_egr /end AXIS_DESCR
 /begin AXIS_DESCR COM_AXIS tqi_egr _CNV_A_R_LINEAR_____52_CM 6 0. 1023.96875 FORMAT "%6.2" AXIS_PTS_REF ldpm_tqi_ip_kr_pi_egr /end AXIS_DESCR
/end CHARACTERISTIC
/begin CHARACTERISTIC ip_tn_pi_sub_thr "GE_ECTL: integral action time for EGR controlling with the EGR- throttle_a" MAP 0x85b62e _REC_MAP_20_u2_u2_u2 4.19424 _CNV_A_R_LINEAR_____64_CM 0. 4.19424 DISPLAY_IDENTIFIER IP_TN_PI_SUB_THR FORMAT "%6.5"
 /begin AXIS_DESCR COM_AXIS n _CNV_A_R_LINEAR_____5_CM 6 0. 6375. FORMAT "%4.0" AXIS_PTS_REF ldpm_n_ip_pi_egr /end AXIS_DESCR
 /begin AXIS_DESCR COM_AXIS tqi_egr _CNV_A_R_LINEAR_____52_CM 6 0. 1023.96875 FORMAT "%6.2" AXIS_PTS_REF ldpm_tqi_ip_kr_pi_egr /end AXIS_DESCR
/end CHARACTERISTIC
/begin CHARACTERISTIC ip_tn_pi_sub_egrv "GE_ECTL: integral action time for EGR controlling with the EGR- valve_a" MAP 0x85b5e6 _REC_MAP_20_u2_u2_u2 4.19424 _CNV_A_R_LINEAR_____64_CM 0. 4.19424 DISPLAY_IDENTIFIER IP_TN_PI_SUB_EGRV FORMAT "%6.5"
 /begin AXIS_DESCR COM_AXIS n _CNV_A_R_LINEAR_____5_CM 6 0. 6375. FORMAT "%4.0" AXIS_PTS_REF ldpm_n_ip_pi_egr /end AXIS_DESCR
 /begin AXIS_DESCR COM_AXIS tqi_egr _CNV_A_R_LINEAR_____52_CM 6 0. 1023.96875 FORMAT "%6.2" AXIS_PTS_REF ldpm_tqi_ip_kr_pi_egr /end AXIS_DESCR
/end CHARACTERISTIC
/begin MEASUREMENT prs_cmp_up_sp "Pressure in front of the compressor" UWORD _CNV_A_R_LINEAR_____45_CM 1 0. 0. 5434. DISPLAY_IDENTIFIER PRS_CMP_UP_SP ECU_ADDRESS 0x7f9898 BYTE_ORDER MSB_LAST FORMAT "%6.2" /end MEASUREMENT
/begin MEASUREMENT maf_cyl_mmv "filtered air mass flow through the engine" UWORD _CNV_A_R_LINEAR_____60_CM 1 0. 0. 1389. DISPLAY_IDENTIFIER MAF_CYL_MMV ECU_ADDRESS 0x7fa6b2 BYTE_ORDER MSB_LAST FORMAT "%6.2" /end MEASUREMENT
/begin MEASUREMENT maf_cyl "airmass flow through the engine" UWORD _CNV_A_R_LINEAR_____60_CM 1 0. 0. 1389. DISPLAY_IDENTIFIER MAF_CYL ECU_ADDRESS 0x7f989a BYTE_ORDER MSB_LAST FORMAT "%6.2" /end MEASUREMENT
/begin MEASUREMENT maf_cyl_kgh "filtered air mass flow through the engine" UWORD _CNV_A_R_LINEAR_____110_CM 1 0. 0. 1023.984375 DISPLAY_IDENTIFIER MAF_CYL_KGH ECU_ADDRESS 0x7f989c BYTE_ORDER MSB_LAST FORMAT "%6.2" /end MEASUREMENT
/begin MEASUREMENT pq_map_prs_ex "pressure quotient manifold pressure to exhaust back pressure" UWORD _CNV_A_R_LINEAR_____199_CM 1 0. 0. 3.99998471 DISPLAY_IDENTIFIER PQ_MAP_PRS_EX ECU_ADDRESS 0x7fa6b4 BYTE_ORDER MSB_LAST FORMAT "%6.5" /end MEASUREMENT
/begin MEASUREMENT fac_maf_cyl "factor for air mass flow through the engine" UWORD _CNV_A_R_LINEAR_____48_CM 1 0. 0. 1.9999696 DISPLAY_IDENTIFIER FAC_MAF_CYL ECU_ADDRESS 0x7f989e BYTE_ORDER MSB_LAST FORMAT "%6.5" /end MEASUREMENT
/begin MEASUREMENT egr "EGR- ratio" UWORD _CNV_A_R_LINEAR_____8_CM 1 0. 0. 99.99847412109381 DISPLAY_IDENTIFIER EGR ECU_ADDRESS 0x7fa6b6 BYTE_ORDER MSB_LAST FORMAT "%5.3" /end MEASUREMENT
/begin MEASUREMENT egr_mmv "filtered EGR ratio" UWORD _CNV_A_R_LINEAR_____8_CM 1 0. 0. 99.99847412109381 DISPLAY_IDENTIFIER EGR_MMV ECU_ADDRESS 0x7f98a0 BYTE_ORDER MSB_LAST FORMAT "%5.3" /end MEASUREMENT
/begin MEASUREMENT mfw_egr "EGR mass flow" UWORD _CNV_A_R_LINEAR_____60_CM 1 0. 0. 1389. DISPLAY_IDENTIFIER MFW_EGR ECU_ADDRESS 0x7f98a2 BYTE_ORDER MSB_LAST FORMAT "%6.2" /end MEASUREMENT
/begin MEASUREMENT maf_im "stored air mass flow inside the intake manifold" SWORD _CNV_A_R_LINEAR_____151_CM 1 0. -694.5 694.479 DISPLAY_IDENTIFIER MAF_IM ECU_ADDRESS 0x7f98a4 BYTE_ORDER MSB_LAST FORMAT "%5.2" /end MEASUREMENT
/begin MEASUREMENT maf_cyl_sp "expected air mass flow through the engine" UWORD _CNV_A_R_LINEAR_____60_CM 1 0. 0. 1389. DISPLAY_IDENTIFIER MAF_CYL_SP ECU_ADDRESS 0x7fa6b0 BYTE_ORDER MSB_LAST FORMAT "%6.2" /end MEASUREMENT
/begin MEASUREMENT pq_map_prs_ex_sp "expected pressure quotient manifold pressure to exhaust back pressure" UWORD _CNV_A_R_LINEAR_____199_CM 1 0. 0. 3.99998471 DISPLAY_IDENTIFIER PQ_MAP_PRS_EX_SP ECU_ADDRESS 0x7fa6b8 BYTE_ORDER MSB_LAST FORMAT "%6.5" /end MEASUREMENT
/begin MEASUREMENT fac_maf_cyl_sp "volumetric efficiency" UWORD _CNV_A_R_LINEAR_____48_CM 1 0. 0. 1.9999696 DISPLAY_IDENTIFIER FAC_MAF_CYL_SP ECU_ADDRESS 0x7f98a6 BYTE_ORDER MSB_LAST FORMAT "%6.5" /end MEASUREMENT
/begin MEASUREMENT mfw_egr_sp "expected EGR mass flow" UWORD _CNV_A_R_LINEAR_____60_CM 1 0. 0. 1389. DISPLAY_IDENTIFIER MFW_EGR_SP ECU_ADDRESS 0x7f98a8 BYTE_ORDER MSB_LAST FORMAT "%6.2" /end MEASUREMENT
/begin MEASUREMENT mfw_ex_sp "exhaust gas mass flow" UWORD _CNV_A_R_LINEAR_____60_CM 1 0. 0. 1389. DISPLAY_IDENTIFIER MFW_EX_SP ECU_ADDRESS 0x7fa6ba BYTE_ORDER MSB_LAST FORMAT "%6.2" /end MEASUREMENT
/begin MEASUREMENT mfw_tur_sp "turbine mass flow" UWORD _CNV_A_R_LINEAR_____60_CM 1 0. 0. 1389. DISPLAY_IDENTIFIER MFW_TUR_SP ECU_ADDRESS 0x7fa6bc BYTE_ORDER MSB_LAST FORMAT "%6.2" /end MEASUREMENT
/begin MEASUREMENT maf_cyl_sp_clc "expected air mass flow through the engine" UWORD _CNV_A_R_LINEAR_____60_CM 1 0. 0. 1389. DISPLAY_IDENTIFIER MAF_CYL_SP_CLC ECU_ADDRESS 0x7fa6be BYTE_ORDER MSB_LAST FORMAT "%6.2" /end MEASUREMENT
/begin MEASUREMENT pq_map_prs_ex_sp_clc "expected pressure quotient manifold pressure to exhaust back pressure" UWORD _CNV_A_R_LINEAR_____199_CM 1 0. 0. 3.99998471 DISPLAY_IDENTIFIER PQ_MAP_PRS_EX_SP_CLC ECU_ADDRESS 0x7fa6c0 BYTE_ORDER MSB_LAST FORMAT "%6.5" /end MEASUREMENT
/begin MEASUREMENT fac_maf_cyl_sp_clc "factor for air mass flow through the engine" UWORD _CNV_A_R_LINEAR_____48_CM 1 0. 0. 1.9999696 DISPLAY_IDENTIFIER FAC_MAF_CYL_SP_CLC ECU_ADDRESS 0x7f98aa BYTE_ORDER MSB_LAST FORMAT "%6.5" /end MEASUREMENT
/begin MEASUREMENT mfw_egr_sp_clc "expected EGR mass flow" UWORD _CNV_A_R_LINEAR_____60_CM 1 0. 0. 1389. DISPLAY_IDENTIFIER MFW_EGR_SP_CLC ECU_ADDRESS 0x7fa6c2 BYTE_ORDER MSB_LAST FORMAT "%6.2" /end MEASUREMENT
/begin MEASUREMENT map_sp_max_egr "Maximum manifold pressure to reach the needed EGR ratio with a totally opened EGR valve" UWORD _CNV_A_R_LINEAR_____45_CM 1 0. 0. 5434. DISPLAY_IDENTIFIER MAP_SP_MAX_EGR ECU_ADDRESS 0x7f98ac BYTE_ORDER MSB_LAST FORMAT "%6.2" /end MEASUREMENT
/begin MEASUREMENT fac_mfw_egr "factor for MAP_SP_MAX_EGR calculation" UWORD _CNV_A_R_LINEAR_____45_CM 1 0. 0. 5434. DISPLAY_IDENTIFIER FAC_MFW_EGR ECU_ADDRESS 0x7fa6c4 BYTE_ORDER MSB_LAST FORMAT "%6.2" /end MEASUREMENT
/begin MEASUREMENT fac_mfw_the__temp_ex "factor depending on the temperature to calculate the mass flow through a valve" UWORD _CNV_A_R_LINEAR_____200_CM 1 0. 0. 1.99997e-002 DISPLAY_IDENTIFIER FAC_MFW_THE__TEMP_EX ECU_ADDRESS 0x7f98ae BYTE_ORDER MSB_LAST FORMAT "%8.7" /end MEASUREMENT
/begin MEASUREMENT temp_up_cyl_sp "expected temperature in front of the engine" UWORD _CNV_A_R_LINEAR_____201_CM 1 0. -50. 973.984375 DISPLAY_IDENTIFIER TEMP_UP_CYL_SP ECU_ADDRESS 0x7f98b0 BYTE_ORDER MSB_LAST FORMAT "%5.2" /end MEASUREMENT
/begin MEASUREMENT temp_up_cyl "temperature in front of the engine" UWORD _CNV_A_R_LINEAR_____201_CM 1 0. -50. 973.984375 DISPLAY_IDENTIFIER TEMP_UP_CYL ECU_ADDRESS 0x7f98b2 BYTE_ORDER MSB_LAST FORMAT "%5.2" /end MEASUREMENT
/begin MEASUREMENT mf_lamb_clc "fuel mass for lambda calculation" UWORD _CNV_A_R_LINEAR_____38_CM 1 0. 0. 262.14 DISPLAY_IDENTIFIER MF_LAMB_CLC ECU_ADDRESS 0x7fa6ae BYTE_ORDER MSB_LAST /end MEASUREMENT
/begin MEASUREMENT lamb_ext_clc_fil "external air/fuel-ratio" UWORD _CNV_A_R_LINEAR_____194_CM 1 0. 0. 31.99951171875 DISPLAY_IDENTIFIER LAMB_EXT_CLC_FIL ECU_ADDRESS 0x7f98b4 BYTE_ORDER MSB_LAST FORMAT "%6.4" /end MEASUREMENT
/begin MEASUREMENT lamb_it_clc_fil "internal air/fuel-ratio" UWORD _CNV_A_R_LINEAR_____194_CM 1 0. 0. 31.99951171875 DISPLAY_IDENTIFIER LAMB_IT_CLC_FIL ECU_ADDRESS 0x7f98b6 BYTE_ORDER MSB_LAST FORMAT "%6.4" /end MEASUREMENT
/begin MEASUREMENT lamb_it_sp_clc_fil "internal air/fuel-ratio setpoint" UWORD _CNV_A_R_LINEAR_____194_CM 1 0. 0. 31.99951171875 DISPLAY_IDENTIFIER LAMB_IT_SP_CLC_FIL ECU_ADDRESS 0x7f98b8 BYTE_ORDER MSB_LAST FORMAT "%6.4" /end MEASUREMENT
/begin MEASUREMENT lamb_ext_sp_clc_fil "external air/fuel-ratio" UWORD _CNV_A_R_LINEAR_____194_CM 1 0. 0. 31.99951171875 DISPLAY_IDENTIFIER LAMB_EXT_SP_CLC_FIL ECU_ADDRESS 0x7f98ba BYTE_ORDER MSB_LAST FORMAT "%6.4" /end MEASUREMENT
/begin CHARACTERISTIC c_vol_cyl "cylinder displacement" VALUE 0x85ce26 _REC_VAL_20_u2 1343.4 _CNV_A_R_LINEAR_____202_CM 0. 1343.4 DISPLAY_IDENTIFIER C_VOL_CYL FORMAT "%6.2" /end CHARACTERISTIC
/begin CHARACTERISTIC c_fac_maf_cyl_fil "filter factor for MAF_CYL" VALUE 0x85c9ea _REC_VAL_20_u2 0.9999847412109381 _CNV_A_R_LINEAR_____14_CM 0. 0.9999847412109381 DISPLAY_IDENTIFIER C_FAC_MAF_CYL_FIL FORMAT "%6.5" /end CHARACTERISTIC
/begin CHARACTERISTIC c_fac_egr_fil "filter factor for EGR_MMV" VALUE 0x85c9d2 _REC_VAL_20_u2 0.9999847412109381 _CNV_A_R_LINEAR_____14_CM 0. 0.9999847412109381 DISPLAY_IDENTIFIER C_FAC_EGR_FIL FORMAT "%6.5" /end CHARACTERISTIC
/begin CHARACTERISTIC c_vol_down_thr "volume down throttle" VALUE 0x85ce28 _REC_VAL_20_u2 1343.4 _CNV_A_R_LINEAR_____203_CM 0. 1343.4 DISPLAY_IDENTIFIER C_VOL_DOWN_THR FORMAT "%6.2" /end CHARACTERISTIC
/begin CHARACTERISTIC c_vol_up_thr "volume up throttle" VALUE 0x85ce2c _REC_VAL_20_u2 1343.4 _CNV_A_R_LINEAR_____203_CM 0. 1343.4 DISPLAY_IDENTIFIER C_VOL_UP_THR FORMAT "%6.2" /end CHARACTERISTIC
/begin CHARACTERISTIC c_fac_lamb_ext_clc_fil "filter-factor for external lambda" VALUE 0x85c9e6 _REC_VAL_20_u2 0.9999847412109381 _CNV_A_R_LINEAR_____14_CM 0. 0.9999847412109381 DISPLAY_IDENTIFIER C_FAC_LAMB_EXT_CLC_FIL FORMAT "%6.5" /end CHARACTERISTIC
/begin CHARACTERISTIC c_fac_lamb_it_clc_fil "filter-factor for internal lambda" VALUE 0x85c9e8 _REC_VAL_20_u2 0.9999847412109381 _CNV_A_R_LINEAR_____14_CM 0. 0.9999847412109381 DISPLAY_IDENTIFIER C_FAC_LAMB_IT_CLC_FIL FORMAT "%6.5" /end CHARACTERISTIC
/begin CHARACTERISTIC c_fac_mf_post_lamb_clc "factor for the influence of MAF_POST on MF_LAMB_CLC" VALUE 0x85c9f6 _REC_VAL_20_u1 1.9921875 _CNV_A_R_LINEAR_____101_CM 0. 1.9921875 DISPLAY_IDENTIFIER C_FAC_MF_POST_LAMB_CLC FORMAT "%4.3" /end CHARACTERISTIC
/begin CHARACTERISTIC c_afs_dsl "stoichiometric air fuel ratio for diesel = 14.6 kg air/kg fuel" VALUE 0x85c86e _REC_VAL_20_u2 15.999755 _CNV_A_R_LINEAR_____13_CM 0. 15.999755 DISPLAY_IDENTIFIER C_AFS_DSL FORMAT "%6.4" /end CHARACTERISTIC
/begin CHARACTERISTIC ip_fac_mfw_the__temp_ex "GE_AIRV: factor depending on temperature to calculate the mass flow through a valve" CURVE 0x852840 _REC_CUR_20_u2_u2 1.99997e-002 _CNV_A_R_LINEAR_____200_CM 0. 1.99997e-002 DISPLAY_IDENTIFIER IP_FAC_MFW_THE__TEMP_EX FORMAT "%8.7"
 /begin AXIS_DESCR COM_AXIS tba _CNV_A_R_LINEAR_____157_CM 12 0. 1023.984375 FORMAT "%6.2" AXIS_PTS_REF ldp_temp_ex_ip_fac_mfw_the /end AXIS_DESCR
/end CHARACTERISTIC
/begin AXIS_PTS ldp_temp_ex_ip_fac_mfw_the "" 0x84241a tba _REC_AXS_20_u2 1023.984375 _CNV_A_R_LINEAR_____157_CM 12 0. 1023.984375 FORMAT "%6.2" /end AXIS_PTS
/begin CHARACTERISTIC ip_fac_maf_cyl__n__pq "GE_AIRV: factor for air mass flow through the engine" MAP 0x85255e _REC_MAP_20_u2_u2_u2 1.9999696 _CNV_A_R_LINEAR_____48_CM 0. 1.9999696 DISPLAY_IDENTIFIER IP_FAC_MAF_CYL__N__PQ FORMAT "%6.5"
 /begin AXIS_DESCR COM_AXIS n _CNV_A_R_LINEAR_____5_CM 12 0. 6375. FORMAT "%4.0" AXIS_PTS_REF ldp_n_ip_fac_maf_cyl /end AXIS_DESCR
 /begin AXIS_DESCR COM_AXIS online_dummy _CNV_A_R_LINEAR_____59_CM 12 0. 3.99998471 FORMAT "%6.5" AXIS_PTS_REF ldp_pq_ip_fac_maf_cyl /end AXIS_DESCR
/end CHARACTERISTIC
/begin AXIS_PTS ldp_n_ip_fac_maf_cyl "" 0x841a36 n _REC_AXS_20_u2 6375. _CNV_A_R_LINEAR_____5_CM 12 0. 6375. FORMAT "%4.0" /end AXIS_PTS
/begin AXIS_PTS ldp_pq_ip_fac_maf_cyl "" 0x84205a online_dummy _REC_AXS_20_u2 3.99998471 _CNV_A_R_LINEAR_____59_CM 12 0. 3.99998471 FORMAT "%6.5" /end AXIS_PTS
/begin CHARACTERISTIC ip_map_max__prs_ex__fac_mfw "GE_AIRV: maximum MAP_SP" MAP 0x854816 _REC_MAP_20_u2_u2_u2 5434. _CNV_A_R_LINEAR_____45_CM 0. 5434. DISPLAY_IDENTIFIER IP_MAP_MAX__PRS_EX__FAC_MFW FORMAT "%6.2"
 /begin AXIS_DESCR COM_AXIS prs_ex _CNV_A_R_LINEAR_____45_CM 12 0. 5434. FORMAT "%6.2" AXIS_PTS_REF ldp_prs_ex_ip_map_max /end AXIS_DESCR
 /begin AXIS_DESCR COM_AXIS prs_ex _CNV_A_R_LINEAR_____45_CM 12 0. 5434. FORMAT "%6.2" AXIS_PTS_REF ldp_fac_mfw_ip_map_max /end AXIS_DESCR
/end CHARACTERISTIC
/begin AXIS_PTS ldp_prs_ex_ip_map_max "" 0x8420bc prs_ex _REC_AXS_20_u2 5434. _CNV_A_R_LINEAR_____45_CM 12 0. 5434. FORMAT "%6.2" /end AXIS_PTS
/begin AXIS_PTS ldp_fac_mfw_ip_map_max "" 0x8416c2 prs_ex _REC_AXS_20_u2 5434. _CNV_A_R_LINEAR_____45_CM 12 0. 5434. FORMAT "%6.2" /end AXIS_PTS
/begin CHARACTERISTIC c_ar_egrv_max_the "theoretic max. cross section of the EGR- valve" VALUE 0x85c8a2 _REC_VAL_20_u2 78.08 _CNV_A_R_LINEAR_____7_CM 0. 78.08 DISPLAY_IDENTIFIER C_AR_EGRV_MAX_THE FORMAT "%5.3" /end CHARACTERISTIC
/begin MEASUREMENT map_dif "MAP controller deviation" SWORD _CNV_A_R_LINEAR_____57_CM 1 0. -2717. 2716.91708 DISPLAY_IDENTIFIER MAP_DIF ECU_ADDRESS 0x7f98d2 BYTE_ORDER MSB_LAST FORMAT "%6.2" /end MEASUREMENT
/begin MEASUREMENT bpapwm_eff "effective boost pressure adjustment output" UWORD _CNV_A_R_LINEAR_____204_CM 1 0. 0. 99.972117 DISPLAY_IDENTIFIER BPAPWM_EFF ECU_ADDRESS 0x7f98d4 BYTE_ORDER MSB_LAST FORMAT "%5.3" /end MEASUREMENT
/begin MEASUREMENT bpapwm_ctl "sum of the PI- and DT1-controller" SWORD _CNV_A_R_LINEAR_____12_CM 1 0. -100. 99.996948242 DISPLAY_IDENTIFIER BPAPWM_CTL ECU_ADDRESS 0x7fa6f4 BYTE_ORDER MSB_LAST FORMAT "%5.3" /end MEASUREMENT
/begin MEASUREMENT bpapwm_ctl_dt1 "DT1 for BPAPWM_CTL" SWORD _CNV_A_R_LINEAR_____12_CM 1 0. -100. 99.996948242 DISPLAY_IDENTIFIER BPAPWM_CTL_DT1 ECU_ADDRESS 0x7fa6f6 BYTE_ORDER MSB_LAST FORMAT "%5.3" /end MEASUREMENT
/begin MEASUREMENT bpapwm_ctl_pi_max "max. output for the PI-controller" SWORD _CNV_A_R_LINEAR_____12_CM 1 0. -100. 99.996948242 DISPLAY_IDENTIFIER BPAPWM_CTL_PI_MAX ECU_ADDRESS 0x7fa6f8 BYTE_ORDER MSB_LAST FORMAT "%5.3" /end MEASUREMENT
/begin MEASUREMENT bpapwm_ctl_pi_min "min. output for the PI-controller" SWORD _CNV_A_R_LINEAR_____12_CM 1 0. -100. 99.996948242 DISPLAY_IDENTIFIER BPAPWM_CTL_PI_MIN ECU_ADDRESS 0x7fa6fa BYTE_ORDER MSB_LAST FORMAT "%5.3" /end MEASUREMENT
/begin MEASUREMENT kr_dt1_bpa "gain for dynamic BPAPWM, depending on N and MAP_DIF" UWORD _CNV_A_R_LINEAR_____205_CM 1 0. -2.46996 2.46988 DISPLAY_IDENTIFIER KR_DT1_BPA ECU_ADDRESS 0x7fa6fc BYTE_ORDER MSB_LAST FORMAT "%6.5" /end MEASUREMENT
/begin MEASUREMENT lv_bpapwm_ctl_min "BPA controller at min. limit" UBYTE _CNV_S_2_RANGE______11_CM 1 0. 0. 1. DISPLAY_IDENTIFIER LV_BPAPWM_CTL_MIN ECU_ADDRESS 0x7fb865 /end MEASUREMENT
/begin MEASUREMENT kr_pi_map "gain factor for MAP controller" UWORD _CNV_A_R_LINEAR_____206_CM 1 0. 0. 2.355575 DISPLAY_IDENTIFIER KR_PI_MAP ECU_ADDRESS 0x7fa6fe BYTE_ORDER MSB_LAST FORMAT "%6.5" /end MEASUREMENT
/begin MEASUREMENT tn_pi_map "integral action time for MAP controller" UWORD _CNV_A_R_LINEAR_____64_CM 1 0. 0. 4.19424 DISPLAY_IDENTIFIER TN_PI_MAP ECU_ADDRESS 0x7fa700 BYTE_ORDER MSB_LAST FORMAT "%6.5" /end MEASUREMENT
/begin MEASUREMENT bpapwm_ctl_pi "PI-conroller output for boost pressure adjustment" SWORD _CNV_A_R_LINEAR_____12_CM 1 0. -100. 99.996948242 DISPLAY_IDENTIFIER BPAPWM_CTL_PI ECU_ADDRESS 0x7f98d6 BYTE_ORDER MSB_LAST FORMAT "%5.3" /end MEASUREMENT
/begin CHARACTERISTIC c_bpapwm_dt1_max "C_BPAPWM_DT1_MAX" VALUE 0x85c8b6 _REC_VAL_20_s2 199.996948242 _CNV_A_R_LINEAR_____12_CM -100. 99.996948242 DISPLAY_IDENTIFIER C_BPAPWM_DT1_MAX FORMAT "%5.3" /end CHARACTERISTIC
/begin CHARACTERISTIC c_bpapwm_dt1_min "C_BPAPWM_DT1_MIN" VALUE 0x85c8b8 _REC_VAL_20_s2 199.996948242 _CNV_A_R_LINEAR_____12_CM -100. 99.996948242 DISPLAY_IDENTIFIER C_BPAPWM_DT1_MIN FORMAT "%5.3" /end CHARACTERISTIC
/begin CHARACTERISTIC lc_bpa_dt1_map_dif_on "DT1 Activation for MAP_DIF" VALUE 0x85ce51 _REC_VAL_20_u1 1. _CNV_A_R_LINEAR_____0_CM 0. 1. DISPLAY_IDENTIFIER LC_BPA_DT1_MAP_DIF_ON FORMAT "%1.0" /end CHARACTERISTIC
/begin CHARACTERISTIC c_fac_bpapwm_ctl_off_fil "filter factor for BPAPWM_CTL" VALUE 0x85c9b8 _REC_VAL_20_u2 0.9999847412109381 _CNV_A_R_LINEAR_____14_CM 0. 0.9999847412109381 DISPLAY_IDENTIFIER C_FAC_BPAPWM_CTL_OFF_FIL FORMAT "%6.5" /end CHARACTERISTIC
/begin CHARACTERISTIC ip_tn_dt1_bpa__n "BPA_CTL: time value for DT1 function BPA" CURVE 0x85b46c _REC_CUR_20_u2_u2 4.19424 _CNV_A_R_LINEAR_____64_CM 0. 4.19424 DISPLAY_IDENTIFIER IP_TN_DT1_BPA__N FORMAT "%6.5"
 /begin AXIS_DESCR COM_AXIS n _CNV_A_R_LINEAR_____5_CM 8 0. 6375. FORMAT "%4.0" AXIS_PTS_REF ldpm_n_ip_map_ctl /end AXIS_DESCR
/end CHARACTERISTIC
/begin AXIS_PTS ldpm_n_ip_map_ctl "time value for DT1 function BPA" 0x84321c n _REC_AXS_20_u2 6375. _CNV_A_R_LINEAR_____5_CM 8 0. 6375. FORMAT "%4.0" /end AXIS_PTS
/begin CHARACTERISTIC ip_fac_kr_pi_map__map_dif "BPA_CTL: factor for the gain value" CURVE 0x85254c _REC_CUR_20_u2_u2 1.9999696 _CNV_A_R_LINEAR_____48_CM 0. 1.9999696 DISPLAY_IDENTIFIER IP_FAC_KR_PI_MAP__MAP_DIF FORMAT "%6.5"
 /begin AXIS_DESCR COM_AXIS map_dif _CNV_A_R_LINEAR_____146_CM 6 -2717.041459 2716.958541 FORMAT "%6.2" AXIS_PTS_REF ldpm_map_dif_ip_map /end AXIS_DESCR
/end CHARACTERISTIC
/begin AXIS_PTS ldpm_map_dif_ip_map "factor for the gain value" 0x842c0a map_dif _REC_AXS_20_u2 5434. _CNV_A_R_LINEAR_____146_CM 6 -2717.041459 2716.958541 FORMAT "%6.2" /end AXIS_PTS
/begin CHARACTERISTIC ip_fac_tn_pi_map__map_dif "BPA_CTL: factor for the integral action time" CURVE 0x852ac4 _REC_CUR_20_u2_u2 1.9999696 _CNV_A_R_LINEAR_____48_CM 0. 1.9999696 DISPLAY_IDENTIFIER IP_FAC_TN_PI_MAP__MAP_DIF FORMAT "%6.5"
 /begin AXIS_DESCR COM_AXIS map_dif _CNV_A_R_LINEAR_____146_CM 6 -2717.041459 2716.958541 FORMAT "%6.2" AXIS_PTS_REF ldpm_map_dif_ip_map /end AXIS_DESCR
/end CHARACTERISTIC
/begin CHARACTERISTIC ip_kr_dt1_bpa__n__map_dif "BPA_CTL: gain value for dynamic bpa on map_dif" MAP 0x8532d4 _REC_MAP_20_u2_u2_u2 4.93984 _CNV_A_R_LINEAR_____205_CM -2.46996 2.46988 DISPLAY_IDENTIFIER IP_KR_DT1_BPA__N__MAP_DIF FORMAT "%6.5"
 /begin AXIS_DESCR COM_AXIS n _CNV_A_R_LINEAR_____5_CM 8 0. 6375. FORMAT "%4.0" AXIS_PTS_REF ldpm_n_ip_map_ctl /end AXIS_DESCR
 /begin AXIS_DESCR COM_AXIS map_dif _CNV_A_R_LINEAR_____146_CM 10 -2717.041459 2716.958541 FORMAT "%6.2" AXIS_PTS_REF ldp_map_dif_ip_kr_dt1_bpa /end AXIS_DESCR
/end CHARACTERISTIC
/begin AXIS_PTS ldp_map_dif_ip_kr_dt1_bpa "gain value for dynamic bpa on map_dif" 0x84184a map_dif _REC_AXS_20_u2 5434. _CNV_A_R_LINEAR_____146_CM 10 -2717.041459 2716.958541 FORMAT "%6.2" /end AXIS_PTS
/begin CHARACTERISTIC ip_kr_pi_map "BPA_CTL: gain value for the PI-controller" MAP 0x85357e _REC_MAP_20_u2_u2_u2 2.355575 _CNV_A_R_LINEAR_____206_CM 0. 2.355575 DISPLAY_IDENTIFIER IP_KR_PI_MAP FORMAT "%6.5"
 /begin AXIS_DESCR COM_AXIS n _CNV_A_R_LINEAR_____5_CM 8 0. 6375. FORMAT "%4.0" AXIS_PTS_REF ldpm_n_ip_ctl_pi_map /end AXIS_DESCR
 /begin AXIS_DESCR COM_AXIS tqi_bpa_ctl _CNV_A_R_LINEAR_____52_CM 8 0. 1023.96875 FORMAT "%6.2" AXIS_PTS_REF ldpm_tqi_ip_ctl_pi_map /end AXIS_DESCR
/end CHARACTERISTIC
/begin AXIS_PTS ldpm_n_ip_ctl_pi_map "gain value for the PI-controller" 0x842f76 n _REC_AXS_20_u2 6375. _CNV_A_R_LINEAR_____5_CM 8 0. 6375. FORMAT "%4.0" /end AXIS_PTS
/begin AXIS_PTS ldpm_tqi_ip_ctl_pi_map "gain value for the PI-controller" 0x8438e6 tqi_bpa_ctl _REC_AXS_20_u2 1023.96875 _CNV_A_R_LINEAR_____52_CM 8 0. 1023.96875 FORMAT "%6.2" /end AXIS_PTS
/begin CHARACTERISTIC ip_tn_pi_map "BPA_CTL: integral action time for the PI-controller" MAP 0x85b566 _REC_MAP_20_u2_u2_u2 4.19424 _CNV_A_R_LINEAR_____64_CM 0. 4.19424 DISPLAY_IDENTIFIER IP_TN_PI_MAP FORMAT "%6.5"
 /begin AXIS_DESCR COM_AXIS n _CNV_A_R_LINEAR_____5_CM 8 0. 6375. FORMAT "%4.0" AXIS_PTS_REF ldpm_n_ip_ctl_pi_map /end AXIS_DESCR
 /begin AXIS_DESCR COM_AXIS tqi_bpa_ctl _CNV_A_R_LINEAR_____52_CM 8 0. 1023.96875 FORMAT "%6.2" AXIS_PTS_REF ldpm_tqi_ip_ctl_pi_map /end AXIS_DESCR
/end CHARACTERISTIC
/begin MEASUREMENT soi_frze_prev1_req1 "start of pulse FROM ZERO PREV1 (requested value)" SWORD _CNV_A_R_LINEAR_____119_CM 1 0. -120. 240. DISPLAY_IDENTIFIER SOI_FRZE_PREV1_REQ1 ECU_ADDRESS 0x7fa1dc BYTE_ORDER MSB_LAST FORMAT "%5.2" /end MEASUREMENT
/begin MEASUREMENT t_cha_frze_prev1_req1 "charging time of pulse FROM ZERO PREV1 (requested value)" UWORD _CNV_A_R_LINEAR_____211_CM 1 0. 0. 32.767 DISPLAY_IDENTIFIER T_CHA_FRZE_PREV1_REQ1 ECU_ADDRESS 0x7fa1de BYTE_ORDER MSB_LAST FORMAT "%5.3" /end MEASUREMENT
/begin MEASUREMENT soi_prev1_req1 "start of injection PREV1 (requested value)" SWORD _CNV_A_R_LINEAR_____119_CM 1 0. -120. 240. DISPLAY_IDENTIFIER SOI_PREV1_REQ1 ECU_ADDRESS 0x7fa1e0 BYTE_ORDER MSB_LAST FORMAT "%5.2" /end MEASUREMENT
/begin MEASUREMENT t_cha_prev1_req1 "charging time of injection PREV1 (requested value)" UWORD _CNV_A_R_LINEAR_____211_CM 1 0. 0. 32.767 DISPLAY_IDENTIFIER T_CHA_PREV1_REQ1 ECU_ADDRESS 0x7fa1e2 BYTE_ORDER MSB_LAST FORMAT "%5.3" /end MEASUREMENT
/begin MEASUREMENT eoi_prev1_req1 "end of injection PREV1 (requested value)" SWORD _CNV_A_R_LINEAR_____119_CM 1 0. -120. 240. DISPLAY_IDENTIFIER EOI_PREV1_REQ1 ECU_ADDRESS 0x7fa1e4 BYTE_ORDER MSB_LAST FORMAT "%5.2" /end MEASUREMENT
/begin MEASUREMENT t_dcha_prev1_req1 "discharging time of injection PREV1 (requested value)" UWORD _CNV_A_R_LINEAR_____211_CM 1 0. 0. 32.767 DISPLAY_IDENTIFIER T_DCHA_PREV1_REQ1 ECU_ADDRESS 0x7fa1e6 BYTE_ORDER MSB_LAST FORMAT "%5.3" /end MEASUREMENT
/begin MEASUREMENT t_hld_toze_prev1_req1 "hold time of pulse TO ZERO PREV1 (requested value)" UWORD _CNV_A_R_LINEAR_____211_CM 1 0. 0. 32.767 DISPLAY_IDENTIFIER T_HLD_TOZE_PREV1_REQ1 ECU_ADDRESS 0x7fa1e8 BYTE_ORDER MSB_LAST FORMAT "%5.3" /end MEASUREMENT
/begin MEASUREMENT t_dcha_toze_prev1_req1 "discharging time of pulse TO ZERO PREV1 (requested value)" UWORD _CNV_A_R_LINEAR_____211_CM 1 0. 0. 32.767 DISPLAY_IDENTIFIER T_DCHA_TOZE_PREV1_REQ1 ECU_ADDRESS 0x7fa1ea BYTE_ORDER MSB_LAST FORMAT "%5.3" /end MEASUREMENT
/begin MEASUREMENT lv_frze_prev1_req2 "activation status of pulse FROM ZERO PREV1 (requested value)" UBYTE _CNV_S_2_RANGE______11_CM 1 0. 0. 1. DISPLAY_IDENTIFIER LV_FRZE_PREV1_REQ2 ECU_ADDRESS 0x7fbb9f /end MEASUREMENT
/begin MEASUREMENT lv_prev1_req2 "activation status of injection PREV1 (requested value)" UBYTE _CNV_S_2_RANGE______11_CM 1 0. 0. 1. DISPLAY_IDENTIFIER LV_PREV1_REQ2 ECU_ADDRESS 0x7fbba0 /end MEASUREMENT
/begin MEASUREMENT lv_toze_prev1_req2 "activation status of pulse TO ZERO PREV1 (requested value)" UBYTE _CNV_S_2_RANGE______11_CM 1 0. 0. 1. DISPLAY_IDENTIFIER LV_TOZE_PREV1_REQ2 ECU_ADDRESS 0x7fbba1 /end MEASUREMENT
/begin MEASUREMENT doi_prev1_bas_tu "duration of injection PREV1 (after tuning)" UWORD _CNV_A_R_LINEAR_____119_CM 1 0. 0. 360. DISPLAY_IDENTIFIER DOI_PREV1_BAS_TU ECU_ADDRESS 0x7fb420 BYTE_ORDER MSB_LAST FORMAT "%5.2" /end MEASUREMENT
/begin MEASUREMENT step_nr_cha_frze_prev1 "number of charge steps for pulse FROM ZERO PREV1" UBYTE _CNV_A_R_LINEAR_____0_CM 1 0. 0. 30. DISPLAY_IDENTIFIER STEP_NR_CHA_FRZE_PREV1 ECU_ADDRESS 0x7fbf7c FORMAT "%2.0" /end MEASUREMENT
/begin MEASUREMENT level_cha_frze_prev1 "charge level of pulse FROM ZERO PREV1" UBYTE _CNV_A_R_LINEAR_____212_CM 1 0. 0. 99.609375 DISPLAY_IDENTIFIER LEVEL_CHA_FRZE_PREV1 ECU_ADDRESS 0x7fbf7d FORMAT "%3.1" /end MEASUREMENT
/begin MEASUREMENT t_hld_frze_prev1 "hold time of pulse FROM ZERO PREV1" UWORD _CNV_A_R_LINEAR_____211_CM 1 0. 0. 32.767 DISPLAY_IDENTIFIER T_HLD_FRZE_PREV1 ECU_ADDRESS 0x7fb424 BYTE_ORDER MSB_LAST FORMAT "%5.3" /end MEASUREMENT
/begin MEASUREMENT step_nr_cha_prev1 "number of charge steps for pulse PREV1" UBYTE _CNV_A_R_LINEAR_____0_CM 1 0. 0. 30. DISPLAY_IDENTIFIER STEP_NR_CHA_PREV1 ECU_ADDRESS 0x7fbf7e FORMAT "%2.0" /end MEASUREMENT
/begin MEASUREMENT step_nr_dcha_prev1 "number of discharge steps for pulse PREV1" UBYTE _CNV_A_R_LINEAR_____0_CM 1 0. 0. 30. DISPLAY_IDENTIFIER STEP_NR_DCHA_PREV1 ECU_ADDRESS 0x7fbf7f FORMAT "%2.0" /end MEASUREMENT
/begin MEASUREMENT level_dcha_toze_prev1 "charge level of pulse TO ZERO PREV1" UBYTE _CNV_A_R_LINEAR_____212_CM 1 0. 0. 99.609375 DISPLAY_IDENTIFIER LEVEL_DCHA_TOZE_PREV1 ECU_ADDRESS 0x7fbf80 FORMAT "%3.1" /end MEASUREMENT
/begin MEASUREMENT step_nr_dcha_toze_prev1 "number of discharge steps for pulse TO ZERO PREV1" UBYTE _CNV_A_R_LINEAR_____0_CM 1 0. 0. 30. DISPLAY_IDENTIFIER STEP_NR_DCHA_TOZE_PREV1 ECU_ADDRESS 0x7fbf81 FORMAT "%2.0" /end MEASUREMENT
/begin MEASUREMENT doi_prev1_bas "duration of injection PREV1 (after Temperature / last Injection Correction)" UWORD _CNV_A_R_LINEAR_____119_CM 1 0. 0. 360. DISPLAY_IDENTIFIER DOI_PREV1_BAS ECU_ADDRESS 0x7fb422 BYTE_ORDER MSB_LAST FORMAT "%5.2" /end MEASUREMENT
/begin MEASUREMENT mf_prev1_tu_cor "increased/decreased fuel mass depending on FAC_MF_PREV1_DOI" UWORD _CNV_A_R_LINEAR_____38_CM 1 0. 0. 262.14 DISPLAY_IDENTIFIER MF_PREV1_TU_COR ECU_ADDRESS 0x7fb41e BYTE_ORDER MSB_LAST /end MEASUREMENT
/begin MEASUREMENT doi_prev1_pwr_on "power on value of duration of injection PREV1" UWORD _CNV_A_R_LINEAR_____119_CM 1 0. 0. 360. DISPLAY_IDENTIFIER DOI_PREV1_PWR_ON ECU_ADDRESS 0x7fa1ec BYTE_ORDER MSB_LAST FORMAT "%5.2" /end MEASUREMENT
/begin MEASUREMENT lv_micro_step_prev1_act "microstepping PREV1 is active" UBYTE _CNV_S_2_RANGE______11_CM 1 0. 0. 1. DISPLAY_IDENTIFIER LV_MICRO_STEP_PREV1_ACT ECU_ADDRESS 0x7fbba2 /end MEASUREMENT
/begin MEASUREMENT soi_frze_cor_prev1 "start of injection PREV1 correction" SWORD _CNV_A_R_LINEAR_____119_CM 1 0. -120. 240. DISPLAY_IDENTIFIER SOI_FRZE_COR_PREV1 ECU_ADDRESS 0x7fb438 BYTE_ORDER MSB_LAST FORMAT "%5.2" /end MEASUREMENT
/begin CHARACTERISTIC ip_level_cha_frze_prev1__n "DPX00O01: charge level of pulse FROM ZERO PREV1" CURVE 0x848534 _REC_CUR_20_u1_u2 99.609375 _CNV_A_R_LINEAR_____212_CM 0. 99.609375 DISPLAY_IDENTIFIER IP_LEVEL_CHA_FRZE_PREV1__N FORMAT "%3.1"
 /begin AXIS_DESCR COM_AXIS n _CNV_A_R_LINEAR_____5_CM 8 0. 6375. FORMAT "%4.0" AXIS_PTS_REF ldp_n_ip_level_cha_frze_prev1 /end AXIS_DESCR
/end CHARACTERISTIC
/begin AXIS_PTS ldp_n_ip_level_cha_frze_prev1 "" 0x841abc n _REC_AXS_20_u2 6375. _CNV_A_R_LINEAR_____5_CM 8 0. 6375. FORMAT "%4.0" /end AXIS_PTS
/begin CHARACTERISTIC ip_t_hld_frze_prev1__n "DPX00O01: hold time of pulse FROM ZERO PREV1" CURVE 0x84ee3a _REC_CUR_20_u2_u2 32.767 _CNV_A_R_LINEAR_____211_CM 0. 32.767 DISPLAY_IDENTIFIER IP_T_HLD_FRZE_PREV1__N FORMAT "%5.3"
 /begin AXIS_DESCR COM_AXIS n _CNV_A_R_LINEAR_____5_CM 8 0. 6375. FORMAT "%4.0" AXIS_PTS_REF ldp_n_ip_t_hld_frze_prev1 /end AXIS_DESCR
/end CHARACTERISTIC
/begin AXIS_PTS ldp_n_ip_t_hld_frze_prev1 "" 0x841e52 n _REC_AXS_20_u2 6375. _CNV_A_R_LINEAR_____5_CM 8 0. 6375. FORMAT "%4.0" /end AXIS_PTS
/begin CHARACTERISTIC c_fac_doi_prev1_tu_[0] "cylinder individual PREV1-injection tuning factor" VALUE 0x84fd0e _REC_VAL_20_u2 1.9999696 _CNV_A_R_LINEAR_____48_CM 0. 1.9999696 DISPLAY_IDENTIFIER C_FAC_DOI_PREV1_TU__0_ FORMAT "%5.4" /end CHARACTERISTIC
/begin CHARACTERISTIC c_fac_doi_prev1_tu_[1] "cylinder individual PREV1-injection tuning factor" VALUE 0x84fd10 _REC_VAL_20_u2 1.9999696 _CNV_A_R_LINEAR_____48_CM 0. 1.9999696 DISPLAY_IDENTIFIER C_FAC_DOI_PREV1_TU__1_ FORMAT "%5.4" /end CHARACTERISTIC
/begin CHARACTERISTIC c_fac_doi_prev1_tu_[2] "cylinder individual PREV1-injection tuning factor" VALUE 0x84fd12 _REC_VAL_20_u2 1.9999696 _CNV_A_R_LINEAR_____48_CM 0. 1.9999696 DISPLAY_IDENTIFIER C_FAC_DOI_PREV1_TU__2_ FORMAT "%5.4" /end CHARACTERISTIC
/begin CHARACTERISTIC c_fac_doi_prev1_tu_[3] "cylinder individual PREV1-injection tuning factor" VALUE 0x84fd14 _REC_VAL_20_u2 1.9999696 _CNV_A_R_LINEAR_____48_CM 0. 1.9999696 DISPLAY_IDENTIFIER C_FAC_DOI_PREV1_TU__3_ FORMAT "%5.4" /end CHARACTERISTIC
/begin CHARACTERISTIC c_doi_prev1_man_[0] "manual value for duration of injection PREV1" VALUE 0x84fc94 _REC_VAL_20_u2 360. _CNV_A_R_LINEAR_____119_CM 0. 360. DISPLAY_IDENTIFIER C_DOI_PREV1_MAN__0_ FORMAT "%5.2" /end CHARACTERISTIC
/begin CHARACTERISTIC c_doi_prev1_man_[1] "manual value for duration of injection PREV1" VALUE 0x84fc96 _REC_VAL_20_u2 360. _CNV_A_R_LINEAR_____119_CM 0. 360. DISPLAY_IDENTIFIER C_DOI_PREV1_MAN__1_ FORMAT "%5.2" /end CHARACTERISTIC
/begin CHARACTERISTIC c_doi_prev1_man_[2] "manual value for duration of injection PREV1" VALUE 0x84fc98 _REC_VAL_20_u2 360. _CNV_A_R_LINEAR_____119_CM 0. 360. DISPLAY_IDENTIFIER C_DOI_PREV1_MAN__2_ FORMAT "%5.2" /end CHARACTERISTIC
/begin CHARACTERISTIC c_doi_prev1_man_[3] "manual value for duration of injection PREV1" VALUE 0x84fc9a _REC_VAL_20_u2 360. _CNV_A_R_LINEAR_____119_CM 0. 360. DISPLAY_IDENTIFIER C_DOI_PREV1_MAN__3_ FORMAT "%5.2" /end CHARACTERISTIC
/begin CHARACTERISTIC lc_doi_prev1_man "button for setting a manual value for duration of injection PREV1" VALUE 0x850119 _REC_VAL_20_u1 1. _CNV_A_R_LINEAR_____0_CM 0. 1. DISPLAY_IDENTIFIER LC_DOI_PREV1_MAN FORMAT "%1.0" /end CHARACTERISTIC
/begin CHARACTERISTIC ip_doi_prev1_0 "DPX00O01: array of injection duration maps (MAP 0) of injection PREV1" MAP 0x84600a _REC_MAP_20_u2_u2_u2 360. _CNV_A_R_LINEAR_____119_CM 0. 360. DISPLAY_IDENTIFIER IP_DOI_PREV1_0 FORMAT "%5.4"
 /begin AXIS_DESCR COM_AXIS n _CNV_A_R_LINEAR_____5_CM 10 0. 6375. FORMAT "%4.0" AXIS_PTS_REF ldpm_n_ip_doi_prev1 /end AXIS_DESCR
 /begin AXIS_DESCR COM_AXIS mf_prev1_tu_cor _CNV_A_R_LINEAR_____38_CM 5 0. 262.14 AXIS_PTS_REF ldpm_mf_ip_doi_prev1 /end AXIS_DESCR
/end CHARACTERISTIC
/begin CHARACTERISTIC ip_doi_prev1_1 "DPX00O01: array of injection duration maps (MAP 1) of injection PREV1" MAP 0x84606e _REC_MAP_20_u2_u2_u2 360. _CNV_A_R_LINEAR_____119_CM 0. 360. DISPLAY_IDENTIFIER IP_DOI_PREV1_1 FORMAT "%5.4"
 /begin AXIS_DESCR COM_AXIS n _CNV_A_R_LINEAR_____5_CM 10 0. 6375. FORMAT "%4.0" AXIS_PTS_REF ldpm_n_ip_doi_prev1 /end AXIS_DESCR
 /begin AXIS_DESCR COM_AXIS mf_prev1_tu_cor _CNV_A_R_LINEAR_____38_CM 5 0. 262.14 AXIS_PTS_REF ldpm_mf_ip_doi_prev1 /end AXIS_DESCR
/end CHARACTERISTIC
/begin CHARACTERISTIC ip_doi_prev1_2 "DPX00O01: array of injection duration maps (MAP 2) of injection PREV1" MAP 0x8460d2 _REC_MAP_20_u2_u2_u2 360. _CNV_A_R_LINEAR_____119_CM 0. 360. DISPLAY_IDENTIFIER IP_DOI_PREV1_2 FORMAT "%5.4"
 /begin AXIS_DESCR COM_AXIS n _CNV_A_R_LINEAR_____5_CM 10 0. 6375. FORMAT "%4.0" AXIS_PTS_REF ldpm_n_ip_doi_prev1 /end AXIS_DESCR
 /begin AXIS_DESCR COM_AXIS mf_prev1_tu_cor _CNV_A_R_LINEAR_____38_CM 5 0. 262.14 AXIS_PTS_REF ldpm_mf_ip_doi_prev1 /end AXIS_DESCR
/end CHARACTERISTIC
/begin CHARACTERISTIC ip_doi_prev1_3 "DPX00O01: array of injection duration maps (MAP 3) of injection PREV1" MAP 0x846136 _REC_MAP_20_u2_u2_u2 360. _CNV_A_R_LINEAR_____119_CM 0. 360. DISPLAY_IDENTIFIER IP_DOI_PREV1_3 FORMAT "%5.4"
 /begin AXIS_DESCR COM_AXIS n _CNV_A_R_LINEAR_____5_CM 10 0. 6375. FORMAT "%4.0" AXIS_PTS_REF ldpm_n_ip_doi_prev1 /end AXIS_DESCR
 /begin AXIS_DESCR COM_AXIS mf_prev1_tu_cor _CNV_A_R_LINEAR_____38_CM 5 0. 262.14 AXIS_PTS_REF ldpm_mf_ip_doi_prev1 /end AXIS_DESCR
/end CHARACTERISTIC
/begin CHARACTERISTIC ip_doi_prev1_4 "DPX00O01: array of injection duration maps (MAP 4) of injection PREV1" MAP 0x84619a _REC_MAP_20_u2_u2_u2 360. _CNV_A_R_LINEAR_____119_CM 0. 360. DISPLAY_IDENTIFIER IP_DOI_PREV1_4 FORMAT "%5.4"
 /begin AXIS_DESCR COM_AXIS n _CNV_A_R_LINEAR_____5_CM 10 0. 6375. FORMAT "%4.0" AXIS_PTS_REF ldpm_n_ip_doi_prev1 /end AXIS_DESCR
 /begin AXIS_DESCR COM_AXIS mf_prev1_tu_cor _CNV_A_R_LINEAR_____38_CM 5 0. 262.14 AXIS_PTS_REF ldpm_mf_ip_doi_prev1 /end AXIS_DESCR
/end CHARACTERISTIC
/begin CHARACTERISTIC ip_doi_prev1_5 "DPX00O01: array of injection duration maps (MAP 5) of injection PREV1" MAP 0x8461fe _REC_MAP_20_u2_u2_u2 360. _CNV_A_R_LINEAR_____119_CM 0. 360. DISPLAY_IDENTIFIER IP_DOI_PREV1_5 FORMAT "%5.4"
 /begin AXIS_DESCR COM_AXIS n _CNV_A_R_LINEAR_____5_CM 10 0. 6375. FORMAT "%4.0" AXIS_PTS_REF ldpm_n_ip_doi_prev1 /end AXIS_DESCR
 /begin AXIS_DESCR COM_AXIS mf_prev1_tu_cor _CNV_A_R_LINEAR_____38_CM 5 0. 262.14 AXIS_PTS_REF ldpm_mf_ip_doi_prev1 /end AXIS_DESCR
/end CHARACTERISTIC
/begin AXIS_PTS ldpm_n_ip_doi_prev1 "" 0x842fc8 n _REC_AXS_20_u2 6375. _CNV_A_R_LINEAR_____5_CM 10 0. 6375. FORMAT "%4.0" /end AXIS_PTS
/begin AXIS_PTS ldpm_mf_ip_doi_prev1 "" 0x842c46 mf_prev1_tu_cor _REC_AXS_20_u2 262.14 _CNV_A_R_LINEAR_____38_CM 5 0. 262.14 /end AXIS_PTS
/begin CHARACTERISTIC ip_sel_ip_doi_prev1__soi "DPX00O01: selector for injection duration maps of injection PREV1" CURVE 0x84d618 _REC_CUR_20_u4_u2 65535. _CNV_A_R_LINEAR_____213_CM 0. 65535. DISPLAY_IDENTIFIER IP_SEL_IP_DOI_PREV1__SOI FORMAT "%10.5"
 /begin AXIS_DESCR COM_AXIS soi_prev1_tu _CNV_A_R_LINEAR_____118_CM 6 -120. 240. FORMAT "%5.2" AXIS_PTS_REF ldp_soi_ip_doi_prev1 /end AXIS_DESCR
/end CHARACTERISTIC
/begin AXIS_PTS ldp_soi_ip_doi_prev1 "" 0x84214c soi_prev1_tu _REC_AXS_20_u2 360. _CNV_A_R_LINEAR_____118_CM 6 -120. 240. FORMAT "%5.2" /end AXIS_PTS
/begin CHARACTERISTIC ip_level_dcha_toze_prev1__n "DPX00O01: discharge level of pulse TO ZERO PREV1" CURVE 0x84854c _REC_CUR_20_u1_u2 99.609375 _CNV_A_R_LINEAR_____212_CM 0. 99.609375 DISPLAY_IDENTIFIER IP_LEVEL_DCHA_TOZE_PREV1__N FORMAT "%3.1"
 /begin AXIS_DESCR COM_AXIS n _CNV_A_R_LINEAR_____5_CM 8 0. 6375. FORMAT "%4.0" AXIS_PTS_REF ldp_n_ip_level_dcha_toze_prev1 /end AXIS_DESCR
/end CHARACTERISTIC
/begin AXIS_PTS ldp_n_ip_level_dcha_toze_prev1 "" 0x841af2 n _REC_AXS_20_u2 6375. _CNV_A_R_LINEAR_____5_CM 8 0. 6375. FORMAT "%4.0" /end AXIS_PTS
/begin CHARACTERISTIC ip_t_hld_toze_prev1__n "DPX00O01: hold time of pulse TO ZERO PREV1" CURVE 0x84ee6a _REC_CUR_20_u2_u2 32.767 _CNV_A_R_LINEAR_____211_CM 0. 32.767 DISPLAY_IDENTIFIER IP_T_HLD_TOZE_PREV1__N FORMAT "%5.3"
 /begin AXIS_DESCR COM_AXIS n _CNV_A_R_LINEAR_____5_CM 8 0. 6375. FORMAT "%4.0" AXIS_PTS_REF ldp_n_ip_t_hld_toze_prev1 /end AXIS_DESCR
/end CHARACTERISTIC
/begin AXIS_PTS ldp_n_ip_t_hld_toze_prev1 "" 0x841e88 n _REC_AXS_20_u2 6375. _CNV_A_R_LINEAR_____5_CM 8 0. 6375. FORMAT "%4.0" /end AXIS_PTS
/begin MEASUREMENT soi_frze_main1_req1 "start of pulse FROM ZERO MAIN1 (requested value)" SWORD _CNV_A_R_LINEAR_____119_CM 1 0. -120. 240. DISPLAY_IDENTIFIER SOI_FRZE_MAIN1_REQ1 ECU_ADDRESS 0x7fa20a BYTE_ORDER MSB_LAST FORMAT "%5.2" /end MEASUREMENT
/begin MEASUREMENT t_cha_frze_main1_req1 "charging time of pulse FROM ZERO MAIN1 (requested value)" UWORD _CNV_A_R_LINEAR_____211_CM 1 0. 0. 32.767 DISPLAY_IDENTIFIER T_CHA_FRZE_MAIN1_REQ1 ECU_ADDRESS 0x7fa20c BYTE_ORDER MSB_LAST FORMAT "%5.3" /end MEASUREMENT
/begin MEASUREMENT soi_main1_req1 "start of injection MAIN1 (requested value)" SWORD _CNV_A_R_LINEAR_____119_CM 1 0. -120. 240. DISPLAY_IDENTIFIER SOI_MAIN1_REQ1 ECU_ADDRESS 0x7fa20e BYTE_ORDER MSB_LAST FORMAT "%5.2" /end MEASUREMENT
/begin MEASUREMENT t_cha_main1_req1 "charging time of injection MAIN1 (requested value)" UWORD _CNV_A_R_LINEAR_____211_CM 1 0. 0. 32.767 DISPLAY_IDENTIFIER T_CHA_MAIN1_REQ1 ECU_ADDRESS 0x7fa210 BYTE_ORDER MSB_LAST FORMAT "%5.3" /end MEASUREMENT
/begin MEASUREMENT eoi_main1_pwr_on "power-on value of end of injection MAIN1" SWORD _CNV_A_R_LINEAR_____119_CM 1 0. -120. 240. DISPLAY_IDENTIFIER EOI_MAIN1_PWR_ON ECU_ADDRESS 0x7fa212 BYTE_ORDER MSB_LAST FORMAT "%5.2" /end MEASUREMENT
/begin MEASUREMENT t_dcha_main1 "discharging time of injection MAIN1" UWORD _CNV_A_R_LINEAR_____211_CM 1 0. 0. 32.767 DISPLAY_IDENTIFIER T_DCHA_MAIN1 ECU_ADDRESS 0x7fa218 BYTE_ORDER MSB_LAST FORMAT "%5.3" /end MEASUREMENT
/begin MEASUREMENT t_hld_toze_main1 "hold time of pulse TO ZERO MAIN1" UWORD _CNV_A_R_LINEAR_____211_CM 1 0. 0. 32.767 DISPLAY_IDENTIFIER T_HLD_TOZE_MAIN1 ECU_ADDRESS 0x7fa214 BYTE_ORDER MSB_LAST FORMAT "%5.3" /end MEASUREMENT
/begin MEASUREMENT t_dcha_toze_main1 "discharging time of pulse TO ZERO MAIN1" UWORD _CNV_A_R_LINEAR_____211_CM 1 0. 0. 32.767 DISPLAY_IDENTIFIER T_DCHA_TOZE_MAIN1 ECU_ADDRESS 0x7fa216 BYTE_ORDER MSB_LAST FORMAT "%5.3" /end MEASUREMENT
/begin MEASUREMENT lv_frze_main1_req2 "activation status of pulse FROM ZERO MAIN1 (requested value)" UBYTE _CNV_S_2_RANGE______11_CM 1 0. 0. 1. DISPLAY_IDENTIFIER LV_FRZE_MAIN1_REQ2 ECU_ADDRESS 0x7fbbab /end MEASUREMENT
/begin MEASUREMENT lv_main1_req2 "activation status of injection MAIN1 (requested value)" UBYTE _CNV_S_2_RANGE______11_CM 1 0. 0. 1. DISPLAY_IDENTIFIER LV_MAIN1_REQ2 ECU_ADDRESS 0x7fbbac /end MEASUREMENT
/begin MEASUREMENT lv_toze_main1_req2 "activation status of pulse TO ZERO MAIN1 (requested value)" UBYTE _CNV_S_2_RANGE______11_CM 1 0. 0. 1. DISPLAY_IDENTIFIER LV_TOZE_MAIN1_REQ2 ECU_ADDRESS 0x7fbbad /end MEASUREMENT
/begin MEASUREMENT lv_frze_prev1_req3 "activation status of pulse FROM ZERO PREV1 (requested value)" UBYTE _CNV_S_2_RANGE______11_CM 1 0. 0. 1. DISPLAY_IDENTIFIER LV_FRZE_PREV1_REQ3 ECU_ADDRESS 0x7fbbae /end MEASUREMENT
/begin MEASUREMENT lv_prev1_req3 "activation status of injection PREV1 (requested value)" UBYTE _CNV_S_2_RANGE______11_CM 1 0. 0. 1. DISPLAY_IDENTIFIER LV_PREV1_REQ3 ECU_ADDRESS 0x7fbbaf /end MEASUREMENT
/begin MEASUREMENT lv_toze_prev1_req3 "activation status of pulse TO ZERO PREV1 (requested value)" UBYTE _CNV_S_2_RANGE______11_CM 1 0. 0. 1. DISPLAY_IDENTIFIER LV_TOZE_PREV1_REQ3 ECU_ADDRESS 0x7fbbb0 /end MEASUREMENT
/begin MEASUREMENT doi_main1_bas_tu "duration of injection MAIN1 (after tuning)" UWORD _CNV_A_R_LINEAR_____119_CM 1 0. 0. 360. DISPLAY_IDENTIFIER DOI_MAIN1_BAS_TU ECU_ADDRESS 0x7fb43a BYTE_ORDER MSB_LAST FORMAT "%5.2" /end MEASUREMENT
/begin MEASUREMENT step_nr_cha_frze_main1 "number of charge steps for pulse FROM ZERO MAIN1" UBYTE _CNV_A_R_LINEAR_____0_CM 1 0. 0. 30. DISPLAY_IDENTIFIER STEP_NR_CHA_FRZE_MAIN1 ECU_ADDRESS 0x7fbf89 FORMAT "%2.0" /end MEASUREMENT
/begin MEASUREMENT level_cha_frze_main1 "charge level of pulse FROM ZERO MAIN1" UBYTE _CNV_A_R_LINEAR_____212_CM 1 0. 0. 99.609375 DISPLAY_IDENTIFIER LEVEL_CHA_FRZE_MAIN1 ECU_ADDRESS 0x7fbf8a FORMAT "%3.1" /end MEASUREMENT
/begin MEASUREMENT t_hld_frze_main1 "hold time of pulse FROM ZERO MAIN1" UWORD _CNV_A_R_LINEAR_____211_CM 1 0. 0. 32.767 DISPLAY_IDENTIFIER T_HLD_FRZE_MAIN1 ECU_ADDRESS 0x7fb43c BYTE_ORDER MSB_LAST FORMAT "%5.3" /end MEASUREMENT
/begin MEASUREMENT step_nr_cha_main1 "number of charge steps for pulse MAIN1" UBYTE _CNV_A_R_LINEAR_____0_CM 1 0. 0. 30. DISPLAY_IDENTIFIER STEP_NR_CHA_MAIN1 ECU_ADDRESS 0x7fbf8b FORMAT "%2.0" /end MEASUREMENT
/begin MEASUREMENT step_nr_dcha_main1 "number of discharge steps for pulse MAIN1" UBYTE _CNV_A_R_LINEAR_____0_CM 1 0. 0. 30. DISPLAY_IDENTIFIER STEP_NR_DCHA_MAIN1 ECU_ADDRESS 0x7fbf8c FORMAT "%2.0" /end MEASUREMENT
/begin MEASUREMENT level_dcha_toze_main1 "discharge level of pulse TO ZERO MAIN1" UBYTE _CNV_A_R_LINEAR_____212_CM 1 0. 0. 99.609375 DISPLAY_IDENTIFIER LEVEL_DCHA_TOZE_MAIN1 ECU_ADDRESS 0x7fbf8d FORMAT "%3.1" /end MEASUREMENT
/begin MEASUREMENT step_nr_dcha_toze_main1 "number of discharge steps for pulse TO ZERO MAIN1" UBYTE _CNV_A_R_LINEAR_____0_CM 1 0. 0. 30. DISPLAY_IDENTIFIER STEP_NR_DCHA_TOZE_MAIN1 ECU_ADDRESS 0x7fbf8e FORMAT "%2.0" /end MEASUREMENT
/begin MEASUREMENT doi_main1_bas "duration of injection MAIN1 (after Temperature / last Injection Correction)" UWORD _CNV_A_R_LINEAR_____119_CM 1 0. 0. 360. DISPLAY_IDENTIFIER DOI_MAIN1_BAS ECU_ADDRESS 0x7fb43e BYTE_ORDER MSB_LAST FORMAT "%5.2" /end MEASUREMENT
/begin MEASUREMENT mf_main1_tu_cor "increased/decreased fuel mass depending on FAC_MF_MAIN1_DOI" UWORD _CNV_A_R_LINEAR_____38_CM 1 0. 0. 262.14 DISPLAY_IDENTIFIER MF_MAIN1_TU_COR ECU_ADDRESS 0x7fb440 BYTE_ORDER MSB_LAST /end MEASUREMENT
/begin MEASUREMENT doi_main1_req1 "duration of injection MAIN1" UWORD _CNV_A_R_LINEAR_____119_CM 1 0. 0. 360. DISPLAY_IDENTIFIER DOI_MAIN1_REQ1 ECU_ADDRESS 0x7fa21a BYTE_ORDER MSB_LAST FORMAT "%5.2" /end MEASUREMENT
/begin MEASUREMENT lv_micro_step_main1_act "microstepping MAIN1 is active" UBYTE _CNV_S_2_RANGE______11_CM 1 0. 0. 1. DISPLAY_IDENTIFIER LV_MICRO_STEP_MAIN1_ACT ECU_ADDRESS 0x7fbbb1 /end MEASUREMENT
/begin MEASUREMENT soi_frze_cor_main1 "start of injection MAIN1 correction" SWORD _CNV_A_R_LINEAR_____119_CM 1 0. -120. 240. DISPLAY_IDENTIFIER SOI_FRZE_COR_MAIN1 ECU_ADDRESS 0x7fb454 BYTE_ORDER MSB_LAST FORMAT "%5.2" /end MEASUREMENT
/begin CHARACTERISTIC ip_level_cha_frze_main1__n "DPX00Q01: charge level of pulse FROM ZERO MAIN1" CURVE 0x848524 _REC_CUR_20_u1_u2 99.609375 _CNV_A_R_LINEAR_____212_CM 0. 99.609375 DISPLAY_IDENTIFIER IP_LEVEL_CHA_FRZE_MAIN1__N FORMAT "%3.1"
 /begin AXIS_DESCR COM_AXIS n _CNV_A_R_LINEAR_____5_CM 8 0. 6375. FORMAT "%4.0" AXIS_PTS_REF ldp_n_ip_level_cha_frze_main1 /end AXIS_DESCR
/end CHARACTERISTIC
/begin AXIS_PTS ldp_n_ip_level_cha_frze_main1 "" 0x841a98 n _REC_AXS_20_u2 6375. _CNV_A_R_LINEAR_____5_CM 8 0. 6375. FORMAT "%4.0" /end AXIS_PTS
/begin CHARACTERISTIC ip_t_hld_frze_main1__n "DPX00Q01: hold time of pulse FROM ZERO MAIN1" CURVE 0x84ee1a _REC_CUR_20_u2_u2 32.767 _CNV_A_R_LINEAR_____211_CM 0. 32.767 DISPLAY_IDENTIFIER IP_T_HLD_FRZE_MAIN1__N FORMAT "%5.3"
 /begin AXIS_DESCR COM_AXIS n _CNV_A_R_LINEAR_____5_CM 8 0. 6375. FORMAT "%4.0" AXIS_PTS_REF ldp_n_ip_t_hld_frze_main1 /end AXIS_DESCR
/end CHARACTERISTIC
/begin AXIS_PTS ldp_n_ip_t_hld_frze_main1 "" 0x841e2e n _REC_AXS_20_u2 6375. _CNV_A_R_LINEAR_____5_CM 8 0. 6375. FORMAT "%4.0" /end AXIS_PTS
/begin CHARACTERISTIC c_fac_doi_main1_tu_[0] "" VALUE 0x84fcfe _REC_VAL_20_u2 1.9999696 _CNV_A_R_LINEAR_____48_CM 0. 1.9999696 DISPLAY_IDENTIFIER C_FAC_DOI_MAIN1_TU__0_ FORMAT "%6.5" /end CHARACTERISTIC
/begin CHARACTERISTIC c_fac_doi_main1_tu_[1] "" VALUE 0x84fd00 _REC_VAL_20_u2 1.9999696 _CNV_A_R_LINEAR_____48_CM 0. 1.9999696 DISPLAY_IDENTIFIER C_FAC_DOI_MAIN1_TU__1_ FORMAT "%6.5" /end CHARACTERISTIC
/begin CHARACTERISTIC c_fac_doi_main1_tu_[2] "" VALUE 0x84fd02 _REC_VAL_20_u2 1.9999696 _CNV_A_R_LINEAR_____48_CM 0. 1.9999696 DISPLAY_IDENTIFIER C_FAC_DOI_MAIN1_TU__2_ FORMAT "%6.5" /end CHARACTERISTIC
/begin CHARACTERISTIC c_fac_doi_main1_tu_[3] "" VALUE 0x84fd04 _REC_VAL_20_u2 1.9999696 _CNV_A_R_LINEAR_____48_CM 0. 1.9999696 DISPLAY_IDENTIFIER C_FAC_DOI_MAIN1_TU__3_ FORMAT "%6.5" /end CHARACTERISTIC
/begin CHARACTERISTIC c_doi_main1_man_[0] "manual value for duration of injection MAIN1" VALUE 0x84fc80 _REC_VAL_20_u2 360. _CNV_A_R_LINEAR_____119_CM 0. 360. DISPLAY_IDENTIFIER C_DOI_MAIN1_MAN__0_ FORMAT "%5.2" /end CHARACTERISTIC
/begin CHARACTERISTIC c_doi_main1_man_[1] "manual value for duration of injection MAIN1" VALUE 0x84fc82 _REC_VAL_20_u2 360. _CNV_A_R_LINEAR_____119_CM 0. 360. DISPLAY_IDENTIFIER C_DOI_MAIN1_MAN__1_ FORMAT "%5.2" /end CHARACTERISTIC
/begin CHARACTERISTIC c_doi_main1_man_[2] "manual value for duration of injection MAIN1" VALUE 0x84fc84 _REC_VAL_20_u2 360. _CNV_A_R_LINEAR_____119_CM 0. 360. DISPLAY_IDENTIFIER C_DOI_MAIN1_MAN__2_ FORMAT "%5.2" /end CHARACTERISTIC
/begin CHARACTERISTIC c_doi_main1_man_[3] "manual value for duration of injection MAIN1" VALUE 0x84fc86 _REC_VAL_20_u2 360. _CNV_A_R_LINEAR_____119_CM 0. 360. DISPLAY_IDENTIFIER C_DOI_MAIN1_MAN__3_ FORMAT "%5.2" /end CHARACTERISTIC
/begin CHARACTERISTIC lc_doi_main1_man "button for setting a manual value for duration of injection MAIN1" VALUE 0x850115 _REC_VAL_20_u1 1. _CNV_A_R_LINEAR_____0_CM 0. 1. DISPLAY_IDENTIFIER LC_DOI_MAIN1_MAN FORMAT "%1.0" /end CHARACTERISTIC
/begin CHARACTERISTIC ip_doi_main1_0 "DPX00Q01: array of injection duration maps (MAP 0) of injection MAIN1" MAP 0x845374 _REC_MAP_20_u2_u2_u2 360. _CNV_A_R_LINEAR_____119_CM 0. 360. DISPLAY_IDENTIFIER IP_DOI_MAIN1_0 FORMAT "%5.2"
 /begin AXIS_DESCR COM_AXIS n _CNV_A_R_LINEAR_____5_CM 16 0. 6375. FORMAT "%4.0" AXIS_PTS_REF ldpm_n_ip_doi_main1 /end AXIS_DESCR
 /begin AXIS_DESCR COM_AXIS mf_main1_tu_cor _CNV_A_R_LINEAR_____38_CM 16 0. 262.14 AXIS_PTS_REF ldpm_mf_ip_doi_main1 /end AXIS_DESCR
/end CHARACTERISTIC
/begin CHARACTERISTIC ip_doi_main1_1 "DPX00Q01: array of injection duration maps (MAP 1) of injection MAIN1" MAP 0x845574 _REC_MAP_20_u2_u2_u2 360. _CNV_A_R_LINEAR_____119_CM 0. 360. DISPLAY_IDENTIFIER IP_DOI_MAIN1_1 FORMAT "%5.2"
 /begin AXIS_DESCR COM_AXIS n _CNV_A_R_LINEAR_____5_CM 16 0. 6375. FORMAT "%4.0" AXIS_PTS_REF ldpm_n_ip_doi_main1 /end AXIS_DESCR
 /begin AXIS_DESCR COM_AXIS mf_main1_tu_cor _CNV_A_R_LINEAR_____38_CM 16 0. 262.14 AXIS_PTS_REF ldpm_mf_ip_doi_main1 /end AXIS_DESCR
/end CHARACTERISTIC
/begin CHARACTERISTIC ip_doi_main1_2 "DPX00Q01: array of injection duration maps (MAP 2) of injection MAIN1" MAP 0x845774 _REC_MAP_20_u2_u2_u2 360. _CNV_A_R_LINEAR_____119_CM 0. 360. DISPLAY_IDENTIFIER IP_DOI_MAIN1_2 FORMAT "%5.2"
 /begin AXIS_DESCR COM_AXIS n _CNV_A_R_LINEAR_____5_CM 16 0. 6375. FORMAT "%4.0" AXIS_PTS_REF ldpm_n_ip_doi_main1 /end AXIS_DESCR
 /begin AXIS_DESCR COM_AXIS mf_main1_tu_cor _CNV_A_R_LINEAR_____38_CM 16 0. 262.14 AXIS_PTS_REF ldpm_mf_ip_doi_main1 /end AXIS_DESCR
/end CHARACTERISTIC
/begin CHARACTERISTIC ip_doi_main1_3 "DPX00Q01: array of injection duration maps (MAP 3) of injection MAIN1" MAP 0x845974 _REC_MAP_20_u2_u2_u2 360. _CNV_A_R_LINEAR_____119_CM 0. 360. DISPLAY_IDENTIFIER IP_DOI_MAIN1_3 FORMAT "%5.2"
 /begin AXIS_DESCR COM_AXIS n _CNV_A_R_LINEAR_____5_CM 16 0. 6375. FORMAT "%4.0" AXIS_PTS_REF ldpm_n_ip_doi_main1 /end AXIS_DESCR
 /begin AXIS_DESCR COM_AXIS mf_main1_tu_cor _CNV_A_R_LINEAR_____38_CM 16 0. 262.14 AXIS_PTS_REF ldpm_mf_ip_doi_main1 /end AXIS_DESCR
/end CHARACTERISTIC
/begin CHARACTERISTIC ip_doi_main1_4 "DPX00Q01: array of injection duration maps (MAP 4) of injection MAIN1" MAP 0x845b74 _REC_MAP_20_u2_u2_u2 360. _CNV_A_R_LINEAR_____119_CM 0. 360. DISPLAY_IDENTIFIER IP_DOI_MAIN1_4 FORMAT "%5.2"
 /begin AXIS_DESCR COM_AXIS n _CNV_A_R_LINEAR_____5_CM 16 0. 6375. FORMAT "%4.0" AXIS_PTS_REF ldpm_n_ip_doi_main1 /end AXIS_DESCR
 /begin AXIS_DESCR COM_AXIS mf_main1_tu_cor _CNV_A_R_LINEAR_____38_CM 16 0. 262.14 AXIS_PTS_REF ldpm_mf_ip_doi_main1 /end AXIS_DESCR
/end CHARACTERISTIC
/begin CHARACTERISTIC ip_doi_main1_5 "DPX00Q01: array of injection duration maps (MAP 5) of injection MAIN1" MAP 0x845d74 _REC_MAP_20_u2_u2_u2 360. _CNV_A_R_LINEAR_____119_CM 0. 360. DISPLAY_IDENTIFIER IP_DOI_MAIN1_5 FORMAT "%5.2"
 /begin AXIS_DESCR COM_AXIS n _CNV_A_R_LINEAR_____5_CM 16 0. 6375. FORMAT "%4.0" AXIS_PTS_REF ldpm_n_ip_doi_main1 /end AXIS_DESCR
 /begin AXIS_DESCR COM_AXIS mf_main1_tu_cor _CNV_A_R_LINEAR_____38_CM 16 0. 262.14 AXIS_PTS_REF ldpm_mf_ip_doi_main1 /end AXIS_DESCR
/end CHARACTERISTIC
/begin AXIS_PTS ldpm_n_ip_doi_main1 "" 0x842f9a n _REC_AXS_20_u2 6375. _CNV_A_R_LINEAR_____5_CM 16 0. 6375. FORMAT "%4.0" /end AXIS_PTS
/begin AXIS_PTS ldpm_mf_ip_doi_main1 "" 0x842c18 mf_main1_tu_cor _REC_AXS_20_u2 262.14 _CNV_A_R_LINEAR_____38_CM 16 0. 262.14 /end AXIS_PTS
/begin CHARACTERISTIC ip_sel_ip_doi_main1__soi "DPX00Q01: selector for injection duration maps of injection MAIN1" CURVE 0x84d5f4 _REC_CUR_20_u4_u2 65535. _CNV_A_R_LINEAR_____213_CM 0. 65535. DISPLAY_IDENTIFIER IP_SEL_IP_DOI_MAIN1__SOI FORMAT "%10.5"
 /begin AXIS_DESCR COM_AXIS soi_main1_tu _CNV_A_R_LINEAR_____118_CM 6 -120. 240. FORMAT "%5.2" AXIS_PTS_REF ldp_soi_ip_doi_main1 /end AXIS_DESCR
/end CHARACTERISTIC
/begin AXIS_PTS ldp_soi_ip_doi_main1 "" 0x842136 soi_main1_tu _REC_AXS_20_u2 360. _CNV_A_R_LINEAR_____118_CM 6 -120. 240. FORMAT "%5.2" /end AXIS_PTS
/begin CHARACTERISTIC ip_level_dcha_toze_main1__n "DPX00Q01: discharge level of pulse TO ZERO MAIN1" CURVE 0x84853c _REC_CUR_20_u1_u2 99.609375 _CNV_A_R_LINEAR_____212_CM 0. 99.609375 DISPLAY_IDENTIFIER IP_LEVEL_DCHA_TOZE_MAIN1__N FORMAT "%3.1"
 /begin AXIS_DESCR COM_AXIS n _CNV_A_R_LINEAR_____5_CM 8 0. 6375. FORMAT "%4.0" AXIS_PTS_REF ldp_n_ip_level_dcha_toze_main1 /end AXIS_DESCR
/end CHARACTERISTIC
/begin AXIS_PTS ldp_n_ip_level_dcha_toze_main1 "" 0x841ace n _REC_AXS_20_u2 6375. _CNV_A_R_LINEAR_____5_CM 8 0. 6375. FORMAT "%4.0" /end AXIS_PTS
/begin CHARACTERISTIC ip_t_hld_toze_main1__n "DPX00Q01: hold time of pulse TO ZERO MAIN1" CURVE 0x84ee4a _REC_CUR_20_u2_u2 32.767 _CNV_A_R_LINEAR_____211_CM 0. 32.767 DISPLAY_IDENTIFIER IP_T_HLD_TOZE_MAIN1__N FORMAT "%5.3"
 /begin AXIS_DESCR COM_AXIS n _CNV_A_R_LINEAR_____5_CM 8 0. 6375. FORMAT "%4.0" AXIS_PTS_REF ldp_n_ip_t_hld_toze_main1 /end AXIS_DESCR
/end CHARACTERISTIC
/begin AXIS_PTS ldp_n_ip_t_hld_toze_main1 "" 0x841e64 n _REC_AXS_20_u2 6375. _CNV_A_R_LINEAR_____5_CM 8 0. 6375. FORMAT "%4.0" /end AXIS_PTS
/begin MEASUREMENT soi_frze_post1_pwr_on "power-on value for start of pulse FROM ZERO POST1" SWORD _CNV_A_R_LINEAR_____119_CM 1 0. -120. 240. DISPLAY_IDENTIFIER SOI_FRZE_POST1_PWR_ON ECU_ADDRESS 0x7fa21c BYTE_ORDER MSB_LAST FORMAT "%5.2" /end MEASUREMENT
/begin MEASUREMENT t_cha_frze_post1 "charging time of pulse FROM ZERO POST1" UWORD _CNV_A_R_LINEAR_____211_CM 1 0. 0. 32.767 DISPLAY_IDENTIFIER T_CHA_FRZE_POST1 ECU_ADDRESS 0x7fa21e BYTE_ORDER MSB_LAST FORMAT "%5.3" /end MEASUREMENT
/begin MEASUREMENT soi_post1_pwr_on "power-on value for start of injection POST1" SWORD _CNV_A_R_LINEAR_____119_CM 1 0. -120. 240. DISPLAY_IDENTIFIER SOI_POST1_PWR_ON ECU_ADDRESS 0x7fa220 BYTE_ORDER MSB_LAST FORMAT "%5.2" /end MEASUREMENT
/begin MEASUREMENT t_cha_post1 "charging time of injection POST1" UWORD _CNV_A_R_LINEAR_____211_CM 1 0. 0. 32.767 DISPLAY_IDENTIFIER T_CHA_POST1 ECU_ADDRESS 0x7fa222 BYTE_ORDER MSB_LAST FORMAT "%5.3" /end MEASUREMENT
/begin MEASUREMENT eoi_post1_pwr_on "power-on value for end of injection POST1" SWORD _CNV_A_R_LINEAR_____119_CM 1 0. -120. 240. DISPLAY_IDENTIFIER EOI_POST1_PWR_ON ECU_ADDRESS 0x7fa224 BYTE_ORDER MSB_LAST FORMAT "%5.2" /end MEASUREMENT
/begin MEASUREMENT t_dcha_post1 "discharging time of injection POST1" UWORD _CNV_A_R_LINEAR_____211_CM 1 0. 0. 32.767 DISPLAY_IDENTIFIER T_DCHA_POST1 ECU_ADDRESS 0x7fa226 BYTE_ORDER MSB_LAST FORMAT "%5.3" /end MEASUREMENT
/begin MEASUREMENT t_hld_toze_post1 "hold time of pulse TO ZERO POST1" UWORD _CNV_A_R_LINEAR_____211_CM 1 0. 0. 32.767 DISPLAY_IDENTIFIER T_HLD_TOZE_POST1 ECU_ADDRESS 0x7fa228 BYTE_ORDER MSB_LAST FORMAT "%5.3" /end MEASUREMENT
/begin MEASUREMENT t_dcha_toze_post1 "discharging time of pulse TO ZERO POST1" UWORD _CNV_A_R_LINEAR_____211_CM 1 0. 0. 32.767 DISPLAY_IDENTIFIER T_DCHA_TOZE_POST1 ECU_ADDRESS 0x7fa22a BYTE_ORDER MSB_LAST FORMAT "%5.3" /end MEASUREMENT
/begin MEASUREMENT lv_frze_post1_act "activation status of pulse FROM ZERO POST1" UBYTE _CNV_S_2_RANGE______11_CM 1 0. 0. 1. DISPLAY_IDENTIFIER LV_FRZE_POST1_ACT ECU_ADDRESS 0x7fbbb2 /end MEASUREMENT
/begin MEASUREMENT lv_post1_act "activation status of injection POST1" UBYTE _CNV_S_2_RANGE______11_CM 1 0. 0. 1. DISPLAY_IDENTIFIER LV_POST1_ACT ECU_ADDRESS 0x7fbbb3 /end MEASUREMENT
/begin MEASUREMENT lv_toze_post1_act "activation status of pulse TO ZERO POST1" UBYTE _CNV_S_2_RANGE______11_CM 1 0. 0. 1. DISPLAY_IDENTIFIER LV_TOZE_POST1_ACT ECU_ADDRESS 0x7fbbb4 /end MEASUREMENT
/begin MEASUREMENT doi_post1_bas_tu "duration of injection POST1 (after tuning)" UWORD _CNV_A_R_LINEAR_____119_CM 1 0. 0. 360. DISPLAY_IDENTIFIER DOI_POST1_BAS_TU ECU_ADDRESS 0x7fb458 BYTE_ORDER MSB_LAST FORMAT "%5.2" /end MEASUREMENT
/begin MEASUREMENT step_nr_cha_frze_post1 "number of charge steps for pulse FROM ZERO POST1" UBYTE _CNV_A_R_LINEAR_____0_CM 1 0. 0. 30. DISPLAY_IDENTIFIER STEP_NR_CHA_FRZE_POST1 ECU_ADDRESS 0x7fbf93 FORMAT "%2.0" /end MEASUREMENT
/begin MEASUREMENT level_cha_frze_post1 "charge level of pulse FROM ZERO POST1" UBYTE _CNV_A_R_LINEAR_____212_CM 1 0. 0. 99.609375 DISPLAY_IDENTIFIER LEVEL_CHA_FRZE_POST1 ECU_ADDRESS 0x7fbf94 FORMAT "%3.1" /end MEASUREMENT
/begin MEASUREMENT t_hld_frze_post1 "hold time of pulse FROM ZERO POST1" UWORD _CNV_A_R_LINEAR_____211_CM 1 0. 0. 32.767 DISPLAY_IDENTIFIER T_HLD_FRZE_POST1 ECU_ADDRESS 0x7fb45c BYTE_ORDER MSB_LAST FORMAT "%5.3" /end MEASUREMENT
/begin MEASUREMENT step_nr_cha_post1 "number of charge steps for pulse POST1" UBYTE _CNV_A_R_LINEAR_____0_CM 1 0. 0. 30. DISPLAY_IDENTIFIER STEP_NR_CHA_POST1 ECU_ADDRESS 0x7fbf95 FORMAT "%2.0" /end MEASUREMENT
/begin MEASUREMENT step_nr_dcha_post1 "number of discharge steps for pulse POST1" UBYTE _CNV_A_R_LINEAR_____0_CM 1 0. 0. 30. DISPLAY_IDENTIFIER STEP_NR_DCHA_POST1 ECU_ADDRESS 0x7fbf96 FORMAT "%2.0" /end MEASUREMENT
/begin MEASUREMENT level_dcha_toze_post1 "discharge level of pulse TO ZERO POST1" UBYTE _CNV_A_R_LINEAR_____212_CM 1 0. 0. 99.609375 DISPLAY_IDENTIFIER LEVEL_DCHA_TOZE_POST1 ECU_ADDRESS 0x7fbf97 FORMAT "%3.1" /end MEASUREMENT
/begin MEASUREMENT step_nr_dcha_toze_post1 "number of discharge steps for pulse TO ZERO POST1" UBYTE _CNV_A_R_LINEAR_____0_CM 1 0. 0. 30. DISPLAY_IDENTIFIER STEP_NR_DCHA_TOZE_POST1 ECU_ADDRESS 0x7fbf98 FORMAT "%2.0" /end MEASUREMENT
/begin MEASUREMENT doi_post1_bas "duration of injection POST1 (after Temperature / last Injection Correction)" UWORD _CNV_A_R_LINEAR_____119_CM 1 0. 0. 360. DISPLAY_IDENTIFIER DOI_POST1_BAS ECU_ADDRESS 0x7fb45a BYTE_ORDER MSB_LAST FORMAT "%5.2" /end MEASUREMENT
/begin MEASUREMENT mf_post1_tu_cor "increased/decreased fuel mass depending on FAC_MF_POST1_DOI" UWORD _CNV_A_R_LINEAR_____38_CM 1 0. 0. 262.14 DISPLAY_IDENTIFIER MF_POST1_TU_COR ECU_ADDRESS 0x7fb456 BYTE_ORDER MSB_LAST /end MEASUREMENT
/begin MEASUREMENT doi_post1_pwr_on "power on value of duration of injection POST1" UWORD _CNV_A_R_LINEAR_____119_CM 1 0. 0. 360. DISPLAY_IDENTIFIER DOI_POST1_PWR_ON ECU_ADDRESS 0x7fa22c BYTE_ORDER MSB_LAST FORMAT "%5.2" /end MEASUREMENT
/begin MEASUREMENT lv_micro_step_post1_act "microstepping POST1 is activ" UBYTE _CNV_S_2_RANGE______11_CM 1 0. 0. 1. DISPLAY_IDENTIFIER LV_MICRO_STEP_POST1_ACT ECU_ADDRESS 0x7fbbb5 /end MEASUREMENT
/begin MEASUREMENT soi_frze_cor_post1 "start of injection POST1 correction" SWORD _CNV_A_R_LINEAR_____119_CM 1 0. -120. 240. DISPLAY_IDENTIFIER SOI_FRZE_COR_POST1 ECU_ADDRESS 0x7fb470 BYTE_ORDER MSB_LAST FORMAT "%5.2" /end MEASUREMENT
/begin CHARACTERISTIC ip_level_cha_frze_post1__n "DPX00S01: charge level of pulse FROM ZERO POST1" CURVE 0x84852c _REC_CUR_20_u1_u2 99.609375 _CNV_A_R_LINEAR_____212_CM 0. 99.609375 DISPLAY_IDENTIFIER IP_LEVEL_CHA_FRZE_POST1__N FORMAT "%3.1"
 /begin AXIS_DESCR COM_AXIS n _CNV_A_R_LINEAR_____5_CM 8 0. 6375. FORMAT "%4.0" AXIS_PTS_REF ldp_n_ip_level_cha_frze_post1 /end AXIS_DESCR
/end CHARACTERISTIC
/begin AXIS_PTS ldp_n_ip_level_cha_frze_post1 "" 0x841aaa n _REC_AXS_20_u2 6375. _CNV_A_R_LINEAR_____5_CM 8 0. 6375. FORMAT "%4.0" /end AXIS_PTS
/begin CHARACTERISTIC ip_t_hld_frze_post1__n "DPX00S01: hold time of pulse FROM ZERO POST1" CURVE 0x84ee2a _REC_CUR_20_u2_u2 32.767 _CNV_A_R_LINEAR_____211_CM 0. 32.767 DISPLAY_IDENTIFIER IP_T_HLD_FRZE_POST1__N FORMAT "%5.3"
 /begin AXIS_DESCR COM_AXIS n _CNV_A_R_LINEAR_____5_CM 8 0. 6375. FORMAT "%4.0" AXIS_PTS_REF ldp_n_ip_t_hld_frze_post1 /end AXIS_DESCR
/end CHARACTERISTIC
/begin AXIS_PTS ldp_n_ip_t_hld_frze_post1 "" 0x841e40 n _REC_AXS_20_u2 6375. _CNV_A_R_LINEAR_____5_CM 8 0. 6375. FORMAT "%4.0" /end AXIS_PTS
/begin CHARACTERISTIC c_fac_doi_post1_tu_[0] "cylinder individual POST1-injection tuning factor" VALUE 0x84fd06 _REC_VAL_20_u2 1.9999696 _CNV_A_R_LINEAR_____48_CM 0. 1.9999696 DISPLAY_IDENTIFIER C_FAC_DOI_POST1_TU__0_ FORMAT "%5.4" /end CHARACTERISTIC
/begin CHARACTERISTIC c_fac_doi_post1_tu_[1] "cylinder individual POST1-injection tuning factor" VALUE 0x84fd08 _REC_VAL_20_u2 1.9999696 _CNV_A_R_LINEAR_____48_CM 0. 1.9999696 DISPLAY_IDENTIFIER C_FAC_DOI_POST1_TU__1_ FORMAT "%5.4" /end CHARACTERISTIC
/begin CHARACTERISTIC c_fac_doi_post1_tu_[2] "cylinder individual POST1-injection tuning factor" VALUE 0x84fd0a _REC_VAL_20_u2 1.9999696 _CNV_A_R_LINEAR_____48_CM 0. 1.9999696 DISPLAY_IDENTIFIER C_FAC_DOI_POST1_TU__2_ FORMAT "%5.4" /end CHARACTERISTIC
/begin CHARACTERISTIC c_fac_doi_post1_tu_[3] "cylinder individual POST1-injection tuning factor" VALUE 0x84fd0c _REC_VAL_20_u2 1.9999696 _CNV_A_R_LINEAR_____48_CM 0. 1.9999696 DISPLAY_IDENTIFIER C_FAC_DOI_POST1_TU__3_ FORMAT "%5.4" /end CHARACTERISTIC
/begin CHARACTERISTIC c_doi_post1_man_[0] "manual value for duration of injection POST1" VALUE 0x84fc8a _REC_VAL_20_u2 360. _CNV_A_R_LINEAR_____119_CM 0. 360. DISPLAY_IDENTIFIER C_DOI_POST1_MAN__0_ FORMAT "%5.2" /end CHARACTERISTIC
/begin CHARACTERISTIC c_doi_post1_man_[1] "manual value for duration of injection POST1" VALUE 0x84fc8c _REC_VAL_20_u2 360. _CNV_A_R_LINEAR_____119_CM 0. 360. DISPLAY_IDENTIFIER C_DOI_POST1_MAN__1_ FORMAT "%5.2" /end CHARACTERISTIC
/begin CHARACTERISTIC c_doi_post1_man_[2] "manual value for duration of injection POST1" VALUE 0x84fc8e _REC_VAL_20_u2 360. _CNV_A_R_LINEAR_____119_CM 0. 360. DISPLAY_IDENTIFIER C_DOI_POST1_MAN__2_ FORMAT "%5.2" /end CHARACTERISTIC
/begin CHARACTERISTIC c_doi_post1_man_[3] "manual value for duration of injection POST1" VALUE 0x84fc90 _REC_VAL_20_u2 360. _CNV_A_R_LINEAR_____119_CM 0. 360. DISPLAY_IDENTIFIER C_DOI_POST1_MAN__3_ FORMAT "%5.2" /end CHARACTERISTIC
/begin CHARACTERISTIC lc_doi_post1_man "button for setting a manual value for duration of injection POST1" VALUE 0x850118 _REC_VAL_20_u1 1. _CNV_A_R_LINEAR_____0_CM 0. 1. DISPLAY_IDENTIFIER LC_DOI_POST1_MAN FORMAT "%1.0" /end CHARACTERISTIC
/begin CHARACTERISTIC ip_doi_post1_0 "DPX00S01: array of injection duration maps (MAP 0) of injection POST1" MAP 0x845f74 _REC_MAP_20_u2_u2_u2 360. _CNV_A_R_LINEAR_____119_CM 0. 360. DISPLAY_IDENTIFIER IP_DOI_POST1_0 FORMAT "%5.2"
 /begin AXIS_DESCR COM_AXIS n _CNV_A_R_LINEAR_____5_CM 5 0. 6375. FORMAT "%4.0" AXIS_PTS_REF ldpm_n_ip_doi_post1 /end AXIS_DESCR
 /begin AXIS_DESCR COM_AXIS mf_post1_tu_cor _CNV_A_R_LINEAR_____38_CM 5 0. 262.14 AXIS_PTS_REF ldpm_mf_ip_doi_post1 /end AXIS_DESCR
/end CHARACTERISTIC
/begin CHARACTERISTIC ip_doi_post1_1 "DPX00S01: array of injection duration maps (MAP 1) of injection POST1" MAP 0x845fa6 _REC_MAP_20_u2_u2_u2 360. _CNV_A_R_LINEAR_____119_CM 0. 360. DISPLAY_IDENTIFIER IP_DOI_POST1_1 FORMAT "%5.2"
 /begin AXIS_DESCR COM_AXIS n _CNV_A_R_LINEAR_____5_CM 5 0. 6375. FORMAT "%4.0" AXIS_PTS_REF ldpm_n_ip_doi_post1 /end AXIS_DESCR
 /begin AXIS_DESCR COM_AXIS mf_post1_tu_cor _CNV_A_R_LINEAR_____38_CM 5 0. 262.14 AXIS_PTS_REF ldpm_mf_ip_doi_post1 /end AXIS_DESCR
/end CHARACTERISTIC
/begin CHARACTERISTIC ip_doi_post1_2 "DPX00S01: array of injection duration maps (MAP 2) of injection POST1" MAP 0x845fd8 _REC_MAP_20_u2_u2_u2 360. _CNV_A_R_LINEAR_____119_CM 0. 360. DISPLAY_IDENTIFIER IP_DOI_POST1_2 FORMAT "%5.2"
 /begin AXIS_DESCR COM_AXIS n _CNV_A_R_LINEAR_____5_CM 5 0. 6375. FORMAT "%4.0" AXIS_PTS_REF ldpm_n_ip_doi_post1 /end AXIS_DESCR
 /begin AXIS_DESCR COM_AXIS mf_post1_tu_cor _CNV_A_R_LINEAR_____38_CM 5 0. 262.14 AXIS_PTS_REF ldpm_mf_ip_doi_post1 /end AXIS_DESCR
/end CHARACTERISTIC
/begin AXIS_PTS ldpm_n_ip_doi_post1 "" 0x842fbc n _REC_AXS_20_u2 6375. _CNV_A_R_LINEAR_____5_CM 5 0. 6375. FORMAT "%4.0" /end AXIS_PTS
/begin AXIS_PTS ldpm_mf_ip_doi_post1 "" 0x842c3a mf_post1_tu_cor _REC_AXS_20_u2 262.14 _CNV_A_R_LINEAR_____38_CM 5 0. 262.14 /end AXIS_PTS
/begin CHARACTERISTIC ip_sel_ip_doi_post1__soi "DPX00S01: selector for injection duration maps of injection POST1" CURVE 0x84d60c _REC_CUR_20_u4_u2 65535. _CNV_A_R_LINEAR_____213_CM 0. 65535. DISPLAY_IDENTIFIER IP_SEL_IP_DOI_POST1__SOI FORMAT "%10.5"
 /begin AXIS_DESCR COM_AXIS soi_post1_tu _CNV_A_R_LINEAR_____118_CM 3 -120. 240. FORMAT "%5.2" AXIS_PTS_REF ldp_soi_ip_doi_post1 /end AXIS_DESCR
/end CHARACTERISTIC
/begin AXIS_PTS ldp_soi_ip_doi_post1 "" 0x842144 soi_post1_tu _REC_AXS_20_u2 360. _CNV_A_R_LINEAR_____118_CM 3 -120. 240. FORMAT "%5.2" /end AXIS_PTS
/begin CHARACTERISTIC ip_level_dcha_toze_post1__n "DPX00S01: discharge level of pulse TO ZERO POST1" CURVE 0x848544 _REC_CUR_20_u1_u2 99.609375 _CNV_A_R_LINEAR_____212_CM 0. 99.609375 DISPLAY_IDENTIFIER IP_LEVEL_DCHA_TOZE_POST1__N FORMAT "%3.1"
 /begin AXIS_DESCR COM_AXIS n _CNV_A_R_LINEAR_____5_CM 8 0. 6375. FORMAT "%4.0" AXIS_PTS_REF ldp_n_ip_level_dcha_toze_post1 /end AXIS_DESCR
/end CHARACTERISTIC
/begin AXIS_PTS ldp_n_ip_level_dcha_toze_post1 "" 0x841ae0 n _REC_AXS_20_u2 6375. _CNV_A_R_LINEAR_____5_CM 8 0. 6375. FORMAT "%4.0" /end AXIS_PTS
/begin CHARACTERISTIC ip_t_hld_toze_post1__n "DPX00S01: hold time of pulse TO ZERO POST1" CURVE 0x84ee5a _REC_CUR_20_u2_u2 32.767 _CNV_A_R_LINEAR_____211_CM 0. 32.767 DISPLAY_IDENTIFIER IP_T_HLD_TOZE_POST1__N FORMAT "%5.3"
 /begin AXIS_DESCR COM_AXIS n _CNV_A_R_LINEAR_____5_CM 8 0. 6375. FORMAT "%4.0" AXIS_PTS_REF ldp_n_ip_t_hld_toze_post1 /end AXIS_DESCR
/end CHARACTERISTIC
/begin AXIS_PTS ldp_n_ip_t_hld_toze_post1 "" 0x841e76 n _REC_AXS_20_u2 6375. _CNV_A_R_LINEAR_____5_CM 8 0. 6375. FORMAT "%4.0" /end AXIS_PTS
/begin CHARACTERISTIC c_fac_t_dif_min_main1_post1 "factor to increase the time gap minimally needed between EOI_MAIN1 and SOI_FRZE_POST1" VALUE 0x84fd48 _REC_VAL_20_u2 3.99998471 _CNV_A_R_LINEAR_____59_CM 0. 3.99998471 DISPLAY_IDENTIFIER C_FAC_T_DIF_MIN_MAIN1_POST1 FORMAT "%6.5" /end CHARACTERISTIC
/begin MEASUREMENT dummy_soi "SOI" SWORD _CNV_A_R_LINEAR_____119_CM 1 0. -120. 240. DISPLAY_IDENTIFIER DUMMY_SOI ECU_ADDRESS 0x7fb472 BYTE_ORDER MSB_LAST FORMAT "%5.2" /end MEASUREMENT
/begin MEASUREMENT dummy_mf "MF" UWORD _CNV_A_R_LINEAR_____38_CM 1 0. 0. 262.14 DISPLAY_IDENTIFIER DUMMY_MF ECU_ADDRESS 0x7fb474 BYTE_ORDER MSB_LAST FORMAT "%4.1" /end MEASUREMENT
/begin MEASUREMENT dummy_level "LEVEL" UBYTE _CNV_A_R_LINEAR_____214_CM 1 0. 0. 63.75 DISPLAY_IDENTIFIER DUMMY_LEVEL ECU_ADDRESS 0x7fbf9d FORMAT "%3.1" /end MEASUREMENT
/begin MEASUREMENT dummy_doi "DURATION" UWORD _CNV_A_R_LINEAR_____119_CM 1 0. 0. 360. DISPLAY_IDENTIFIER DUMMY_DOI ECU_ADDRESS 0x7fb476 BYTE_ORDER MSB_LAST FORMAT "%5.2" /end MEASUREMENT
/begin MEASUREMENT t_dcha2newcyl_min "minimal time from discharge to charge (with switching to another cylinder)" UWORD _CNV_A_R_LINEAR_____211_CM 1 0. 0. 32.767 DISPLAY_IDENTIFIER T_DCHA2NEWCYL_MIN ECU_ADDRESS 0x7fa176 BYTE_ORDER MSB_LAST FORMAT "%5.3" /end MEASUREMENT
/begin MEASUREMENT t_cha_min "minimal time for charging" UWORD _CNV_A_R_LINEAR_____211_CM 1 0. 0. 32.767 DISPLAY_IDENTIFIER T_CHA_MIN ECU_ADDRESS 0x7fa178 BYTE_ORDER MSB_LAST FORMAT "%5.3" /end MEASUREMENT
/begin MEASUREMENT t_cha_max "maximal time for charging" UWORD _CNV_A_R_LINEAR_____211_CM 1 0. 0. 32.767 DISPLAY_IDENTIFIER T_CHA_MAX ECU_ADDRESS 0x7fa17a BYTE_ORDER MSB_LAST FORMAT "%5.3" /end MEASUREMENT
/begin MEASUREMENT t_dcha_min "minimal time for discharging" UWORD _CNV_A_R_LINEAR_____211_CM 1 0. 0. 32.767 DISPLAY_IDENTIFIER T_DCHA_MIN ECU_ADDRESS 0x7fa17c BYTE_ORDER MSB_LAST FORMAT "%5.3" /end MEASUREMENT
/begin MEASUREMENT t_dcha_max "maximal time for discharging" UWORD _CNV_A_R_LINEAR_____211_CM 1 0. 0. 32.767 DISPLAY_IDENTIFIER T_DCHA_MAX ECU_ADDRESS 0x7fa17e BYTE_ORDER MSB_LAST FORMAT "%5.3" /end MEASUREMENT
/begin MEASUREMENT stk_max_piezo "maximal piezo stroke" UBYTE _CNV_A_R_LINEAR_____215_CM 1 0. 0. 51. DISPLAY_IDENTIFIER STK_MAX_PIEZO ECU_ADDRESS 0x7fbb85 FORMAT "%3.1" /end MEASUREMENT
/begin MEASUREMENT t_step_pps "duration of one charge/discharge step of the CC powerstage" UWORD _CNV_A_R_LINEAR_____211_CM 1 0. 0. 32.767 DISPLAY_IDENTIFIER T_STEP_PPS ECU_ADDRESS 0x7fa180 BYTE_ORDER MSB_LAST FORMAT "%5.3" /end MEASUREMENT
/begin MEASUREMENT t_soi_dly "runtime delay for start of injection (time)" UWORD _CNV_A_R_LINEAR_____211_CM 1 0. 0. 32.767 DISPLAY_IDENTIFIER T_SOI_DLY ECU_ADDRESS 0x7fa182 BYTE_ORDER MSB_LAST FORMAT "%5.3" /end MEASUREMENT
/begin MEASUREMENT lv_doi_mod "chosen duration calculation method (0: \"classic\", 1: \"new\")" UBYTE _CNV_S_2_RANGE______11_CM 1 0. 0. 1. DISPLAY_IDENTIFIER LV_DOI_MOD ECU_ADDRESS 0x7fbb8b /end MEASUREMENT
/begin MEASUREMENT step_sp_pps "set point for total number of charge steps (including steps for building up force of tightness only)" UBYTE _CNV_A_R_LINEAR_____0_CM 1 0. 1. 30. DISPLAY_IDENTIFIER STEP_SP_PPS ECU_ADDRESS 0x7fbb86 FORMAT "%2.0" /end MEASUREMENT
/begin MEASUREMENT step_sp_iv_foc "set point for number of charge steps for building up force of tightness only" UBYTE _CNV_A_R_LINEAR_____0_CM 1 0. 0. 30. DISPLAY_IDENTIFIER STEP_SP_IV_FOC ECU_ADDRESS 0x7fbb87 FORMAT "%2.0" /end MEASUREMENT
/begin MEASUREMENT ti_req_ti_min "injection time of the minimal injection time mode" UWORD _CNV_A_R_LINEAR_____211_CM 1 0. 0. 32.767 DISPLAY_IDENTIFIER TI_REQ_TI_MIN ECU_ADDRESS 0x7fa184 BYTE_ORDER MSB_LAST FORMAT "%5.3" /end MEASUREMENT
/begin MEASUREMENT t_hld_min_bas "base value for minimal hold time of any pulse" UWORD _CNV_A_R_LINEAR_____211_CM 1 0. 0. 32.767 DISPLAY_IDENTIFIER T_HLD_MIN_BAS ECU_ADDRESS 0x7fa186 BYTE_ORDER MSB_LAST FORMAT "%5.3" /end MEASUREMENT
/begin MEASUREMENT step_cha_min "minimal step number for charging" UBYTE _CNV_A_R_LINEAR_____0_CM 1 0. 0. 30. DISPLAY_IDENTIFIER STEP_CHA_MIN ECU_ADDRESS 0x7fbb88 FORMAT "%2.0" /end MEASUREMENT
/begin MEASUREMENT step_dcha_min "minimal step number for discharging" UBYTE _CNV_A_R_LINEAR_____0_CM 1 0. 0. 30. DISPLAY_IDENTIFIER STEP_DCHA_MIN ECU_ADDRESS 0x7fbb89 FORMAT "%2.0" /end MEASUREMENT
/begin MEASUREMENT ang_cam_st "start angle of active camshaft" SWORD _CNV_A_R_LINEAR_____119_CM 1 0. -120. 240. DISPLAY_IDENTIFIER ANG_CAM_ST ECU_ADDRESS 0x7fa188 BYTE_ORDER MSB_LAST FORMAT "%5.2" /end MEASUREMENT
/begin MEASUREMENT ang_cam_end "end angle of active camshaft" SWORD _CNV_A_R_LINEAR_____119_CM 1 0. -120. 240. DISPLAY_IDENTIFIER ANG_CAM_END ECU_ADDRESS 0x7fa18a BYTE_ORDER MSB_LAST FORMAT "%5.2" /end MEASUREMENT
/begin MEASUREMENT ti_min "minimal time for durations of injections" UWORD _CNV_A_R_LINEAR_____211_CM 1 0. 0. 32.767 DISPLAY_IDENTIFIER TI_MIN ECU_ADDRESS 0x7fa18c BYTE_ORDER MSB_LAST FORMAT "%5.3" /end MEASUREMENT
/begin MEASUREMENT lv_ip_on "button for choice of Level and T_HLD calculation method (0: \" by control\", 1: \"by map\")" UBYTE _CNV_S_2_RANGE______11_CM 1 0. 0. 1. DISPLAY_IDENTIFIER LV_IP_ON ECU_ADDRESS 0x7fbb8c /end MEASUREMENT
/begin MEASUREMENT t_grp2sel_min "minimal time from end of group signal to selection signal" UWORD _CNV_A_R_LINEAR_____211_CM 1 0. 0. 32.767 DISPLAY_IDENTIFIER T_GRP2SEL_MIN ECU_ADDRESS 0x7fa18e BYTE_ORDER MSB_LAST FORMAT "%5.3" /end MEASUREMENT
/begin MEASUREMENT t_cha_frze_min "minimal time for charging from zero" UWORD _CNV_A_R_LINEAR_____211_CM 1 0. 0. 32.767 DISPLAY_IDENTIFIER T_CHA_FRZE_MIN ECU_ADDRESS 0x7fa190 BYTE_ORDER MSB_LAST FORMAT "%5.3" /end MEASUREMENT
/begin MEASUREMENT t_cha_micro_step_min "minimal time for charging" UWORD _CNV_A_R_LINEAR_____211_CM 1 0. 0. 32.767 DISPLAY_IDENTIFIER T_CHA_MICRO_STEP_MIN ECU_ADDRESS 0x7fa192 BYTE_ORDER MSB_LAST FORMAT "%5.3" /end MEASUREMENT
/begin MEASUREMENT t_hld_pls_min "minimal time from end of charge to EOI" UWORD _CNV_A_R_LINEAR_____211_CM 1 0. 0. 32.767 DISPLAY_IDENTIFIER T_HLD_PLS_MIN ECU_ADDRESS 0x7fa194 BYTE_ORDER MSB_LAST FORMAT "%5.3" /end MEASUREMENT
/begin MEASUREMENT t_dist_pls2pls_min "minimal time from end of discharge PREV1 to charge MAIN1" UWORD _CNV_A_R_LINEAR_____211_CM 1 0. 0. 32.767 DISPLAY_IDENTIFIER T_DIST_PLS2PLS_MIN ECU_ADDRESS 0x7fa196 BYTE_ORDER MSB_LAST FORMAT "%5.3" /end MEASUREMENT
/begin MEASUREMENT t_eoi_trig_ofs "time from EOI Trigger to EOI" UWORD _CNV_A_R_LINEAR_____211_CM 1 0. 0. 32.767 DISPLAY_IDENTIFIER T_EOI_TRIG_OFS ECU_ADDRESS 0x7fa198 BYTE_ORDER MSB_LAST FORMAT "%5.3" /end MEASUREMENT
/begin MEASUREMENT lv_doi_min_mod "button for choice DOI_MIN calculation mode" UBYTE _CNV_S_2_RANGE______11_CM 1 0. 0. 1. DISPLAY_IDENTIFIER LV_DOI_MIN_MOD ECU_ADDRESS 0x7fbb8d /end MEASUREMENT
/begin MEASUREMENT lv_micro_step_frze_mod "button for choice Pulse FRZE Limitation mode" UBYTE _CNV_S_2_RANGE______11_CM 1 0. 0. 1. DISPLAY_IDENTIFIER LV_MICRO_STEP_FRZE_MOD ECU_ADDRESS 0x7fbb8e /end MEASUREMENT
/begin MEASUREMENT t_dist_main12post1_min "minimal time from end of discharge Main1 to charge Post1" UWORD _CNV_A_R_LINEAR_____211_CM 1 0. 0. 32.767 DISPLAY_IDENTIFIER T_DIST_MAIN12POST1_MIN ECU_ADDRESS 0x7fa19a BYTE_ORDER MSB_LAST FORMAT "%5.3" /end MEASUREMENT
/begin MEASUREMENT lv_micro_step_on "button for activation micro stepping (0: \"off\", 1: \"on\")" UBYTE _CNV_S_2_RANGE______11_CM 1 0. 0. 1. DISPLAY_IDENTIFIER LV_MICRO_STEP_ON ECU_ADDRESS 0x7fbb8f /end MEASUREMENT
/begin CHARACTERISTIC c_t_cha2cha_min "minimal time from charge to charge" VALUE 0x84ff2c _REC_VAL_20_u2 32.767 _CNV_A_R_LINEAR_____211_CM 0. 32.767 DISPLAY_IDENTIFIER C_T_CHA2CHA_MIN FORMAT "%5.3" /end CHARACTERISTIC
/begin CHARACTERISTIC c_t_dcha2dcha_min "minimal time from discharge to discharge" VALUE 0x84ff48 _REC_VAL_20_u2 32.767 _CNV_A_R_LINEAR_____211_CM 0. 32.767 DISPLAY_IDENTIFIER C_T_DCHA2DCHA_MIN FORMAT "%5.3" /end CHARACTERISTIC
/begin CHARACTERISTIC c_t_cha2dcha_min "minimal time from charge to discharge" VALUE 0x84ff2e _REC_VAL_20_u2 32.767 _CNV_A_R_LINEAR_____211_CM 0. 32.767 DISPLAY_IDENTIFIER C_T_CHA2DCHA_MIN FORMAT "%5.3" /end CHARACTERISTIC
/begin CHARACTERISTIC c_t_dcha2cha_min "minimal time from discharge to charge" VALUE 0x84ff46 _REC_VAL_20_u2 32.767 _CNV_A_R_LINEAR_____211_CM 0. 32.767 DISPLAY_IDENTIFIER C_T_DCHA2CHA_MIN FORMAT "%5.3" /end CHARACTERISTIC
/begin CHARACTERISTIC c_t_dcha2newcha_min "minimal time from discharge to charge (with full discharge in between)" VALUE 0x84ff4a _REC_VAL_20_u2 32.767 _CNV_A_R_LINEAR_____211_CM 0. 32.767 DISPLAY_IDENTIFIER C_T_DCHA2NEWCHA_MIN FORMAT "%5.3" /end CHARACTERISTIC
/begin CHARACTERISTIC c_stk_max_piezo "maximal piezo stroke" VALUE 0x84ff0c _REC_VAL_20_u1 50.8 _CNV_A_R_LINEAR_____215_CM 0.2 51. DISPLAY_IDENTIFIER C_STK_MAX_PIEZO FORMAT "%3.1" /end CHARACTERISTIC
/begin CHARACTERISTIC c_t_soi_dly "runtime delay for start of injection" VALUE 0x84ffee _REC_VAL_20_u2 32.767 _CNV_A_R_LINEAR_____211_CM 0. 32.767 DISPLAY_IDENTIFIER C_T_SOI_DLY FORMAT "%5.3" /end CHARACTERISTIC
/begin CHARACTERISTIC lc_doi_mod "button for choice of duration calculation method (0: \"classic\", 1: \"new\")" VALUE 0x850117 _REC_VAL_20_u1 1. _CNV_A_R_LINEAR_____0_CM 0. 1. DISPLAY_IDENTIFIER LC_DOI_MOD FORMAT "%1.0" /end CHARACTERISTIC
/begin CHARACTERISTIC c_step_sp_pps "set point for total number of charge steps (including steps for building up force of tightness only)" VALUE 0x84ff08 _REC_VAL_20_u1 29. _CNV_A_R_LINEAR_____0_CM 1. 30. DISPLAY_IDENTIFIER C_STEP_SP_PPS FORMAT "%2.0" /end CHARACTERISTIC
/begin CHARACTERISTIC c_step_sp_iv_foc "set point for number of charge steps for building up force of tightness only" VALUE 0x84ff07 _REC_VAL_20_u1 30. _CNV_A_R_LINEAR_____0_CM 0. 30. DISPLAY_IDENTIFIER C_STEP_SP_IV_FOC FORMAT "%2.0" /end CHARACTERISTIC
/begin CHARACTERISTIC c_ti_req_ti_min "injection time of the minimal injection time mode" VALUE 0x85003e _REC_VAL_20_u2 32.767 _CNV_A_R_LINEAR_____211_CM 0. 32.767 DISPLAY_IDENTIFIER C_TI_REQ_TI_MIN FORMAT "%5.3" /end CHARACTERISTIC
/begin CHARACTERISTIC c_t_hld_min_bas "base value for minimal hold time of any pulse" VALUE 0x84ff8c _REC_VAL_20_u2 32.767 _CNV_A_R_LINEAR_____211_CM 0. 32.767 DISPLAY_IDENTIFIER C_T_HLD_MIN_BAS FORMAT "%5.3" /end CHARACTERISTIC
/begin CHARACTERISTIC c_ang_cam_st "start angle of active camshaft" VALUE 0x84fb98 _REC_VAL_20_s2 360. _CNV_A_R_LINEAR_____119_CM -120. 240. DISPLAY_IDENTIFIER C_ANG_CAM_ST FORMAT "%5.2" /end CHARACTERISTIC
/begin CHARACTERISTIC c_ang_cam_end "end angle of active camshaft" VALUE 0x84fb96 _REC_VAL_20_s2 360. _CNV_A_R_LINEAR_____119_CM -120. 240. DISPLAY_IDENTIFIER C_ANG_CAM_END FORMAT "%5.2" /end CHARACTERISTIC
/begin CHARACTERISTIC c_ti_min "minimal time for durations of injections" VALUE 0x85003c _REC_VAL_20_u2 32.767 _CNV_A_R_LINEAR_____211_CM 0. 32.767 DISPLAY_IDENTIFIER C_TI_MIN FORMAT "%5.3" /end CHARACTERISTIC
/begin CHARACTERISTIC lc_ip_on "button for choice of Level and T_HLD calculation method (0: \" by control\", 1: \"by map\")" VALUE 0x850133 _REC_VAL_20_u1 1. _CNV_A_R_LINEAR_____0_CM 0. 1. DISPLAY_IDENTIFIER LC_IP_ON FORMAT "%1.0" /end CHARACTERISTIC
/begin CHARACTERISTIC c_t_grp2sel_min "minimal time from end of group signal to selection signal minimal time for charging from zero minimal time for charging minimal time from end of charge to EOI minimal time from end of discharge PREV1 to charge MAIN1 time from EOI Trigger to EOI button for" VALUE 0x84ff82 _REC_VAL_20_u2 32.767 _CNV_A_R_LINEAR_____211_CM 0. 32.767 DISPLAY_IDENTIFIER C_T_GRP2SEL_MIN FORMAT "%5.3" /end CHARACTERISTIC
/begin MEASUREMENT ti_max "maximal time for durations of injections" UWORD _CNV_A_R_LINEAR_____211_CM 1 0. 0. 32.767 DISPLAY_IDENTIFIER TI_MAX ECU_ADDRESS 0x7fa19c BYTE_ORDER MSB_LAST FORMAT "%5.3" /end MEASUREMENT
/begin MEASUREMENT doi_max "maximal duration of injections" UWORD _CNV_A_R_LINEAR_____119_CM 1 0. 0. 360. DISPLAY_IDENTIFIER DOI_MAX ECU_ADDRESS 0x7fa19e BYTE_ORDER MSB_LAST FORMAT "%5.2" /end MEASUREMENT
/begin MEASUREMENT doi_min "minimal duration of injections" UWORD _CNV_A_R_LINEAR_____119_CM 1 0. 0. 360. DISPLAY_IDENTIFIER DOI_MIN ECU_ADDRESS 0x7fa1a0 BYTE_ORDER MSB_LAST FORMAT "%5.2" /end MEASUREMENT
/begin MEASUREMENT soi_dly "runtime delay for start of injection (angle)" UWORD _CNV_A_R_LINEAR_____119_CM 1 0. 0. 360. DISPLAY_IDENTIFIER SOI_DLY ECU_ADDRESS 0x7fa1a2 BYTE_ORDER MSB_LAST FORMAT "%5.2" /end MEASUREMENT
/begin MEASUREMENT dur_dcha2newcyl_min "minimal duration from discharge to charge (with switching to another cylinder)" UWORD _CNV_A_R_LINEAR_____119_CM 1 0. 0. 360. DISPLAY_IDENTIFIER DUR_DCHA2NEWCYL_MIN ECU_ADDRESS 0x7fa1a4 BYTE_ORDER MSB_LAST FORMAT "%5.2" /end MEASUREMENT
/begin MEASUREMENT dur_pls_min "duration of a minimal pulse" UWORD _CNV_A_R_LINEAR_____119_CM 1 0. 0. 360. DISPLAY_IDENTIFIER DUR_PLS_MIN ECU_ADDRESS 0x7fa1a6 BYTE_ORDER MSB_LAST FORMAT "%5.2" /end MEASUREMENT
/begin MEASUREMENT dur_grp2sel_min "minimal duration from end of group signal to selection signal" UWORD _CNV_A_R_LINEAR_____119_CM 1 0. 0. 360. DISPLAY_IDENTIFIER DUR_GRP2SEL_MIN ECU_ADDRESS 0x7fa1a8 BYTE_ORDER MSB_LAST FORMAT "%5.2" /end MEASUREMENT
/begin MEASUREMENT t_hld_min "minimal hold time of any pulse" UWORD _CNV_A_R_LINEAR_____211_CM 1 0. 0. 32.767 DISPLAY_IDENTIFIER T_HLD_MIN ECU_ADDRESS 0x7fa1aa BYTE_ORDER MSB_LAST FORMAT "%5.3" /end MEASUREMENT
/begin MEASUREMENT ofs_level_cor "correction offset for all levels" SBYTE _CNV_A_R_LINEAR_____216_CM 1 0. -50. 49.6094 DISPLAY_IDENTIFIER OFS_LEVEL_COR ECU_ADDRESS 0x7fbb8a FORMAT "%3.1" /end MEASUREMENT
/begin MEASUREMENT dur_wout_frze_min "minimal duration without FROM ZERO Pulse" UWORD _CNV_A_R_LINEAR_____119_CM 1 0. 0. 360. DISPLAY_IDENTIFIER DUR_WOUT_FRZE_MIN ECU_ADDRESS 0x7fa1ac BYTE_ORDER MSB_LAST FORMAT "%5.2" /end MEASUREMENT
/begin MEASUREMENT dur_with_frze_min "minimal duration with FROM ZERO Pulse" UWORD _CNV_A_R_LINEAR_____119_CM 1 0. 0. 360. DISPLAY_IDENTIFIER DUR_WITH_FRZE_MIN ECU_ADDRESS 0x7fa1ae BYTE_ORDER MSB_LAST FORMAT "%5.2" /end MEASUREMENT
/begin CHARACTERISTIC c_ti_cold_max "upper time limit for durations of injections at cold start" VALUE 0x850038 _REC_VAL_20_u2 32.767 _CNV_A_R_LINEAR_____211_CM 0. 32.767 DISPLAY_IDENTIFIER C_TI_COLD_MAX FORMAT "%5.3" /end CHARACTERISTIC
/begin CHARACTERISTIC c_ti_max "maximal time for durations of injections" VALUE 0x85003a _REC_VAL_20_u2 32.767 _CNV_A_R_LINEAR_____211_CM 0. 32.767 DISPLAY_IDENTIFIER C_TI_MAX FORMAT "%5.3" /end CHARACTERISTIC
/begin CHARACTERISTIC ip_fac_t_hld_min_inc__n "DPX00M01: correction factor for minimal hold time of any pulse" CURVE 0x8483f8 _REC_CUR_20_u2_u2 32.767 _CNV_A_R_LINEAR_____217_CM 0. 32.767 DISPLAY_IDENTIFIER IP_FAC_T_HLD_MIN_INC__N FORMAT "%5.3"
 /begin AXIS_DESCR COM_AXIS n _CNV_A_R_LINEAR_____5_CM 8 0. 6375. FORMAT "%4.0" AXIS_PTS_REF ldp_n_ip_fac_t_hld_min_inc /end AXIS_DESCR
/end CHARACTERISTIC
/begin AXIS_PTS ldp_n_ip_fac_t_hld_min_inc "" 0x8440b0 n _REC_AXS_20_u2 6375. _CNV_A_R_LINEAR_____5_CM 8 0. 6375. FORMAT "%4.0" /end AXIS_PTS
/begin CHARACTERISTIC ip_ofs_level_cor__tfu "DPX00M01: correction offset for all level values" CURVE 0x84d450 _REC_CUR_20_u1_u1 99.60939999999999 _CNV_A_R_LINEAR_____218_CM -50. 49.6094 DISPLAY_IDENTIFIER IP_OFS_LEVEL_COR__TFU FORMAT "%3.1"
 /begin AXIS_DESCR COM_AXIS tfu _CNV_A_R_LINEAR_____18_CM 6 -50. 205. FORMAT "%3.0" AXIS_PTS_REF ldp_tfu_ip_ofs_level_cor /end AXIS_DESCR
/end CHARACTERISTIC
/begin AXIS_PTS ldp_tfu_ip_ofs_level_cor "" 0x842479 tfu _REC_AXS_20_u1 255. _CNV_A_R_LINEAR_____18_CM 6 -50. 205. FORMAT "%3.0" /end AXIS_PTS
/begin CHARACTERISTIC c_t_cha_frze_min "mminimal time for charging from zero" VALUE 0x84ff32 _REC_VAL_20_u2 32.767 _CNV_A_R_LINEAR_____211_CM 0. 32.767 DISPLAY_IDENTIFIER C_T_CHA_FRZE_MIN FORMAT "%5.3" /end CHARACTERISTIC
/begin CHARACTERISTIC c_t_cha_micro_step_min "minimal time for charging" VALUE 0x84ff3a _REC_VAL_20_u2 32.767 _CNV_A_R_LINEAR_____211_CM 0. 32.767 DISPLAY_IDENTIFIER C_T_CHA_MICRO_STEP_MIN FORMAT "%5.3" /end CHARACTERISTIC
/begin CHARACTERISTIC c_t_hld_pls_min "minimal time from end of charge EOI" VALUE 0x84ff8e _REC_VAL_20_u2 32.767 _CNV_A_R_LINEAR_____211_CM 0. 32.767 DISPLAY_IDENTIFIER C_T_HLD_PLS_MIN FORMAT "%5.3" /end CHARACTERISTIC
/begin CHARACTERISTIC c_t_dist_pls2pls_min "minimal time from end of discharge PREV1 to charge MAIN1" VALUE 0x84ff5c _REC_VAL_20_u2 32.767 _CNV_A_R_LINEAR_____211_CM 0. 32.767 DISPLAY_IDENTIFIER C_T_DIST_PLS2PLS_MIN FORMAT "%5.3" /end CHARACTERISTIC
/begin CHARACTERISTIC c_t_eoi_trig_ofs "time from EOI Trigger to EOI" VALUE 0x84ff7a _REC_VAL_20_u2 32.767 _CNV_A_R_LINEAR_____211_CM 0. 32.767 DISPLAY_IDENTIFIER C_T_EOI_TRIG_OFS FORMAT "%5.3" /end CHARACTERISTIC
/begin CHARACTERISTIC c_t_dist_main12post1_min "minimal time from end of discharge MAIN1 to charge POST1" VALUE 0x84ff5a _REC_VAL_20_u2 32.767 _CNV_A_R_LINEAR_____211_CM 0. 32.767 DISPLAY_IDENTIFIER C_T_DIST_MAIN12POST1_MIN FORMAT "%5.3" /end CHARACTERISTIC
/begin CHARACTERISTIC lc_doi_min_mod "button for choice DOI_MIN calculation mode" VALUE 0x850116 _REC_VAL_20_u1 1. _CNV_A_R_LINEAR_____0_CM 0. 1. DISPLAY_IDENTIFIER LC_DOI_MIN_MOD FORMAT "%1.0" /end CHARACTERISTIC
/begin CHARACTERISTIC lc_micro_step_frze_mod "button for choice Pulse FRZE Limitation mode" VALUE 0x85015b _REC_VAL_20_u1 1. _CNV_A_R_LINEAR_____0_CM 0. 1. DISPLAY_IDENTIFIER LC_MICRO_STEP_FRZE_MOD FORMAT "%1.0" /end CHARACTERISTIC
/begin CHARACTERISTIC lc_micro_step_on "button for activation micro stepping (0: off, 1: on)" VALUE 0x85015c _REC_VAL_20_u1 1. _CNV_A_R_LINEAR_____0_CM 0. 1. DISPLAY_IDENTIFIER LC_MICRO_STEP_ON FORMAT "%1.0" /end CHARACTERISTIC
/begin CHARACTERISTIC c_fac1_egy_pps_stk "linear coefficient of the polynomial energy stroke dependency" VALUE 0x84fcf4 _REC_VAL_20_u2 3.99993896484375 _CNV_A_R_LINEAR_____219_CM 0. 3.99993896484375 DISPLAY_IDENTIFIER C_FAC1_EGY_PPS_STK FORMAT "%6.5" /end CHARACTERISTIC
/begin CHARACTERISTIC c_fac2_egy_pps_stk "quadratic coefficient of the polynomial energy stroke dependency" VALUE 0x84fcf6 _REC_VAL_20_u2 1.99996948242188 _CNV_A_R_LINEAR_____220_CM 0. 1.99996948242188 DISPLAY_IDENTIFIER C_FAC2_EGY_PPS_STK FORMAT "%6.5" /end CHARACTERISTIC
/begin CHARACTERISTIC ip_fac_prs_soi__mf__dur "DPX00T01: factor for a SOI value describing the effect of the preceding injection on the system pressure" MAP 0x848316 _REC_MAP_20_u2_u2_u2 3.99993896484375 _CNV_A_R_LINEAR_____15_CM 0. 3.99993896484375 DISPLAY_IDENTIFIER IP_FAC_PRS_SOI__MF__DUR FORMAT "%6.5"
 /begin AXIS_DESCR COM_AXIS dummy_mf _CNV_A_R_LINEAR_____221_CM 6 0. 262.14 AXIS_PTS_REF ldp_mf_ip_fac_prs_soi /end AXIS_DESCR
 /begin AXIS_DESCR COM_AXIS dummy_doi _CNV_A_R_LINEAR_____119_CM 8 0. 360. FORMAT "%5.2" AXIS_PTS_REF ldp_dur_ip_fac_prs_soi /end AXIS_DESCR
/end CHARACTERISTIC
/begin AXIS_PTS ldp_mf_ip_fac_prs_soi "" 0x84188e dummy_mf _REC_AXS_20_u2 262.14 _CNV_A_R_LINEAR_____221_CM 6 0. 262.14 /end AXIS_PTS
/begin AXIS_PTS ldp_dur_ip_fac_prs_soi "" 0x841656 dummy_doi _REC_AXS_20_u2 360. _CNV_A_R_LINEAR_____119_CM 8 0. 360. FORMAT "%5.2" /end AXIS_PTS
/begin CHARACTERISTIC ip_fac_prs_doi__mf__dur "DPX00T01: factor for a DOI value describing the effect of the preceding injection on the system pressure" MAP 0x8482b6 _REC_MAP_20_u2_u2_u2 3.99993896484375 _CNV_A_R_LINEAR_____15_CM 0. 3.99993896484375 DISPLAY_IDENTIFIER IP_FAC_PRS_DOI__MF__DUR FORMAT "%6.5"
 /begin AXIS_DESCR COM_AXIS dummy_mf _CNV_A_R_LINEAR_____221_CM 6 0. 262.14 AXIS_PTS_REF ldp_mf_ip_fac_prs_doi /end AXIS_DESCR
 /begin AXIS_DESCR COM_AXIS dummy_doi _CNV_A_R_LINEAR_____119_CM 8 0. 360. FORMAT "%5.2" AXIS_PTS_REF ldp_dur_ip_fac_prs_doi /end AXIS_DESCR
/end CHARACTERISTIC
/begin AXIS_PTS ldp_mf_ip_fac_prs_doi "" 0x841880 dummy_mf _REC_AXS_20_u2 262.14 _CNV_A_R_LINEAR_____221_CM 6 0. 262.14 /end AXIS_PTS
/begin AXIS_PTS ldp_dur_ip_fac_prs_doi "" 0x841644 dummy_doi _REC_AXS_20_u2 360. _CNV_A_R_LINEAR_____119_CM 8 0. 360. FORMAT "%5.2" /end AXIS_PTS
/begin CHARACTERISTIC ip_soi_dly__n__level "DPX00T01: delay angle for start of injection" MAP 0x84d63c _REC_MAP_20_u2_u2_u1 360. _CNV_A_R_LINEAR_____118_CM -120. 240. DISPLAY_IDENTIFIER IP_SOI_DLY__N__LEVEL FORMAT "%5.2"
 /begin AXIS_DESCR COM_AXIS n _CNV_A_R_LINEAR_____5_CM 8 0. 6375. FORMAT "%4.0" AXIS_PTS_REF ldp_n_ip_soi_dly /end AXIS_DESCR
 /begin AXIS_DESCR COM_AXIS dummy_level _CNV_A_R_LINEAR_____212_CM 6 0. 99.609375 FORMAT "%3.1" AXIS_PTS_REF ldp_level_ip_soi_dly /end AXIS_DESCR
/end CHARACTERISTIC
/begin AXIS_PTS ldp_n_ip_soi_dly "" 0x841d28 n _REC_AXS_20_u2 6375. _CNV_A_R_LINEAR_____5_CM 8 0. 6375. FORMAT "%4.0" /end AXIS_PTS
/begin AXIS_PTS ldp_level_ip_soi_dly "" 0x841742 dummy_level _REC_AXS_20_u1 99.609375 _CNV_A_R_LINEAR_____212_CM 6 0. 99.609375 FORMAT "%3.1" /end AXIS_PTS
/begin AXIS_PTS ldpm_soi_ip_fac_doi "" 0x843776 dummy_soi _REC_AXS_20_u2 360. _CNV_A_R_LINEAR_____118_CM 8 -120. 240. FORMAT "%5.2" /end AXIS_PTS
/begin CHARACTERISTIC ip_fac_doi__soi__tfu_delta "DPX00T01: factor for de-/increase the DOI depending on TFU" MAP 0x847fb0 _REC_MAP_20_u2_u2_u2 3.99993896484375 _CNV_A_R_LINEAR_____15_CM 0. 3.99993896484375 DISPLAY_IDENTIFIER IP_FAC_DOI__SOI__TFU_DELTA FORMAT "%6.5"
 /begin AXIS_DESCR COM_AXIS dummy_soi _CNV_A_R_LINEAR_____118_CM 8 -120. 240. FORMAT "%5.2" AXIS_PTS_REF ldpm_soi_ip_fac_doi /end AXIS_DESCR
 /begin AXIS_DESCR COM_AXIS dummy_soi _CNV_A_R_LINEAR_____222_CM 8 -205. 205. FORMAT "%3.0" AXIS_PTS_REF ldp_tfu_delta_ip_fac_doi /end AXIS_DESCR
/end CHARACTERISTIC
/begin AXIS_PTS ldp_tfu_delta_ip_fac_doi "" 0x842456 dummy_soi _REC_AXS_20_u2 410. _CNV_A_R_LINEAR_____222_CM 8 -205. 205. FORMAT "%3.0" /end AXIS_PTS
/begin CHARACTERISTIC ip_fac_doi__soi__tco_delta "DPX00T01: factor for de-/increase the DOI depending on TCO" MAP 0x847f30 _REC_MAP_20_u2_u2_u2 3.99993896484375 _CNV_A_R_LINEAR_____15_CM 0. 3.99993896484375 DISPLAY_IDENTIFIER IP_FAC_DOI__SOI__TCO_DELTA FORMAT "%6.5"
 /begin AXIS_DESCR COM_AXIS dummy_soi _CNV_A_R_LINEAR_____118_CM 8 -120. 240. FORMAT "%5.2" AXIS_PTS_REF ldpm_soi_ip_fac_doi /end AXIS_DESCR
 /begin AXIS_DESCR COM_AXIS dummy_doi _CNV_A_R_LINEAR_____222_CM 8 -205. 205. FORMAT "%3.0" AXIS_PTS_REF ldp_tco_delta_ip_fac_doi /end AXIS_DESCR
/end CHARACTERISTIC
/begin AXIS_PTS ldp_tco_delta_ip_fac_doi "" 0x842276 dummy_doi _REC_AXS_20_u2 410. _CNV_A_R_LINEAR_____222_CM 8 -205. 205. FORMAT "%3.0" /end AXIS_PTS
/begin MEASUREMENT sf_pls_state_tu_[0] "pulse state (tuned)" UWORD _CNV_A_R_LINEAR_____0_CM 1 0. 0. 65535. DISPLAY_IDENTIFIER SF_PLS_STATE_TU__0_ ECU_ADDRESS 0x7fa24e BYTE_ORDER MSB_LAST FORMAT "%5.0" /end MEASUREMENT
/begin MEASUREMENT sf_pls_state_tu_[1] "pulse state (tuned)" UWORD _CNV_A_R_LINEAR_____0_CM 1 0. 0. 65535. DISPLAY_IDENTIFIER SF_PLS_STATE_TU__1_ ECU_ADDRESS 0x7fa250 BYTE_ORDER MSB_LAST FORMAT "%5.0" /end MEASUREMENT
/begin MEASUREMENT sf_pls_state_tu_[2] "pulse state (tuned)" UWORD _CNV_A_R_LINEAR_____0_CM 1 0. 0. 65535. DISPLAY_IDENTIFIER SF_PLS_STATE_TU__2_ ECU_ADDRESS 0x7fa252 BYTE_ORDER MSB_LAST FORMAT "%5.0" /end MEASUREMENT
/begin MEASUREMENT sf_pls_state_tu_[3] "pulse state (tuned)" UWORD _CNV_A_R_LINEAR_____0_CM 1 0. 0. 65535. DISPLAY_IDENTIFIER SF_PLS_STATE_TU__3_ ECU_ADDRESS 0x7fa254 BYTE_ORDER MSB_LAST FORMAT "%5.0" /end MEASUREMENT
/begin MEASUREMENT sf_inj_off_tu "tuned value of disabled injectors status word" UBYTE _CNV_A_R_LINEAR_____0_CM 1 0. 0. 255. DISPLAY_IDENTIFIER SF_INJ_OFF_TU ECU_ADDRESS 0x7fbbc3 FORMAT "%3.0" /end MEASUREMENT
/begin MEASUREMENT lv_inj_ena_st "Release of injection during engine state start" UBYTE _CNV_S_2_RANGE______11_CM 1 0. 0. 1. DISPLAY_IDENTIFIER LV_INJ_ENA_ST ECU_ADDRESS 0x7fbbcc /end MEASUREMENT
/begin MEASUREMENT mf_is_tar "Target fuel mass for transition from start to idle speed" UWORD _CNV_A_R_LINEAR_____38_CM 1 0. 0. 262.14 DISPLAY_IDENTIFIER MF_IS_TAR ECU_ADDRESS 0x7fa26c BYTE_ORDER MSB_LAST /end MEASUREMENT
/begin MEASUREMENT ctr_tran_st_is "Segment counter for transition engine start to idle speed" UBYTE _CNV_A_R_LINEAR_____0_CM 1 0. 0. 255. DISPLAY_IDENTIFIER CTR_TRAN_ST_IS ECU_ADDRESS 0x7fbbc9 FORMAT "%3.0" /end MEASUREMENT
/begin MEASUREMENT sf_inj_off "" UBYTE _CNV_A_R_LINEAR_____0_CM 1 0. 0. 255. DISPLAY_IDENTIFIER SF_INJ_OFF ECU_ADDRESS 0x7fbbcb FORMAT "%3.0" /end MEASUREMENT
/begin CHARACTERISTIC ip_mf_is_tar__tco "DPX00901: target fuel mass for transition from engine start to idle speed" CURVE 0x84bc64 _REC_CUR_20_u2_u1 262.14 _CNV_A_R_LINEAR_____38_CM 0. 262.14 DISPLAY_IDENTIFIER IP_MF_IS_TAR__TCO
 /begin AXIS_DESCR COM_AXIS tco _CNV_A_R_LINEAR_____18_CM 8 -50. 205. FORMAT "%3.0" AXIS_PTS_REF ldp_tco_ip_mf_is_tar /end AXIS_DESCR
/end CHARACTERISTIC
/begin AXIS_PTS ldp_tco_ip_mf_is_tar "" 0x84239b tco _REC_AXS_20_u1 255. _CNV_A_R_LINEAR_____18_CM 8 -50. 205. FORMAT "%3.0" /end AXIS_PTS
/begin CHARACTERISTIC ip_ctr_tran_st_is__tco "DPX00901: segment counter for transition from engine start to idle speed" CURVE 0x845360 _REC_CUR_20_u1_u1 255. _CNV_A_R_LINEAR_____0_CM 0. 255. DISPLAY_IDENTIFIER IP_CTR_TRAN_ST_IS__TCO FORMAT "%3.0"
 /begin AXIS_DESCR COM_AXIS tco _CNV_A_R_LINEAR_____18_CM 8 -50. 205. FORMAT "%3.0" AXIS_PTS_REF ldp_tco_ip_ctr_tran_st_is /end AXIS_DESCR
/end CHARACTERISTIC
/begin AXIS_PTS ldp_tco_ip_ctr_tran_st_is "" 0x842288 tco _REC_AXS_20_u1 255. _CNV_A_R_LINEAR_____18_CM 8 -50. 205. FORMAT "%3.0" /end AXIS_PTS
/begin MEASUREMENT sf_inj_state.word "" UWORD _CNV_S_9_CONV_INJ_S_224_CM 1 0. 0. 8. DISPLAY_IDENTIFIER SF_INJ_STATE ECU_ADDRESS 0x7fa270 BYTE_ORDER MSB_LAST /end MEASUREMENT
/begin MEASUREMENT sf_inj_state.bf.unused "" UWORD _CNV_A_R_LINEAR_____0_CM 1 0. 0. 65535. DISPLAY_IDENTIFIER SF_INJ_STATE_BF_UNUSED ECU_ADDRESS 0x7fa270 BYTE_ORDER MSB_LAST BIT_MASK 0xFFC00000 /end MEASUREMENT
/begin MEASUREMENT sf_inj_state.bf.lv_inj_di "" UWORD _CNV_A_R_LINEAR_____0_CM 1 0. 0. 65535. DISPLAY_IDENTIFIER SF_INJ_STATE_BF_LV_INJ_DI ECU_ADDRESS 0x7fa270 BYTE_ORDER MSB_LAST BIT_MASK 0x200000 /end MEASUREMENT
/begin MEASUREMENT sf_inj_state.bf.lv_post1_inj_act "" UWORD _CNV_A_R_LINEAR_____0_CM 1 0. 0. 65535. DISPLAY_IDENTIFIER SF_INJ_STATE_BF_LV_POST1_INJ_ACT ECU_ADDRESS 0x7fa270 BYTE_ORDER MSB_LAST BIT_MASK 0x100000 /end MEASUREMENT
/begin MEASUREMENT sf_inj_state.bf.lv_main2_inj_act "" UWORD _CNV_A_R_LINEAR_____0_CM 1 0. 0. 65535. DISPLAY_IDENTIFIER SF_INJ_STATE_BF_LV_MAIN2_INJ_ACT ECU_ADDRESS 0x7fa270 BYTE_ORDER MSB_LAST BIT_MASK 0x80000 /end MEASUREMENT
/begin MEASUREMENT sf_inj_state.bf.lv_main1_inj_act "" UWORD _CNV_A_R_LINEAR_____0_CM 1 0. 0. 65535. DISPLAY_IDENTIFIER SF_INJ_STATE_BF_LV_MAIN1_INJ_ACT ECU_ADDRESS 0x7fa270 BYTE_ORDER MSB_LAST BIT_MASK 0x40000 /end MEASUREMENT
/begin MEASUREMENT sf_inj_state.bf.lv_prev2_inj_act "" UWORD _CNV_A_R_LINEAR_____0_CM 1 0. 0. 65535. DISPLAY_IDENTIFIER SF_INJ_STATE_BF_LV_PREV2_INJ_ACT ECU_ADDRESS 0x7fa270 BYTE_ORDER MSB_LAST BIT_MASK 0x20000 /end MEASUREMENT
/begin MEASUREMENT sf_inj_state.bf.lv_prev1_inj_act "" UWORD _CNV_A_R_LINEAR_____0_CM 1 0. 0. 65535. DISPLAY_IDENTIFIER SF_INJ_STATE_BF_LV_PREV1_INJ_ACT ECU_ADDRESS 0x7fa270 BYTE_ORDER MSB_LAST BIT_MASK 0x10000 /end MEASUREMENT
/begin MEASUREMENT sf_pls_state "pulse activation status word" UWORD _CNV_A_R_LINEAR_____0_CM 1 0. 0. 65535. DISPLAY_IDENTIFIER SF_PLS_STATE ECU_ADDRESS 0x7fa274 BYTE_ORDER MSB_LAST FORMAT "%5.0" /end MEASUREMENT
/begin MEASUREMENT iv_on "injections enabled status word" UWORD _CNV_A_R_LINEAR_____0_CM 1 0. 0. 65535. DISPLAY_IDENTIFIER IV_ON ECU_ADDRESS 0x7fa276 BYTE_ORDER MSB_LAST FORMAT "%5.0" /end MEASUREMENT
/begin MEASUREMENT nr_inj_seg "number of enabled injections" UBYTE _CNV_A_R_LINEAR_____0_CM 1 0. 0. 255. DISPLAY_IDENTIFIER NR_INJ_SEG ECU_ADDRESS 0x7fbbca FORMAT "%3.0" /end MEASUREMENT
/begin MEASUREMENT lv_inj_ena "flag indicating if the injection is globally enabled or not" UBYTE _CNV_S_2_RANGE______11_CM 1 0. 0. 1. DISPLAY_IDENTIFIER LV_INJ_ENA ECU_ADDRESS 0x7fbbcd /end MEASUREMENT
/begin MEASUREMENT lv_inj_di "flag indicating if all injections are disabled or not" UBYTE _CNV_S_2_RANGE______11_CM 1 0. 0. 1. DISPLAY_IDENTIFIER LV_INJ_DI ECU_ADDRESS 0x7fbbce /end MEASUREMENT
/begin MEASUREMENT fac_doi_inc "factor to increase/decrease fuel mass at cold start" UWORD _CNV_A_R_LINEAR_____15_CM 1 0. 0. 3.99993896484375 DISPLAY_IDENTIFIER FAC_DOI_INC ECU_ADDRESS 0x7fa1d4 BYTE_ORDER MSB_LAST FORMAT "%6.5" /end MEASUREMENT
/begin MEASUREMENT lv_doi_inc_ena "fuel mass compensation for cold start active" UBYTE _CNV_S_2_RANGE______11_CM 1 0. 0. 1. DISPLAY_IDENTIFIER LV_DOI_INC_ENA ECU_ADDRESS 0x7fbb9e /end MEASUREMENT
/begin MEASUREMENT fac_doi_prev1_tfu "factor to increase/decrease DOI depending on TFU" UWORD _CNV_A_R_LINEAR_____15_CM 1 0. 0. 3.99993896484375 DISPLAY_IDENTIFIER FAC_DOI_PREV1_TFU ECU_ADDRESS 0x7fb40a BYTE_ORDER MSB_LAST FORMAT "%6.5" /end MEASUREMENT
/begin MEASUREMENT fac_doi_main1_tfu "factor to increase/decrease DOI depending on TFU" UWORD _CNV_A_R_LINEAR_____15_CM 1 0. 0. 3.99993896484375 DISPLAY_IDENTIFIER FAC_DOI_MAIN1_TFU ECU_ADDRESS 0x7fb40c BYTE_ORDER MSB_LAST FORMAT "%6.5" /end MEASUREMENT
/begin MEASUREMENT fac_doi_post1_tfu "factor to increase/decrease DOI depending on TFU" UWORD _CNV_A_R_LINEAR_____15_CM 1 0. 0. 3.99993896484375 DISPLAY_IDENTIFIER FAC_DOI_POST1_TFU ECU_ADDRESS 0x7fb40e BYTE_ORDER MSB_LAST FORMAT "%6.5" /end MEASUREMENT
/begin MEASUREMENT fac_doi_prev1 "factor to increase/decrease DOI depending on TFU and TCO" UWORD _CNV_A_R_LINEAR_____15_CM 1 0. 0. 3.99993896484375 DISPLAY_IDENTIFIER FAC_DOI_PREV1 ECU_ADDRESS 0x7fa1d6 BYTE_ORDER MSB_LAST FORMAT "%6.5" /end MEASUREMENT
/begin MEASUREMENT fac_doi_main1 "factor to increase/decrease DOI depending on TFU and TCO" UWORD _CNV_A_R_LINEAR_____15_CM 1 0. 0. 3.99993896484375 DISPLAY_IDENTIFIER FAC_DOI_MAIN1 ECU_ADDRESS 0x7fa1d8 BYTE_ORDER MSB_LAST FORMAT "%6.5" /end MEASUREMENT
/begin MEASUREMENT fac_doi_post1 "factor to increase/decrease DOI depending on TFU and TCO" UWORD _CNV_A_R_LINEAR_____15_CM 1 0. 0. 3.99993896484375 DISPLAY_IDENTIFIER FAC_DOI_POST1 ECU_ADDRESS 0x7fa1da BYTE_ORDER MSB_LAST FORMAT "%6.5" /end MEASUREMENT
/begin MEASUREMENT fac_doi_prev1_tco "factor to increase/decrease DOI depending on TCO" UWORD _CNV_A_R_LINEAR_____15_CM 1 0. 0. 3.99993896484375 DISPLAY_IDENTIFIER FAC_DOI_PREV1_TCO ECU_ADDRESS 0x7fb410 BYTE_ORDER MSB_LAST FORMAT "%6.5" /end MEASUREMENT
/begin MEASUREMENT fac_doi_main1_tco "factor to increase/decrease DOI depending on TCO" UWORD _CNV_A_R_LINEAR_____15_CM 1 0. 0. 3.99993896484375 DISPLAY_IDENTIFIER FAC_DOI_MAIN1_TCO ECU_ADDRESS 0x7fb412 BYTE_ORDER MSB_LAST FORMAT "%6.5" /end MEASUREMENT
/begin MEASUREMENT fac_doi_post1_tco "factor to increase/decrease DOI depending on TCO" UWORD _CNV_A_R_LINEAR_____15_CM 1 0. 0. 3.99993896484375 DISPLAY_IDENTIFIER FAC_DOI_POST1_TCO ECU_ADDRESS 0x7fb414 BYTE_ORDER MSB_LAST FORMAT "%6.5" /end MEASUREMENT
/begin CHARACTERISTIC c_tfu_max_doi_inc "maximal TFU for fuel mass compensation for cold start" VALUE 0x850032 _REC_VAL_20_u1 255. _CNV_A_R_LINEAR_____18_CM -50. 205. DISPLAY_IDENTIFIER C_TFU_MAX_DOI_INC FORMAT "%3.0" /end CHARACTERISTIC
/begin CHARACTERISTIC c_tfu_tco_dif_max_doi_inc "maximal difference between TFU and TCO for fuel mass compensation" VALUE 0x850036 _REC_VAL_20_u1 205. _CNV_A_R_LINEAR_____20_CM 0. 205. DISPLAY_IDENTIFIER C_TFU_TCO_DIF_MAX_DOI_INC FORMAT "%3.0" /end CHARACTERISTIC
/begin CHARACTERISTIC ip_dly_ctr_doi_inc__tfu "DPX00N01: number of strokes with fixed fuel mass compensation" CURVE 0x845368 _REC_CUR_20_u2_u1 65535. _CNV_A_R_LINEAR_____225_CM 0. 65535. DISPLAY_IDENTIFIER IP_DLY_CTR_DOI_INC__TFU FORMAT "%5.0"
 /begin AXIS_DESCR COM_AXIS tfu _CNV_A_R_LINEAR_____18_CM 6 -50. 205. FORMAT "%3.0" AXIS_PTS_REF ldpm_tfu_ip_doi_inc /end AXIS_DESCR
/end CHARACTERISTIC
/begin AXIS_PTS ldpm_tfu_ip_doi_inc "" 0x843801 tfu _REC_AXS_20_u1 255. _CNV_A_R_LINEAR_____18_CM 6 -50. 205. FORMAT "%3.0" /end AXIS_PTS
/begin CHARACTERISTIC ip_fac_doi_inc_ini__tfu "DPX00N01: fuel mass compensation factor for cold start" CURVE 0x848030 _REC_CUR_20_u1_u1 3.984375 _CNV_A_R_LINEAR_____95_CM 0. 3.984375 DISPLAY_IDENTIFIER IP_FAC_DOI_INC_INI__TFU FORMAT "%3.2"
 /begin AXIS_DESCR COM_AXIS tfu _CNV_A_R_LINEAR_____18_CM 6 -50. 205. FORMAT "%3.0" AXIS_PTS_REF ldpm_tfu_ip_doi_inc /end AXIS_DESCR
/end CHARACTERISTIC
/begin CHARACTERISTIC ip_slop_ctr_doi_inc__tfu "DPX00N01: increment/decrement value for fuel mass compensation at cold start" CURVE 0x84d630 _REC_CUR_20_u2_u1 3.99993896484375 _CNV_A_R_LINEAR_____15_CM 0. 3.99993896484375 DISPLAY_IDENTIFIER IP_SLOP_CTR_DOI_INC__TFU FORMAT "%6.5"
 /begin AXIS_DESCR COM_AXIS tfu _CNV_A_R_LINEAR_____18_CM 6 -50. 205. FORMAT "%3.0" AXIS_PTS_REF ldpm_tfu_ip_doi_inc /end AXIS_DESCR
/end CHARACTERISTIC
/begin CHARACTERISTIC lc_doi_inc_rest_on "button for fuel mass compensation also at restart" VALUE 0x850114 _REC_VAL_20_u1 1. _CNV_A_R_LINEAR_____0_CM 0. 1. DISPLAY_IDENTIFIER LC_DOI_INC_REST_ON FORMAT "%1.0" /end CHARACTERISTIC
/begin CHARACTERISTIC lc_cold_start_cor_on "button for fuel mass compensation at start" VALUE 0x850110 _REC_VAL_20_u1 1. _CNV_A_R_LINEAR_____0_CM 0. 1. DISPLAY_IDENTIFIER LC_COLD_START_COR_ON FORMAT "%1.0" /end CHARACTERISTIC
/begin CHARACTERISTIC lc_temp_cor_on "button for DOI compensation depending on TCO and TFU" VALUE 0x850171 _REC_VAL_20_u1 1. _CNV_A_R_LINEAR_____0_CM 0. 1. DISPLAY_IDENTIFIER LC_TEMP_COR_ON FORMAT "%1.0" /end CHARACTERISTIC
/begin CHARACTERISTIC c_tfu_tco_dif_max_doi_inj "maximal difference between TFU and TCO for start of TFU Correction Counter" VALUE 0x850037 _REC_VAL_20_u1 255. _CNV_A_R_LINEAR_____18_CM -50. 205. DISPLAY_IDENTIFIER C_TFU_TCO_DIF_MAX_DOI_INJ FORMAT "%3.0" /end CHARACTERISTIC
/begin CHARACTERISTIC c_tco_min_doi_inj "maximal TCO for start of TFU Correction Counter" VALUE 0x850020 _REC_VAL_20_u1 255. _CNV_A_R_LINEAR_____18_CM -50. 205. DISPLAY_IDENTIFIER C_TCO_MIN_DOI_INJ FORMAT "%3.0" /end CHARACTERISTIC
/begin CHARACTERISTIC c_nr_seg_tfu_cor "Number of Segments to approach TFU" VALUE 0x84fe40 _REC_VAL_20_u2 65535. _CNV_A_R_LINEAR_____0_CM 0. 65535. DISPLAY_IDENTIFIER C_NR_SEG_TFU_COR FORMAT "%5.0" /end CHARACTERISTIC
/begin CHARACTERISTIC ip_fac_temp_delta__ctr "DPX00N01: factor to transfer the corrected TFU value from TCO to TFU" CURVE 0x848426 _REC_CUR_20_u2_u2 0.9999847412109381 _CNV_A_R_LINEAR_____14_CM 0. 0.9999847412109381 DISPLAY_IDENTIFIER IP_FAC_TEMP_DELTA__CTR FORMAT "%6.5"
 /begin AXIS_DESCR COM_AXIS dummy_level _CNV_A_R_LINEAR_____14_CM 10 0. 0.9999847412109381 FORMAT "%6.5" AXIS_PTS_REF ldp_fac_ip_fac_temp_delta /end AXIS_DESCR
/end CHARACTERISTIC
/begin AXIS_PTS ldp_fac_ip_fac_temp_delta "" 0x8416ac dummy_level _REC_AXS_20_u2 0.9999847412109381 _CNV_A_R_LINEAR_____14_CM 10 0. 0.9999847412109381 FORMAT "%6.5" /end AXIS_PTS
/begin CHARACTERISTIC ip_tfu_sp__n__mf "DPX00N01: Set point for Fuel Temperature" MAP 0x84f4de _REC_MAP_20_u1_u2_u2 255. _CNV_A_R_LINEAR_____18_CM -50. 205. DISPLAY_IDENTIFIER IP_TFU_SP__N__MF FORMAT "%3.0"
 /begin AXIS_DESCR COM_AXIS n _CNV_A_R_LINEAR_____5_CM 16 0. 6375. FORMAT "%4.0" AXIS_PTS_REF ldpm_n_ip_temp_sp /end AXIS_DESCR
 /begin AXIS_DESCR COM_AXIS mf_tot _CNV_A_R_LINEAR_____221_CM 16 0. 262.14 AXIS_PTS_REF ldpm_mf_ip_temp_sp /end AXIS_DESCR
/end CHARACTERISTIC
/begin AXIS_PTS ldpm_n_ip_temp_sp "" 0x84353e n _REC_AXS_20_u2 6375. _CNV_A_R_LINEAR_____5_CM 16 0. 6375. FORMAT "%4.0" /end AXIS_PTS
/begin AXIS_PTS ldpm_mf_ip_temp_sp "" 0x842c64 mf_tot _REC_AXS_20_u2 262.14 _CNV_A_R_LINEAR_____221_CM 16 0. 262.14 /end AXIS_PTS
/begin CHARACTERISTIC ip_tco_sp__n__mf "DPX00N01: Set point for cooling water Temperature" MAP 0x84f2a8 _REC_MAP_20_u2_u2_u2 360. _CNV_A_R_LINEAR_____119_CM 0. 360. DISPLAY_IDENTIFIER IP_TCO_SP__N__MF FORMAT "%5.2"
 /begin AXIS_DESCR COM_AXIS n _CNV_A_R_LINEAR_____5_CM 16 0. 6375. FORMAT "%4.0" AXIS_PTS_REF ldpm_n_ip_temp_sp /end AXIS_DESCR
 /begin AXIS_DESCR COM_AXIS mf_tot _CNV_A_R_LINEAR_____221_CM 16 0. 262.14 AXIS_PTS_REF ldpm_mf_ip_temp_sp /end AXIS_DESCR
/end CHARACTERISTIC
/begin MEASUREMENT lv_fast_inj_upd "the fast update is tried" UBYTE _CNV_S_2_RANGE______11_CM 1 0. 0. 1. DISPLAY_IDENTIFIER LV_FAST_INJ_UPD ECU_ADDRESS 0x7fbbaa /end MEASUREMENT
/begin MEASUREMENT lv_fast_upd_miss "the fast update failed" UBYTE _CNV_S_2_RANGE______11_CM 1 0. 0. 1. DISPLAY_IDENTIFIER LV_FAST_UPD_MISS ECU_ADDRESS 0x7fbf88 /end MEASUREMENT
/begin CHARACTERISTIC c_n_max_fast_inj_upd "maximal engine speed where an fast update is attempted" VALUE 0x85cb1a _REC_VAL_20_u2 3500. _CNV_A_R_LINEAR_____5_CM 0. 3500. DISPLAY_IDENTIFIER C_N_MAX_FAST_INJ_UPD FORMAT "%4.0" /end CHARACTERISTIC
/begin CHARACTERISTIC lc_fast_inj_upd_cdn_ovs "Fast update is deactivated in part load (default is one)" VALUE 0x85ce7a _REC_VAL_20_u1 1. _CNV_A_R_LINEAR_____0_CM 0. 1. DISPLAY_IDENTIFIER LC_FAST_INJ_UPD_CDN_OVS FORMAT "%1.0" /end CHARACTERISTIC
/begin CHARACTERISTIC c_cyl_bal_ad_cdn "lower reversing point for hysteresis" VALUE 0x85c974 _REC_VAL_20_u2 7.999755856000001 _CNV_A_R_LINEAR_____372_CM 0. 7.999755856 DISPLAY_IDENTIFIER C_CYL_BAL_AD_CDN FORMAT "%5.4" /end CHARACTERISTIC
/begin CHARACTERISTIC c_cyl_bal_ad_hys "upper reversing point for hysteresis" VALUE 0x85c976 _REC_VAL_20_u2 7.999755856000001 _CNV_A_R_LINEAR_____373_CM 0. 7.999755856 DISPLAY_IDENTIFIER C_CYL_BAL_AD_HYS FORMAT "%5.4" /end CHARACTERISTIC
/begin CHARACTERISTIC c_t_dly_cyl_bal_ad "time delay for application conditions" VALUE 0x85cc16 _REC_VAL_20_u2 6553.5 _CNV_A_R_LINEAR_____19_CM 0. 6553.5 DISPLAY_IDENTIFIER C_T_DLY_CYL_BAL_AD FORMAT "%5.1" /end CHARACTERISTIC
/begin CHARACTERISTIC c_thd_drv1_er_bal_fdout "threshold for disabling balancing in case of dynamics" VALUE 0x85cd00 _REC_VAL_20_s2 65535. _CNV_A_R_LINEAR_____362_CM -32768. 32767. DISPLAY_IDENTIFIER C_THD_DRV1_ER_BAL_FDOUT FORMAT "%1.0" /end CHARACTERISTIC
/begin CHARACTERISTIC lc_cyl_bal_pl_ena "button to enable balancing also in partload" VALUE 0x85ce67 _REC_VAL_20_u1 1. _CNV_A_R_LINEAR_____0_CM 0. 1. DISPLAY_IDENTIFIER LC_CYL_BAL_PL_ENA FORMAT "%1.0" /end CHARACTERISTIC
/begin MEASUREMENT cyl_bal_dif_mmv "mean value over the control inputs over one camshaft revolution" SWORD _CNV_A_R_LINEAR_____374_CM 1 0. -8. 7.999755856 DISPLAY_IDENTIFIER CYL_BAL_DIF_MMV ECU_ADDRESS 0x7fa600 BYTE_ORDER MSB_LAST FORMAT "%6.5" /end MEASUREMENT
/begin MEASUREMENT lv_cyl_bal_ena "boolean for balancing conditions active" UBYTE _CNV_A_R_LINEAR_____0_CM 1 0. 0. 1. DISPLAY_IDENTIFIER LV_CYL_BAL_ENA ECU_ADDRESS 0x7fb805 FORMAT "%1.0" /end MEASUREMENT
/begin MEASUREMENT lv_hys_cyl_bal_dif_mmv "flag for hysteresis condition" UBYTE _CNV_A_R_LINEAR_____0_CM 1 0. 0. 1. DISPLAY_IDENTIFIER LV_HYS_CYL_BAL_DIF_MMV ECU_ADDRESS 0x7fb806 FORMAT "%1.0" /end MEASUREMENT
/begin MEASUREMENT lv_t_dly_cyl_bal_act_st "" UBYTE _CNV_A_R_LINEAR_____0_CM 1 0. 0. 1. DISPLAY_IDENTIFIER LV_T_DLY_CYL_BAL_ACT_ST ECU_ADDRESS 0x7fb804 FORMAT "%1.0" /end MEASUREMENT
/begin CHARACTERISTIC c_cyl_bal_ofs "offset for correction factor segment" VALUE 0x85c978 _REC_VAL_20_u1 255. _CNV_A_R_LINEAR_____0_CM 0. 255. DISPLAY_IDENTIFIER C_CYL_BAL_OFS FORMAT "%3.0" /end CHARACTERISTIC
/begin CHARACTERISTIC c_n_max_bol_cyl_bal "lower enginespeed limit of variable weight" VALUE 0x85cb12 _REC_VAL_20_u2 6375. _CNV_A_R_LINEAR_____5_CM 0. 6375. DISPLAY_IDENTIFIER C_N_MAX_BOL_CYL_BAL FORMAT "%5.0" /end CHARACTERISTIC
/begin CHARACTERISTIC c_n_max_bol_cyl_bal_pl "lower enginespeed limit of variable weight for partload" VALUE 0x85cb14 _REC_VAL_20_u2 6375. _CNV_A_R_LINEAR_____5_CM 0. 6375. DISPLAY_IDENTIFIER C_N_MAX_BOL_CYL_BAL_PL FORMAT "%5.0" /end CHARACTERISTIC
/begin CHARACTERISTIC c_n_max_tol_cyl_bal "upper enginespeed limit of variable weight" VALUE 0x85cb2c _REC_VAL_20_u2 6375. _CNV_A_R_LINEAR_____5_CM 0. 6375. DISPLAY_IDENTIFIER C_N_MAX_TOL_CYL_BAL FORMAT "%5.0" /end CHARACTERISTIC
/begin CHARACTERISTIC c_n_max_tol_cyl_bal_pl "upper enginespeed limit of variable weight for partload" VALUE 0x85cb2e _REC_VAL_20_u2 6375. _CNV_A_R_LINEAR_____5_CM 0. 6375. DISPLAY_IDENTIFIER C_N_MAX_TOL_CYL_BAL_PL FORMAT "%5.0" /end CHARACTERISTIC
/begin CHARACTERISTIC c_t_dly_cyl_bal_lock "time after cold start with factors = 1" VALUE 0x85cc18 _REC_VAL_20_u2 6553.5 _CNV_A_R_LINEAR_____19_CM 0. 6553.5 DISPLAY_IDENTIFIER C_T_DLY_CYL_BAL_LOCK FORMAT "%5.1" /end CHARACTERISTIC
/begin CHARACTERISTIC c_thd_tco_cyl_bal_di "tco threshold below which balancing is disabled" VALUE 0x85cd02 _REC_VAL_20_u1 255. _CNV_A_R_LINEAR_____18_CM -50. 205. DISPLAY_IDENTIFIER C_THD_TCO_CYL_BAL_DI FORMAT "%3.0" /end CHARACTERISTIC
/begin CHARACTERISTIC c_thd_tco_cyl_bal_ena "threshold for enabling balancing depending on coolant temperature" VALUE 0x85cd03 _REC_VAL_20_u1 255. _CNV_A_R_LINEAR_____18_CM -50. 205. DISPLAY_IDENTIFIER C_THD_TCO_CYL_BAL_ENA FORMAT "%4.1" /end CHARACTERISTIC
/begin MEASUREMENT fac_cyl_bal_ramp_tco[0] "correction factor calculated by the ramp for TCO x=0...NC_CYL_NR-1" UWORD _CNV_A_R_LINEAR_____48_CM 1 0. 0. 1.9999696 DISPLAY_IDENTIFIER FAC_CYL_BAL_RAMP_TCO_0_ ECU_ADDRESS 0x7f9846 BYTE_ORDER MSB_LAST FORMAT "%5.3" /end MEASUREMENT
/begin MEASUREMENT fac_cyl_bal_ramp_tco[1] "correction factor calculated by the ramp for TCO x=0...NC_CYL_NR-1" UWORD _CNV_A_R_LINEAR_____48_CM 1 0. 0. 1.9999696 DISPLAY_IDENTIFIER FAC_CYL_BAL_RAMP_TCO_1_ ECU_ADDRESS 0x7f9848 BYTE_ORDER MSB_LAST FORMAT "%5.3" /end MEASUREMENT
/begin MEASUREMENT fac_cyl_bal_ramp_tco[2] "correction factor calculated by the ramp for TCO x=0...NC_CYL_NR-1" UWORD _CNV_A_R_LINEAR_____48_CM 1 0. 0. 1.9999696 DISPLAY_IDENTIFIER FAC_CYL_BAL_RAMP_TCO_2_ ECU_ADDRESS 0x7f984a BYTE_ORDER MSB_LAST FORMAT "%5.3" /end MEASUREMENT
/begin MEASUREMENT lv_cyl_bal_lock_tco "bit showing that TCO conditions set cylinder balancing to state  OFF" UBYTE _CNV_A_R_LINEAR_____0_CM 1 0. 0. 1. DISPLAY_IDENTIFIER LV_CYL_BAL_LOCK_TCO ECU_ADDRESS 0x7fbde2 FORMAT "%1.0" /end MEASUREMENT
/begin MEASUREMENT lv_cyl_bal_tco_ramp_off "bit showing that the first ramp (for TCO condition) is no more active" UBYTE _CNV_A_R_LINEAR_____0_CM 1 0. 0. 1. DISPLAY_IDENTIFIER LV_CYL_BAL_TCO_RAMP_OFF ECU_ADDRESS 0x7fbde5 FORMAT "%1.0" /end MEASUREMENT
/begin MEASUREMENT lv_fac_cyl_bal_grd_lim_act "bit showing that gradient limitation is active" UBYTE _CNV_A_R_LINEAR_____0_CM 1 0. 0. 1. DISPLAY_IDENTIFIER LV_FAC_CYL_BAL_GRD_LIM_ACT ECU_ADDRESS 0x7fb80a FORMAT "%1.0" /end MEASUREMENT
/begin MEASUREMENT lv_t_dly_cyl_bal_lock_st "" UBYTE _CNV_A_R_LINEAR_____0_CM 1 0. 0. 1. DISPLAY_IDENTIFIER LV_T_DLY_CYL_BAL_LOCK_ST ECU_ADDRESS 0x7fb808 FORMAT "%1.0" /end MEASUREMENT
/begin MEASUREMENT n_max_bol_cyl_bal "lower enginespeed limit of variable weight" UWORD _CNV_A_R_LINEAR_____5_CM 1 0. 0. 6375. DISPLAY_IDENTIFIER N_MAX_BOL_CYL_BAL ECU_ADDRESS 0x7fa602 BYTE_ORDER MSB_LAST FORMAT "%4.0" /end MEASUREMENT
/begin MEASUREMENT n_max_tol_cyl_bal "upper enginespeed limit of variable weight" UWORD _CNV_A_R_LINEAR_____5_CM 1 0. 0. 6375. DISPLAY_IDENTIFIER N_MAX_TOL_CYL_BAL ECU_ADDRESS 0x7fa604 BYTE_ORDER MSB_LAST FORMAT "%4.0" /end MEASUREMENT
/begin MEASUREMENT lv_cyl_bal_lock "balancing is locked, balancing factors are set to 1" UBYTE _CNV_A_R_LINEAR_____0_CM 1 0. 0. 1. DISPLAY_IDENTIFIER LV_CYL_BAL_LOCK ECU_ADDRESS 0x7fb807 FORMAT "%1.0" /end MEASUREMENT
/begin MEASUREMENT lv_cyl_bal_init_tco "initialisation request for cylinder balancing controller for low TCO" UBYTE _CNV_A_R_LINEAR_____0_CM 1 0. 0. 1. DISPLAY_IDENTIFIER LV_CYL_BAL_INIT_TCO ECU_ADDRESS 0x7fb80c FORMAT "%1.0" /end MEASUREMENT
/begin MEASUREMENT fac_cyl_bal[0] "cylinder balancing factor x=0...NC_CYL_NR-1" UWORD _CNV_A_R_LINEAR_____48_CM 1 0. 0. 1.9999696 DISPLAY_IDENTIFIER FAC_CYL_BAL_0_ ECU_ADDRESS 0x7f9836 BYTE_ORDER MSB_LAST FORMAT "%5.3" /end MEASUREMENT
/begin MEASUREMENT fac_cyl_bal[1] "cylinder balancing factor x=0...NC_CYL_NR-1" UWORD _CNV_A_R_LINEAR_____48_CM 1 0. 0. 1.9999696 DISPLAY_IDENTIFIER FAC_CYL_BAL_1_ ECU_ADDRESS 0x7f9838 BYTE_ORDER MSB_LAST FORMAT "%5.3" /end MEASUREMENT
/begin MEASUREMENT fac_cyl_bal[2] "cylinder balancing factor x=0...NC_CYL_NR-1" UWORD _CNV_A_R_LINEAR_____48_CM 1 0. 0. 1.9999696 DISPLAY_IDENTIFIER FAC_CYL_BAL_2_ ECU_ADDRESS 0x7f983a BYTE_ORDER MSB_LAST FORMAT "%5.3" /end MEASUREMENT
/begin MEASUREMENT fac_cyl_bal_n_fdout[0] "" UWORD _CNV_A_R_LINEAR_____48_CM 1 0. 0. 1.9999696 DISPLAY_IDENTIFIER FAC_CYL_BAL_N_FDOUT_0_ ECU_ADDRESS 0x7fa606 BYTE_ORDER MSB_LAST FORMAT "%6.4" /end MEASUREMENT
/begin MEASUREMENT fac_cyl_bal_n_fdout[1] "" UWORD _CNV_A_R_LINEAR_____48_CM 1 0. 0. 1.9999696 DISPLAY_IDENTIFIER FAC_CYL_BAL_N_FDOUT_1_ ECU_ADDRESS 0x7fa608 BYTE_ORDER MSB_LAST FORMAT "%6.4" /end MEASUREMENT
/begin MEASUREMENT fac_cyl_bal_n_fdout[2] "" UWORD _CNV_A_R_LINEAR_____48_CM 1 0. 0. 1.9999696 DISPLAY_IDENTIFIER FAC_CYL_BAL_N_FDOUT_2_ ECU_ADDRESS 0x7fa60a BYTE_ORDER MSB_LAST FORMAT "%6.4" /end MEASUREMENT
/begin CHARACTERISTIC lc_cyl_bal_on "switch to enable balancing manually" VALUE 0x85ce66 _REC_VAL_20_u1 1. _CNV_A_R_LINEAR_____0_CM 0. 1. DISPLAY_IDENTIFIER LC_CYL_BAL_ON FORMAT "%1.0" /end CHARACTERISTIC
/begin CHARACTERISTIC lc_cyl_bal_init_tco_act "switch to enable reinitialization of controller for low TCO" VALUE 0x85ce65 _REC_VAL_20_u1 1. _CNV_A_R_LINEAR_____0_CM 0. 1. DISPLAY_IDENTIFIER LC_CYL_BAL_INIT_TCO_ACT FORMAT "%1.0" /end CHARACTERISTIC
/begin CHARACTERISTIC c_slop_tran_cyl_bal_off_on "slope for transition from factor 1 to stored values" VALUE 0x85cba0 _REC_VAL_20_u2 0.49999237 _CNV_A_R_LINEAR_____376_CM 0. 0.49999237 DISPLAY_IDENTIFIER C_SLOP_TRAN_CYL_BAL_OFF_ON FORMAT "%7.6" /end CHARACTERISTIC
/begin CHARACTERISTIC c_mf_bol_cyl_bal_fdout "start point for fadeout of cylinder balancing factors via fuelmass" VALUE 0x85cace _REC_VAL_20_u2 262.14 _CNV_A_R_LINEAR_____38_CM 0. 262.14 DISPLAY_IDENTIFIER C_MF_BOL_CYL_BAL_FDOUT FORMAT "%7.3" /end CHARACTERISTIC
/begin CHARACTERISTIC c_slop_fdout_cyl_bal_mf "slope for the balancing factor correction in dependence of MF_TOT" VALUE 0x85cb9e _REC_VAL_20_u2 125. _CNV_A_R_LINEAR_____377_CM 0. 125. DISPLAY_IDENTIFIER C_SLOP_FDOUT_CYL_BAL_MF FORMAT "%7.4" /end CHARACTERISTIC
/begin CHARACTERISTIC c_cyl_bal_pi_max "maximum threshold for controller output" VALUE 0x85c97a _REC_VAL_20_u2 1.9999696 _CNV_A_R_LINEAR_____48_CM 0. 1.9999696 DISPLAY_IDENTIFIER C_CYL_BAL_PI_MAX FORMAT "%6.5" /end CHARACTERISTIC
/begin CHARACTERISTIC c_cyl_bal_pi_min "minimum threshold for controller output" VALUE 0x85c97c _REC_VAL_20_u2 1.9999696 _CNV_A_R_LINEAR_____48_CM 0. 1.9999696 DISPLAY_IDENTIFIER C_CYL_BAL_PI_MIN FORMAT "%6.5" /end CHARACTERISTIC
/begin CHARACTERISTIC c_kr_pi_cyl_bal "gain for PI-controller" VALUE 0x85ca46 _REC_VAL_20_u2 0.9999874 _CNV_A_R_LINEAR_____87_CM 0. 0.9999874 DISPLAY_IDENTIFIER C_KR_PI_CYL_BAL FORMAT "%7.6" /end CHARACTERISTIC
/begin CHARACTERISTIC c_tn_pi_cyl_bal "integral action time for PI controller" VALUE 0x85cd26 _REC_VAL_20_u2 8388.48 _CNV_A_R_LINEAR_____378_CM 0. 8388.48 DISPLAY_IDENTIFIER C_TN_PI_CYL_BAL FORMAT "%6.2" /end CHARACTERISTIC
/begin CHARACTERISTIC lc_cyl_bal_init "switch to re-initialise the controller manually" VALUE 0x85ce64 _REC_VAL_20_u1 1. _CNV_A_R_LINEAR_____0_CM 0. 1. DISPLAY_IDENTIFIER LC_CYL_BAL_INIT FORMAT "%1.0" /end CHARACTERISTIC
/begin MEASUREMENT cyl_bal_pi[0] "output of the PI-controller x = 0...NC_CYL_NR-1" UWORD _CNV_A_R_LINEAR_____48_CM 1 0. 0. 1.9999696 DISPLAY_IDENTIFIER CYL_BAL_PI_0_ ECU_ADDRESS 0x7f984e BYTE_ORDER MSB_LAST FORMAT "%5.3" /end MEASUREMENT
/begin MEASUREMENT cyl_bal_pi[1] "output of the PI-controller x = 0...NC_CYL_NR-1" UWORD _CNV_A_R_LINEAR_____48_CM 1 0. 0. 1.9999696 DISPLAY_IDENTIFIER CYL_BAL_PI_1_ ECU_ADDRESS 0x7f9850 BYTE_ORDER MSB_LAST FORMAT "%5.3" /end MEASUREMENT
/begin MEASUREMENT cyl_bal_pi[2] "output of the PI-controller x = 0...NC_CYL_NR-1" UWORD _CNV_A_R_LINEAR_____48_CM 1 0. 0. 1.9999696 DISPLAY_IDENTIFIER CYL_BAL_PI_2_ ECU_ADDRESS 0x7f9852 BYTE_ORDER MSB_LAST FORMAT "%5.3" /end MEASUREMENT
/begin MEASUREMENT cyl_bal_pi_mmv "mean value over PI-controller output" UWORD _CNV_A_R_LINEAR_____48_CM 1 0. 0. 1.9999696 DISPLAY_IDENTIFIER CYL_BAL_PI_MMV ECU_ADDRESS 0x7fa610 BYTE_ORDER MSB_LAST FORMAT "%5.3" /end MEASUREMENT
/begin MEASUREMENT lv_t_dly_cyl_bal_act "" UBYTE _CNV_S_2_RANGE______3_CM 1 0. 0. 1. DISPLAY_IDENTIFIER LV_T_DLY_CYL_BAL_ACT ECU_ADDRESS 0x7fbde7 /end MEASUREMENT
/begin MEASUREMENT lv_t_dly_cyl_bal_lock "" UBYTE _CNV_A_R_LINEAR_____0_CM 1 0. 0. 1. DISPLAY_IDENTIFIER LV_T_DLY_CYL_BAL_LOCK ECU_ADDRESS 0x7fbde8 FORMAT "%1.0" /end MEASUREMENT
/begin MEASUREMENT sf_cyl_bal "state of cylinder balancing" UBYTE _CNV_S_3_Cylinder_B_379_CM 1 0. 1. 3. DISPLAY_IDENTIFIER SF_CYL_BAL ECU_ADDRESS 0x7fb80d /end MEASUREMENT
/begin MEASUREMENT lv_cyl_bal_pi_lim[0] "" UBYTE _CNV_S_2_RANGE______23_CM 1 0. 0. 1. DISPLAY_IDENTIFIER LV_CYL_BAL_PI_LIM_0_ ECU_ADDRESS 0x7fb80e /end MEASUREMENT
/begin MEASUREMENT lv_cyl_bal_pi_lim[1] "" UBYTE _CNV_S_2_RANGE______23_CM 1 0. 0. 1. DISPLAY_IDENTIFIER LV_CYL_BAL_PI_LIM_1_ ECU_ADDRESS 0x7fb80f /end MEASUREMENT
/begin MEASUREMENT lv_cyl_bal_pi_lim[2] "" UBYTE _CNV_S_2_RANGE______23_CM 1 0. 0. 1. DISPLAY_IDENTIFIER LV_CYL_BAL_PI_LIM_2_ ECU_ADDRESS 0x7fb810 /end MEASUREMENT
/begin MEASUREMENT lv_cyl_bal_pi_lim[3] "" UBYTE _CNV_S_2_RANGE______23_CM 1 0. 0. 1. DISPLAY_IDENTIFIER LV_CYL_BAL_PI_LIM_3_ ECU_ADDRESS 0x7fb811 /end MEASUREMENT
/begin MEASUREMENT lv_cyl_bal_init "flag for initialisation of controller" UBYTE _CNV_A_R_LINEAR_____0_CM 1 0. 0. 1. DISPLAY_IDENTIFIER LV_CYL_BAL_INIT ECU_ADDRESS 0x7fbde9 FORMAT "%1.0" /end MEASUREMENT
/begin CHARACTERISTIC c_fac_er_fil "filterfactor for ER lowpass" VALUE 0x85c9d8 _REC_VAL_20_u2 0.9999847412109381 _CNV_A_R_LINEAR_____14_CM 0. 0.9999847412109381 DISPLAY_IDENTIFIER C_FAC_ER_FIL FORMAT "%6.5" /end CHARACTERISTIC
/begin CHARACTERISTIC lc_swi_cyl_bal_inp "switches input signal for cylinder balancing controller" VALUE 0x85ceaa _REC_VAL_20_u1 1. _CNV_A_R_LINEAR_____0_CM 0. 1. DISPLAY_IDENTIFIER LC_SWI_CYL_BAL_INP FORMAT "%1.0" /end CHARACTERISTIC
/begin MEASUREMENT cyl_bal_dif[0] "control deviation cylinder balancing x=0...NC_CYL_NR-1" SWORD _CNV_A_R_LINEAR_____374_CM 1 0. -8. 7.999755856 DISPLAY_IDENTIFIER CYL_BAL_DIF_0_ ECU_ADDRESS 0x7f9862 BYTE_ORDER MSB_LAST FORMAT "%6.5" /end MEASUREMENT
/begin MEASUREMENT cyl_bal_dif[1] "control deviation cylinder balancing x=0...NC_CYL_NR-1" SWORD _CNV_A_R_LINEAR_____374_CM 1 0. -8. 7.999755856 DISPLAY_IDENTIFIER CYL_BAL_DIF_1_ ECU_ADDRESS 0x7f9864 BYTE_ORDER MSB_LAST FORMAT "%6.5" /end MEASUREMENT
/begin MEASUREMENT cyl_bal_dif[2] "control deviation cylinder balancing x=0...NC_CYL_NR-1" SWORD _CNV_A_R_LINEAR_____374_CM 1 0. -8. 7.999755856 DISPLAY_IDENTIFIER CYL_BAL_DIF_2_ ECU_ADDRESS 0x7f9866 BYTE_ORDER MSB_LAST FORMAT "%6.5" /end MEASUREMENT
/begin MEASUREMENT cyl_nr_cyl_bal "offset corrected cylinder number for balancing" UBYTE _CNV_A_R_LINEAR_____0_CM 1 0. 0. 255. DISPLAY_IDENTIFIER CYL_NR_CYL_BAL ECU_ADDRESS 0x7fb812 FORMAT "%3.0" /end MEASUREMENT
/begin MEASUREMENT lv_intv_thr[0] "open loop control active" UBYTE _CNV_S_2_RANGE______11_CM 1 0. 0. 1. DISPLAY_IDENTIFIER LV_INTV_THR_0_ ECU_ADDRESS 0x7fb84e /end MEASUREMENT
/begin MEASUREMENT intv_thr[0] "open loop control signal" SWORD _CNV_A_R_LINEAR_____136_CM 1 0. -100. 99.9969482421875 DISPLAY_IDENTIFIER INTV_THR_0_ ECU_ADDRESS 0x7f9880 BYTE_ORDER MSB_LAST FORMAT "%5.3" /end MEASUREMENT
/begin CHARACTERISTIC ip_ctl_max_thr_grd "GE_TCLP: maximum limit of THR_j controller output depending on actuator velocity" MAP 0x8452d0 _REC_MAP_20_u2_u2_u2 199.9969482 _CNV_A_R_LINEAR_____161_CM -100. 99.99694820000001 DISPLAY_IDENTIFIER IP_CTL_MAX_THR_GRD FORMAT "%5.3"
 /begin AXIS_DESCR COM_AXIS ang_thr_fil[0] _CNV_A_R_LINEAR_____161_CM 6 -100. 99.99694820000001 FORMAT "%5.3" AXIS_PTS_REF ldp_ang_thr_ip_ctl_max /end AXIS_DESCR
 /begin AXIS_DESCR COM_AXIS ang_grd_thr_fil[0] _CNV_A_R_LINEAR_____427_CM 6 -32768. 32766. FORMAT "%10.5" AXIS_PTS_REF ldp_ang_grd_thr_ip_ctl_max /end AXIS_DESCR
/end CHARACTERISTIC
/begin AXIS_PTS ldp_ang_thr_ip_ctl_max "" 0x8413d2 ang_thr_fil[0] _REC_AXS_20_u2 199.9969482 _CNV_A_R_LINEAR_____161_CM 6 -100. 99.99694820000001 FORMAT "%5.3" /end AXIS_PTS
/begin AXIS_PTS ldp_ang_grd_thr_ip_ctl_max "" 0x84134e ang_grd_thr_fil[0] _REC_AXS_20_u2 65534. _CNV_A_R_LINEAR_____427_CM 6 -32768. 32766. FORMAT "%10.5" /end AXIS_PTS
/begin CHARACTERISTIC ip_ctl_min_thr_grd "GE_TCLP: minimum limit of THR_j controller output depending on actuator velocity" MAP 0x845318 _REC_MAP_20_u2_u2_u2 199.9969482 _CNV_A_R_LINEAR_____161_CM -100. 99.99694820000001 DISPLAY_IDENTIFIER IP_CTL_MIN_THR_GRD FORMAT "%5.3"
 /begin AXIS_DESCR COM_AXIS ang_thr_fil[0] _CNV_A_R_LINEAR_____161_CM 6 -100. 99.99694820000001 FORMAT "%5.3" AXIS_PTS_REF ldp_ang_thr_ip_ctl_min /end AXIS_DESCR
 /begin AXIS_DESCR COM_AXIS ang_grd_thr_fil[0] _CNV_A_R_LINEAR_____427_CM 6 -32768. 32766. FORMAT "%10.5" AXIS_PTS_REF ldp_ang_grd_thr_ip_ctl_min /end AXIS_DESCR
/end CHARACTERISTIC
/begin AXIS_PTS ldp_ang_thr_ip_ctl_min "" 0x8413e0 ang_thr_fil[0] _REC_AXS_20_u2 199.9969482 _CNV_A_R_LINEAR_____161_CM 6 -100. 99.99694820000001 FORMAT "%5.3" /end AXIS_PTS
/begin AXIS_PTS ldp_ang_grd_thr_ip_ctl_min "" 0x84135c ang_grd_thr_fil[0] _REC_AXS_20_u2 65534. _CNV_A_R_LINEAR_____427_CM 6 -32768. 32766. FORMAT "%10.5" /end AXIS_PTS
/begin MEASUREMENT ad_thr_mmv[0] "adaption signal" SWORD _CNV_A_R_LINEAR_____12_CM 1 0. -100. 99.996948242 DISPLAY_IDENTIFIER AD_THR_MMV_0_ ECU_ADDRESS 0x7f9882 BYTE_ORDER MSB_LAST FORMAT "%5.3" /end MEASUREMENT
/begin MEASUREMENT lv_ad_thr[0] "enable flag for the EGR- throttle adaption" UBYTE _CNV_S_2_RANGE______11_CM 1 0. 0. 1. DISPLAY_IDENTIFIER LV_AD_THR_0_ ECU_ADDRESS 0x7fb84f /end MEASUREMENT
/begin MEASUREMENT lv_v_thr_tol_ad_orng[0] "minimum of sensor value at top limit out of range" UBYTE _CNV_S_2_RANGE______11_CM 1 0. 0. 1. DISPLAY_IDENTIFIER LV_V_THR_TOL_AD_ORNG_0_ ECU_ADDRESS 0x7fbe2c /end MEASUREMENT
/begin MEASUREMENT v_thr_tol[0] "adaption value of V_THR_TOL_j" UWORD _CNV_A_R_LINEAR_____415_CM 1 0. 0. 319.995172 DISPLAY_IDENTIFIER V_THR_TOL_0_ ECU_ADDRESS 0x7f9884 BYTE_ORDER MSB_LAST /end MEASUREMENT
/begin MEASUREMENT lv_cdn_ad_v_thr_tol[0] "period of time when then new adaption value is stored" UBYTE _CNV_S_2_RANGE______11_CM 1 0. 0. 1. DISPLAY_IDENTIFIER LV_CDN_AD_V_THR_TOL_0_ ECU_ADDRESS 0x7fbe2d /end MEASUREMENT
/begin MEASUREMENT v_thr_tol_det[0] "sampled value of V_THR_i" UWORD _CNV_A_R_LINEAR_____415_CM 1 0. 0. 319.995172 DISPLAY_IDENTIFIER V_THR_TOL_DET_0_ ECU_ADDRESS 0x7fa682 BYTE_ORDER MSB_LAST /end MEASUREMENT
/begin MEASUREMENT t_ad_thr_bol_av[0] "adaption time at the bottom limit" UWORD _CNV_A_R_LINEAR_____73_CM 1 0. 0. 65.535 DISPLAY_IDENTIFIER T_AD_THR_BOL_AV_0_ ECU_ADDRESS 0x7fa684 BYTE_ORDER MSB_LAST FORMAT "%5.3" /end MEASUREMENT
/begin MEASUREMENT lv_ad_thr_bol[0] "enabled adaption at the bottom limit" UBYTE _CNV_S_2_RANGE______11_CM 1 0. 0. 1. DISPLAY_IDENTIFIER LV_AD_THR_BOL_0_ ECU_ADDRESS 0x7fb850 /end MEASUREMENT
/begin MEASUREMENT lv_ad_thr_bol_req[0] "requested enabled adaption at the bottom limit" UBYTE _CNV_S_2_RANGE______11_CM 1 0. 0. 1. DISPLAY_IDENTIFIER LV_AD_THR_BOL_REQ_0_ ECU_ADDRESS 0x7fbe2e /end MEASUREMENT
/begin MEASUREMENT lv_ad_thr_tol_req[0] "requested enabled adaption at the top limit" UBYTE _CNV_S_2_RANGE______11_CM 1 0. 0. 1. DISPLAY_IDENTIFIER LV_AD_THR_TOL_REQ_0_ ECU_ADDRESS 0x7fbe2f /end MEASUREMENT
/begin MEASUREMENT lv_ena_ad_thr[0] "enabled ad. EGR throttle sensor" UBYTE _CNV_S_2_RANGE______11_CM 1 0. 0. 1. DISPLAY_IDENTIFIER LV_ENA_AD_THR_0_ ECU_ADDRESS 0x7fbe30 /end MEASUREMENT
/begin MEASUREMENT t_ad_thr_tol_av[0] "adaption time at the top limit" UWORD _CNV_A_R_LINEAR_____73_CM 1 0. 0. 65.535 DISPLAY_IDENTIFIER T_AD_THR_TOL_AV_0_ ECU_ADDRESS 0x7fa686 BYTE_ORDER MSB_LAST FORMAT "%5.3" /end MEASUREMENT
/begin MEASUREMENT lv_ad_thr_tol[0] "enabled adaption at the top limit" UBYTE _CNV_S_2_RANGE______11_CM 1 0. 0. 1. DISPLAY_IDENTIFIER LV_AD_THR_TOL_0_ ECU_ADDRESS 0x7fb851 /end MEASUREMENT
/begin MEASUREMENT lv_v_thr_bol_ad_orng[0] "minimum of sensor value at bottom limit out of range" UBYTE _CNV_S_2_RANGE______11_CM 1 0. 0. 1. DISPLAY_IDENTIFIER LV_V_THR_BOL_AD_ORNG_0_ ECU_ADDRESS 0x7fb852 /end MEASUREMENT
/begin MEASUREMENT v_thr_bol[0] "adaption value of V_THR_BOL_j" UWORD _CNV_A_R_LINEAR_____415_CM 1 0. 0. 319.995172 DISPLAY_IDENTIFIER V_THR_BOL_0_ ECU_ADDRESS 0x7f9886 BYTE_ORDER MSB_LAST /end MEASUREMENT
/begin MEASUREMENT lv_cdn_ad_v_thr_bol[0] "period of time when then new adaption value is stored" UBYTE _CNV_S_2_RANGE______11_CM 1 0. 0. 1. DISPLAY_IDENTIFIER LV_CDN_AD_V_THR_BOL_0_ ECU_ADDRESS 0x7fb853 /end MEASUREMENT
/begin MEASUREMENT v_thr_bol_det[0] "sampled value of V_THR_i" UWORD _CNV_A_R_LINEAR_____415_CM 1 0. 0. 319.995172 DISPLAY_IDENTIFIER V_THR_BOL_DET_0_ ECU_ADDRESS 0x7fa688 BYTE_ORDER MSB_LAST /end MEASUREMENT
/begin CHARACTERISTIC c_crlc_ad_thr[0] "correlation coefficient for adaption of THR" VALUE 0x85c8f6 _REC_VAL_20_u2 0.9999847412109381 _CNV_A_R_LINEAR_____14_CM 0. 0.9999847412109381 DISPLAY_IDENTIFIER C_CRLC_AD_THR_0 FORMAT "%6.5" /end CHARACTERISTIC
/begin CHARACTERISTIC c_crlc_v_thr_tol[0] "correlation of V_THR_i during adaption at top limit" VALUE 0x85c91a _REC_VAL_20_u2 0.9999847412109381 _CNV_A_R_LINEAR_____14_CM 0. 0.9999847412109381 DISPLAY_IDENTIFIER C_CRLC_V_THR_0_TOL FORMAT "%6.5" /end CHARACTERISTIC
/begin CHARACTERISTIC c_v_thr_max_ad_tol[0] "allowed maximum adaption value of V_THR_j at top limit" VALUE 0x85cdea _REC_VAL_20_u2 319.995172 _CNV_A_R_LINEAR_____415_CM 0. 319.995172 DISPLAY_IDENTIFIER C_V_THR_0_MAX_AD_TOL /end CHARACTERISTIC
/begin CHARACTERISTIC c_v_thr_min_ad_tol[0] "allowed minimum adaption value of V_THR at top limit" VALUE 0x85cdf6 _REC_VAL_20_u2 319.995172 _CNV_A_R_LINEAR_____415_CM 0. 319.995172 DISPLAY_IDENTIFIER C_V_THR_0_MIN_AD_TOL /end CHARACTERISTIC
/begin CHARACTERISTIC lc_v_thr_tol_sub[0] "activation of substitute value of V_THR_j_TOL at top limit if an adaption error is detected" VALUE 0x85cecf _REC_VAL_20_u1 1. _CNV_A_R_LINEAR_____0_CM 0. 1. DISPLAY_IDENTIFIER LC_V_THR_0_TOL_SUB FORMAT "%1.0" /end CHARACTERISTIC
/begin CHARACTERISTIC c_v_thr_tol_sub[0] "substitute value of V_THR_j_TOL at top limit if an adaption error is detected" VALUE 0x85cdfe _REC_VAL_20_u2 319.995172 _CNV_A_R_LINEAR_____415_CM 0. 319.995172 DISPLAY_IDENTIFIER C_V_THR_0_TOL_SUB /end CHARACTERISTIC
/begin CHARACTERISTIC c_ang_sp_ad_thr_bol[0] "activation threshold for adaption at the bottom limit" VALUE 0x85c88e _REC_VAL_20_u2 99.99847412109381 _CNV_A_R_LINEAR_____8_CM 0. 99.99847412109381 DISPLAY_IDENTIFIER C_ANG_SP_AD_THR_0_BOL FORMAT "%5.3" /end CHARACTERISTIC
/begin CHARACTERISTIC c_v_grd_thr_st_ad_bol[0] "maximum gradient of potentiometer voltage to start adaption" VALUE 0x85cd94 _REC_VAL_20_u1 124.511719 _CNV_A_R_LINEAR_____416_CM 0. 124.511719 DISPLAY_IDENTIFIER C_V_GRD_THR_0_ST_AD_BOL FORMAT "%4.1" /end CHARACTERISTIC
/begin CHARACTERISTIC c_temp_st_ad_thr_max[0] "maximum ambient temperature to start adaption" VALUE 0x85cce5 _REC_VAL_20_u1 255. _CNV_A_R_LINEAR_____18_CM -50. 205. DISPLAY_IDENTIFIER C_TEMP_ST_AD_THR_0_MAX FORMAT "%3.0" /end CHARACTERISTIC
/begin CHARACTERISTIC c_temp_st_ad_thr_min[0] "minimum ambient temperature to start adaption" VALUE 0x85cce7 _REC_VAL_20_u1 255. _CNV_A_R_LINEAR_____18_CM -50. 205. DISPLAY_IDENTIFIER C_TEMP_ST_AD_THR_0_MIN FORMAT "%3.0" /end CHARACTERISTIC
/begin CHARACTERISTIC c_v_thr_max_st_ad_bol[0] "value of V_THR to start adaption" VALUE 0x85cdee _REC_VAL_20_u2 319.995172 _CNV_A_R_LINEAR_____415_CM 0. 319.995172 DISPLAY_IDENTIFIER C_V_THR_0_MAX_ST_AD_BOL /end CHARACTERISTIC
/begin CHARACTERISTIC c_t_ad_thr_bol[0] "adaption time at the bottom limit" VALUE 0x85cbfe _REC_VAL_20_u2 65.535 _CNV_A_R_LINEAR_____73_CM 0. 65.535 DISPLAY_IDENTIFIER C_T_AD_THR_0_BOL FORMAT "%5.3" /end CHARACTERISTIC
/begin CHARACTERISTIC c_t_ad_thr_bol_ini[0] "initialization of learning unit" VALUE 0x85cc02 _REC_VAL_20_u2 65.535 _CNV_A_R_LINEAR_____73_CM 0. 65.535 DISPLAY_IDENTIFIER C_T_AD_THR_0_BOL_INI FORMAT "%5.3" /end CHARACTERISTIC
/begin CHARACTERISTIC c_ang_sp_ad_thr_tol[0] "activation threshold for adaption at the top limit" VALUE 0x85c892 _REC_VAL_20_u2 99.99847412109381 _CNV_A_R_LINEAR_____8_CM 0. 99.99847412109381 DISPLAY_IDENTIFIER C_ANG_SP_AD_THR_0_TOL FORMAT "%5.3" /end CHARACTERISTIC
/begin CHARACTERISTIC c_v_grd_thr_st_ad_tol[0] "maximum gradient of potentiometer voltage to start adaption" VALUE 0x85cd96 _REC_VAL_20_u1 124.511719 _CNV_A_R_LINEAR_____416_CM 0. 124.511719 DISPLAY_IDENTIFIER C_V_GRD_THR_0_ST_AD_TOL FORMAT "%4.1" /end CHARACTERISTIC
/begin CHARACTERISTIC c_v_thr_min_st_ad_tol[0] "value of V_THR to start adaption" VALUE 0x85cdfa _REC_VAL_20_u2 319.995172 _CNV_A_R_LINEAR_____415_CM 0. 319.995172 DISPLAY_IDENTIFIER C_V_THR_0_MIN_ST_AD_TOL /end CHARACTERISTIC
/begin CHARACTERISTIC c_t_ad_thr_tol[0] "adaption time at the top limit" VALUE 0x85cc06 _REC_VAL_20_u2 65.535 _CNV_A_R_LINEAR_____73_CM 0. 65.535 DISPLAY_IDENTIFIER C_T_AD_THR_0_TOL FORMAT "%5.3" /end CHARACTERISTIC
/begin CHARACTERISTIC c_t_ad_thr_tol_ini[0] "initialization of learning unit" VALUE 0x85cc0a _REC_VAL_20_u2 65.535 _CNV_A_R_LINEAR_____73_CM 0. 65.535 DISPLAY_IDENTIFIER C_T_AD_THR_0_TOL_INI FORMAT "%5.3" /end CHARACTERISTIC
/begin CHARACTERISTIC c_crlc_v_thr_bol[0] "correlation of V_THR_i during adaption at bottom limit" VALUE 0x85c916 _REC_VAL_20_u2 0.9999847412109381 _CNV_A_R_LINEAR_____14_CM 0. 0.9999847412109381 DISPLAY_IDENTIFIER C_CRLC_V_THR_0_BOL FORMAT "%6.5" /end CHARACTERISTIC
/begin CHARACTERISTIC c_v_thr_max_ad_bol[0] "allowed maximum adaption value of V_THR at bottom limit" VALUE 0x85cde6 _REC_VAL_20_u2 319.995172 _CNV_A_R_LINEAR_____415_CM 0. 319.995172 DISPLAY_IDENTIFIER C_V_THR_0_MAX_AD_BOL /end CHARACTERISTIC
/begin CHARACTERISTIC c_v_thr_min_ad_bol[0] "allowed minimum adaption value of V_THR at bottom limit" VALUE 0x85cdf2 _REC_VAL_20_u2 319.995172 _CNV_A_R_LINEAR_____415_CM 0. 319.995172 DISPLAY_IDENTIFIER C_V_THR_0_MIN_AD_BOL /end CHARACTERISTIC
/begin CHARACTERISTIC lc_v_thr_bol_sub[0] "activation of substitute value of V_THR_j_BOL at bottom limit if an adaption error is detected" VALUE 0x85cecd _REC_VAL_20_u1 1. _CNV_A_R_LINEAR_____0_CM 0. 1. DISPLAY_IDENTIFIER LC_V_THR_0_BOL_SUB FORMAT "%1.0" /end CHARACTERISTIC
/begin CHARACTERISTIC c_v_thr_bol_sub[0] "substitute value of V_THR_j_BOL at bottom limit if an adaption error is detected" VALUE 0x85cde2 _REC_VAL_20_u2 319.995172 _CNV_A_R_LINEAR_____415_CM 0. 319.995172 DISPLAY_IDENTIFIER C_V_THR_0_BOL_SUB /end CHARACTERISTIC
/begin CHARACTERISTIC id_ad_thr_bol__t_ad_thr "GE_TAD: actuator signal during BOL adaption" CURVE 0x850286 _REC_CUR_20_u2_u2 199.9969482 _CNV_A_R_LINEAR_____161_CM -100. 99.99694820000001 DISPLAY_IDENTIFIER ID_AD_THR_BOL__T_AD_THR FORMAT "%5.3"
 /begin AXIS_DESCR COM_AXIS t_ad_thr_bol_av[0] _CNV_A_R_LINEAR_____73_CM 4 0. 65.535 FORMAT "%5.3" AXIS_PTS_REF ldp_t_ad_thr_bol__ip_ad_thr /end AXIS_DESCR
/end CHARACTERISTIC
/begin AXIS_PTS ldp_t_ad_thr_bol__ip_ad_thr "" 0x8421d0 t_ad_thr_bol_av[0] _REC_AXS_20_u2 65.535 _CNV_A_R_LINEAR_____73_CM 4 0. 65.535 FORMAT "%5.3" /end AXIS_PTS
/begin CHARACTERISTIC id_ad_thr_tol__t_ad_thr "GE_TAD: actuator signal during TOL adaption" CURVE 0x85028e _REC_CUR_20_u2_u2 199.9969482 _CNV_A_R_LINEAR_____161_CM -100. 99.99694820000001 DISPLAY_IDENTIFIER ID_AD_THR_TOL__T_AD_THR FORMAT "%5.3"
 /begin AXIS_DESCR COM_AXIS t_ad_thr_tol_av[0] _CNV_A_R_LINEAR_____73_CM 4 0. 65.535 FORMAT "%5.3" AXIS_PTS_REF ldp_t_ad_thr_tol__ip_ad_thr /end AXIS_DESCR
/end CHARACTERISTIC
/begin AXIS_PTS ldp_t_ad_thr_tol__ip_ad_thr "" 0x8421da t_ad_thr_tol_av[0] _REC_AXS_20_u2 65.535 _CNV_A_R_LINEAR_____73_CM 4 0. 65.535 FORMAT "%5.3" /end AXIS_PTS
/begin CHARACTERISTIC c_vb_max_ad_thr "maximum battery voltage for THR adaption" VALUE 0x85ce0e _REC_VAL_20_u1 28.8 _CNV_A_R_LINEAR_____43_CM 0. 28.8 DISPLAY_IDENTIFIER C_VB_MAX_AD_THR /end CHARACTERISTIC
/begin CHARACTERISTIC c_vb_min_ad_thr "minimum battery voltage for THR adaption" VALUE 0x85ce12 _REC_VAL_20_u1 28.8 _CNV_A_R_LINEAR_____43_CM 0. 28.8 DISPLAY_IDENTIFIER C_VB_MIN_AD_THR /end CHARACTERISTIC
/begin MEASUREMENT lv_ena_ad_thr_ext[0] "enabled adaption of the thr pos sensor" UBYTE _CNV_S_2_RANGE______11_CM 1 0. 0. 1. DISPLAY_IDENTIFIER LV_ENA_AD_THR_EXT_0_ ECU_ADDRESS 0x7fb875 /end MEASUREMENT
/begin MEASUREMENT portpwm_hys_out "Output of hysteresis" UBYTE _CNV_A_R_LINEAR_____0_CM 1 0. 0. 1. DISPLAY_IDENTIFIER PORTPWM_HYS_OUT ECU_ADDRESS 0x7fbe77 FORMAT "%1.0" /end MEASUREMENT
/begin MEASUREMENT portpwm_wout_hys "Duty cycle without hysteresis" UWORD _CNV_A_R_LINEAR_____204_CM 1 0. 0. 99.972117 DISPLAY_IDENTIFIER PORTPWM_WOUT_HYS ECU_ADDRESS 0x7fa942 BYTE_ORDER MSB_LAST FORMAT "%5.3" /end MEASUREMENT
/begin MEASUREMENT portpwm_hys "Duty cycle with hysteresis" UWORD _CNV_A_R_LINEAR_____204_CM 1 0. 0. 99.972117 DISPLAY_IDENTIFIER PORTPWM_HYS ECU_ADDRESS 0x7fa940 BYTE_ORDER MSB_LAST FORMAT "%5.3" /end MEASUREMENT
/begin MEASUREMENT portpwm "Duty cycle of swirl flap" UWORD _CNV_A_R_LINEAR_____204_CM 1 0. 0. 99.972117 DISPLAY_IDENTIFIER PORTPWM ECU_ADDRESS 0x7f99c8 BYTE_ORDER MSB_LAST FORMAT "%5.3" /end MEASUREMENT
/begin CHARACTERISTIC c_ducy_on "Value of duty for hysteresis on" VALUE 0x84fcaa _REC_VAL_20_u2 99.972117 _CNV_A_R_LINEAR_____204_CM 0. 99.972117 DISPLAY_IDENTIFIER C_DUCY_ON FORMAT "%6.5" /end CHARACTERISTIC
/begin CHARACTERISTIC c_ducy_off "Upper value for duty cycle for hysteresis" VALUE 0x84fca8 _REC_VAL_20_u2 99.972117 _CNV_A_R_LINEAR_____204_CM 0. 99.972117 DISPLAY_IDENTIFIER C_DUCY_OFF FORMAT "%6.5" /end CHARACTERISTIC
/begin CHARACTERISTIC c_ducy_hys_up "Upper value for the hysteresis" VALUE 0x84fca6 _REC_VAL_20_u2 99.972117 _CNV_A_R_LINEAR_____204_CM 0. 99.972117 DISPLAY_IDENTIFIER C_DUCY_HYS_UP FORMAT "%6.5" /end CHARACTERISTIC
/begin CHARACTERISTIC c_ducy_hys_down "lower level for the hysteresis" VALUE 0x84fca4 _REC_VAL_20_u2 99.972117 _CNV_A_R_LINEAR_____204_CM 0. 99.972117 DISPLAY_IDENTIFIER C_DUCY_HYS_DOWN FORMAT "%6.5" /end CHARACTERISTIC
/begin CHARACTERISTIC ip_portpwm__n__mf_tot "GE_SWRL: Swirl map" MAP 0x84d532 _REC_MAP_20_u2_u2_u2 99.972117 _CNV_A_R_LINEAR_____204_CM 0. 99.972117 DISPLAY_IDENTIFIER IP_PORTPWM__N__MF_TOT FORMAT "%5.3"
 /begin AXIS_DESCR COM_AXIS n _CNV_A_R_LINEAR_____5_CM 5 0. 8160. FORMAT "%4.0" AXIS_PTS_REF ldp_n_ip_portpwm /end AXIS_DESCR
 /begin AXIS_DESCR COM_AXIS mf_tot _CNV_A_R_LINEAR_____50_CM 5 0. 65.535 FORMAT "%5.3" AXIS_PTS_REF ldp_mf_tot_ip_portpwm /end AXIS_DESCR
/end CHARACTERISTIC
/begin AXIS_PTS ldp_n_ip_portpwm "" 0x841cca n _REC_AXS_20_u2 8160. _CNV_A_R_LINEAR_____5_CM 5 0. 8160. FORMAT "%4.0" /end AXIS_PTS
/begin AXIS_PTS ldp_mf_tot_ip_portpwm "" 0x8418c2 mf_tot _REC_AXS_20_u2 65.535 _CNV_A_R_LINEAR_____50_CM 5 0. 65.535 FORMAT "%5.3" /end AXIS_PTS
/begin COMPU_METHOD _CNV_A_R_LINEAR_____0_CM "" RAT_FUNC "%6.3" "[-]" COEFFS 0 1. 0. 0 0 1 /end COMPU_METHOD
/begin COMPU_METHOD _CNV_S_2_RANGE______3_CM "" TAB_VERB "%6.3" "[-]" COMPU_TAB_REF _CNV_S_2_RANGE______3 /end COMPU_METHOD
/begin COMPU_VTAB _CNV_S_2_RANGE______3 "" TAB_VERB 2 0 "" 1 "1" /end COMPU_VTAB
/begin COMPU_METHOD _CNV_A_R_LINEAR_____5_CM "" RAT_FUNC "%6.3" "[rpm]" COEFFS 0 1. 0. 0 0 1 /end COMPU_METHOD
/begin COMPU_METHOD _CNV_A_R_LINEAR_____7_CM "" RAT_FUNC "%6.3" "[cm^2]" COEFFS 0 839.3314549180328 0. 0 0 1 /end COMPU_METHOD
/begin COMPU_METHOD _CNV_A_R_LINEAR_____8_CM "" RAT_FUNC "%6.3" "[%]" COEFFS 0 655.3599999999997 0. 0 0 1 /end COMPU_METHOD
/begin COMPU_METHOD _CNV_S_2_RANGE______11_CM "" TAB_VERB "%6.3" "[-]" COMPU_TAB_REF _CNV_S_2_RANGE______11 /end COMPU_METHOD
/begin COMPU_VTAB _CNV_S_2_RANGE______11 "" TAB_VERB 2 0 "0" 1 "1" /end COMPU_VTAB
/begin COMPU_METHOD _CNV_A_R_LINEAR_____12_CM "" RAT_FUNC "%6.3" "[%]" COEFFS 0 327.6800000003072 3.071909304708242e-008 0 0 1 /end COMPU_METHOD
/begin COMPU_METHOD _CNV_A_R_LINEAR_____13_CM "" RAT_FUNC "%6.3" "[-]" COEFFS 0 4096.000220003369 0. 0 0 1 /end COMPU_METHOD
/begin COMPU_METHOD _CNV_A_R_LINEAR_____14_CM "" RAT_FUNC "%6.3" "[-]" COEFFS 0 65535.99999999996 0. 0 0 1 /end COMPU_METHOD
/begin COMPU_METHOD _CNV_A_R_LINEAR_____15_CM "" RAT_FUNC "%6.3" "[-]" COEFFS 0 16384. 0. 0 0 1 /end COMPU_METHOD
/begin COMPU_METHOD _CNV_A_R_LINEAR_____18_CM "" RAT_FUNC "%6.3" "[°C]" COEFFS 0 1. 50. 0 0 1 /end COMPU_METHOD
/begin COMPU_METHOD _CNV_A_R_LINEAR_____19_CM "" RAT_FUNC "%6.3" "[s]" COEFFS 0 10. 0. 0 0 1 /end COMPU_METHOD
/begin COMPU_METHOD _CNV_A_R_LINEAR_____20_CM "" RAT_FUNC "%6.3" "[°C]" COEFFS 0 1. 0. 0 0 1 /end COMPU_METHOD
/begin COMPU_METHOD _CNV_S_2_RANGE______23_CM "" TAB_VERB "%6.3" "[-]" COMPU_TAB_REF _CNV_S_2_RANGE______23 /end COMPU_METHOD
/begin COMPU_VTAB _CNV_S_2_RANGE______23 "" TAB_VERB 2 0 "passive" 1 "active" /end COMPU_VTAB
/begin COMPU_METHOD _CNV_A_R_LINEAR_____38_CM "" RAT_FUNC "%6.3" "[mg/stk]" COEFFS 0 250. 0. 0 0 1 /end COMPU_METHOD
/begin COMPU_METHOD _CNV_A_R_LINEAR_____43_CM "" RAT_FUNC "%6.3" "[V]" COEFFS 0 8.854166666666666 0. 0 0 1 /end COMPU_METHOD
/begin COMPU_METHOD _CNV_A_R_LINEAR_____45_CM "" RAT_FUNC "%6.3" "[hPa]" COEFFS 0 12.06017666543982 0. 0 0 1 /end COMPU_METHOD
/begin COMPU_METHOD _CNV_A_R_LINEAR_____48_CM "" RAT_FUNC "%6.3" "[-]" COEFFS 0 32767.99807357072 0. 0 0 1 /end COMPU_METHOD
/begin COMPU_METHOD _CNV_A_R_LINEAR_____50_CM "" RAT_FUNC "%6.3" "[mg/stk]" COEFFS 0 1000. 0. 0 0 1 /end COMPU_METHOD
/begin COMPU_METHOD _CNV_A_R_LINEAR_____52_CM "" RAT_FUNC "%6.3" "[Nm]" COEFFS 0 32. 0. 0 0 1 /end COMPU_METHOD
/begin COMPU_METHOD _CNV_A_R_LINEAR_____57_CM "" RAT_FUNC "%6.3" "[hPa]" COEFFS 0 12.06036070024094 2.255463186884299e-005 0 0 1 /end COMPU_METHOD
/begin COMPU_METHOD _CNV_A_R_LINEAR_____59_CM "" RAT_FUNC "%6.3" "[-]" COEFFS 0 16383.81262712377 0. 0 0 1 /end COMPU_METHOD
/begin COMPU_METHOD _CNV_A_R_LINEAR_____60_CM "" RAT_FUNC "%6.3" "[mg/stk]" COEFFS 0 47.18142548596112 0. 0 0 1 /end COMPU_METHOD
/begin COMPU_METHOD _CNV_A_R_LINEAR_____64_CM "" RAT_FUNC "%6.3" "[s]" COEFFS 0 15625. 0. 0 0 1 /end COMPU_METHOD
/begin COMPU_METHOD _CNV_A_R_LINEAR_____73_CM "" RAT_FUNC "%6.3" "[s]" COEFFS 0 1000. 0. 0 0 1 /end COMPU_METHOD
/begin COMPU_METHOD _CNV_A_R_LINEAR_____87_CM "" RAT_FUNC "%6.3" "[-]" COEFFS 0 65535.82575140447 0. 0 0 1 /end COMPU_METHOD
/begin COMPU_METHOD _CNV_A_R_LINEAR_____95_CM "" RAT_FUNC "%6.3" "[-]" COEFFS 0 64. 0. 0 0 1 /end COMPU_METHOD
/begin COMPU_METHOD _CNV_A_R_LINEAR_____101_CM "" RAT_FUNC "%6.3" "[-]" COEFFS 0 128. 0. 0 0 1 /end COMPU_METHOD
/begin COMPU_METHOD _CNV_A_R_LINEAR_____110_CM "" RAT_FUNC "%6.3" "[kg/h]" COEFFS 0 64. 0. 0 0 1 /end COMPU_METHOD
/begin COMPU_METHOD _CNV_A_R_LINEAR_____118_CM "" RAT_FUNC "%6.3" "[°CRK]" COEFFS 0 42.66666666666666 5120. 0 0 1 /end COMPU_METHOD
/begin COMPU_METHOD _CNV_A_R_LINEAR_____119_CM "" RAT_FUNC "%6.3" "[°CRK]" COEFFS 0 42.66666666666666 0. 0 0 1 /end COMPU_METHOD
/begin COMPU_METHOD _CNV_A_R_LINEAR_____136_CM "" RAT_FUNC "%6.3" "[%]" COEFFS 0 327.68 0. 0 0 1 /end COMPU_METHOD
/begin COMPU_METHOD _CNV_A_R_LINEAR_____146_CM "" RAT_FUNC "%6.3" "[hPa]" COEFFS 0 12.06017666543982 32768.00000286437 0 0 1 /end COMPU_METHOD
/begin COMPU_METHOD _CNV_A_R_LINEAR_____151_CM "" RAT_FUNC "%6.3" "[mg/stk]" COEFFS 0 47.18213882283317 -4.587542360241059e-003 0 0 1 /end COMPU_METHOD
/begin COMPU_METHOD _CNV_A_R_LINEAR_____157_CM "" RAT_FUNC "%6.3" "[°C]" COEFFS 0 64. 0. 0 0 1 /end COMPU_METHOD
/begin COMPU_METHOD _CNV_A_R_LINEAR_____158_CM "" RAT_FUNC "%6.3" "[cm^2]" COEFFS 0 419.6646578731184 -1.793924711819273e-004 0 0 1 /end COMPU_METHOD
/begin COMPU_METHOD _CNV_A_R_LINEAR_____159_CM "" RAT_FUNC "%6.3" "[cm^2/%]" COEFFS 0 20983.23262491643 0. 0 0 1 /end COMPU_METHOD
/begin COMPU_METHOD _CNV_A_R_LINEAR_____160_CM "" RAT_FUNC "%6.3" "[%*s/(N*m)]" COEFFS 0 32767.9915198728 -8.480127202346921e-003 0 0 1 /end COMPU_METHOD
/begin COMPU_METHOD _CNV_A_R_LINEAR_____161_CM "" RAT_FUNC "%6.3" "[%]" COEFFS 0 327.680000069121 32768.0000069121 0 0 1 /end COMPU_METHOD
/begin COMPU_METHOD _CNV_A_R_LINEAR_____194_CM "" RAT_FUNC "%6.3" "[-]" COEFFS 0 2048. 0. 0 0 1 /end COMPU_METHOD
/begin COMPU_METHOD _CNV_A_R_LINEAR_____199_CM "" RAT_FUNC "%6.3" "[hPa]" COEFFS 0 16383.81262712377 0. 0 0 1 /end COMPU_METHOD
/begin COMPU_METHOD _CNV_A_R_LINEAR_____200_CM "" RAT_FUNC "%6.3" "[s/m]" COEFFS 0 3276799.15198728 0. 0 0 1 /end COMPU_METHOD
/begin COMPU_METHOD _CNV_A_R_LINEAR_____201_CM "" RAT_FUNC "%6.3" "[°C]" COEFFS 0 64. 3200. 0 0 1 /end COMPU_METHOD
/begin COMPU_METHOD _CNV_A_R_LINEAR_____202_CM "" RAT_FUNC "%6.3" "[cm^3]" COEFFS 0 48.78293881196963 0. 0 0 1 /end COMPU_METHOD
/begin COMPU_METHOD _CNV_A_R_LINEAR_____203_CM "" RAT_FUNC "%6.3" "[dm^3]" COEFFS 0 48.78293881196963 0. 0 0 1 /end COMPU_METHOD
/begin COMPU_METHOD _CNV_A_R_LINEAR_____204_CM "" RAT_FUNC "%6.3" "[%]" COEFFS 0 327.7613897082924 0. 0 0 1 /end COMPU_METHOD
/begin COMPU_METHOD _CNV_A_R_LINEAR_____205_CM "" RAT_FUNC "%6.3" "[%*s/hPa]" COEFFS 0 13266.62402021118 32768.0306649608 0 0 1 /end COMPU_METHOD
/begin COMPU_METHOD _CNV_A_R_LINEAR_____206_CM "" RAT_FUNC "%6.3" "[%/hPa]" COEFFS 0 27821.2326077497 0. 0 0 1 /end COMPU_METHOD
/begin COMPU_METHOD _CNV_A_R_LINEAR_____211_CM "" RAT_FUNC "%6.3" "[ms]" COEFFS 0 999.9999999999999 0. 0 0 1 /end COMPU_METHOD
/begin COMPU_METHOD _CNV_A_R_LINEAR_____212_CM "" RAT_FUNC "%6.3" "[%/um]" COEFFS 0 2.56 0. 0 0 1 /end COMPU_METHOD
/begin COMPU_METHOD _CNV_A_R_LINEAR_____213_CM "" RAT_FUNC "%6.3" "[-]" COEFFS 0 65537. 0. 0 0 1 /end COMPU_METHOD
/begin COMPU_METHOD _CNV_A_R_LINEAR_____214_CM "" RAT_FUNC "%6.3" "[um]" COEFFS 0 4. 0. 0 0 1 /end COMPU_METHOD
/begin COMPU_METHOD _CNV_A_R_LINEAR_____215_CM "" RAT_FUNC "%6.3" "[um]" COEFFS 0 5. 0. 0 0 1 /end COMPU_METHOD
/begin COMPU_METHOD _CNV_A_R_LINEAR_____216_CM "" RAT_FUNC "%6.3" "[%/um]" COEFFS 0 2.559999357490358 -3.212548212161437e-005 0 0 1 /end COMPU_METHOD
/begin COMPU_METHOD _CNV_A_R_LINEAR_____217_CM "" RAT_FUNC "%6.3" "[-]" COEFFS 0 999.9999999999999 0. 0 0 1 /end COMPU_METHOD
/begin COMPU_METHOD _CNV_A_R_LINEAR_____218_CM "" RAT_FUNC "%6.3" "[%/um]" COEFFS 0 2.559999357490358 127.9999678745179 0 0 1 /end COMPU_METHOD
/begin COMPU_METHOD _CNV_A_R_LINEAR_____219_CM "" RAT_FUNC "%6.3" "[mVAs/um]" COEFFS 0 16384. 0. 0 0 1 /end COMPU_METHOD
/begin COMPU_METHOD _CNV_A_R_LINEAR_____220_CM "" RAT_FUNC "%6.3" "[mVAs/um2]" COEFFS 0 32767.99999999992 0. 0 0 1 /end COMPU_METHOD
/begin COMPU_METHOD _CNV_A_R_LINEAR_____221_CM "" RAT_FUNC "%6.3" "mg/stk" COEFFS 0 250. 0. 0 0 1 /end COMPU_METHOD
/begin COMPU_METHOD _CNV_A_R_LINEAR_____222_CM "" RAT_FUNC "%6.3" "[°C]" COEFFS 0 1. 205. 0 0 1 /end COMPU_METHOD
/begin COMPU_METHOD _CNV_S_9_CONV_INJ_S_224_CM "" TAB_VERB "%6.3" "[-]" COMPU_TAB_REF _CNV_S_9_CONV_INJ_S_224 /end COMPU_METHOD
/begin COMPU_VTAB _CNV_S_9_CONV_INJ_S_224 "" TAB_VERB 9 0 "NO INJECTION" 1 "PREV" 2 "MAIN" 3 "PREV/MAIN" 4 "POST" 5 "PREV/POST" 6 "MAIN/POST" 7 "PREV/MAIN/POST" 8 "INJECTION DISABLED" /end COMPU_VTAB
/begin COMPU_METHOD _CNV_A_R_LINEAR_____225_CM "" RAT_FUNC "%6.3" "[stk]" COEFFS 0 1. 0. 0 0 1 /end COMPU_METHOD
/begin COMPU_METHOD _CNV_A_R_LINEAR_____362_CM "" RAT_FUNC "%6.3" "[us]" COEFFS 0 1. 0. 0 0 1 /end COMPU_METHOD
/begin COMPU_METHOD _CNV_A_R_LINEAR_____372_CM "" RAT_FUNC "%6.3" "[rpm/ms]" COEFFS 0 4096.000001728053 0. 0 0 1 /end COMPU_METHOD
/begin COMPU_METHOD _CNV_A_R_LINEAR_____373_CM "" RAT_FUNC "%6.3" "[-]" COEFFS 0 4096.000001728053 0. 0 0 1 /end COMPU_METHOD
/begin COMPU_METHOD _CNV_A_R_LINEAR_____374_CM "" RAT_FUNC "%6.3" "[-]" COEFFS 0 4096.000000864013 6.912101525813341e-006 0 0 1 /end COMPU_METHOD
/begin COMPU_METHOD _CNV_A_R_LINEAR_____376_CM "" RAT_FUNC "%6.3" "[1/seg]" COEFFS 0 131072.0001587224 0. 0 0 1 /end COMPU_METHOD
/begin COMPU_METHOD _CNV_A_R_LINEAR_____377_CM "" RAT_FUNC "%6.3" "[1/mg/stk]" COEFFS 0 524.28 0. 0 0 1 /end COMPU_METHOD
/begin COMPU_METHOD _CNV_A_R_LINEAR_____378_CM "" RAT_FUNC "%6.3" "[ms]" COEFFS 0 7.8125 0. 0 0 1 /end COMPU_METHOD
/begin COMPU_METHOD _CNV_S_3_Cylinder_B_379_CM "" TAB_VERB "%6.3" "[-]" COMPU_TAB_REF _CNV_S_3_Cylinder_B_379 /end COMPU_METHOD
/begin COMPU_VTAB _CNV_S_3_Cylinder_B_379 "" TAB_VERB 3 1 "OFF" 2 "OPEN LOOP" 3 "ACTIVE" /end COMPU_VTAB
/begin COMPU_METHOD _CNV_A_R_LINEAR_____415_CM "" RAT_FUNC "%6.3" "[V]" COEFFS 0 204.7999649194707 0. 0 0 1 /end COMPU_METHOD
/begin COMPU_METHOD _CNV_A_R_LINEAR_____416_CM "" RAT_FUNC "%6.3" "[V/s]" COEFFS 0 2.047999995887937 0. 0 0 1 /end COMPU_METHOD
/begin COMPU_METHOD _CNV_A_R_LINEAR_____427_CM "" RAT_FUNC "%6.3" "[%/s]" COEFFS 0 1.000015259254738 32768.50001525926 0 0 1 /end COMPU_METHOD
/begin RECORD_LAYOUT _REC_VAL_20_u1 FNC_VALUES 1 UBYTE COLUMN_DIR DIRECT /end RECORD_LAYOUT
/begin RECORD_LAYOUT _REC_AXS_20_u2 NO_AXIS_PTS_X 1 UWORD AXIS_PTS_X 2 UWORD INDEX_INCR DIRECT /end RECORD_LAYOUT
/begin RECORD_LAYOUT _REC_MAP_20_u2_u2_u2 FNC_VALUES 1 UWORD COLUMN_DIR DIRECT /end RECORD_LAYOUT
/begin RECORD_LAYOUT _REC_VAL_20_u2 FNC_VALUES 1 UWORD COLUMN_DIR DIRECT /end RECORD_LAYOUT
/begin RECORD_LAYOUT _REC_VAL_20_s2 FNC_VALUES 1 SWORD COLUMN_DIR DIRECT /end RECORD_LAYOUT
/begin RECORD_LAYOUT _REC_AXS_20_u1 NO_AXIS_PTS_X 1 UBYTE AXIS_PTS_X 2 UBYTE INDEX_INCR DIRECT /end RECORD_LAYOUT
/begin RECORD_LAYOUT _REC_CUR_20_u2_u2 FNC_VALUES 1 UWORD COLUMN_DIR DIRECT /end RECORD_LAYOUT
/begin RECORD_LAYOUT _REC_CUR_20_u2_u1 FNC_VALUES 1 UWORD COLUMN_DIR DIRECT /end RECORD_LAYOUT
/begin RECORD_LAYOUT _REC_MAP_20_u1_u2_u2 FNC_VALUES 1 UBYTE COLUMN_DIR DIRECT /end RECORD_LAYOUT
/begin RECORD_LAYOUT _REC_MAP_20_u2_u2_u1 FNC_VALUES 1 UWORD COLUMN_DIR DIRECT /end RECORD_LAYOUT
/begin RECORD_LAYOUT _REC_CUR_20_u1_u2 FNC_VALUES 1 UBYTE COLUMN_DIR DIRECT /end RECORD_LAYOUT
/begin RECORD_LAYOUT _REC_CUR_20_u1_u1 FNC_VALUES 1 UBYTE COLUMN_DIR DIRECT /end RECORD_LAYOUT
/begin RECORD_LAYOUT _REC_CUR_20_u4_u2 FNC_VALUES 1 ULONG COLUMN_DIR DIRECT /end RECORD_LAYOUT
/begin FUNCTION GES_AGE_BCTL ""
 /begin DEF_CHARACTERISTIC c_bpapwm_dt1_max c_bpapwm_dt1_min lc_bpa_dt1_map_dif_on c_fac_bpapwm_ctl_off_fil ip_tn_dt1_bpa__n ldpm_n_ip_map_ctl ip_fac_kr_pi_map__map_dif ldpm_map_dif_ip_map ip_fac_tn_pi_map__map_dif ip_kr_dt1_bpa__n__map_dif ldp_map_dif_ip_kr_dt1_bpa ip_kr_pi_map ldpm_n_ip_ctl_pi_map ldpm_tqi_ip_ctl_pi_map ip_tn_pi_map /end DEF_CHARACTERISTIC
 /begin OUT_MEASUREMENT map_dif bpapwm_eff bpapwm_ctl bpapwm_ctl_dt1 bpapwm_ctl_pi_max bpapwm_ctl_pi_min kr_dt1_bpa lv_bpapwm_ctl_min kr_pi_map tn_pi_map bpapwm_ctl_pi /end OUT_MEASUREMENT
/end FUNCTION
/begin FUNCTION GES_AGE_AIRV ""
 /begin DEF_CHARACTERISTIC c_vol_cyl c_fac_maf_cyl_fil c_fac_egr_fil c_vol_down_thr c_vol_up_thr c_fac_lamb_ext_clc_fil c_fac_lamb_it_clc_fil c_fac_mf_post_lamb_clc c_afs_dsl ip_fac_mfw_the__temp_ex ldp_temp_ex_ip_fac_mfw_the ip_fac_maf_cyl__n__pq ldp_n_ip_fac_maf_cyl ldp_pq_ip_fac_maf_cyl ip_map_max__prs_ex__fac_mfw ldp_prs_ex_ip_map_max ldp_fac_mfw_ip_map_max c_ar_egrv_max_the /end DEF_CHARACTERISTIC
 /begin OUT_MEASUREMENT prs_cmp_up_sp maf_cyl_mmv maf_cyl maf_cyl_kgh pq_map_prs_ex fac_maf_cyl egr egr_mmv mfw_egr maf_im maf_cyl_sp pq_map_prs_ex_sp fac_maf_cyl_sp mfw_egr_sp mfw_ex_sp mfw_tur_sp maf_cyl_sp_clc pq_map_prs_ex_sp_clc fac_maf_cyl_sp_clc mfw_egr_sp_clc map_sp_max_egr fac_mfw_egr fac_mfw_the__temp_ex temp_up_cyl_sp temp_up_cyl mf_lamb_clc lamb_ext_clc_fil lamb_it_clc_fil lamb_it_sp_clc_fil lamb_ext_sp_clc_fil /end OUT_MEASUREMENT
/end FUNCTION
/begin FUNCTION GES_AGE_ECTL ""
 /begin DEF_CHARACTERISTIC lc_egr_ctl_sub c_maf_cyl_sub lc_thr_3 c_t_ramp_fac_ar_thr_byp c_ar_egrv_max_dif c_ar_thr_max_dif c_ar_thr_max_the c_ar_thr_min_the c_mafpwm_pi_dif c_mafpwm_max c_mafpwm_min lc_mafpwm_pi_dt1 c_tn_mafpwm_pi_dt1 c_kr_mafpwm_pi_dt1_tqi c_mafpwm_thd_thr c_mafpwm_hys_thr ip_fac_kr_pi_egr__egr_dif ldpm_egr_dif_ip_fac_pi_egr ip_fac_tn_pi_egr__egr_dif ip_mafpwm_pi_max_dt1__n__fac ldpm_n_ip_mafpwm_pi_dt1 ldpm_fac_ip_mafpwm_pi_dt1 ip_mafpwm_pi_min_dt1__n__fac ip_mafpwm_pi_min ldpm_n_ip_mafpwm_pi_lim ldpm_tqi_ip_mafpwm_pi_lim ip_mafpwm_pi_max ip_kr_pi_thr ldpm_n_ip_pi_egr ldpm_tqi_ip_kr_pi_egr ip_kr_pi_egrv ip_kr_pi_sub_thr ip_kr_pi_sub_egrv ip_tn_pi_thr ip_tn_pi_egrv ip_tn_pi_sub_thr ip_tn_pi_sub_egrv /end DEF_CHARACTERISTIC
 /begin OUT_MEASUREMENT ar_pi_egr egr_mmv_ctl lv_egr_ctl_sub egr_sp_mmv_ctl egr_sp_mmv_out egr_mmv_out egr_dif mafpwm mafpwm_pi ar_byp_ctl_the ar_thr_ctl_the fac_ar_byp_egr_ctl fac_ar_thr_egr_ctl ar_thr_ico_ctl_the ar_egrv_ctl_the lv_egr_ctl_thr ar_pi_egr_max ar_pi_egr_min ar_pi_egr_min_lim ar_pi_egr_min_dif ar_pi_egr_min_bas ar_pi_egr_max_lim ar_pi_egr_max_dif ar_pi_egr_max_bas mafpwm_pi_min mafpwm_pi_max fac_mafpwm_pi_dt1 lv_mafpwm_thd_thr kr_pi_egr tn_pi_egr /end OUT_MEASUREMENT
/end FUNCTION
/begin FUNCTION GES_AGE_TAD ""
 /begin DEF_CHARACTERISTIC c_crlc_ad_thr[0] c_crlc_v_thr_tol[0] c_v_thr_max_ad_tol[0] c_v_thr_min_ad_tol[0] lc_v_thr_tol_sub[0] c_v_thr_tol_sub[0] c_ang_sp_ad_thr_bol[0] c_v_grd_thr_st_ad_bol[0] c_temp_st_ad_thr_max[0] c_temp_st_ad_thr_min[0] c_v_thr_max_st_ad_bol[0] c_t_ad_thr_bol[0] c_t_ad_thr_bol_ini[0] c_ang_sp_ad_thr_tol[0] c_v_grd_thr_st_ad_tol[0] c_v_thr_min_st_ad_tol[0] c_t_ad_thr_tol[0] c_t_ad_thr_tol_ini[0] c_crlc_v_thr_bol[0] c_v_thr_max_ad_bol[0] c_v_thr_min_ad_bol[0] lc_v_thr_bol_sub[0] c_v_thr_bol_sub[0] id_ad_thr_bol__t_ad_thr ldp_t_ad_thr_bol__ip_ad_thr id_ad_thr_tol__t_ad_thr ldp_t_ad_thr_tol__ip_ad_thr c_vb_max_ad_thr c_vb_min_ad_thr /end DEF_CHARACTERISTIC
 /begin OUT_MEASUREMENT ad_thr_mmv[0] lv_ad_thr[0] lv_v_thr_tol_ad_orng[0] v_thr_tol[0] lv_cdn_ad_v_thr_tol[0] v_thr_tol_det[0] t_ad_thr_bol_av[0] lv_ad_thr_bol[0] lv_ad_thr_bol_req[0] lv_ad_thr_tol_req[0] lv_ena_ad_thr[0] t_ad_thr_tol_av[0] lv_ad_thr_tol[0] lv_v_thr_bol_ad_orng[0] v_thr_bol[0] lv_cdn_ad_v_thr_bol[0] v_thr_bol_det[0] lv_ena_ad_thr_ext[0] /end OUT_MEASUREMENT
/end FUNCTION
/begin FUNCTION GES_AGE_TCLP ""
 /begin DEF_CHARACTERISTIC ip_ctl_max_thr_grd ldp_ang_thr_ip_ctl_max ldp_ang_grd_thr_ip_ctl_max ip_ctl_min_thr_grd ldp_ang_thr_ip_ctl_min ldp_ang_grd_thr_ip_ctl_min /end DEF_CHARACTERISTIC
/end FUNCTION
/begin FUNCTION GES_AGE_TAI "" /begin OUT_MEASUREMENT lv_intv_thr[0] intv_thr[0] /end OUT_MEASUREMENT /end FUNCTION
/begin FUNCTION GES_AGE_SWRL ""
 /begin DEF_CHARACTERISTIC c_ducy_on c_ducy_off c_ducy_hys_up c_ducy_hys_down ip_portpwm__n__mf_tot ldp_n_ip_portpwm ldp_mf_tot_ip_portpwm /end DEF_CHARACTERISTIC
 /begin OUT_MEASUREMENT portpwm_hys_out portpwm_wout_hys portpwm_hys portpwm /end OUT_MEASUREMENT
/end FUNCTION
/begin FUNCTION C_X_DOI ""
 /begin SUB_FUNCTION DOI_ASTCCORD DOI_ACYB_ACT DOI_ACYB_COR DOI_ACYB_CTL DOI_ACYB_PRP /end SUB_FUNCTION
/end FUNCTION
/begin FUNCTION DOI_ASTCCORD "PUI Stroke Control General" /end FUNCTION
/begin FUNCTION DOI_ACYB_ACT "Cylinder Balancing - Activation Conditions"
 /begin DEF_CHARACTERISTIC c_cyl_bal_ad_cdn c_cyl_bal_ad_hys c_t_dly_cyl_bal_ad c_thd_drv1_er_bal_fdout lc_cyl_bal_pl_ena /end DEF_CHARACTERISTIC
 /begin OUT_MEASUREMENT cyl_bal_dif_mmv lv_cyl_bal_ena lv_hys_cyl_bal_dif_mmv lv_t_dly_cyl_bal_act_st /end OUT_MEASUREMENT
/end FUNCTION
/begin FUNCTION DOI_ACYB_COR "Cylinder Balancing - Calculation of Correction Values"
 /begin DEF_CHARACTERISTIC c_cyl_bal_ofs c_n_max_bol_cyl_bal c_n_max_bol_cyl_bal_pl c_n_max_tol_cyl_bal c_n_max_tol_cyl_bal_pl c_t_dly_cyl_bal_lock c_thd_tco_cyl_bal_di c_thd_tco_cyl_bal_ena lc_cyl_bal_on lc_cyl_bal_init_tco_act c_slop_tran_cyl_bal_off_on c_mf_bol_cyl_bal_fdout c_slop_fdout_cyl_bal_mf /end DEF_CHARACTERISTIC
 /begin OUT_MEASUREMENT fac_cyl_bal_ramp_tco[0] fac_cyl_bal_ramp_tco[1] fac_cyl_bal_ramp_tco[2] lv_cyl_bal_lock_tco lv_cyl_bal_tco_ramp_off lv_fac_cyl_bal_grd_lim_act lv_t_dly_cyl_bal_lock_st n_max_bol_cyl_bal n_max_tol_cyl_bal lv_cyl_bal_lock lv_cyl_bal_init_tco fac_cyl_bal[0] fac_cyl_bal[1] fac_cyl_bal[2] fac_cyl_bal_n_fdout[0] fac_cyl_bal_n_fdout[1] fac_cyl_bal_n_fdout[2] /end OUT_MEASUREMENT
/end FUNCTION
/begin FUNCTION DOI_ACYB_CTL "Cylinder Balancing - Control Algorithm"
 /begin DEF_CHARACTERISTIC c_cyl_bal_pi_max c_cyl_bal_pi_min c_kr_pi_cyl_bal c_tn_pi_cyl_bal lc_cyl_bal_init /end DEF_CHARACTERISTIC
 /begin OUT_MEASUREMENT cyl_bal_pi[0] cyl_bal_pi[1] cyl_bal_pi[2] cyl_bal_pi_mmv lv_t_dly_cyl_bal_act lv_t_dly_cyl_bal_lock sf_cyl_bal lv_cyl_bal_pi_lim[0] lv_cyl_bal_pi_lim[1] lv_cyl_bal_pi_lim[2] lv_cyl_bal_pi_lim[3] lv_cyl_bal_init /end OUT_MEASUREMENT
/end FUNCTION
/begin FUNCTION DOI_ACYB_PRP "Cylinder Balancing - Signal Preparation" /begin DEF_CHARACTERISTIC c_fac_er_fil lc_swi_cyl_bal_inp /end DEF_CHARACTERISTIC
 /begin OUT_MEASUREMENT cyl_bal_dif[0] cyl_bal_dif[1] cyl_bal_dif[2] cyl_nr_cyl_bal /end OUT_MEASUREMENT
/end FUNCTION
/begin FUNCTION C_X_TI ""
 /begin SUB_FUNCTION TI_COLDSTART TI_LIBC TI_LIM TI_MAIN1 TI_CORD TI_COLCK TI_POST1 TI_PREV1 TI_RLINJ TI_TUNE TI_FIU TI_TUN TI_COL TI_SUPP /end SUB_FUNCTION
/end FUNCTION
/begin FUNCTION TI_COLDSTART ""
 /begin DEF_CHARACTERISTIC c_tfu_max_doi_inc c_tfu_tco_dif_max_doi_inc ip_dly_ctr_doi_inc__tfu ldpm_tfu_ip_doi_inc ip_fac_doi_inc_ini__tfu ip_slop_ctr_doi_inc__tfu lc_doi_inc_rest_on lc_cold_start_cor_on lc_temp_cor_on c_tfu_tco_dif_max_doi_inj c_tco_min_doi_inj c_nr_seg_tfu_cor ip_fac_temp_delta__ctr ldp_fac_ip_fac_temp_delta ip_tfu_sp__n__mf ldpm_n_ip_temp_sp ldpm_mf_ip_temp_sp ip_tco_sp__n__mf /end DEF_CHARACTERISTIC
 /begin OUT_MEASUREMENT fac_doi_inc lv_doi_inc_ena fac_doi_prev1_tfu fac_doi_main1_tfu fac_doi_post1_tfu fac_doi_prev1 fac_doi_main1 fac_doi_post1 fac_doi_prev1_tco fac_doi_main1_tco fac_doi_post1_tco /end OUT_MEASUREMENT
/end FUNCTION
/begin FUNCTION TI_LIBC ""
 /begin DEF_CHARACTERISTIC c_fac1_egy_pps_stk c_fac2_egy_pps_stk ip_fac_prs_soi__mf__dur ldp_mf_ip_fac_prs_soi ldp_dur_ip_fac_prs_soi ip_fac_prs_doi__mf__dur ldp_mf_ip_fac_prs_doi ldp_dur_ip_fac_prs_doi ip_soi_dly__n__level ldp_n_ip_soi_dly ldp_level_ip_soi_dly ldpm_soi_ip_fac_doi ip_fac_doi__soi__tfu_delta ldp_tfu_delta_ip_fac_doi ip_fac_doi__soi__tco_delta ldp_tco_delta_ip_fac_doi /end DEF_CHARACTERISTIC
/end FUNCTION
/begin FUNCTION TI_LIM ""
 /begin DEF_CHARACTERISTIC c_t_cha2cha_min c_t_dcha2dcha_min c_t_cha2dcha_min c_t_dcha2cha_min c_t_dcha2newcha_min c_stk_max_piezo c_t_soi_dly lc_doi_mod c_step_sp_pps c_step_sp_iv_foc c_ti_req_ti_min c_t_hld_min_bas c_ang_cam_st c_ang_cam_end c_ti_min lc_ip_on c_t_grp2sel_min c_ti_cold_max c_ti_max ip_fac_t_hld_min_inc__n ldp_n_ip_fac_t_hld_min_inc ip_ofs_level_cor__tfu ldp_tfu_ip_ofs_level_cor c_t_cha_frze_min c_t_cha_micro_step_min c_t_hld_pls_min c_t_dist_pls2pls_min c_t_eoi_trig_ofs c_t_dist_main12post1_min lc_doi_min_mod lc_micro_step_frze_mod lc_micro_step_on /end DEF_CHARACTERISTIC
 /begin OUT_MEASUREMENT t_dcha2newcyl_min t_cha_min t_cha_max t_dcha_min t_dcha_max stk_max_piezo t_step_pps t_soi_dly lv_doi_mod step_sp_pps step_sp_iv_foc ti_req_ti_min t_hld_min_bas step_cha_min step_dcha_min ang_cam_st ang_cam_end ti_min lv_ip_on t_grp2sel_min t_cha_frze_min t_cha_micro_step_min t_hld_pls_min t_dist_pls2pls_min t_eoi_trig_ofs lv_doi_min_mod lv_micro_step_frze_mod t_dist_main12post1_min lv_micro_step_on ti_max doi_max doi_min soi_dly dur_dcha2newcyl_min dur_pls_min dur_grp2sel_min t_hld_min ofs_level_cor dur_wout_frze_min dur_with_frze_min /end OUT_MEASUREMENT
/end FUNCTION
/begin FUNCTION TI_MAIN1 ""
 /begin DEF_CHARACTERISTIC ip_level_cha_frze_main1__n ldp_n_ip_level_cha_frze_main1 ip_t_hld_frze_main1__n ldp_n_ip_t_hld_frze_main1 c_fac_doi_main1_tu_[0] c_fac_doi_main1_tu_[1] c_fac_doi_main1_tu_[2] c_fac_doi_main1_tu_[3] c_doi_main1_man_[0] c_doi_main1_man_[1] c_doi_main1_man_[2] c_doi_main1_man_[3] lc_doi_main1_man ip_doi_main1_0 ip_doi_main1_1 ip_doi_main1_2 ip_doi_main1_3 ip_doi_main1_4 ip_doi_main1_5 ldpm_n_ip_doi_main1 ldpm_mf_ip_doi_main1 ip_sel_ip_doi_main1__soi ldp_soi_ip_doi_main1 ip_level_dcha_toze_main1__n ldp_n_ip_level_dcha_toze_main1 ip_t_hld_toze_main1__n ldp_n_ip_t_hld_toze_main1 /end DEF_CHARACTERISTIC
 /begin OUT_MEASUREMENT soi_frze_cor_prev1 soi_frze_main1_req1 t_cha_frze_main1_req1 soi_main1_req1 t_cha_main1_req1 eoi_main1_pwr_on t_dcha_main1 t_hld_toze_main1 t_dcha_toze_main1 lv_frze_main1_req2 lv_main1_req2 lv_toze_main1_req2 lv_frze_prev1_req3 lv_prev1_req3 lv_toze_prev1_req3 doi_main1_bas_tu step_nr_cha_frze_main1 level_cha_frze_main1 t_hld_frze_main1 step_nr_cha_main1 step_nr_dcha_main1 level_dcha_toze_main1 step_nr_dcha_toze_main1 doi_main1_bas mf_main1_tu_cor doi_main1_req1 lv_micro_step_main1_act soi_frze_cor_main1 soi_frze_cor_post1 /end OUT_MEASUREMENT
/end FUNCTION
/begin FUNCTION TI_CORD "" /begin OUT_MEASUREMENT dummy_soi dummy_mf dummy_level dummy_doi /end OUT_MEASUREMENT /end FUNCTION
/begin FUNCTION TI_COLCK "" /end FUNCTION
/begin FUNCTION TI_POST1 ""
 /begin DEF_CHARACTERISTIC ip_level_cha_frze_post1__n ldp_n_ip_level_cha_frze_post1 ip_t_hld_frze_post1__n ldp_n_ip_t_hld_frze_post1 c_fac_doi_post1_tu_[0] c_fac_doi_post1_tu_[1] c_fac_doi_post1_tu_[2] c_fac_doi_post1_tu_[3] c_doi_post1_man_[0] c_doi_post1_man_[1] c_doi_post1_man_[2] c_doi_post1_man_[3] lc_doi_post1_man ip_doi_post1_0 ip_doi_post1_1 ip_doi_post1_2 ldpm_n_ip_doi_post1 ldpm_mf_ip_doi_post1 ip_sel_ip_doi_post1__soi ldp_soi_ip_doi_post1 ip_level_dcha_toze_post1__n ldp_n_ip_level_dcha_toze_post1 ip_t_hld_toze_post1__n ldp_n_ip_t_hld_toze_post1 c_fac_t_dif_min_main1_post1 /end DEF_CHARACTERISTIC
 /begin OUT_MEASUREMENT soi_frze_post1_pwr_on t_cha_frze_post1 soi_post1_pwr_on t_cha_post1 eoi_post1_pwr_on t_dcha_post1 t_hld_toze_post1 t_dcha_toze_post1 lv_frze_post1_act lv_post1_act lv_toze_post1_act doi_post1_bas_tu step_nr_cha_frze_post1 level_cha_frze_post1 t_hld_frze_post1 step_nr_cha_post1 step_nr_dcha_post1 level_dcha_toze_post1 step_nr_dcha_toze_post1 doi_post1_bas mf_post1_tu_cor doi_post1_pwr_on lv_micro_step_post1_act /end OUT_MEASUREMENT
/end FUNCTION
/begin FUNCTION TI_PREV1 ""
 /begin DEF_CHARACTERISTIC ip_level_cha_frze_prev1__n ldp_n_ip_level_cha_frze_prev1 ip_t_hld_frze_prev1__n ldp_n_ip_t_hld_frze_prev1 c_fac_doi_prev1_tu_[0] c_fac_doi_prev1_tu_[1] c_fac_doi_prev1_tu_[2] c_fac_doi_prev1_tu_[3] c_doi_prev1_man_[0] c_doi_prev1_man_[1] c_doi_prev1_man_[2] c_doi_prev1_man_[3] lc_doi_prev1_man ip_doi_prev1_0 ip_doi_prev1_1 ip_doi_prev1_2 ip_doi_prev1_3 ip_doi_prev1_4 ip_doi_prev1_5 ldpm_n_ip_doi_prev1 ldpm_mf_ip_doi_prev1 ip_sel_ip_doi_prev1__soi ldp_soi_ip_doi_prev1 ip_level_dcha_toze_prev1__n ldp_n_ip_level_dcha_toze_prev1 ip_t_hld_toze_prev1__n ldp_n_ip_t_hld_toze_prev1 /end DEF_CHARACTERISTIC
 /begin OUT_MEASUREMENT soi_frze_prev1_req1 t_cha_frze_prev1_req1 soi_prev1_req1 t_cha_prev1_req1 eoi_prev1_req1 t_dcha_prev1_req1 t_hld_toze_prev1_req1 t_dcha_toze_prev1_req1 lv_frze_prev1_req2 lv_prev1_req2 lv_toze_prev1_req2 doi_prev1_bas_tu step_nr_cha_frze_prev1 level_cha_frze_prev1 t_hld_frze_prev1 step_nr_cha_prev1 step_nr_dcha_prev1 level_dcha_toze_prev1 step_nr_dcha_toze_prev1 doi_prev1_bas mf_prev1_tu_cor doi_prev1_pwr_on lv_micro_step_prev1_act /end OUT_MEASUREMENT
/end FUNCTION
/begin FUNCTION TI_RLINJ ""
 /begin DEF_CHARACTERISTIC ip_mf_is_tar__tco ldp_tco_ip_mf_is_tar ip_ctr_tran_st_is__tco ldp_tco_ip_ctr_tran_st_is /end DEF_CHARACTERISTIC
 /begin OUT_MEASUREMENT lv_inj_ena_st mf_is_tar ctr_tran_st_is sf_inj_off sf_inj_state.word sf_inj_state.bf.unused sf_inj_state.bf.lv_inj_di sf_inj_state.bf.lv_post1_inj_act sf_inj_state.bf.lv_main2_inj_act sf_inj_state.bf.lv_main1_inj_act sf_inj_state.bf.lv_prev2_inj_act sf_inj_state.bf.lv_prev1_inj_act sf_pls_state iv_on nr_inj_seg lv_inj_ena lv_inj_di /end OUT_MEASUREMENT
/end FUNCTION
/begin FUNCTION TI_TUNE ""
 /begin OUT_MEASUREMENT sf_pls_state_tu_[0] sf_pls_state_tu_[1] sf_pls_state_tu_[2] sf_pls_state_tu_[3] sf_inj_off_tu /end OUT_MEASUREMENT
/end FUNCTION
/begin FUNCTION TI_FIU "Taskhandling of the Fast Injection Update" /begin DEF_CHARACTERISTIC c_n_max_fast_inj_upd lc_fast_inj_upd_cdn_ovs /end DEF_CHARACTERISTIC /begin OUT_MEASUREMENT lv_fast_inj_upd lv_fast_upd_miss /end OUT_MEASUREMENT /end FUNCTION
/end MODULE
/end PROJECT
