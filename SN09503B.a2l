ASAP2_VERSION 1 41
/begin PROJECT SN0 "SIMOS PPD"
/begin HEADER "_default_HeaderComment" PROJECT_NO PRJ_NUM /end HEADER
/begin MODULE _default_ModuleName "_default_ModuleLongIdentifier"
/begin MOD_COMMON "_default_ModCommonComment" DEPOSIT ABSOLUTE BYTE_ORDER MSB_FIRST ALIGNMENT_BYTE 1 ALIGNMENT_WORD 2 ALIGNMENT_LONG 4 ALIGNMENT_FLOAT32_IEEE 4 ALIGNMENT_FLOAT64_IEEE 8 /end MOD_COMMON
/begin CHARACTERISTIC c_ctr_max_wup_cyc "Initialization value for the warm-up cycle of diagnostics" VALUE 0x84fc04 _REC_VAL_20_u1 255. _CNV_A_R_LINEAR_____1_CM 0. 255. DISPLAY_IDENTIFIER C_CTR_MAX_WUP_CYC FORMAT "%3.0" /end CHARACTERISTIC
/begin AXIS_PTS ldp_fmy_dtc "" 0x8416dc online_dummy _REC_AXS_20_u2 5. _CNV_A_R_LINEAR_____0_CM 6 0. 5. FORMAT "%2.0" /end AXIS_PTS
/begin CHARACTERISTIC lc_abc_bench "logical constant to manage the anti-bounce bench mode" VALUE 0x850105 _REC_VAL_20_u1 1. _CNV_A_R_LINEAR_____0_CM 0. 1. DISPLAY_IDENTIFIER LC_ABC_BENCH FORMAT "%2.0" /end CHARACTERISTIC
/begin CHARACTERISTIC id_err_dtc_mis "DTC table declaration for diagnosis misfiring" MAP 0x8444c8 _REC_MAP_20_u2_u2_u2 65535. _CNV_A_R_LINEAR_____1_CM 0. 65535. DISPLAY_IDENTIFIER ID_ERR_DTC_MIS FORMAT "%5.0"
 /begin AXIS_DESCR COM_AXIS online_dummy _CNV_A_R_LINEAR_____1_CM 2 0. 65535. FORMAT "%5.0" AXIS_PTS_REF ldp_1_id_err_dtc_mis /end AXIS_DESCR
 /begin AXIS_DESCR COM_AXIS online_dummy _CNV_A_R_LINEAR_____1_CM 7 0. 65535. FORMAT "%5.0" AXIS_PTS_REF ldp_2_id_err_dtc_mis /end AXIS_DESCR
/end CHARACTERISTIC
/begin AXIS_PTS ldp_1_id_err_dtc_mis "" 0x84106c online_dummy _REC_AXS_20_u2 65535. _CNV_A_R_LINEAR_____1_CM 2 0. 65535. FORMAT "%5.0" /end AXIS_PTS
/begin AXIS_PTS ldp_2_id_err_dtc_mis "" 0x841072 online_dummy _REC_AXS_20_u2 65535. _CNV_A_R_LINEAR_____1_CM 7 0. 65535. FORMAT "%5.0" /end AXIS_PTS
/begin CHARACTERISTIC c_obd_state_1 "" VALUE 0x84feb2 _REC_VAL_20_u1 7. _CNV_A_R_LINEAR_____0_CM 0. 7. DISPLAY_IDENTIFIER C_OBD_STATE_1 FORMAT "%2.0" /end CHARACTERISTIC
/begin CHARACTERISTIC c_obd_state_2 "" VALUE 0x84feb3 _REC_VAL_20_u1 255. _CNV_A_R_LINEAR_____1_CM 0. 255. DISPLAY_IDENTIFIER C_OBD_STATE_2 FORMAT "%3.0" /end CHARACTERISTIC
/begin CHARACTERISTIC lc_ena_scdn "Boolean to indicate iof similar conditions are inhibited (0) or (1)" VALUE 0x850128 _REC_VAL_20_u1 1. _CNV_A_R_LINEAR_____0_CM 0. 1. DISPLAY_IDENTIFIER LC_ENA_SCDN FORMAT "%2.0" /end CHARACTERISTIC
/begin CHARACTERISTIC lc_clr_fmy "Boolean to clear failure memory when set to 1" VALUE 0x85010e _REC_VAL_20_u1 1. _CNV_A_R_LINEAR_____0_CM 0. 1. DISPLAY_IDENTIFIER LC_CLR_FMY FORMAT "%2.0" /end CHARACTERISTIC
/begin CHARACTERISTIC lc_clr_his_fmy "Clearing the history memory" VALUE 0x85010f _REC_VAL_20_u1 1. _CNV_A_R_LINEAR_____0_CM 0. 1. DISPLAY_IDENTIFIER LC_CLR_HIS_FMY FORMAT "%2.0" /end CHARACTERISTIC
/begin CHARACTERISTIC c_conf_mil "" VALUE 0x84fbec _REC_VAL_20_u1 7. _CNV_A_R_LINEAR_____0_CM 0. 7. DISPLAY_IDENTIFIER C_CONF_MIL FORMAT "%1.0" /end CHARACTERISTIC
/begin CHARACTERISTIC c_conf_wal_1 "" VALUE 0x84fbed _REC_VAL_20_u1 7. _CNV_A_R_LINEAR_____0_CM 0. 7. DISPLAY_IDENTIFIER C_CONF_WAL_1 FORMAT "%1.0" /end CHARACTERISTIC
/begin CHARACTERISTIC c_conf_wal_2 "" VALUE 0x84fbee _REC_VAL_20_u1 7. _CNV_A_R_LINEAR_____0_CM 0. 7. DISPLAY_IDENTIFIER C_CONF_WAL_2 FORMAT "%1.0" /end CHARACTERISTIC
/begin CHARACTERISTIC lc_inh_wal_st "" VALUE 0x85012f _REC_VAL_20_u1 1. _CNV_A_R_LINEAR_____0_CM 0. 1. DISPLAY_IDENTIFIER LC_INH_WAL_ST FORMAT "%2.0" /end CHARACTERISTIC
/begin CHARACTERISTIC c_dly_inh_iv_mis "Delay for MIL blinking in case of misfiring present failure with cylinder cut off" VALUE 0x84fc10 _REC_VAL_20_u1 255. _CNV_A_R_LINEAR_____4_CM 0. 255. DISPLAY_IDENTIFIER C_DLY_INH_IV_MIS FORMAT "%3.0" /end CHARACTERISTIC
/begin CHARACTERISTIC lc_ad_clr "" VALUE 0x85010b _REC_VAL_20_u1 1. _CNV_A_R_LINEAR_____0_CM 0. 1. DISPLAY_IDENTIFIER LC_AD_CLR FORMAT "%1.0" /end CHARACTERISTIC
/begin CHARACTERISTIC c_nvmy_inst_chk "" VALUE 0x84feb1 _REC_VAL_20_u1 255. _CNV_A_R_LINEAR_____0_CM 0. 255. DISPLAY_IDENTIFIER C_NVMY_INST_CHK FORMAT "%3.0" /end CHARACTERISTIC
/begin AXIS_PTS ldpm_n_ip_mf_pf "" 0x84331e n _REC_AXS_20_u2 6375. _CNV_A_R_LINEAR_____5_CM 24 0. 6375. FORMAT "%4.0" /end AXIS_PTS
/begin CHARACTERISTIC c_dly_mil_ready_1 "Delay to start MIL blinking for readiness display during pre-drive check." VALUE 0x84fc11 _REC_VAL_20_u1 127500. _CNV_A_R_LINEAR_____6_CM 0. 127500. DISPLAY_IDENTIFIER C_DLY_MIL_READY_1 FORMAT "%6.0" /end CHARACTERISTIC
/begin CHARACTERISTIC c_dly_mil_ready_2 "MIL blinking duration for readiness display during pre-drive check" VALUE 0x84fc12 _REC_VAL_20_u1 127500. _CNV_A_R_LINEAR_____6_CM 0. 127500. DISPLAY_IDENTIFIER C_DLY_MIL_READY_2 FORMAT "%6.0" /end CHARACTERISTIC
/begin CHARACTERISTIC lc_egrv_pctl_on "" VALUE 0x85ce76 _REC_VAL_20_u1 1. _CNV_A_R_LINEAR_____0_CM 0. 1. DISPLAY_IDENTIFIER LC_EGRV_PCTL_ON FORMAT "%1.0" /end CHARACTERISTIC
/begin CHARACTERISTIC c_bpapwm_min_diag "" VALUE 0x85c8c8 _REC_VAL_20_u2 99.99847412109381 _CNV_A_R_LINEAR_____8_CM 0. 99.99847412109381 DISPLAY_IDENTIFIER C_BPAPWM_MIN_DIAG FORMAT "%5.3" /end CHARACTERISTIC
/begin CHARACTERISTIC c_bpapwm_max_diag "" VALUE 0x85c8c6 _REC_VAL_20_u2 99.99847412109381 _CNV_A_R_LINEAR_____8_CM 0. 99.99847412109381 DISPLAY_IDENTIFIER C_BPAPWM_MAX_DIAG FORMAT "%5.3" /end CHARACTERISTIC
/begin CHARACTERISTIC c_fac_ar_egrv_pctl_fil "" VALUE 0x85c9a8 _REC_VAL_20_u2 0.9999847412109381 _CNV_A_R_LINEAR_____14_CM 0. 0.9999847412109381 DISPLAY_IDENTIFIER C_FAC_AR_EGRV_PCTL_FIL FORMAT "%6.5" /end CHARACTERISTIC
/begin CHARACTERISTIC c_thrpwm_min_diag "" VALUE 0x85cd1a _REC_VAL_20_u2 99.99847412109381 _CNV_A_R_LINEAR_____8_CM 0. 99.99847412109381 DISPLAY_IDENTIFIER C_THRPWM_MIN_DIAG FORMAT "%5.3" /end CHARACTERISTIC
/begin CHARACTERISTIC c_thrpwm_max_diag "" VALUE 0x85cd16 _REC_VAL_20_u2 99.99847412109381 _CNV_A_R_LINEAR_____8_CM 0. 99.99847412109381 DISPLAY_IDENTIFIER C_THRPWM_MAX_DIAG FORMAT "%5.3" /end CHARACTERISTIC
/begin CHARACTERISTIC c_ctr_inh_temp_diag "" VALUE 0x85c95c _REC_VAL_20_u2 65535. _CNV_A_R_LINEAR_____16_CM 0. 65535. DISPLAY_IDENTIFIER C_CTR_INH_TEMP_DIAG FORMAT "%5.0" /end CHARACTERISTIC
/begin CHARACTERISTIC c_tco_mes_grd_diag "" VALUE 0x85ccbb _REC_VAL_20_u1 255. _CNV_A_R_LINEAR_____17_CM 0. 255. DISPLAY_IDENTIFIER C_TCO_MES_GRD_DIAG FORMAT "%3.0" /end CHARACTERISTIC
/begin CHARACTERISTIC c_tco_mes_st_diag "" VALUE 0x85ccbc _REC_VAL_20_u1 255. _CNV_A_R_LINEAR_____18_CM -50. 205. DISPLAY_IDENTIFIER C_TCO_MES_ST_DIAG FORMAT "%3.0" /end CHARACTERISTIC
/begin CHARACTERISTIC c_t_ast_tco_diag "" VALUE 0x85cc10 _REC_VAL_20_u2 6553.5 _CNV_A_R_LINEAR_____19_CM 0. 6553.5 DISPLAY_IDENTIFIER C_T_AST_TCO_DIAG FORMAT "%5.1" /end CHARACTERISTIC
/begin CHARACTERISTIC c_tco_plaus_inc_diag "" VALUE 0x85ccbe _REC_VAL_20_u1 255. _CNV_A_R_LINEAR_____20_CM 0. 255. DISPLAY_IDENTIFIER C_TCO_PLAUS_INC_DIAG FORMAT "%3.0" /end CHARACTERISTIC
/begin AXIS_PTS ldp_fmy_envd "" 0x8416ea online_dummy _REC_AXS_20_u1 7. _CNV_A_R_LINEAR_____0_CM 8 0. 7. READ_ONLY FORMAT "%2.0" /end AXIS_PTS
/begin CHARACTERISTIC c_tco_wup_thd "OBD II required at least 72 °C for GS and 60 °C for DS engines EOBD required at least 70 °C for DS and GS engines" VALUE 0x85002b _REC_VAL_20_u1 255. _CNV_A_R_LINEAR_____18_CM -50. 205. DISPLAY_IDENTIFIER C_TCO_WUP_THD FORMAT "%3.0" /end CHARACTERISTIC
/begin CHARACTERISTIC c_tco_wup_inc "OBDII required at least 23 °C for GS and DS engines EOBD required at least 22 °C for GS and DS engines" VALUE 0x85002a _REC_VAL_20_u1 255. _CNV_A_R_LINEAR_____18_CM -50. 205. DISPLAY_IDENTIFIER C_TCO_WUP_INC FORMAT "%3.0" /end CHARACTERISTIC
/begin CHARACTERISTIC c_abc_inc_pvs_l_1 "" VALUE 0x84fac3 _REC_VAL_20_u1 255. _CNV_A_R_LINEAR_____0_CM 0. 255. DISPLAY_IDENTIFIER C_ABC_INC_PVS_L_1 FORMAT "%3.0" /end CHARACTERISTIC
/begin CHARACTERISTIC c_abc_max_pvs_l_1 "" VALUE 0x84fb4f _REC_VAL_20_u1 255. _CNV_A_R_LINEAR_____0_CM 0. 255. DISPLAY_IDENTIFIER C_ABC_MAX_PVS_L_1 FORMAT "%3.0" /end CHARACTERISTIC
/begin CHARACTERISTIC c_abc_inc_pvs_l_2 "" VALUE 0x84fac4 _REC_VAL_20_u1 255. _CNV_A_R_LINEAR_____0_CM 0. 255. DISPLAY_IDENTIFIER C_ABC_INC_PVS_L_2 FORMAT "%3.0" /end CHARACTERISTIC
/begin CHARACTERISTIC c_abc_max_pvs_l_2 "" VALUE 0x84fb50 _REC_VAL_20_u1 255. _CNV_A_R_LINEAR_____0_CM 0. 255. DISPLAY_IDENTIFIER C_ABC_MAX_PVS_L_2 FORMAT "%3.0" /end CHARACTERISTIC
/begin CHARACTERISTIC c_abc_inc_pvs_h_1 "" VALUE 0x84fac1 _REC_VAL_20_u1 255. _CNV_A_R_LINEAR_____0_CM 0. 255. DISPLAY_IDENTIFIER C_ABC_INC_PVS_H_1 FORMAT "%3.0" /end CHARACTERISTIC
/begin CHARACTERISTIC c_abc_max_pvs_h_1 "" VALUE 0x84fb4d _REC_VAL_20_u1 255. _CNV_A_R_LINEAR_____0_CM 0. 255. DISPLAY_IDENTIFIER C_ABC_MAX_PVS_H_1 FORMAT "%3.0" /end CHARACTERISTIC
/begin CHARACTERISTIC c_abc_inc_pvs_h_2 "" VALUE 0x84fac2 _REC_VAL_20_u1 255. _CNV_A_R_LINEAR_____0_CM 0. 255. DISPLAY_IDENTIFIER C_ABC_INC_PVS_H_2 FORMAT "%3.0" /end CHARACTERISTIC
/begin CHARACTERISTIC c_abc_max_pvs_h_2 "" VALUE 0x84fb4e _REC_VAL_20_u1 255. _CNV_A_R_LINEAR_____0_CM 0. 255. DISPLAY_IDENTIFIER C_ABC_MAX_PVS_H_2 FORMAT "%3.0" /end CHARACTERISTIC
/begin CHARACTERISTIC c_abc_inc_pvs_ratio "" VALUE 0x84fac7 _REC_VAL_20_u1 255. _CNV_A_R_LINEAR_____0_CM 0. 255. DISPLAY_IDENTIFIER C_ABC_INC_PVS_RATIO FORMAT "%3.0" /end CHARACTERISTIC
/begin CHARACTERISTIC c_abc_max_pvs_ratio "" VALUE 0x84fb53 _REC_VAL_20_u1 255. _CNV_A_R_LINEAR_____0_CM 0. 255. DISPLAY_IDENTIFIER C_ABC_MAX_PVS_RATIO FORMAT "%3.0" /end CHARACTERISTIC
/begin CHARACTERISTIC c_abc_inc_pvs_bls_bts "" VALUE 0x84fac0 _REC_VAL_20_u1 255. _CNV_A_R_LINEAR_____0_CM 0. 255. DISPLAY_IDENTIFIER C_ABC_INC_PVS_BLS_BTS FORMAT "%3.0" /end CHARACTERISTIC
/begin CHARACTERISTIC c_abc_max_pvs_bls_bts "" VALUE 0x84fb4c _REC_VAL_20_u1 255. _CNV_A_R_LINEAR_____0_CM 0. 255. DISPLAY_IDENTIFIER C_ABC_MAX_PVS_BLS_BTS FORMAT "%3.0" /end CHARACTERISTIC
/begin CHARACTERISTIC c_abc_inc_pvs_move "" VALUE 0x84fac6 _REC_VAL_20_u1 255. _CNV_A_R_LINEAR_____0_CM 0. 255. DISPLAY_IDENTIFIER C_ABC_INC_PVS_MOVE FORMAT "%3.0" /end CHARACTERISTIC
/begin CHARACTERISTIC c_abc_max_pvs_move "" VALUE 0x84fb52 _REC_VAL_20_u1 255. _CNV_A_R_LINEAR_____0_CM 0. 255. DISPLAY_IDENTIFIER C_ABC_MAX_PVS_MOVE FORMAT "%3.0" /end CHARACTERISTIC
/begin CHARACTERISTIC c_crlc_pvs_1_move "" VALUE 0x85c904 _REC_VAL_20_u1 0.99609375 _CNV_A_R_LINEAR_____29_CM 0. 0.99609375 DISPLAY_IDENTIFIER C_CRLC_PVS_1_MOVE FORMAT "%3.2" /end CHARACTERISTIC
/begin CHARACTERISTIC c_crlc_pvs_2_move "" VALUE 0x85c905 _REC_VAL_20_u1 0.99609375 _CNV_A_R_LINEAR_____29_CM 0. 0.99609375 DISPLAY_IDENTIFIER C_CRLC_PVS_2_MOVE FORMAT "%3.2" /end CHARACTERISTIC
/begin CHARACTERISTIC c_ctr_max_pv_av_con "" VALUE 0x85c968 _REC_VAL_20_u1 255. _CNV_A_R_LINEAR_____0_CM 0. 255. DISPLAY_IDENTIFIER C_CTR_MAX_PV_AV_CON FORMAT "%3.0" /end CHARACTERISTIC
/begin CHARACTERISTIC c_ctr_max_pvs_bls_bts_plaus "" VALUE 0x85c969 _REC_VAL_20_u1 255. _CNV_A_R_LINEAR_____0_CM 0. 255. DISPLAY_IDENTIFIER C_CTR_MAX_PVS_BLS_BTS_PLAUS FORMAT "%3.0" /end CHARACTERISTIC
/begin CHARACTERISTIC c_ctr_max_pvs_h_r_1 "" VALUE 0x85c96a _REC_VAL_20_u1 255. _CNV_A_R_LINEAR_____0_CM 0. 255. DISPLAY_IDENTIFIER C_CTR_MAX_PVS_H_R_1 FORMAT "%3.0" /end CHARACTERISTIC
/begin CHARACTERISTIC c_ctr_max_pvs_h_r_2 "" VALUE 0x85c96b _REC_VAL_20_u1 255. _CNV_A_R_LINEAR_____0_CM 0. 255. DISPLAY_IDENTIFIER C_CTR_MAX_PVS_H_R_2 FORMAT "%3.0" /end CHARACTERISTIC
/begin CHARACTERISTIC c_ctr_max_pvs_is_rng "" VALUE 0x85c96c _REC_VAL_20_u1 255. _CNV_A_R_LINEAR_____0_CM 0. 255. DISPLAY_IDENTIFIER C_CTR_MAX_PVS_IS_RNG FORMAT "%3.0" /end CHARACTERISTIC
/begin CHARACTERISTIC c_ctr_max_pvs_move "" VALUE 0x85c96f _REC_VAL_20_u1 255. _CNV_A_R_LINEAR_____0_CM 0. 255. DISPLAY_IDENTIFIER C_CTR_MAX_PVS_MOVE FORMAT "%3.0" /end CHARACTERISTIC
/begin CHARACTERISTIC c_ctr_max_pvs_move_err "" VALUE 0x85c970 _REC_VAL_20_u1 255. _CNV_A_R_LINEAR_____0_CM 0. 255. DISPLAY_IDENTIFIER C_CTR_MAX_PVS_MOVE_ERR FORMAT "%3.0" /end CHARACTERISTIC
/begin CHARACTERISTIC c_n_pvs_bls_bts_plaus "" VALUE 0x85cb3f _REC_VAL_20_u1 8160. _CNV_A_R_LINEAR_____30_CM 0. 8160. DISPLAY_IDENTIFIER C_N_PVS_BLS_BTS_PLAUS FORMAT "%4.0" /end CHARACTERISTIC
/begin CHARACTERISTIC c_pv_av_hys_bls_bts_plaus "" VALUE 0x85cb66 _REC_VAL_20_u2 99.90234375 _CNV_A_R_LINEAR_____31_CM 0. 99.90234375 DISPLAY_IDENTIFIER C_PV_AV_HYS_BLS_BTS_PLAUS FORMAT "%3.1" /end CHARACTERISTIC
/begin CHARACTERISTIC c_pv_av_pvs_bls_bts_plaus "" VALUE 0x85cb6c _REC_VAL_20_u2 99.90234375 _CNV_A_R_LINEAR_____31_CM 0. 99.90234375 DISPLAY_IDENTIFIER C_PV_AV_PVS_BLS_BTS_PLAUS FORMAT "%3.1" /end CHARACTERISTIC
/begin CHARACTERISTIC c_pvs_ratio_fac "" VALUE 0x85cb78 _REC_VAL_20_u2 7.9998779296875 _CNV_A_R_LINEAR_____32_CM 0. 7.9998779296875 DISPLAY_IDENTIFIER C_PVS_RATIO_FAC FORMAT "%3.2" /end CHARACTERISTIC
/begin CHARACTERISTIC c_v_pvs_max_diag_1 "" VALUE 0x85cda8 _REC_VAL_20_u2 4.9951171875 _CNV_A_R_LINEAR_____28_CM 0. 4.9951171875 DISPLAY_IDENTIFIER C_V_PVS_MAX_DIAG_1 FORMAT "%3.2" /end CHARACTERISTIC
/begin CHARACTERISTIC c_v_pvs_max_diag_2 "" VALUE 0x85cdaa _REC_VAL_20_u2 4.9951171875 _CNV_A_R_LINEAR_____28_CM 0. 4.9951171875 DISPLAY_IDENTIFIER C_V_PVS_MAX_DIAG_2 FORMAT "%3.2" /end CHARACTERISTIC
/begin CHARACTERISTIC c_v_pvs_min_diag_1 "" VALUE 0x85cdae _REC_VAL_20_u2 4.9951171875 _CNV_A_R_LINEAR_____28_CM 0. 4.9951171875 DISPLAY_IDENTIFIER C_V_PVS_MIN_DIAG_1 FORMAT "%3.2" /end CHARACTERISTIC
/begin CHARACTERISTIC c_v_pvs_min_diag_2 "" VALUE 0x85cdb0 _REC_VAL_20_u2 4.9951171875 _CNV_A_R_LINEAR_____28_CM 0. 4.9951171875 DISPLAY_IDENTIFIER C_V_PVS_MIN_DIAG_2 FORMAT "%3.2" /end CHARACTERISTIC
/begin CHARACTERISTIC c_v_pvs_min_diag_min_1 "" VALUE 0x85cdb2 _REC_VAL_20_u2 4.9951171875 _CNV_A_R_LINEAR_____28_CM 0. 4.9951171875 DISPLAY_IDENTIFIER C_V_PVS_MIN_DIAG_MIN_1 FORMAT "%3.2" /end CHARACTERISTIC
/begin CHARACTERISTIC c_v_pvs_min_diag_min_2 "" VALUE 0x85cdb4 _REC_VAL_20_u2 4.9951171875 _CNV_A_R_LINEAR_____28_CM 0. 4.9951171875 DISPLAY_IDENTIFIER C_V_PVS_MIN_DIAG_MIN_2 FORMAT "%3.2" /end CHARACTERISTIC
/begin CHARACTERISTIC c_v_pvs_move_hys_1 "" VALUE 0x85cdb6 _REC_VAL_20_u2 4.9951171875 _CNV_A_R_LINEAR_____28_CM 0. 4.9951171875 DISPLAY_IDENTIFIER C_V_PVS_MOVE_HYS_1 FORMAT "%3.2" /end CHARACTERISTIC
/begin CHARACTERISTIC c_v_pvs_move_hys_2 "" VALUE 0x85cdb8 _REC_VAL_20_u2 4.9951171875 _CNV_A_R_LINEAR_____28_CM 0. 4.9951171875 DISPLAY_IDENTIFIER C_V_PVS_MOVE_HYS_2 FORMAT "%3.2" /end CHARACTERISTIC
/begin CHARACTERISTIC c_v_pvs_ratio_ofs "" VALUE 0x85cdba _REC_VAL_20_s2 4.995117000000001 _CNV_A_R_LINEAR_____33_CM -2.5 2.495117 DISPLAY_IDENTIFIER C_V_PVS_RATIO_OFS FORMAT "%4.2" /end CHARACTERISTIC
/begin CHARACTERISTIC c_v_pvs_thd_move_1 "" VALUE 0x85cdd8 _REC_VAL_20_u2 4.9951171875 _CNV_A_R_LINEAR_____28_CM 0. 4.9951171875 DISPLAY_IDENTIFIER C_V_PVS_THD_MOVE_1 FORMAT "%3.2" /end CHARACTERISTIC
/begin CHARACTERISTIC c_vs_pvs_bls_bts_plaus "" VALUE 0x85ce45 _REC_VAL_20_u1 255. _CNV_A_R_LINEAR_____34_CM 0. 255. DISPLAY_IDENTIFIER C_VS_PVS_BLS_BTS_PLAUS FORMAT "%3.0" /end CHARACTERISTIC
/begin CHARACTERISTIC lc_poti "" VALUE 0x85ce9f _REC_VAL_20_u1 1. _CNV_A_R_LINEAR_____0_CM 0. 1. DISPLAY_IDENTIFIER LC_POTI FORMAT "%1.0" /end CHARACTERISTIC
/begin CHARACTERISTIC lc_pvs_bls_bts_plaus_ena "" VALUE 0x85cea0 _REC_VAL_20_u1 1. _CNV_A_R_LINEAR_____0_CM 0. 1. DISPLAY_IDENTIFIER LC_PVS_BLS_BTS_PLAUS_ENA FORMAT "%1.0" /end CHARACTERISTIC
/begin AXIS_PTS ldp_v_pvs_min_ip_pvs_ratio_hys "" 0x8429ee v_pvs_min _REC_AXS_20_u2 4.9951171875 _CNV_A_R_LINEAR_____28_CM 6 0. 4.9951171875 FORMAT "%3.2" /end AXIS_PTS
/begin CHARACTERISTIC ip_pvs_ratio_hys__v_pvs_min "PVS: Maximum PVS ratio hystheresis" CURVE 0x8581f0 _REC_CUR_20_u2_u2 4.9951171875 _CNV_A_R_LINEAR_____28_CM 0. 4.9951171875 DISPLAY_IDENTIFIER IP_PVS_RATIO_HYS__V_PVS_MIN FORMAT "%3.2"
 /begin AXIS_DESCR COM_AXIS v_pvs_min _CNV_A_R_LINEAR_____28_CM 6 0. 4.9951171875 FORMAT "%3.2" AXIS_PTS_REF ldp_v_pvs_min_ip_pvs_ratio_hys /end AXIS_DESCR
/end CHARACTERISTIC
/begin CHARACTERISTIC c_abc_inc_vcc_1 "" VALUE 0x84faf5 _REC_VAL_20_u1 255. _CNV_A_R_LINEAR_____0_CM 0. 255. DISPLAY_IDENTIFIER C_ABC_INC_VCC_1 FORMAT "%3.0" /end CHARACTERISTIC
/begin CHARACTERISTIC c_abc_max_vcc_1 "" VALUE 0x84fb81 _REC_VAL_20_u1 255. _CNV_A_R_LINEAR_____0_CM 0. 255. DISPLAY_IDENTIFIER C_ABC_MAX_VCC_1 FORMAT "%3.0" /end CHARACTERISTIC
/begin CHARACTERISTIC c_abc_inc_vcc_2 "" VALUE 0x84faf6 _REC_VAL_20_u1 255. _CNV_A_R_LINEAR_____0_CM 0. 255. DISPLAY_IDENTIFIER C_ABC_INC_VCC_2 FORMAT "%3.0" /end CHARACTERISTIC
/begin CHARACTERISTIC c_abc_max_vcc_2 "" VALUE 0x84fb82 _REC_VAL_20_u1 255. _CNV_A_R_LINEAR_____0_CM 0. 255. DISPLAY_IDENTIFIER C_ABC_MAX_VCC_2 FORMAT "%3.0" /end CHARACTERISTIC
/begin CHARACTERISTIC c_vcc_min_diag "" VALUE 0x85ce1e _REC_VAL_20_u2 9.99023 _CNV_A_R_LINEAR_____35_CM 0. 9.99023 DISPLAY_IDENTIFIER C_VCC_MIN_DIAG FORMAT "%5.3" /end CHARACTERISTIC
/begin CHARACTERISTIC c_vcc_max_diag "" VALUE 0x85ce1c _REC_VAL_20_u2 9.99023 _CNV_A_R_LINEAR_____35_CM 0. 9.99023 DISPLAY_IDENTIFIER C_VCC_MAX_DIAG FORMAT "%5.3" /end CHARACTERISTIC
/begin CHARACTERISTIC c_amp_sub_diag "" VALUE 0x85c87c _REC_VAL_20_u2 5434. _CNV_A_R_LINEAR_____45_CM 0. 5434. DISPLAY_IDENTIFIER C_AMP_SUB_DIAG FORMAT "%4.3" /end CHARACTERISTIC
/begin CHARACTERISTIC ip_amp_mes__v_amp "Ambient pressure" CURVE 0x85097e _REC_CUR_20_u2_u2 5434. _CNV_A_R_LINEAR_____45_CM 0. 5434. DISPLAY_IDENTIFIER IP_AMP_MES__V_AMP FORMAT "%4.3"
 /begin AXIS_DESCR COM_AXIS v_amp _CNV_A_R_LINEAR_____28_CM 2 0. 4.9951171875 FORMAT "%3.2" AXIS_PTS_REF ldp_v_amp_ip_amp_mes /end AXIS_DESCR
/end CHARACTERISTIC
/begin AXIS_PTS ldp_v_amp_ip_amp_mes "" 0x8429a2 v_amp _REC_AXS_20_u2 4.9951171875 _CNV_A_R_LINEAR_____28_CM 2 0. 4.9951171875 FORMAT "%3.2" /end AXIS_PTS
/begin CHARACTERISTIC c_abc_inc_cyl_bal_0 "" VALUE 0x84fa8a _REC_VAL_20_u1 255. _CNV_A_R_LINEAR_____0_CM 0. 255. DISPLAY_IDENTIFIER C_ABC_INC_CYL_BAL_0 FORMAT "%3.0" /end CHARACTERISTIC
/begin CHARACTERISTIC c_abc_max_cyl_bal_0 "" VALUE 0x84fb16 _REC_VAL_20_u1 255. _CNV_A_R_LINEAR_____0_CM 0. 255. DISPLAY_IDENTIFIER C_ABC_MAX_CYL_BAL_0 FORMAT "%3.0" /end CHARACTERISTIC
/begin CHARACTERISTIC c_abc_inc_cyl_bal_1 "" VALUE 0x84fa8b _REC_VAL_20_u1 255. _CNV_A_R_LINEAR_____0_CM 0. 255. DISPLAY_IDENTIFIER C_ABC_INC_CYL_BAL_1 FORMAT "%3.0" /end CHARACTERISTIC
/begin CHARACTERISTIC c_abc_max_cyl_bal_1 "" VALUE 0x84fb17 _REC_VAL_20_u1 255. _CNV_A_R_LINEAR_____0_CM 0. 255. DISPLAY_IDENTIFIER C_ABC_MAX_CYL_BAL_1 FORMAT "%3.0" /end CHARACTERISTIC
/begin CHARACTERISTIC c_abc_inc_cyl_bal_2 "" VALUE 0x84fa8c _REC_VAL_20_u1 255. _CNV_A_R_LINEAR_____0_CM 0. 255. DISPLAY_IDENTIFIER C_ABC_INC_CYL_BAL_2 FORMAT "%3.0" /end CHARACTERISTIC
/begin CHARACTERISTIC c_abc_max_cyl_bal_2 "" VALUE 0x84fb18 _REC_VAL_20_u1 255. _CNV_A_R_LINEAR_____0_CM 0. 255. DISPLAY_IDENTIFIER C_ABC_MAX_CYL_BAL_2 FORMAT "%3.0" /end CHARACTERISTIC
/begin CHARACTERISTIC c_abc_inc_cyl_bal_3 "" VALUE 0x84fa8d _REC_VAL_20_u1 255. _CNV_A_R_LINEAR_____0_CM 0. 255. DISPLAY_IDENTIFIER C_ABC_INC_CYL_BAL_3 FORMAT "%3.0" /end CHARACTERISTIC
/begin CHARACTERISTIC c_abc_max_cyl_bal_3 "" VALUE 0x84fb19 _REC_VAL_20_u1 255. _CNV_A_R_LINEAR_____0_CM 0. 255. DISPLAY_IDENTIFIER C_ABC_MAX_CYL_BAL_3 FORMAT "%3.0" /end CHARACTERISTIC
/begin MEASUREMENT ctr_bas_cyl_bal[3] "" UBYTE _CNV_A_R_LINEAR_____0_CM 1 0. 0. 255. DISPLAY_IDENTIFIER CTR_BAS_CYL_BAL_3_ ECU_ADDRESS 0x7fb82e FORMAT "%3.0" /end MEASUREMENT
/begin MEASUREMENT ctr_eve_cyl_bal[3] "" UBYTE _CNV_A_R_LINEAR_____0_CM 1 0. 0. 255. DISPLAY_IDENTIFIER CTR_EVE_CYL_BAL_3_ ECU_ADDRESS 0x7fb832 FORMAT "%3.0" /end MEASUREMENT
/begin CHARACTERISTIC c_ctr_eve_cyl_bal_max "" VALUE 0x85c956 _REC_VAL_20_u1 255. _CNV_A_R_LINEAR_____0_CM 0. 255. DISPLAY_IDENTIFIER C_CTR_EVE_CYL_BAL_MAX FORMAT "%3.0" /end CHARACTERISTIC
/begin CHARACTERISTIC c_ctr_bas_cyl_bal_max "" VALUE 0x85c94d _REC_VAL_20_u1 255. _CNV_A_R_LINEAR_____0_CM 0. 255. DISPLAY_IDENTIFIER C_CTR_BAS_CYL_BAL_MAX FORMAT "%3.0" /end CHARACTERISTIC
/begin CHARACTERISTIC c_fac_is_fil_neg "" VALUE 0x85c9e2 _REC_VAL_20_u2 0.9999847412109381 _CNV_A_R_LINEAR_____14_CM 0. 0.9999847412109381 DISPLAY_IDENTIFIER C_FAC_IS_FIL_NEG FORMAT "%5.4" /end CHARACTERISTIC
/begin CHARACTERISTIC c_fac_is_fil_pos "" VALUE 0x85c9e4 _REC_VAL_20_u2 0.9999847412109381 _CNV_A_R_LINEAR_____14_CM 0. 0.9999847412109381 DISPLAY_IDENTIFIER C_FAC_IS_FIL_POS FORMAT "%5.4" /end CHARACTERISTIC
/begin CHARACTERISTIC c_t_is_fil_ais_req "" VALUE 0x85cc4e _REC_VAL_20_u2 6553.5 _CNV_A_R_LINEAR_____19_CM 0. 6553.5 DISPLAY_IDENTIFIER C_T_IS_FIL_AIS_REQ FORMAT "%5.1" /end CHARACTERISTIC
/begin AXIS_PTS ldp_dri_id_fac_pl_is "" 0x84160a dri _REC_AXS_20_u1 15. _CNV_P_8_TABLE_______68_CM 7 0. 15. FORMAT "%2.0" /end AXIS_PTS
/begin AXIS_PTS ldp_tco_ip_fac_fil_pl_is "" 0x84229a tco _REC_AXS_20_u1 255. _CNV_A_R_LINEAR_____18_CM 8 -50. 205. FORMAT "%4.0" /end AXIS_PTS
/begin AXIS_PTS ldp_tco_ip_fac_fil_st_is "" 0x8422a3 tco _REC_AXS_20_u1 255. _CNV_A_R_LINEAR_____18_CM 8 -50. 205. FORMAT "%4.0" /end AXIS_PTS
/begin CHARACTERISTIC id_fac_pl_is__dri "IS: setpoint filter factor transition PL -> IS for gear" CURVE 0x85031a _REC_CUR_20_u2_u1 0.9999847412109381 _CNV_A_R_LINEAR_____14_CM 0. 0.9999847412109381 DISPLAY_IDENTIFIER ID_FAC_PL_IS__DRI FORMAT "%4.3"
 /begin AXIS_DESCR COM_AXIS dri _CNV_P_8_TABLE_______68_CM 7 0. 15. FORMAT "%2.0" AXIS_PTS_REF ldp_dri_id_fac_pl_is /end AXIS_DESCR
/end CHARACTERISTIC
/begin CHARACTERISTIC ip_fac_fil_pl_is__tco "IS: setpoint filter factor transition PL -> IS for TCO" CURVE 0x852420 _REC_CUR_20_u2_u1 0.9999847412109381 _CNV_A_R_LINEAR_____14_CM 0. 0.9999847412109381 DISPLAY_IDENTIFIER IP_FAC_FIL_PL_IS__TCO FORMAT "%4.3"
 /begin AXIS_DESCR COM_AXIS tco _CNV_A_R_LINEAR_____18_CM 8 -50. 205. FORMAT "%4.0" AXIS_PTS_REF ldp_tco_ip_fac_fil_pl_is /end AXIS_DESCR
/end CHARACTERISTIC
/begin CHARACTERISTIC ip_fac_fil_st_is__tco "IS: setpoint filter factor transition ST -> IS" CURVE 0x852430 _REC_CUR_20_u2_u1 0.9999847412109381 _CNV_A_R_LINEAR_____14_CM 0. 0.9999847412109381 DISPLAY_IDENTIFIER IP_FAC_FIL_ST_IS__TCO FORMAT "%4.3"
 /begin AXIS_DESCR COM_AXIS tco _CNV_A_R_LINEAR_____18_CM 8 -50. 205. FORMAT "%4.0" AXIS_PTS_REF ldp_tco_ip_fac_fil_st_is /end AXIS_DESCR
/end CHARACTERISTIC
/begin CHARACTERISTIC id_dri__vs_n "Drive detection map" CURVE 0x8502d6 _REC_CUR_20_u1_u2 6. _CNV_A_R_LINEAR_____0_CM 0. 6. DISPLAY_IDENTIFIER ID_DRI__VS_N FORMAT "%2.0"
 /begin AXIS_DESCR COM_AXIS vs_n _CNV_A_R_LINEAR_____70_CM 13 0. 0.1 FORMAT "%7.6" AXIS_PTS_REF ldp_vs_n_id_dri /end AXIS_DESCR
/end CHARACTERISTIC
/begin AXIS_PTS ldp_vs_n_id_dri "" 0x842ad4 vs_n _REC_AXS_20_u2 9.e-002 _CNV_A_R_LINEAR_____70_CM 13 0. 0.1 FORMAT "%7.6" /end AXIS_PTS
/begin CHARACTERISTIC c_vs_n_grd_fil_thd "" VALUE 0x85ce3e _REC_VAL_20_s2 9.9998474e-002 _CNV_A_R_LINEAR_____69_CM -5.e-002 4.9998474e-002 DISPLAY_IDENTIFIER C_VS_N_GRD_FIL_THD FORMAT "%7.6" /end CHARACTERISTIC
/begin CHARACTERISTIC lc_dri "" VALUE 0x85ce6a _REC_VAL_20_u1 255. _CNV_A_R_LINEAR_____0_CM 0. 255. DISPLAY_IDENTIFIER LC_DRI FORMAT "%3.0" /end CHARACTERISTIC
/begin CHARACTERISTIC c_fac_fil_vs_n_grd "" VALUE 0x85c9e0 _REC_VAL_20_u2 0.9999847412109381 _CNV_A_R_LINEAR_____14_CM 0. 0.9999847412109381 DISPLAY_IDENTIFIER C_FAC_FIL_VS_N_GRD FORMAT "%6.5" /end CHARACTERISTIC
/begin CHARACTERISTIC lc_dri_sub "" VALUE 0x85ce6b _REC_VAL_20_u1 1. _CNV_S_2_RANGE______11_CM 0. 1. DISPLAY_IDENTIFIER LC_DRI_SUB /end CHARACTERISTIC
/begin CHARACTERISTIC c_dri_sub "" VALUE 0x85c984 _REC_VAL_20_u1 6. _CNV_A_R_LINEAR_____0_CM 0. 6. DISPLAY_IDENTIFIER C_DRI_SUB FORMAT "%1.0" /end CHARACTERISTIC
/begin CHARACTERISTIC c_t_max_vs_n "" VALUE 0x85cc66 _REC_VAL_20_u2 655.35 _CNV_A_R_LINEAR_____56_CM 0. 655.35 DISPLAY_IDENTIFIER C_T_MAX_VS_N FORMAT "%5.2" /end CHARACTERISTIC
/begin CHARACTERISTIC c_vs_n_hys "" VALUE 0x85ce40 _REC_VAL_20_u2 0.1 _CNV_A_R_LINEAR_____70_CM 0. 0.1 DISPLAY_IDENTIFIER C_VS_N_HYS FORMAT "%5.4" /end CHARACTERISTIC
/begin CHARACTERISTIC c_t_max_vs_n_diag "" VALUE 0x85cc68 _REC_VAL_20_u2 655.35 _CNV_A_R_LINEAR_____56_CM 0. 655.35 DISPLAY_IDENTIFIER C_T_MAX_VS_N_DIAG FORMAT "%5.2" /end CHARACTERISTIC
/begin CHARACTERISTIC c_vs_n_hys_diag "" VALUE 0x85ce42 _REC_VAL_20_u2 0.1 _CNV_A_R_LINEAR_____70_CM 0. 0.1 DISPLAY_IDENTIFIER C_VS_N_HYS_DIAG FORMAT "%5.4" /end CHARACTERISTIC
/begin CHARACTERISTIC c_t_upd_vs_abs "" VALUE 0x85cc9c _REC_VAL_20_u2 1.024 _CNV_A_R_LINEAR_____73_CM 0. 1.024 DISPLAY_IDENTIFIER C_T_UPD_VS_ABS FORMAT "%4.3" /end CHARACTERISTIC
/begin CHARACTERISTIC c_vs_lih_grd "" VALUE 0x85ce36 _REC_VAL_20_u2 655.35 _CNV_A_R_LINEAR_____71_CM 0. 655.35 DISPLAY_IDENTIFIER C_VS_LIH_GRD FORMAT "%5.2" /end CHARACTERISTIC
/begin CHARACTERISTIC c_vs_lih "" VALUE 0x85ce34 _REC_VAL_20_u2 655.35 _CNV_A_R_LINEAR_____71_CM 0. 655.35 DISPLAY_IDENTIFIER C_VS_LIH FORMAT "%5.2" /end CHARACTERISTIC
/begin CHARACTERISTIC c_fac_vs_fil "" VALUE 0x85ca2c _REC_VAL_20_u2 0.9999847412109381 _CNV_A_R_LINEAR_____14_CM 0. 0.9999847412109381 DISPLAY_IDENTIFIER C_FAC_VS_FIL FORMAT "%6.5" /end CHARACTERISTIC
/begin CHARACTERISTIC lc_ac_fil "" VALUE 0x85ce46 _REC_VAL_20_u1 1. _CNV_A_R_LINEAR_____0_CM 0. 1. DISPLAY_IDENTIFIER LC_AC_FIL FORMAT "%2.0" /end CHARACTERISTIC
/begin CHARACTERISTIC c_vs_det_min "" VALUE 0x85ce32 _REC_VAL_20_u1 25.5 _CNV_A_R_LINEAR_____74_CM 0. 25.5 DISPLAY_IDENTIFIER C_VS_DET_MIN FORMAT "%3.1" /end CHARACTERISTIC
/begin CHARACTERISTIC c_vs_puls_div "" VALUE 0x85ce44 _REC_VAL_20_u1 255. _CNV_A_R_LINEAR_____0_CM 0. 255. DISPLAY_IDENTIFIER C_VS_PULS_DIV FORMAT "%3.0" /end CHARACTERISTIC
/begin CHARACTERISTIC c_buf_size_vs "" VALUE 0x85c8d0 _REC_VAL_20_u1 16. _CNV_A_R_LINEAR_____0_CM 0. 16. DISPLAY_IDENTIFIER C_BUF_SIZE_VS FORMAT "%3.0" /end CHARACTERISTIC
/begin CHARACTERISTIC c_abc_inc_vs "" VALUE 0x84faf7 _REC_VAL_20_u1 255. _CNV_A_R_LINEAR_____0_CM 0. 255. DISPLAY_IDENTIFIER C_ABC_INC_VS FORMAT "%3.0" /end CHARACTERISTIC
/begin CHARACTERISTIC c_abc_max_vs "" VALUE 0x84fb83 _REC_VAL_20_u1 255. _CNV_A_R_LINEAR_____0_CM 0. 255. DISPLAY_IDENTIFIER C_ABC_MAX_VS FORMAT "%3.0" /end CHARACTERISTIC
/begin CHARACTERISTIC c_mf_tot_vs_cor_diag "" VALUE 0x85caee _REC_VAL_20_u2 262.14 _CNV_A_R_LINEAR_____38_CM 0. 262.14 DISPLAY_IDENTIFIER C_MF_TOT_VS_COR_DIAG FORMAT "%5.2" /end CHARACTERISTIC
/begin CHARACTERISTIC c_vs_max_diag "" VALUE 0x85ce38 _REC_VAL_20_u1 255. _CNV_A_R_LINEAR_____34_CM 0. 255. DISPLAY_IDENTIFIER C_VS_MAX_DIAG FORMAT "%3.0" /end CHARACTERISTIC
/begin CHARACTERISTIC c_vs_min_diag "" VALUE 0x85ce3c _REC_VAL_20_u1 255. _CNV_A_R_LINEAR_____34_CM 0. 255. DISPLAY_IDENTIFIER C_VS_MIN_DIAG FORMAT "%3.0" /end CHARACTERISTIC
/begin CHARACTERISTIC c_n_vs_cor_diag "" VALUE 0x85cb52 _REC_VAL_20_u2 6375. _CNV_A_R_LINEAR_____5_CM 0. 6375. DISPLAY_IDENTIFIER C_N_VS_COR_DIAG FORMAT "%4.0" /end CHARACTERISTIC
/begin CHARACTERISTIC c_n_dif_vs_cor_diag "" VALUE 0x85cb04 _REC_VAL_20_u2 6375. _CNV_A_R_LINEAR_____75_CM 0. 6375. DISPLAY_IDENTIFIER C_N_DIF_VS_COR_DIAG FORMAT "%4.0" /end CHARACTERISTIC
/begin CHARACTERISTIC c_tco_vs_cor_diag "" VALUE 0x85ccc7 _REC_VAL_20_u1 255. _CNV_A_R_LINEAR_____18_CM -50. 205. DISPLAY_IDENTIFIER C_TCO_VS_COR_DIAG FORMAT "%3.2" /end CHARACTERISTIC
/begin CHARACTERISTIC c_t_max_vs_cor_diag "" VALUE 0x85cc64 _REC_VAL_20_u2 6553.5 _CNV_A_R_LINEAR_____19_CM 0. 6553.5 DISPLAY_IDENTIFIER C_T_MAX_VS_COR_DIAG FORMAT "%5.1" /end CHARACTERISTIC
/begin CHARACTERISTIC c_fac_vs "" VALUE 0x85ca2a _REC_VAL_20_u2 65535. _CNV_A_R_LINEAR_____76_CM 0. 65535. DISPLAY_IDENTIFIER C_FAC_VS FORMAT "%5.0" /end CHARACTERISTIC
/begin CHARACTERISTIC lc_can_vs_abs "" VALUE 0x85ce5b _REC_VAL_20_u1 1. _CNV_A_R_LINEAR_____0_CM 0. 1. DISPLAY_IDENTIFIER LC_CAN_VS_ABS FORMAT "%1.0" /end CHARACTERISTIC
/begin CHARACTERISTIC lc_can_ac_abs "" VALUE 0x85ce59 _REC_VAL_20_u1 1. _CNV_A_R_LINEAR_____0_CM 0. 1. DISPLAY_IDENTIFIER LC_CAN_AC_ABS FORMAT "%1.0" /end CHARACTERISTIC
/begin CHARACTERISTIC lc_can_dist_abs "" VALUE 0x85ce5a _REC_VAL_20_u1 1. _CNV_A_R_LINEAR_____0_CM 0. 1. DISPLAY_IDENTIFIER LC_CAN_DIST_ABS FORMAT "%1.0" /end CHARACTERISTIC
/begin AXIS_PTS ldpm_n_ip_tqfr "" 0x8435b0 n _REC_AXS_20_u2 6375. _CNV_A_R_LINEAR_____5_CM 12 0. 6375. FORMAT "%4.0" /end AXIS_PTS
/begin MEASUREMENT lv_efp_rly "" UBYTE _CNV_A_R_LINEAR_____0_CM 1 0. 0. 1. DISPLAY_IDENTIFIER LV_EFP_RLY ECU_ADDRESS 0x7fbb17 FORMAT "%1.0" /end MEASUREMENT
/begin MEASUREMENT lv_efp_reset "" UBYTE _CNV_A_R_LINEAR_____0_CM 1 0. 0. 1. DISPLAY_IDENTIFIER LV_EFP_RESET ECU_ADDRESS 0x7fbf53 FORMAT "%1.0" /end MEASUREMENT
/begin MEASUREMENT lv_efp_reset_st "" UBYTE _CNV_A_R_LINEAR_____0_CM 1 0. 0. 1. DISPLAY_IDENTIFIER LV_EFP_RESET_ST ECU_ADDRESS 0x7fbf54 FORMAT "%1.0" /end MEASUREMENT
/begin MEASUREMENT lv_efp_reset_es "" UBYTE _CNV_A_R_LINEAR_____0_CM 1 0. 0. 1. DISPLAY_IDENTIFIER LV_EFP_RESET_ES ECU_ADDRESS 0x7fbf55 FORMAT "%1.0" /end MEASUREMENT
/begin CHARACTERISTIC lc_efp_ctl_on "" VALUE 0x85ce6f _REC_VAL_20_u1 1. _CNV_A_R_LINEAR_____0_CM 0. 1. DISPLAY_IDENTIFIER LC_EFP_CTL_ON FORMAT "%1.0" /end CHARACTERISTIC
/begin CHARACTERISTIC lc_efp_rly_man_on "" VALUE 0x85ce70 _REC_VAL_20_u1 1. _CNV_A_R_LINEAR_____0_CM 0. 1. DISPLAY_IDENTIFIER LC_EFP_RLY_MAN_ON FORMAT "%1.0" /end CHARACTERISTIC
/begin CHARACTERISTIC c_t_efp_reset_st "" VALUE 0x85cc34 _REC_VAL_20_u2 6553.5 _CNV_A_R_LINEAR_____19_CM 0. 6553.5 DISPLAY_IDENTIFIER C_T_EFP_RESET_ST FORMAT "%5.4" /end CHARACTERISTIC
/begin CHARACTERISTIC c_t_efp_reset_es "" VALUE 0x85cc32 _REC_VAL_20_u2 6553.5 _CNV_A_R_LINEAR_____19_CM 0. 6553.5 DISPLAY_IDENTIFIER C_T_EFP_RESET_ES FORMAT "%5.4" /end CHARACTERISTIC
/begin CHARACTERISTIC c_crlc_tqfr "" VALUE 0x85c90c _REC_VAL_20_u2 0.9999847412109381 _CNV_A_R_LINEAR_____14_CM 0. 0.9999847412109381 DISPLAY_IDENTIFIER C_CRLC_TQFR FORMAT "%5.4" /end CHARACTERISTIC
/begin CHARACTERISTIC ip_tqfr_add__n_mmv__toil "TQ: LOSS TOIL correction" MAP 0x85b91c _REC_MAP_20_u2_u2_u1 2047.96875 _CNV_A_R_LINEAR_____86_CM -1024. 1023.96875 DISPLAY_IDENTIFIER IP_TQFR_ADD__N_MMV__TOIL FORMAT "%7.2"
 /begin AXIS_DESCR COM_AXIS n_mmv _CNV_A_R_LINEAR_____5_CM 12 0. 6375. FORMAT "%4.0" AXIS_PTS_REF ldpm_n_mmv_ip_tqfr_add /end AXIS_DESCR
 /begin AXIS_DESCR COM_AXIS toil _CNV_A_R_LINEAR_____18_CM 8 -50. 205. FORMAT "%3.0" AXIS_PTS_REF ldp_toil_ip_tqfr_add /end AXIS_DESCR
/end CHARACTERISTIC
/begin CHARACTERISTIC ip_tqfr_add__n_mmv__tco "TQ: LOSS TCO correction" MAP 0x85b85c _REC_MAP_20_u2_u2_u1 2047.96875 _CNV_A_R_LINEAR_____86_CM -1024. 1023.96875 DISPLAY_IDENTIFIER IP_TQFR_ADD__N_MMV__TCO FORMAT "%7.2"
 /begin AXIS_DESCR COM_AXIS n_mmv _CNV_A_R_LINEAR_____5_CM 12 0. 6375. FORMAT "%4.0" AXIS_PTS_REF ldpm_n_mmv_ip_tqfr_add /end AXIS_DESCR
 /begin AXIS_DESCR COM_AXIS tco _CNV_A_R_LINEAR_____18_CM 8 -50. 205. FORMAT "%3.0" AXIS_PTS_REF ldp_tco_ip_tqfr_add /end AXIS_DESCR
/end CHARACTERISTIC
/begin CHARACTERISTIC ip_tqfr__n "TQ: LOSS warm engine" CURVE 0x85b844 _REC_CUR_20_u2_u2 2047.96875 _CNV_A_R_LINEAR_____86_CM -1024. 1023.96875 DISPLAY_IDENTIFIER IP_TQFR__N FORMAT "%7.2"
 /begin AXIS_DESCR COM_AXIS n _CNV_A_R_LINEAR_____5_CM 12 0. 6375. FORMAT "%4.0" AXIS_PTS_REF ldpm_n_ip_tqfr /end AXIS_DESCR
/end CHARACTERISTIC
/begin AXIS_PTS ldpm_n_mmv_ip_tqfr_add "" 0x84371e n_mmv _REC_AXS_20_u2 6375. _CNV_A_R_LINEAR_____5_CM 12 0. 6375. FORMAT "%4.0" /end AXIS_PTS
/begin AXIS_PTS ldp_toil_ip_tqfr_add "" 0x842595 toil _REC_AXS_20_u1 255. _CNV_A_R_LINEAR_____18_CM 8 -50. 205. FORMAT "%3.0" /end AXIS_PTS
/begin AXIS_PTS ldp_tco_ip_tqfr_add "" 0x8423f0 tco _REC_AXS_20_u1 255. _CNV_A_R_LINEAR_____18_CM 8 -50. 205. FORMAT "%3.0" /end AXIS_PTS
/begin CHARACTERISTIC c_tq_max_sca "" VALUE 0x85cd34 _REC_VAL_20_s2 2047.96875 _CNV_A_R_LINEAR_____52_CM -1024. 1023.96875 DISPLAY_IDENTIFIER C_TQ_MAX_SCA FORMAT "%5.1" /end CHARACTERISTIC
/begin CHARACTERISTIC lc_tq_tra_act "" VALUE 0x85cebd _REC_VAL_20_u1 1. _CNV_A_R_LINEAR_____0_CM 0. 1. DISPLAY_IDENTIFIER LC_TQ_TRA_ACT FORMAT "%1.0" /end CHARACTERISTIC
/begin CHARACTERISTIC c_fac_pv_av_dif_tra "" VALUE 0x85c9fa _REC_VAL_20_u2 1. _CNV_A_R_LINEAR_____88_CM 0. 1. DISPLAY_IDENTIFIER C_FAC_PV_AV_DIF_TRA FORMAT "%6.5" /end CHARACTERISTIC
/begin CHARACTERISTIC c_pv_av_max "" VALUE 0x85cb68 _REC_VAL_20_u2 100. _CNV_A_R_LINEAR_____78_CM 0. 100. DISPLAY_IDENTIFIER C_PV_AV_MAX FORMAT "%4.2" /end CHARACTERISTIC
/begin CHARACTERISTIC lc_tq_tra_pv_av_lim "" VALUE 0x85cebf _REC_VAL_20_u1 1. _CNV_A_R_LINEAR_____0_CM 0. 1. DISPLAY_IDENTIFIER LC_TQ_TRA_PV_AV_LIM FORMAT "%1.0" /end CHARACTERISTIC
/begin CHARACTERISTIC c_n_dif_max "" VALUE 0x85cb02 _REC_VAL_20_u2 6375. _CNV_A_R_LINEAR_____5_CM 0. 6375. DISPLAY_IDENTIFIER C_N_DIF_MAX FORMAT "%4.0" /end CHARACTERISTIC
/begin CHARACTERISTIC c_fac_n_dif_tra "" VALUE 0x85c9f8 _REC_VAL_20_u2 1. _CNV_A_R_LINEAR_____88_CM 0. 1. DISPLAY_IDENTIFIER C_FAC_N_DIF_TRA FORMAT "%6.5" /end CHARACTERISTIC
/begin CHARACTERISTIC lc_n_mmv_tra_act "" VALUE 0x85ce94 _REC_VAL_20_u1 1. _CNV_A_R_LINEAR_____0_CM 0. 1. DISPLAY_IDENTIFIER LC_N_MMV_TRA_ACT FORMAT "%1.0" /end CHARACTERISTIC
/begin CHARACTERISTIC lc_tq_tra_n_lim "" VALUE 0x85cebe _REC_VAL_20_u1 1. _CNV_A_R_LINEAR_____0_CM 0. 1. DISPLAY_IDENTIFIER LC_TQ_TRA_N_LIM FORMAT "%1.0" /end CHARACTERISTIC
/begin CHARACTERISTIC c_t_dly_diag_tcs_dec "" VALUE 0x84ff67 _REC_VAL_20_u1 2.55 _CNV_A_R_LINEAR_____56_CM 0. 2.55 DISPLAY_IDENTIFIER C_T_DLY_DIAG_TCS_DEC FORMAT "%3.2" /end CHARACTERISTIC
/begin CHARACTERISTIC c_t_max_tcs_inc "" VALUE 0x84ffc6 _REC_VAL_20_u2 655.35 _CNV_A_R_LINEAR_____56_CM 0. 655.35 DISPLAY_IDENTIFIER C_T_MAX_TCS_INC FORMAT "%5.2" /end CHARACTERISTIC
/begin CHARACTERISTIC c_tq_inc_sum_max_tcs "" VALUE 0x85005a _REC_VAL_20_u2 16383.75 _CNV_A_R_LINEAR_____90_CM 0. 16383.75 DISPLAY_IDENTIFIER C_TQ_INC_SUM_MAX_TCS FORMAT "%7.2" /end CHARACTERISTIC
/begin CHARACTERISTIC c_vs_min_tcs_inc "" VALUE 0x8500ff _REC_VAL_20_u1 255. _CNV_A_R_LINEAR_____34_CM 0. 255. DISPLAY_IDENTIFIER C_VS_MIN_TCS_INC FORMAT "%3.0" /end CHARACTERISTIC
/begin CHARACTERISTIC lc_tcs_dec_act "" VALUE 0x85016e _REC_VAL_20_u1 1. _CNV_A_R_LINEAR_____0_CM 0. 1. DISPLAY_IDENTIFIER LC_TCS_DEC_ACT FORMAT "%1.0" /end CHARACTERISTIC
/begin CHARACTERISTIC lc_tcs_inc_act "" VALUE 0x85016f _REC_VAL_20_u1 1. _CNV_A_R_LINEAR_____0_CM 0. 1. DISPLAY_IDENTIFIER LC_TCS_INC_ACT FORMAT "%1.0" /end CHARACTERISTIC
/begin CHARACTERISTIC lc_tcs_inc_di_clu "" VALUE 0x850170 _REC_VAL_20_u1 1. _CNV_A_R_LINEAR_____0_CM 0. 1. DISPLAY_IDENTIFIER LC_TCS_INC_DI_CLU FORMAT "%1.0" /end CHARACTERISTIC
/begin MEASUREMENT lv_var_sap "Sekundärluftpumpe verbaut (dsk_byte_0 bit 4)" UBYTE _CNV_S_2_RANGE__0___85_CM 1 0. 0. 1. DISPLAY_IDENTIFIER LV_VAR_SAP ECU_ADDRESS 0x7fba4b BIT_MASK 0x1 /end MEASUREMENT
/begin MEASUREMENT lv_var_sav "ansteuerbares Sekundärluftventil verbaut (dsk_byte_0 bit 5)" UBYTE _CNV_S_2_RANGE__0___85_CM 1 0. 0. 1. DISPLAY_IDENTIFIER LV_VAR_SAV ECU_ADDRESS 0x7fba4c BIT_MASK 0x1 /end MEASUREMENT
/begin MEASUREMENT lv_var_egr "EGR-Ventil verbaut (dsk_byte_0 bit 6)" UBYTE _CNV_S_2_RANGE__0___85_CM 1 0. 0. 1. DISPLAY_IDENTIFIER LV_VAR_EGR ECU_ADDRESS 0x7fba4d BIT_MASK 0x1 /end MEASUREMENT
/begin MEASUREMENT lv_var_knks_2 "2 Klopfsensoren verbaut (dsk_byte_1 bit 5)" UBYTE _CNV_S_2_RANGE__0___85_CM 1 0. 0. 1. DISPLAY_IDENTIFIER LV_VAR_KNKS_2 ECU_ADDRESS 0x7fba55 BIT_MASK 0x1 /end MEASUREMENT
/begin MEASUREMENT lv_var_mil "MIL aktiv (dsk_byte_1 bit 6)" UBYTE _CNV_S_2_RANGE__0___85_CM 1 0. 0. 1. DISPLAY_IDENTIFIER LV_VAR_MIL ECU_ADDRESS 0x7fba56 BIT_MASK 0x1 /end MEASUREMENT
/begin MEASUREMENT lv_var_pwl "Hauptrelais verbaut, d.h. ECF-Diagnose im Nachlauf aktiv (dsk_byte_1 bit 7)" UBYTE _CNV_S_2_RANGE__0___85_CM 1 0. 0. 1. DISPLAY_IDENTIFIER LV_VAR_PWL ECU_ADDRESS 0x7fba57 BIT_MASK 0x1 /end MEASUREMENT
/begin MEASUREMENT lv_var_cps "Tankentlüftungsventil verbaut (dsk_byte_3 bit 3)" UBYTE _CNV_S_2_RANGE__0___85_CM 1 0. 0. 1. DISPLAY_IDENTIFIER LV_VAR_CPS ECU_ADDRESS 0x7fba5c BIT_MASK 0x1 /end MEASUREMENT
/begin MEASUREMENT lv_var_cs "Kupplungsschalter verbaut (dsk_byte_3 bit 4)" UBYTE _CNV_S_2_RANGE__0___85_CM 1 0. 0. 1. DISPLAY_IDENTIFIER LV_VAR_CS ECU_ADDRESS 0x7fba5d BIT_MASK 0x1 /end MEASUREMENT
/begin MEASUREMENT lv_var_can "CAN aktiv (dsk_byte_4 bit 0)" UBYTE _CNV_S_2_RANGE__0___85_CM 1 0. 0. 1. DISPLAY_IDENTIFIER LV_VAR_CAN ECU_ADDRESS 0x7fba61 BIT_MASK 0x1 /end MEASUREMENT
/begin MEASUREMENT lv_var_can_vecu "Bordnetzsteuergerät vorhanden (dsk_byte_4 bit 3)" UBYTE _CNV_S_2_RANGE__0___85_CM 1 0. 0. 1. DISPLAY_IDENTIFIER LV_VAR_CAN_VECU ECU_ADDRESS 0x7fba64 BIT_MASK 0x1 /end MEASUREMENT
/begin MEASUREMENT lv_var_rr_sw "SW Algorithmus zur RR Detektierung verwenden (dsk_byte_4 bit 4)" UBYTE _CNV_S_2_RANGE__0___85_CM 1 0. 0. 1. DISPLAY_IDENTIFIER LV_VAR_RR_SW ECU_ADDRESS 0x7fba65 BIT_MASK 0x1 /end MEASUREMENT
/begin MEASUREMENT lv_var_ac "Klimaanlage verbaut (dsk_byte_0 bit 0)" UBYTE _CNV_S_2_RANGE__0___85_CM 1 0. 0. 1. DISPLAY_IDENTIFIER LV_VAR_AC ECU_ADDRESS 0x7fba48 BIT_MASK 0x1 /end MEASUREMENT
/begin MEASUREMENT lv_var_syn "syncro codiert" UBYTE _CNV_S_2_RANGE__0___85_CM 1 0. 0. 1. DISPLAY_IDENTIFIER LV_VAR_SYN ECU_ADDRESS 0x7fba69 BIT_MASK 0x1 /end MEASUREMENT
/begin MEASUREMENT lv_var_climatronic "Klimatronic codiert" UBYTE _CNV_S_2_RANGE__0___85_CM 1 0. 0. 1. DISPLAY_IDENTIFIER LV_VAR_CLIMATRONIC ECU_ADDRESS 0x7fba6a BIT_MASK 0x1 /end MEASUREMENT
/begin MEASUREMENT lv_var_can_tcs "TCS (traction control) via CAN codiert" UBYTE _CNV_S_2_RANGE__0___85_CM 1 0. 0. 1. DISPLAY_IDENTIFIER LV_VAR_CAN_TCS ECU_ADDRESS 0x7fba6b BIT_MASK 0x1 /end MEASUREMENT
/begin MEASUREMENT lv_var_can_acu "CAN Airbag codiert" UBYTE _CNV_S_2_RANGE__0___85_CM 1 0. 0. 1. DISPLAY_IDENTIFIER LV_VAR_CAN_ACU ECU_ADDRESS 0x7fba6e BIT_MASK 0x1 /end MEASUREMENT
/begin MEASUREMENT lv_var_can_ccu "CAN Klima codiert" UBYTE _CNV_S_2_RANGE__0___85_CM 1 0. 0. 1. DISPLAY_IDENTIFIER LV_VAR_CAN_CCU ECU_ADDRESS 0x7fba6f BIT_MASK 0x1 /end MEASUREMENT
/begin MEASUREMENT lv_var_can_tcu "CAN TCU (transmission control) codiert, d.h.  AT codiert" UBYTE _CNV_S_2_RANGE__0___85_CM 1 0. 0. 1. DISPLAY_IDENTIFIER LV_VAR_CAN_TCU ECU_ADDRESS 0x7fba70 BIT_MASK 0x1 /end MEASUREMENT
/begin MEASUREMENT lv_at "= LV_VAR_CAN_TCU; d.h. AT codiert" UBYTE _CNV_S_2_RANGE__0___85_CM 1 0. 0. 1. DISPLAY_IDENTIFIER LV_AT ECU_ADDRESS 0x7fba71 BIT_MASK 0x1 /end MEASUREMENT
/begin MEASUREMENT lv_var_asr "Traktionskontrolle verbaut" UBYTE _CNV_S_2_RANGE__0___85_CM 1 0. 0. 1. DISPLAY_IDENTIFIER LV_VAR_ASR ECU_ADDRESS 0x7fba6c BIT_MASK 0x1 /end MEASUREMENT
/begin CHARACTERISTIC c_dsk_byte_1 "Datensatzkennung Byte 1" VALUE 0x84fc9f _REC_VAL_20_u1 255. _CNV_A_R_LINEAR_____1_CM 0. 255. DISPLAY_IDENTIFIER C_DSK_BYTE_1 FORMAT "%3.0" /end CHARACTERISTIC
/begin CHARACTERISTIC c_dsk_byte_2 "Datensatzkennung Byte 2" VALUE 0x84fca0 _REC_VAL_20_u1 255. _CNV_A_R_LINEAR_____1_CM 0. 255. DISPLAY_IDENTIFIER C_DSK_BYTE_2 FORMAT "%3.0" /end CHARACTERISTIC
/begin CHARACTERISTIC c_dsk_byte_3 "Datensatzkennung Byte 3" VALUE 0x84fca1 _REC_VAL_20_u1 255. _CNV_A_R_LINEAR_____1_CM 0. 255. DISPLAY_IDENTIFIER C_DSK_BYTE_3 FORMAT "%3.0" /end CHARACTERISTIC
/begin CHARACTERISTIC c_dsk_byte_4 "Datensatzkennung Byte 4" VALUE 0x84fca2 _REC_VAL_20_u1 255. _CNV_A_R_LINEAR_____1_CM 0. 255. DISPLAY_IDENTIFIER C_DSK_BYTE_4 FORMAT "%3.0" /end CHARACTERISTIC
/begin CHARACTERISTIC c_dsk_byte_0 "Datensatzkennung Byte 0" VALUE 0x84fc9e _REC_VAL_20_u1 255. _CNV_A_R_LINEAR_____1_CM 0. 255. DISPLAY_IDENTIFIER C_DSK_BYTE_0 FORMAT "%3.0" /end CHARACTERISTIC
/begin CHARACTERISTIC c_var_code_2 "vorgesehene Variantencodiermöglichkeit über VAG-Tester" VALUE 0x8500da _REC_VAL_20_u2 32767. _CNV_A_R_LINEAR_____0_CM 0. 32767. DISPLAY_IDENTIFIER C_VAR_CODE_2 FORMAT "%5.0" /end CHARACTERISTIC
/begin CHARACTERISTIC c_var_code_3 "vorgesehene Variantencodiermöglichkeit über VAG-Tester" VALUE 0x8500dc _REC_VAL_20_u2 32767. _CNV_A_R_LINEAR_____0_CM 0. 32767. DISPLAY_IDENTIFIER C_VAR_CODE_3 FORMAT "%5.0" /end CHARACTERISTIC
/begin CHARACTERISTIC c_var_code_5 "vorgesehene Variantencodiermöglichkeit über VAG-Tester" VALUE 0x8500e0 _REC_VAL_20_u2 32767. _CNV_A_R_LINEAR_____0_CM 0. 32767. DISPLAY_IDENTIFIER C_VAR_CODE_5 FORMAT "%5.0" /end CHARACTERISTIC
/begin CHARACTERISTIC c_var_code_6 "vorgesehene Variantencodiermöglichkeit über VAG-Tester" VALUE 0x8500e2 _REC_VAL_20_u2 32767. _CNV_A_R_LINEAR_____0_CM 0. 32767. DISPLAY_IDENTIFIER C_VAR_CODE_6 FORMAT "%5.0" /end CHARACTERISTIC
/begin CHARACTERISTIC c_var_code_7 "vorgesehene Variantencodiermöglichkeit über VAG-Tester" VALUE 0x8500e4 _REC_VAL_20_u2 32767. _CNV_A_R_LINEAR_____0_CM 0. 32767. DISPLAY_IDENTIFIER C_VAR_CODE_7 FORMAT "%5.0" /end CHARACTERISTIC
/begin CHARACTERISTIC c_var_code_8 "vorgesehene Variantencodiermöglichkeit über VAG-Tester" VALUE 0x8500e6 _REC_VAL_20_u2 32767. _CNV_A_R_LINEAR_____0_CM 0. 32767. DISPLAY_IDENTIFIER C_VAR_CODE_8 FORMAT "%5.0" /end CHARACTERISTIC
/begin CHARACTERISTIC c_var_code_9 "vorgesehene Variantencodiermöglichkeit über VAG-Tester" VALUE 0x8500e8 _REC_VAL_20_u2 32767. _CNV_A_R_LINEAR_____0_CM 0. 32767. DISPLAY_IDENTIFIER C_VAR_CODE_9 FORMAT "%5.0" /end CHARACTERISTIC
/begin CHARACTERISTIC c_var_code_10 "vorgesehene Variantencodiermöglichkeit über VAG-Tester" VALUE 0x8500cc _REC_VAL_20_u2 32767. _CNV_A_R_LINEAR_____0_CM 0. 32767. DISPLAY_IDENTIFIER C_VAR_CODE_10 FORMAT "%5.0" /end CHARACTERISTIC
/begin CHARACTERISTIC c_var_code_11 "vorgesehene Variantencodiermöglichkeit über VAG-Tester" VALUE 0x8500ce _REC_VAL_20_u2 32767. _CNV_A_R_LINEAR_____0_CM 0. 32767. DISPLAY_IDENTIFIER C_VAR_CODE_11 FORMAT "%5.0" /end CHARACTERISTIC
/begin CHARACTERISTIC c_var_code_12 "vorgesehene Variantencodiermöglichkeit über VAG-Tester" VALUE 0x8500d0 _REC_VAL_20_u2 32767. _CNV_A_R_LINEAR_____0_CM 0. 32767. DISPLAY_IDENTIFIER C_VAR_CODE_12 FORMAT "%5.0" /end CHARACTERISTIC
/begin CHARACTERISTIC c_var_code_13 "vorgesehene Variantencodiermöglichkeit über VAG-Tester" VALUE 0x8500d2 _REC_VAL_20_u2 32767. _CNV_A_R_LINEAR_____0_CM 0. 32767. DISPLAY_IDENTIFIER C_VAR_CODE_13 FORMAT "%5.0" /end CHARACTERISTIC
/begin CHARACTERISTIC c_var_code_14 "vorgesehene Variantencodiermöglichkeit über VAG-Tester" VALUE 0x8500d4 _REC_VAL_20_u2 32767. _CNV_A_R_LINEAR_____0_CM 0. 32767. DISPLAY_IDENTIFIER C_VAR_CODE_14 FORMAT "%5.0" /end CHARACTERISTIC
/begin CHARACTERISTIC c_var_code_15 "vorgesehene Variantencodiermöglichkeit über VAG-Tester" VALUE 0x8500d6 _REC_VAL_20_u2 32767. _CNV_A_R_LINEAR_____0_CM 0. 32767. DISPLAY_IDENTIFIER C_VAR_CODE_15 FORMAT "%5.0" /end CHARACTERISTIC
/begin CHARACTERISTIC c_var_code_1 "vorgesehene Variantencodiermöglichkeit über VAG-Tester" VALUE 0x8500ca _REC_VAL_20_u2 32767. _CNV_A_R_LINEAR_____0_CM 0. 32767. DISPLAY_IDENTIFIER C_VAR_CODE_1 FORMAT "%5.0" /end CHARACTERISTIC
/begin CHARACTERISTIC c_var_code_16 "vorgesehene Variantencodiermöglichkeit über VAG-Tester" VALUE 0x8500d8 _REC_VAL_20_u2 32767. _CNV_A_R_LINEAR_____0_CM 0. 32767. DISPLAY_IDENTIFIER C_VAR_CODE_16 FORMAT "%5.0" /end CHARACTERISTIC
/begin CHARACTERISTIC c_var_code_4 "vorgesehene Variantencodiermöglichkeit über VAG-Tester" VALUE 0x8500de _REC_VAL_20_u2 32767. _CNV_A_R_LINEAR_____0_CM 0. 32767. DISPLAY_IDENTIFIER C_VAR_CODE_4 FORMAT "%5.0" /end CHARACTERISTIC
/begin MEASUREMENT lv_var_ect "elektrisch geschaltetes Thermostat verbaut (dsk_byte_0 bit 3)" UBYTE _CNV_S_2_RANGE__0___85_CM 1 0. 0. 1. DISPLAY_IDENTIFIER LV_VAR_ECT ECU_ADDRESS 0x7fba4a BIT_MASK 0x1 /end MEASUREMENT
/begin MEASUREMENT lv_var_can_bem "CAN-Energiemanager verbaut (dsk_byte_4 bit 6)" UBYTE _CNV_S_2_RANGE__0___85_CM 1 0. 0. 1. DISPLAY_IDENTIFIER LV_VAR_CAN_BEM ECU_ADDRESS 0x7fba67 BIT_MASK 0x1 /end MEASUREMENT
/begin MEASUREMENT lv_var_vim "Schaltsaugrohr verbaut (dsk_byte_0 bit 7)" UBYTE _CNV_S_2_RANGE__0___85_CM 1 0. 0. 1. DISPLAY_IDENTIFIER LV_VAR_VIM ECU_ADDRESS 0x7fba4e BIT_MASK 0x1 /end MEASUREMENT
/begin MEASUREMENT lv_var_vim_1 "Schaltsaugrohr 1 verbaut (dsk_byte_3 bit 6)" UBYTE _CNV_S_2_RANGE__0___85_CM 1 0. 0. 1. DISPLAY_IDENTIFIER LV_VAR_VIM_1 ECU_ADDRESS 0x7fba5f BIT_MASK 0x1 /end MEASUREMENT
/begin MEASUREMENT lv_var_vim_2 "Schaltsaugrohr 2 verbaut (dsk_byte_3 bit 6)" UBYTE _CNV_S_2_RANGE__0___85_CM 1 0. 0. 1. DISPLAY_IDENTIFIER LV_VAR_VIM_2 ECU_ADDRESS 0x7fba60 BIT_MASK 0x1 /end MEASUREMENT
/begin MEASUREMENT lv_var_ecfpwm "PWM-gesteuerter Kühlerlüfter verbaut (dsk_byte_0 bit 2)" UBYTE _CNV_S_2_RANGE__0___85_CM 1 0. 0. 1. DISPLAY_IDENTIFIER LV_VAR_ECFPWM ECU_ADDRESS 0x7fba49 BIT_MASK 0x1 /end MEASUREMENT
/begin MEASUREMENT lv_var_ecfpwm_1 "erster PWM-Kühlerlüfter verbaut (dsk_byte_1 bit 0)" UBYTE _CNV_S_2_RANGE__0___85_CM 1 0. 0. 1. DISPLAY_IDENTIFIER LV_VAR_ECFPWM_1 ECU_ADDRESS 0x7fba4f BIT_MASK 0x1 /end MEASUREMENT
/begin MEASUREMENT lv_var_ecfpwm_2 "zweiter PWM-Kühlerlüfter verbaut (dsk_byte_1 bit 0)" UBYTE _CNV_S_2_RANGE__0___85_CM 1 0. 0. 1. DISPLAY_IDENTIFIER LV_VAR_ECFPWM_2 ECU_ADDRESS 0x7fba50 BIT_MASK 0x1 /end MEASUREMENT
/begin MEASUREMENT lv_dct "Doppelkupplungsgetriebe verbaut" UBYTE _CNV_S_2_RANGE__0___85_CM 1 0. 0. 1. DISPLAY_IDENTIFIER LV_DCT ECU_ADDRESS 0x7fba72 BIT_MASK 0x1 /end MEASUREMENT
/begin MEASUREMENT lv_cvt "CVT-Getriebe verbaut" UBYTE _CNV_S_2_RANGE__0___85_CM 1 0. 0. 1. DISPLAY_IDENTIFIER LV_CVT ECU_ADDRESS 0x7fba73 BIT_MASK 0x1 /end MEASUREMENT
/begin MEASUREMENT lv_var_msr "MSR Funktion vorhanden" UBYTE _CNV_S_2_RANGE__0___85_CM 1 0. 0. 1. DISPLAY_IDENTIFIER LV_VAR_MSR ECU_ADDRESS 0x7fba6d BIT_MASK 0x1 /end MEASUREMENT
/begin MEASUREMENT lv_var_vim_fb "VIM_FB  built in " UBYTE _CNV_S_2_RANGE__0___85_CM 1 0. 0. 1. DISPLAY_IDENTIFIER LV_VAR_VIM_FB ECU_ADDRESS 0x7fba5e BIT_MASK 0x1 /end MEASUREMENT
/begin MEASUREMENT lv_var_can_tog "" UBYTE _CNV_S_2_RANGE__0___85_CM 1 0. 0. 1. DISPLAY_IDENTIFIER LV_VAR_CAN_TOG ECU_ADDRESS 0x7fba68 BIT_MASK 0x1 /end MEASUREMENT
/begin MEASUREMENT lv_var_can_stans "Lenkwinkelsensor vorhanden (dsk_byte_4 bit 2)" UBYTE _CNV_S_2_RANGE__0___85_CM 1 0. 0. 1. DISPLAY_IDENTIFIER LV_VAR_CAN_STANS ECU_ADDRESS 0x7fba63 BIT_MASK 0x1 /end MEASUREMENT
/begin MEASUREMENT lv_var_vcv "Mengensteuerventil verbaut (dsk_byte_1 bit 1)" UBYTE _CNV_S_2_RANGE__0___85_CM 1 0. 0. 1. DISPLAY_IDENTIFIER LV_VAR_VCV ECU_ADDRESS 0x7fba51 BIT_MASK 0x1 /end MEASUREMENT
/begin MEASUREMENT lv_var_port "Ladungsbewegungsklappe verbaut (dsk_byte_1 bit 2)" UBYTE _CNV_S_2_RANGE__0___85_CM 1 0. 0. 1. DISPLAY_IDENTIFIER LV_VAR_PORT ECU_ADDRESS 0x7fba52 BIT_MASK 0x1 /end MEASUREMENT
/begin MEASUREMENT lv_var_cwp "Kühlmittelnachlaufpumpe verbaut (dsk_byte_1 bit 3)" UBYTE _CNV_S_2_RANGE__0___85_CM 1 0. 0. 1. DISPLAY_IDENTIFIER LV_VAR_CWP ECU_ADDRESS 0x7fba53 BIT_MASK 0x1 /end MEASUREMENT
/begin MEASUREMENT lv_var_aeb "aktive Motorlager verbaut (dsk_byte_1 bit 4)" UBYTE _CNV_S_2_RANGE__0___85_CM 1 0. 0. 1. DISPLAY_IDENTIFIER LV_VAR_AEB ECU_ADDRESS 0x7fba54 BIT_MASK 0x1 /end MEASUREMENT
/begin MEASUREMENT lv_var_tldp "Tankleckage-Diagnosepumpe verbaut (dsk_byte_3 bit 0)" UBYTE _CNV_S_2_RANGE__0___85_CM 1 0. 0. 1. DISPLAY_IDENTIFIER LV_VAR_TLDP ECU_ADDRESS 0x7fba5b BIT_MASK 0x1 /end MEASUREMENT
/begin MEASUREMENT lv_var_can_if_cft "CAN-Gateway-Komfort verbaut (dsk_byte_4 bit 1)" UBYTE _CNV_S_2_RANGE__0___85_CM 1 0. 0. 1. DISPLAY_IDENTIFIER LV_VAR_CAN_IF_CFT ECU_ADDRESS 0x7fba62 BIT_MASK 0x1 /end MEASUREMENT
/begin MEASUREMENT lv_var_can_dt_ccp "CAN-Applikation auf Antriebstrang-CAN (dsk_byte_2 bit 0)" UBYTE _CNV_S_2_RANGE__0___85_CM 1 0. 0. 1. DISPLAY_IDENTIFIER LV_VAR_CAN_DT_CCP ECU_ADDRESS 0x7fba58 BIT_MASK 0x1 /end MEASUREMENT
/begin MEASUREMENT lv_var_can_ccp "CAN-Applikation auf Sensor-CAN (dsk_byte_2 bit 1)" UBYTE _CNV_S_2_RANGE__0___85_CM 1 0. 0. 1. DISPLAY_IDENTIFIER LV_VAR_CAN_CCP ECU_ADDRESS 0x7fba59 BIT_MASK 0x1 /end MEASUREMENT
/begin MEASUREMENT lv_var_can_icl "CAN-Kombiinstrument verbaut (dsk_byte_4 bit 5)" UBYTE _CNV_S_2_RANGE__0___85_CM 1 0. 0. 1. DISPLAY_IDENTIFIER LV_VAR_CAN_ICL ECU_ADDRESS 0x7fba66 BIT_MASK 0x1 /end MEASUREMENT
/begin MEASUREMENT lv_var_can_eilu "CAN-Zündanlaßschloß verbaut (dsk_byte_2 bit 2)" UBYTE _CNV_S_2_RANGE__0___85_CM 1 0. 0. 1. DISPLAY_IDENTIFIER LV_VAR_CAN_EILU ECU_ADDRESS 0x7fba5a BIT_MASK 0x1 /end MEASUREMENT
/begin MEASUREMENT sf_conf_gb "" UBYTE _CNV_S_8_gearbox_ty_112_CM 1 0. 1. 128. DISPLAY_IDENTIFIER SF_CONF_GB ECU_ADDRESS 0x7fba74 /end MEASUREMENT
/begin MEASUREMENT sf_conf_acc "Air conditioning system" UBYTE _CNV_A_R_LINEAR_____0_CM 1 0. 0. 7. DISPLAY_IDENTIFIER SF_CONF_ACC ECU_ADDRESS 0x7fba75 FORMAT "%1.0" /end MEASUREMENT
/begin MEASUREMENT sf_conf_heat "" UBYTE _CNV_A_R_LINEAR_____0_CM 1 0. 0. 3. DISPLAY_IDENTIFIER SF_CONF_HEAT ECU_ADDRESS 0x7fba76 FORMAT "%1.0" /end MEASUREMENT
/begin MEASUREMENT lv_var_can_cs "Switch of clutch integrated" UBYTE _CNV_S_2_RANGE______11_CM 1 0. 0. 1. DISPLAY_IDENTIFIER LV_VAR_CAN_CS ECU_ADDRESS 0x7fba77 /end MEASUREMENT
/begin MEASUREMENT lv_acc_is_can_aut_ena "increase of idle speed, requirement of full automatic air conditioning system allowed" UBYTE _CNV_S_2_RANGE______11_CM 1 0. 0. 1. DISPLAY_IDENTIFIER LV_ACC_IS_CAN_AUT_ENA ECU_ADDRESS 0x7fba78 /end MEASUREMENT
/begin MEASUREMENT lv_acc_is_can_state_ena "increase of idle speed, requirement because of air conditioning system compressor state allowed" UBYTE _CNV_S_2_RANGE______11_CM 1 0. 0. 1. DISPLAY_IDENTIFIER LV_ACC_IS_CAN_STATE_ENA ECU_ADDRESS 0x7fba79 /end MEASUREMENT
/begin MEASUREMENT lv_acc_is_can_req_ena "increase of idle speed, requirement by A/C switch of semi automatic air conditioning system allowed" UBYTE _CNV_S_2_RANGE______11_CM 1 0. 0. 1. DISPLAY_IDENTIFIER LV_ACC_IS_CAN_REQ_ENA ECU_ADDRESS 0x7fba7a /end MEASUREMENT
/begin MEASUREMENT lv_acc_is_driv_req_ena "increase of idle speed, requirement by A/C switch of manual air conditioning system allowed" UBYTE _CNV_S_2_RANGE______11_CM 1 0. 0. 1. DISPLAY_IDENTIFIER LV_ACC_IS_DRIV_REQ_ENA ECU_ADDRESS 0x7fba7b /end MEASUREMENT
/begin MEASUREMENT lv_gl_var "Selection of the glowing plug generation (2 or 3)" UBYTE _CNV_S_2_RANGE______11_CM 1 0. 0. 1. DISPLAY_IDENTIFIER LV_GL_VAR ECU_ADDRESS 0x7fba7c /end MEASUREMENT
/begin MEASUREMENT lv_var_can_whl "Haldex-clutch installed" UBYTE _CNV_S_2_RANGE______11_CM 1 0. 0. 1. DISPLAY_IDENTIFIER LV_VAR_CAN_WHL ECU_ADDRESS 0x7fba7d /end MEASUREMENT
/begin MEASUREMENT lv_var_can_sys_info "CAN message 'Systeminfo' should be received and evaluated" UBYTE _CNV_S_2_RANGE______11_CM 1 0. 0. 1. DISPLAY_IDENTIFIER LV_VAR_CAN_SYS_INFO ECU_ADDRESS 0x7fba7e /end MEASUREMENT
/begin MEASUREMENT lv_var_can_nom_sys "CAN message 'Sollverbauliste_neu' should be received and evaluated" UBYTE _CNV_S_2_RANGE______11_CM 1 0. 0. 1. DISPLAY_IDENTIFIER LV_VAR_CAN_NOM_SYS ECU_ADDRESS 0x7fba7f /end MEASUREMENT
/begin MEASUREMENT lv_var_egr_conf "configuration EGR valve : LV_VAR_EGR_CONF = 0 / 1 means PWM / H-Bridge" UBYTE _CNV_S_2_RANGE______11_CM 1 0. 0. 1. DISPLAY_IDENTIFIER LV_VAR_EGR_CONF ECU_ADDRESS 0x7fba80 /end MEASUREMENT
/begin MEASUREMENT lv_var_egr_hbr_conf "configuration H-Bridge EGR valve : LV_VAR_EGR_HBR_CONF = 0 / 1 means Pierburg / Siemens H-Bridge" UBYTE _CNV_S_2_RANGE______11_CM 1 0. 0. 1. DISPLAY_IDENTIFIER LV_VAR_EGR_HBR_CONF ECU_ADDRESS 0x7fba81 /end MEASUREMENT
/begin MEASUREMENT lv_var_maf_conf "configuration MAF: LV_VAR_MAF_CONF =0/1 means HFM5 / HFM6" UBYTE _CNV_S_2_RANGE______11_CM 1 0. 0. 1. DISPLAY_IDENTIFIER LV_VAR_MAF_CONF ECU_ADDRESS 0x7fba82 /end MEASUREMENT
/begin MEASUREMENT lv_var_rms_conf "configuration RMS: LV_VAR_RMS_CONF = 1 means TFU / RMS will be measured from one sensor" UBYTE _CNV_S_2_RANGE______11_CM 1 0. 0. 1. DISPLAY_IDENTIFIER LV_VAR_RMS_CONF ECU_ADDRESS 0x7fba83 /end MEASUREMENT
/begin MEASUREMENT lv_var_can_ac "Semi automatic air conditioning" UBYTE _CNV_S_2_RANGE______11_CM 1 0. 0. 1. DISPLAY_IDENTIFIER LV_VAR_CAN_AC ECU_ADDRESS 0x7fba84 /end MEASUREMENT
/begin CHARACTERISTIC c_conf_gb "" VALUE 0x84fbea _REC_VAL_20_u1 127. _CNV_S_8_gearbox_ty_112_CM 1. 128. DISPLAY_IDENTIFIER C_CONF_GB /end CHARACTERISTIC
/begin CHARACTERISTIC c_conf_heat "Development value for: Coding of heating elements" VALUE 0x84fbeb _REC_VAL_20_u1 3. _CNV_A_R_LINEAR_____0_CM 0. 3. DISPLAY_IDENTIFIER C_CONF_HEAT FORMAT "%1.0" /end CHARACTERISTIC
/begin CHARACTERISTIC lc_var_can_cs "Development value for: Switch of clutch integrated" VALUE 0x850184 _REC_VAL_20_u1 1. _CNV_A_R_LINEAR_____0_CM 0. 1. DISPLAY_IDENTIFIER LC_VAR_CAN_CS FORMAT "%1.0" /end CHARACTERISTIC
/begin CHARACTERISTIC lc_acc_is_can_aut_ena "increase of idle speed, requirement of full automatic air conditioning system allowed" VALUE 0x850107 _REC_VAL_20_u1 1. _CNV_A_R_LINEAR_____0_CM 0. 1. DISPLAY_IDENTIFIER LC_ACC_IS_CAN_AUT_ENA FORMAT "%1.0" /end CHARACTERISTIC
/begin CHARACTERISTIC lc_acc_is_can_state_ena "increase of idle speed, requirement because of air conditioning system compressor state allowed" VALUE 0x850109 _REC_VAL_20_u1 1. _CNV_A_R_LINEAR_____0_CM 0. 1. DISPLAY_IDENTIFIER LC_ACC_IS_CAN_STATE_ENA FORMAT "%1.0" /end CHARACTERISTIC
/begin CHARACTERISTIC lc_acc_is_can_req_ena "increase of idle speed, requirement by A/C switch of semi automatic air conditioning system allowed" VALUE 0x850108 _REC_VAL_20_u1 1. _CNV_A_R_LINEAR_____0_CM 0. 1. DISPLAY_IDENTIFIER LC_ACC_IS_CAN_REQ_ENA FORMAT "%1.0" /end CHARACTERISTIC
/begin CHARACTERISTIC lc_acc_is_driv_req_ena "increase of idle speed, requirement by A/C switch of manual air conditioning system allowed" VALUE 0x85010a _REC_VAL_20_u1 1. _CNV_A_R_LINEAR_____0_CM 0. 1. DISPLAY_IDENTIFIER LC_ACC_IS_DRIV_REQ_ENA FORMAT "%1.0" /end CHARACTERISTIC
/begin CHARACTERISTIC lc_gl_var "Selection of the glowing plug generation (2 or 3)" VALUE 0x85012e _REC_VAL_20_u1 1. _CNV_A_R_LINEAR_____0_CM 0. 1. DISPLAY_IDENTIFIER LC_GL_VAR FORMAT "%1.0" /end CHARACTERISTIC
/begin CHARACTERISTIC lc_var_can_whl "Haldex-Kupplung verbaut" VALUE 0x850187 _REC_VAL_20_u1 1. _CNV_A_R_LINEAR_____0_CM 0. 1. DISPLAY_IDENTIFIER LC_VAR_CAN_WHL FORMAT "%1.0" /end CHARACTERISTIC
/begin CHARACTERISTIC lc_var_can_sys_info "can botschaft 'sys_info' soll empfangen und ausgewertet werden" VALUE 0x850186 _REC_VAL_20_u1 1. _CNV_A_R_LINEAR_____0_CM 0. 1. DISPLAY_IDENTIFIER LC_VAR_CAN_SYS_INFO FORMAT "%1.0" /end CHARACTERISTIC
/begin CHARACTERISTIC lc_var_can_nom_sys "can botschaft 'sollverbauliste_neu' soll empfangen und ausgewertet werden" VALUE 0x850185 _REC_VAL_20_u1 1. _CNV_A_R_LINEAR_____0_CM 0. 1. DISPLAY_IDENTIFIER LC_VAR_CAN_NOM_SYS FORMAT "%1.0" /end CHARACTERISTIC
/begin CHARACTERISTIC lc_var_egr_conf "configuration EGR valve : LC_VAR_EGR_CONF = 0 / 1 means PWM / H-Bridge" VALUE 0x850188 _REC_VAL_20_u1 1. _CNV_A_R_LINEAR_____0_CM 0. 1. DISPLAY_IDENTIFIER LC_VAR_EGR_CONF FORMAT "%1.0" /end CHARACTERISTIC
/begin CHARACTERISTIC lc_var_maf_conf "Konfiguration Luftmassenmesser: LC_VAR_MAF_CONF =0/1 entspricht HFM5 / HFM6" VALUE 0x85018a _REC_VAL_20_u1 1. _CNV_A_R_LINEAR_____0_CM 0. 1. DISPLAY_IDENTIFIER LC_VAR_MAF_CONF FORMAT "%1.0" /end CHARACTERISTIC
/begin CHARACTERISTIC lc_var_rms_conf "configuration RMS: LC_VAR_RMS_CONF = 1 means TFU / RMS will be measured from one sensor" VALUE 0x85018b _REC_VAL_20_u1 1. _CNV_A_R_LINEAR_____0_CM 0. 1. DISPLAY_IDENTIFIER LC_VAR_RMS_CONF FORMAT "%1.0" /end CHARACTERISTIC
/begin CHARACTERISTIC lc_var_egr_hbr_conf "configuration H-Bridge EGR valve : LC_VAR_EGR_HBR_CONF = 0 / 1 means Pierburg / Siemens H-Bridge" VALUE 0x850189 _REC_VAL_20_u1 1. _CNV_A_R_LINEAR_____0_CM 0. 1. DISPLAY_IDENTIFIER LC_VAR_EGR_HBR_CONF FORMAT "%1.0" /end CHARACTERISTIC
/begin CHARACTERISTIC c_thd_ctr_vs_dist "" VALUE 0x85ccfe _REC_VAL_20_u2 6.5535 _CNV_A_R_LINEAR_____115_CM 0. 6.5535 DISPLAY_IDENTIFIER C_THD_CTR_VS_DIST FORMAT "%5.4" /end CHARACTERISTIC
/begin CHARACTERISTIC c_fac_vb_fil "MF: Speed limit Filterfactor" VALUE 0x85ca28 _REC_VAL_20_u1 0.99609375 _CNV_A_R_LINEAR_____29_CM 0. 0.99609375 DISPLAY_IDENTIFIER C_FAC_VB_FIL FORMAT "%5.4" /end CHARACTERISTIC
/begin CHARACTERISTIC ip_n_prev1_inh__vb_fil "MF: speed limit of PREV1" CURVE 0x857e4a _REC_CUR_20_u2_u1 6375. _CNV_A_R_LINEAR_____5_CM 0. 6375. DISPLAY_IDENTIFIER IP_N_PREV1_INH__VB_FIL FORMAT "%4.0"
 /begin AXIS_DESCR COM_AXIS vb_fil _CNV_A_R_LINEAR_____43_CM 5 0. 28.8 FORMAT "%5.3" AXIS_PTS_REF ldpm_vb_fil_ip_n_inh /end AXIS_DESCR
/end CHARACTERISTIC
/begin AXIS_PTS ldpm_vb_fil_ip_n_inh "" 0x843f32 vb_fil _REC_AXS_20_u1 28.8 _CNV_A_R_LINEAR_____43_CM 5 0. 28.8 FORMAT "%5.3" /end AXIS_PTS
/begin CHARACTERISTIC ip_n_main2_inh__vb_fil "MF: speed limit of MAIN2" CURVE 0x857e1c _REC_CUR_20_u2_u1 6375. _CNV_A_R_LINEAR_____5_CM 0. 6375. DISPLAY_IDENTIFIER IP_N_MAIN2_INH__VB_FIL FORMAT "%4.0"
 /begin AXIS_DESCR COM_AXIS vb_fil _CNV_A_R_LINEAR_____43_CM 5 0. 28.8 FORMAT "%5.3" AXIS_PTS_REF ldpm_vb_fil_ip_n_inh /end AXIS_DESCR
/end CHARACTERISTIC
/begin CHARACTERISTIC ip_n_main1_inh__vb_fil "MF: speed limit of MAIN1" CURVE 0x857e12 _REC_CUR_20_u2_u1 6375. _CNV_A_R_LINEAR_____5_CM 0. 6375. DISPLAY_IDENTIFIER IP_N_MAIN1_INH__VB_FIL FORMAT "%4.0"
 /begin AXIS_DESCR COM_AXIS vb_fil _CNV_A_R_LINEAR_____43_CM 5 0. 28.8 FORMAT "%5.3" AXIS_PTS_REF ldpm_vb_fil_ip_n_inh /end AXIS_DESCR
/end CHARACTERISTIC
/begin CHARACTERISTIC ip_n_prev2_inh__vb_fil "MF: speed limit of PREV2" CURVE 0x857e54 _REC_CUR_20_u2_u1 6375. _CNV_A_R_LINEAR_____5_CM 0. 6375. DISPLAY_IDENTIFIER IP_N_PREV2_INH__VB_FIL FORMAT "%4.0"
 /begin AXIS_DESCR COM_AXIS vb_fil _CNV_A_R_LINEAR_____43_CM 5 0. 28.8 FORMAT "%5.3" AXIS_PTS_REF ldpm_vb_fil_ip_n_inh /end AXIS_DESCR
/end CHARACTERISTIC
/begin CHARACTERISTIC ip_n_post1_inh__vb_fil "MF: speed limit of POST1" CURVE 0x857e36 _REC_CUR_20_u2_u1 6375. _CNV_A_R_LINEAR_____5_CM 0. 6375. DISPLAY_IDENTIFIER IP_N_POST1_INH__VB_FIL FORMAT "%4.0"
 /begin AXIS_DESCR COM_AXIS vb_fil _CNV_A_R_LINEAR_____43_CM 5 0. 28.8 FORMAT "%5.3" AXIS_PTS_REF ldpm_vb_fil_ip_n_inh /end AXIS_DESCR
/end CHARACTERISTIC
/begin CHARACTERISTIC ip_n_post2_inh__vb_fil "MF: speed limit of POST2" CURVE 0x857e40 _REC_CUR_20_u2_u1 6375. _CNV_A_R_LINEAR_____5_CM 0. 6375. DISPLAY_IDENTIFIER IP_N_POST2_INH__VB_FIL FORMAT "%4.0"
 /begin AXIS_DESCR COM_AXIS vb_fil _CNV_A_R_LINEAR_____43_CM 5 0. 28.8 FORMAT "%5.3" AXIS_PTS_REF ldpm_vb_fil_ip_n_inh /end AXIS_DESCR
/end CHARACTERISTIC
/begin MEASUREMENT temp_up_egrv_sp "" UWORD _CNV_A_R_LINEAR_____157_CM 1 0. 0. 1023.984375 DISPLAY_IDENTIFIER TEMP_UP_EGRV_SP ECU_ADDRESS 0x7fa8ae BYTE_ORDER MSB_LAST FORMAT "%6.2" /end MEASUREMENT
/begin CHARACTERISTIC c_fac_thermo_down_egrv "" VALUE 0x85ca0e _REC_VAL_20_u2 1023.984375 _CNV_A_R_LINEAR_____110_CM 0. 1023.984375 DISPLAY_IDENTIFIER C_FAC_THERMO_DOWN_EGRV FORMAT "%6.2" /end CHARACTERISTIC
/begin CHARACTERISTIC c_fac_thermo_up_egrv "" VALUE 0x85ca10 _REC_VAL_20_u2 1023.984375 _CNV_A_R_LINEAR_____110_CM 0. 1023.984375 DISPLAY_IDENTIFIER C_FAC_THERMO_UP_EGRV FORMAT "%6.2" /end CHARACTERISTIC
/begin MEASUREMENT quo_mfw_down_egrv "" UWORD _CNV_A_R_LINEAR_____162_CM 1 0. 0. 65.535 DISPLAY_IDENTIFIER QUO_MFW_DOWN_EGRV ECU_ADDRESS 0x7fa8a6 BYTE_ORDER MSB_LAST FORMAT "%5.3" /end MEASUREMENT
/begin MEASUREMENT quo_mfw_up_egrv_sp "" UWORD _CNV_A_R_LINEAR_____162_CM 1 0. 0. 65.535 DISPLAY_IDENTIFIER QUO_MFW_UP_EGRV_SP ECU_ADDRESS 0x7fa8a8 BYTE_ORDER MSB_LAST FORMAT "%5.3" /end MEASUREMENT
/begin MEASUREMENT quo_mfw_down_egrv_sp "" UWORD _CNV_A_R_LINEAR_____162_CM 1 0. 0. 65.535 DISPLAY_IDENTIFIER QUO_MFW_DOWN_EGRV_SP ECU_ADDRESS 0x7fa8a4 BYTE_ORDER MSB_LAST FORMAT "%5.3" /end MEASUREMENT
/begin MEASUREMENT quo_mfw_up_egrv "" UWORD _CNV_A_R_LINEAR_____162_CM 1 0. 0. 65.535 DISPLAY_IDENTIFIER QUO_MFW_UP_EGRV ECU_ADDRESS 0x7fa8aa BYTE_ORDER MSB_LAST FORMAT "%5.3" /end MEASUREMENT
/begin CHARACTERISTIC ip_fac_temp_egr_cool "EGR_VAR: exp-function to calculate the temperature decrease inside the EGR-cooler" CURVE 0x852a3e _REC_CUR_20_u2_u2 0.9999847412109381 _CNV_A_R_LINEAR_____14_CM 0. 0.9999847412109381 DISPLAY_IDENTIFIER IP_FAC_TEMP_EGR_COOL FORMAT "%6.5"
 /begin AXIS_DESCR COM_AXIS quo_mfw_down_egrv_sp _CNV_A_R_LINEAR_____162_CM 12 0. 65.535 FORMAT "%6.5" AXIS_PTS_REF ldp_quo_mfw_ip_fac_temp_egr /end AXIS_DESCR
/end CHARACTERISTIC
/begin AXIS_PTS ldp_quo_mfw_ip_fac_temp_egr "" 0x84210e quo_mfw_down_egrv_sp _REC_AXS_20_u2 65.535 _CNV_A_R_LINEAR_____162_CM 12 0. 65.535 FORMAT "%6.5" /end AXIS_PTS
/begin CHARACTERISTIC c_abc_inc_v_tba_rng "" VALUE 0x84faeb _REC_VAL_20_u1 255. _CNV_A_R_LINEAR_____0_CM 0. 255. DISPLAY_IDENTIFIER C_ABC_INC_V_TBA_RNG FORMAT "%3.0" /end CHARACTERISTIC
/begin CHARACTERISTIC c_abc_max_v_tba_rng "" VALUE 0x84fb77 _REC_VAL_20_u1 255. _CNV_A_R_LINEAR_____0_CM 0. 255. DISPLAY_IDENTIFIER C_ABC_MAX_V_TBA_RNG FORMAT "%3.0" /end CHARACTERISTIC
/begin CHARACTERISTIC c_abc_inc_tba_mes_grd "" VALUE 0x84facf _REC_VAL_20_u1 255. _CNV_A_R_LINEAR_____0_CM 0. 255. DISPLAY_IDENTIFIER C_ABC_INC_TBA_MES_GRD FORMAT "%3.0" /end CHARACTERISTIC
/begin CHARACTERISTIC c_abc_max_tba_mes_grd "" VALUE 0x84fb5b _REC_VAL_20_u1 255. _CNV_A_R_LINEAR_____0_CM 0. 255. DISPLAY_IDENTIFIER C_ABC_MAX_TBA_MES_GRD FORMAT "%3.0" /end CHARACTERISTIC
/begin CHARACTERISTIC c_v_tba_max_diag "" VALUE 0x85cdda _REC_VAL_20_u2 4.9951171875 _CNV_A_R_LINEAR_____28_CM 0. 4.9951171875 DISPLAY_IDENTIFIER C_V_TBA_MAX_DIAG FORMAT "%4.3" /end CHARACTERISTIC
/begin CHARACTERISTIC c_v_tba_min_diag "" VALUE 0x85cddc _REC_VAL_20_u2 4.9951171875 _CNV_A_R_LINEAR_____28_CM 0. 4.9951171875 DISPLAY_IDENTIFIER C_V_TBA_MIN_DIAG FORMAT "%3.2" /end CHARACTERISTIC
/begin CHARACTERISTIC c_tba_mes_grd_diag "" VALUE 0x85cc9f _REC_VAL_20_u1 255. _CNV_A_R_LINEAR_____238_CM 0. 255. DISPLAY_IDENTIFIER C_TBA_MES_GRD_DIAG FORMAT "%3.0" /end CHARACTERISTIC
/begin MEASUREMENT lv_err_tba_mes "" UBYTE _CNV_S_2_RANGE______23_CM 1 0. 0. 1. DISPLAY_IDENTIFIER LV_ERR_TBA_MES ECU_ADDRESS 0x7fb83d /end MEASUREMENT
/begin CHARACTERISTIC c_frq_pwm_ect "Frequency electronically controlled thermostat" VALUE 0x85ca34 _REC_VAL_20_u2 65535. _CNV_A_R_LINEAR_____0_CM 0. 65535. DISPLAY_IDENTIFIER C_FRQ_PWM_ECT FORMAT "%1.0" /end CHARACTERISTIC
/begin CHARACTERISTIC c_frq_pwm_ecf_1 "Frequency electronically controlled cooling fan 1" VALUE 0x85ca30 _REC_VAL_20_u2 65535. _CNV_A_R_LINEAR_____0_CM 0. 65535. DISPLAY_IDENTIFIER C_FRQ_PWM_ECF_1 FORMAT "%1.0" /end CHARACTERISTIC
/begin CHARACTERISTIC c_frq_pwm_ecf_2 "Frequency electronically controlled cooling fan 1" VALUE 0x85ca32 _REC_VAL_20_u2 65535. _CNV_A_R_LINEAR_____0_CM 0. 65535. DISPLAY_IDENTIFIER C_FRQ_PWM_ECF_2 FORMAT "%1.0" /end CHARACTERISTIC
/begin CHARACTERISTIC c_frq_pwm_gl "Frequency glow plug control" VALUE 0x85ca36 _REC_VAL_20_u2 65535. _CNV_A_R_LINEAR_____0_CM 0. 65535. DISPLAY_IDENTIFIER C_FRQ_PWM_GL FORMAT "%1.0" /end CHARACTERISTIC
/begin CHARACTERISTIC c_frq_pwm_acc_b "Frequency air conditioning compressor bidirectional" VALUE 0x85ca2e _REC_VAL_20_u2 65535. _CNV_A_R_LINEAR_____0_CM 0. 65535. DISPLAY_IDENTIFIER C_FRQ_PWM_ACC_B FORMAT "%1.0" /end CHARACTERISTIC
/begin MEASUREMENT vb_mmv "Filtered Battery Voltage" UBYTE _CNV_A_R_LINEAR_____43_CM 1 0. 0. 28.8 DISPLAY_IDENTIFIER VB_MMV ECU_ADDRESS 0x7fbc17 FORMAT "%3.1" /end MEASUREMENT
/begin MEASUREMENT v_pvs_1_bas "" UWORD _CNV_A_R_LINEAR_____28_CM 1 0. 0. 4.9951171875 DISPLAY_IDENTIFIER V_PVS_1_BAS ECU_ADDRESS 0x7fcd8e BYTE_ORDER MSB_LAST FORMAT "%3.2" /end MEASUREMENT
/begin MEASUREMENT v_pvs_2_bas "" UWORD _CNV_A_R_LINEAR_____28_CM 1 0. 0. 4.9951171875 DISPLAY_IDENTIFIER V_PVS_2_BAS ECU_ADDRESS 0x7fcd90 BYTE_ORDER MSB_LAST FORMAT "%3.2" /end MEASUREMENT
/begin MEASUREMENT v_dcdc "" UWORD _CNV_A_R_LINEAR_____269_CM 1 0. 0. 96.32231400000001 DISPLAY_IDENTIFIER V_DCDC ECU_ADDRESS 0x7f986a BYTE_ORDER MSB_LAST FORMAT "%5.2" /end MEASUREMENT
/begin CHARACTERISTIC lc_ad_clr_ensd "" VALUE 0x841020 _REC_VAL_20_u1 1. _CNV_A_R_LINEAR_____0_CM 0. 1. DISPLAY_IDENTIFIER LC_AD_CLR_ENSD FORMAT "%1.0" /end CHARACTERISTIC
/begin MEASUREMENT tq_loss_dip_pf "o v" SWORD _CNV_A_R_LINEAR_____52_CM 1 0. -1024. 1023.96875 DISPLAY_IDENTIFIER TQ_LOSS_DIP_PF ECU_ADDRESS 0x7fcd50 BYTE_ORDER MSB_LAST FORMAT "%6.2" /end MEASUREMENT
/begin MEASUREMENT lv_act_ico "o v" UBYTE _CNV_S_2_RANGE__0___85_CM 1 0. 0. 1. DISPLAY_IDENTIFIER LV_ACT_ICO ECU_ADDRESS 0x7fce50 /end MEASUREMENT
/begin MEASUREMENT lv_act_byp "o v" UBYTE _CNV_S_2_RANGE__0___85_CM 1 0. 0. 1. DISPLAY_IDENTIFIER LV_ACT_BYP ECU_ADDRESS 0x7fce51 /end MEASUREMENT
/begin MEASUREMENT fac_byppwm_iah_mmv "o v" UWORD _CNV_A_R_LINEAR_____289_CM 1 0. 0. 1.9999696 DISPLAY_IDENTIFIER FAC_BYPPWM_IAH_MMV ECU_ADDRESS 0x7fcd44 BYTE_ORDER MSB_LAST FORMAT "%6.5" /end MEASUREMENT
/begin MEASUREMENT thrpwm_iah_clc "o v" UWORD _CNV_A_R_LINEAR_____8_CM 1 0. 0. 99.99847412109381 DISPLAY_IDENTIFIER THRPWM_IAH_CLC ECU_ADDRESS 0x7fcd46 BYTE_ORDER MSB_LAST FORMAT "%5.3" /end MEASUREMENT
/begin MEASUREMENT byppwm_iah_clc "o v" UWORD _CNV_A_R_LINEAR_____8_CM 1 0. 0. 99.99847412109381 DISPLAY_IDENTIFIER BYPPWM_IAH_CLC ECU_ADDRESS 0x7fcd48 BYTE_ORDER MSB_LAST FORMAT "%5.3" /end MEASUREMENT
/begin MEASUREMENT temp_cyl "o v" UWORD _CNV_A_R_LINEAR_____201_CM 1 0. -50. 973.984375 DISPLAY_IDENTIFIER TEMP_CYL ECU_ADDRESS 0x7fcd4a BYTE_ORDER MSB_LAST FORMAT "%5.2" /end MEASUREMENT
/begin MEASUREMENT temp_up_ico "o v" UWORD _CNV_A_R_LINEAR_____201_CM 1 0. -50. 973.984375 DISPLAY_IDENTIFIER TEMP_UP_ICO ECU_ADDRESS 0x7fcd4e BYTE_ORDER MSB_LAST FORMAT "%5.2" /end MEASUREMENT
/begin MEASUREMENT temp_up_cmp "o v" UWORD _CNV_A_R_LINEAR_____201_CM 1 0. -50. 973.984375 DISPLAY_IDENTIFIER TEMP_UP_CMP ECU_ADDRESS 0x7fcd4c BYTE_ORDER MSB_LAST FORMAT "%5.2" /end MEASUREMENT
/begin MEASUREMENT lv_cdn_act_bpa_pf "o v" UBYTE _CNV_S_2_RANGE__0___85_CM 1 0. 0. 1. DISPLAY_IDENTIFIER LV_CDN_ACT_BPA_PF ECU_ADDRESS 0x7fce4d /end MEASUREMENT
/begin MEASUREMENT bpapwm_pctl_post "o v" SWORD _CNV_A_R_LINEAR_____12_CM 1 0. -100. 99.996948242 DISPLAY_IDENTIFIER BPAPWM_PCTL_POST ECU_ADDRESS 0x7fcd38 BYTE_ORDER MSB_LAST FORMAT "%5.3" /end MEASUREMENT
/begin MEASUREMENT map_sp_post "o v" UWORD _CNV_A_R_LINEAR_____45_CM 1 0. 0. 5434. DISPLAY_IDENTIFIER MAP_SP_POST ECU_ADDRESS 0x7fcd3a BYTE_ORDER MSB_LAST FORMAT "%6.2" /end MEASUREMENT
/begin MEASUREMENT map_sp_bas_pf "o v" UWORD _CNV_A_R_LINEAR_____45_CM 1 0. 0. 5434. DISPLAY_IDENTIFIER MAP_SP_BAS_PF ECU_ADDRESS 0x7fcd3e BYTE_ORDER MSB_LAST FORMAT "%6.2" /end MEASUREMENT
/begin MEASUREMENT tba_sp_pf "o v" UWORD _CNV_A_R_LINEAR_____201_CM 1 0. -50. 973.984375 DISPLAY_IDENTIFIER TBA_SP_PF ECU_ADDRESS 0x7fcd3c BYTE_ORDER MSB_LAST FORMAT "%5.2" /end MEASUREMENT
/begin MEASUREMENT thrpwm_pctl_post "o v" UWORD _CNV_A_R_LINEAR_____204_CM 1 0. 0. 99.972117 DISPLAY_IDENTIFIER THRPWM_PCTL_POST ECU_ADDRESS 0x7fcd40 BYTE_ORDER MSB_LAST FORMAT "%5.3" /end MEASUREMENT
/begin MEASUREMENT thrpwm_pctl_bas_pf "o v" UWORD _CNV_A_R_LINEAR_____204_CM 1 0. 0. 99.972117 DISPLAY_IDENTIFIER THRPWM_PCTL_BAS_PF ECU_ADDRESS 0x7fcd42 BYTE_ORDER MSB_LAST FORMAT "%5.3" /end MEASUREMENT
/begin MEASUREMENT fup_sp_cor_post "o v" SWORD _CNV_A_R_LINEAR_____290_CM 1 0. -100. 99.996948242 DISPLAY_IDENTIFIER FUP_SP_COR_POST ECU_ADDRESS 0x7f9dbc BYTE_ORDER MSB_LAST FORMAT "%5.3" /end MEASUREMENT
/begin MEASUREMENT fac_mf_post2_cor_1 "o v" UWORD _CNV_A_R_LINEAR_____291_CM 1 0. 0. 1. DISPLAY_IDENTIFIER FAC_MF_POST2_COR_1 ECU_ADDRESS 0x7f9de0 BYTE_ORDER MSB_LAST FORMAT "%6.5" /end MEASUREMENT
/begin MEASUREMENT fac_mf_post2_cor_0 "o v" UWORD _CNV_A_R_LINEAR_____291_CM 1 0. 0. 1. DISPLAY_IDENTIFIER FAC_MF_POST2_COR_0 ECU_ADDRESS 0x7f9dde BYTE_ORDER MSB_LAST FORMAT "%6.5" /end MEASUREMENT
/begin MEASUREMENT t_rgn_deact_mf_pf "o v" UWORD _CNV_A_R_LINEAR_____292_CM 1 0. 0. 15.258556 DISPLAY_IDENTIFIER T_RGN_DEACT_MF_PF ECU_ADDRESS 0x7f9dbe BYTE_ORDER MSB_LAST FORMAT "%6.4" /end MEASUREMENT
/begin MEASUREMENT t_rgn_deact_soi_pf "o v" UWORD _CNV_A_R_LINEAR_____292_CM 1 0. 0. 15.258556 DISPLAY_IDENTIFIER T_RGN_DEACT_SOI_PF ECU_ADDRESS 0x7f9dc0 BYTE_ORDER MSB_LAST FORMAT "%6.4" /end MEASUREMENT
/begin MEASUREMENT t_rgn_deact_fup_pf "o v" UWORD _CNV_A_R_LINEAR_____292_CM 1 0. 0. 15.258556 DISPLAY_IDENTIFIER T_RGN_DEACT_FUP_PF ECU_ADDRESS 0x7f9dc2 BYTE_ORDER MSB_LAST FORMAT "%6.4" /end MEASUREMENT
/begin MEASUREMENT t_rgn_deact_map_sp_pf "o v" UWORD _CNV_A_R_LINEAR_____292_CM 1 0. 0. 15.258556 DISPLAY_IDENTIFIER T_RGN_DEACT_MAP_SP_PF ECU_ADDRESS 0x7f9dc4 BYTE_ORDER MSB_LAST FORMAT "%6.4" /end MEASUREMENT
/begin MEASUREMENT t_rgn_act_mf_pf "o v" UWORD _CNV_A_R_LINEAR_____292_CM 1 0. 0. 15.258556 DISPLAY_IDENTIFIER T_RGN_ACT_MF_PF ECU_ADDRESS 0x7f9dc6 BYTE_ORDER MSB_LAST FORMAT "%6.4" /end MEASUREMENT
/begin MEASUREMENT t_rgn_act_soi_pf "o v" UWORD _CNV_A_R_LINEAR_____292_CM 1 0. 0. 15.258556 DISPLAY_IDENTIFIER T_RGN_ACT_SOI_PF ECU_ADDRESS 0x7f9dc8 BYTE_ORDER MSB_LAST FORMAT "%6.4" /end MEASUREMENT
/begin MEASUREMENT t_rgn_act_fup_pf "o v" UWORD _CNV_A_R_LINEAR_____292_CM 1 0. 0. 15.258556 DISPLAY_IDENTIFIER T_RGN_ACT_FUP_PF ECU_ADDRESS 0x7f9dca BYTE_ORDER MSB_LAST FORMAT "%6.4" /end MEASUREMENT
/begin MEASUREMENT t_rgn_act_map_sp_pf "o v" UWORD _CNV_A_R_LINEAR_____292_CM 1 0. 0. 15.258556 DISPLAY_IDENTIFIER T_RGN_ACT_MAP_SP_PF ECU_ADDRESS 0x7f9dcc BYTE_ORDER MSB_LAST FORMAT "%6.4" /end MEASUREMENT
/begin MEASUREMENT mf_prev1_pf "o v" UWORD _CNV_A_R_LINEAR_____50_CM 1 0. 0. 65.535 DISPLAY_IDENTIFIER MF_PREV1_PF ECU_ADDRESS 0x7f9dce BYTE_ORDER MSB_LAST /end MEASUREMENT
/begin MEASUREMENT mf_prev2_pf "o v" UWORD _CNV_A_R_LINEAR_____50_CM 1 0. 0. 65.535 DISPLAY_IDENTIFIER MF_PREV2_PF ECU_ADDRESS 0x7f9dd0 BYTE_ORDER MSB_LAST /end MEASUREMENT
/begin MEASUREMENT mf_main1_pf "o v" UWORD _CNV_A_R_LINEAR_____50_CM 1 0. 0. 65.535 DISPLAY_IDENTIFIER MF_MAIN1_PF ECU_ADDRESS 0x7f9dd2 BYTE_ORDER MSB_LAST /end MEASUREMENT
/begin MEASUREMENT mf_main2_pf "o v" UWORD _CNV_A_R_LINEAR_____50_CM 1 0. 0. 65.535 DISPLAY_IDENTIFIER MF_MAIN2_PF ECU_ADDRESS 0x7f9dd4 BYTE_ORDER MSB_LAST /end MEASUREMENT
/begin MEASUREMENT mf_post1_pf "o v" UWORD _CNV_A_R_LINEAR_____50_CM 1 0. 0. 65.535 DISPLAY_IDENTIFIER MF_POST1_PF ECU_ADDRESS 0x7f9dd6 BYTE_ORDER MSB_LAST /end MEASUREMENT
/begin MEASUREMENT mf_post2_pf "o v" UWORD _CNV_A_R_LINEAR_____50_CM 1 0. 0. 65.535 DISPLAY_IDENTIFIER MF_POST2_PF ECU_ADDRESS 0x7f9dd8 BYTE_ORDER MSB_LAST /end MEASUREMENT
/begin MEASUREMENT soi_prev1_pf "o v" UWORD _CNV_A_R_LINEAR_____118_CM 1 0. -120. 240. DISPLAY_IDENTIFIER SOI_PREV1_PF ECU_ADDRESS 0x7f9de4 BYTE_ORDER MSB_LAST FORMAT "%5.2" /end MEASUREMENT
/begin MEASUREMENT soi_prev2_pf "o v" UWORD _CNV_A_R_LINEAR_____118_CM 1 0. -120. 240. DISPLAY_IDENTIFIER SOI_PREV2_PF ECU_ADDRESS 0x7f9de6 BYTE_ORDER MSB_LAST FORMAT "%5.2" /end MEASUREMENT
/begin MEASUREMENT soi_main1_pf "o v" UWORD _CNV_A_R_LINEAR_____118_CM 1 0. -120. 240. DISPLAY_IDENTIFIER SOI_MAIN1_PF ECU_ADDRESS 0x7f9de8 BYTE_ORDER MSB_LAST FORMAT "%5.2" /end MEASUREMENT
/begin MEASUREMENT soi_main2_pf "o v" UWORD _CNV_A_R_LINEAR_____118_CM 1 0. -120. 240. DISPLAY_IDENTIFIER SOI_MAIN2_PF ECU_ADDRESS 0x7f9dea BYTE_ORDER MSB_LAST FORMAT "%5.2" /end MEASUREMENT
/begin MEASUREMENT soi_post1_pf "o v" UWORD _CNV_A_R_LINEAR_____118_CM 1 0. -120. 240. DISPLAY_IDENTIFIER SOI_POST1_PF ECU_ADDRESS 0x7f9dec BYTE_ORDER MSB_LAST FORMAT "%5.2" /end MEASUREMENT
/begin MEASUREMENT soi_post2_pf "o v" UWORD _CNV_A_R_LINEAR_____118_CM 1 0. -120. 240. DISPLAY_IDENTIFIER SOI_POST2_PF ECU_ADDRESS 0x7f9dee BYTE_ORDER MSB_LAST FORMAT "%5.2" /end MEASUREMENT
/begin MEASUREMENT lv_req_egr_pf "o v" UBYTE _CNV_S_2_RANGE__0___85_CM 1 0. 0. 1. DISPLAY_IDENTIFIER LV_REQ_EGR_PF ECU_ADDRESS 0x7fbabf /end MEASUREMENT
/begin MEASUREMENT lv_req_thr_pf "o v" UBYTE _CNV_S_2_RANGE__0___85_CM 1 0. 0. 1. DISPLAY_IDENTIFIER LV_REQ_THR_PF ECU_ADDRESS 0x7fbac0 /end MEASUREMENT
/begin MEASUREMENT lv_req_bpa_pf "o v" UBYTE _CNV_S_2_RANGE__0___85_CM 1 0. 0. 1. DISPLAY_IDENTIFIER LV_REQ_BPA_PF ECU_ADDRESS 0x7fbac1 /end MEASUREMENT
/begin MEASUREMENT lv_req_post_act "o v" UBYTE _CNV_S_2_RANGE__0___85_CM 1 0. 0. 1. DISPLAY_IDENTIFIER LV_REQ_POST_ACT ECU_ADDRESS 0x7fbac2 /end MEASUREMENT
/begin MEASUREMENT lv_cmd_gl_ext "o v" UBYTE _CNV_S_2_RANGE__0___85_CM 1 0. 0. 1. DISPLAY_IDENTIFIER LV_CMD_GL_EXT ECU_ADDRESS 0x7fce4c /end MEASUREMENT
/begin MEASUREMENT pwm_gl_ext "o v" UBYTE _CNV_A_R_LINEAR_____39_CM 1 0. 0. 100. DISPLAY_IDENTIFIER PWM_GL_EXT ECU_ADDRESS 0x7fce4b FORMAT "%4.1" /end MEASUREMENT
/begin AXIS_PTS ldp_n_wiv_ip_toil_mdl "X Axis LDP for IP_TOIL_MDL" 0x841fba n _REC_AXS_20_u2 8160. _CNV_A_R_LINEAR_____154_CM 10 0. 8160. FORMAT "%4.0" /end AXIS_PTS
/begin MEASUREMENT n_max_etc "" UWORD _CNV_A_R_LINEAR_____5_CM 1 0. 0. 6375. DISPLAY_IDENTIFIER N_MAX_ETC ECU_ADDRESS 0x7fb404 BYTE_ORDER MSB_LAST FORMAT "%4.0" /end MEASUREMENT
/begin MEASUREMENT n_max_mt "" UWORD _CNV_A_R_LINEAR_____5_CM 1 0. 0. 6375. DISPLAY_IDENTIFIER N_MAX_MT ECU_ADDRESS 0x7fb3fe BYTE_ORDER MSB_LAST FORMAT "%4.0" /end MEASUREMENT
/begin MEASUREMENT n_max_tqi "" UWORD _CNV_A_R_LINEAR_____5_CM 1 0. 0. 6375. DISPLAY_IDENTIFIER N_MAX_TQI ECU_ADDRESS 0x7fb402 BYTE_ORDER MSB_LAST FORMAT "%4.0" /end MEASUREMENT
/begin MEASUREMENT ctr_max_ti_min_0 "" UBYTE _CNV_A_R_LINEAR_____0_CM 1 0. 0. 255. DISPLAY_IDENTIFIER CTR_MAX_TI_MIN_0 ECU_ADDRESS 0x7fce43 FORMAT "%3.0" /end MEASUREMENT
/begin MEASUREMENT ctr_max_ti_min_1 "" UBYTE _CNV_A_R_LINEAR_____0_CM 1 0. 0. 255. DISPLAY_IDENTIFIER CTR_MAX_TI_MIN_1 ECU_ADDRESS 0x7fce44 FORMAT "%3.0" /end MEASUREMENT
/begin MEASUREMENT ctr_max_ti_min_2 "" UBYTE _CNV_A_R_LINEAR_____0_CM 1 0. 0. 255. DISPLAY_IDENTIFIER CTR_MAX_TI_MIN_2 ECU_ADDRESS 0x7fce45 FORMAT "%3.0" /end MEASUREMENT
/begin MEASUREMENT ctr_max_ti_min_3 "" UBYTE _CNV_A_R_LINEAR_____0_CM 1 0. 0. 255. DISPLAY_IDENTIFIER CTR_MAX_TI_MIN_3 ECU_ADDRESS 0x7fce46 FORMAT "%3.0" /end MEASUREMENT
/begin MEASUREMENT lv_req_ti_min_cyl_0 "" UBYTE _CNV_S_2_RANGE______11_CM 1 0. 0. 1. DISPLAY_IDENTIFIER LV_REQ_TI_MIN_CYL_0 ECU_ADDRESS 0x7fce47 /end MEASUREMENT
/begin MEASUREMENT lv_req_ti_min_cyl_1 "" UBYTE _CNV_S_2_RANGE______11_CM 1 0. 0. 1. DISPLAY_IDENTIFIER LV_REQ_TI_MIN_CYL_1 ECU_ADDRESS 0x7fce48 /end MEASUREMENT
/begin MEASUREMENT lv_req_ti_min_cyl_2 "" UBYTE _CNV_S_2_RANGE______11_CM 1 0. 0. 1. DISPLAY_IDENTIFIER LV_REQ_TI_MIN_CYL_2 ECU_ADDRESS 0x7fce49 /end MEASUREMENT
/begin MEASUREMENT lv_req_ti_min_cyl_3 "" UBYTE _CNV_S_2_RANGE______11_CM 1 0. 0. 1. DISPLAY_IDENTIFIER LV_REQ_TI_MIN_CYL_3 ECU_ADDRESS 0x7fce4a /end MEASUREMENT
/begin CHARACTERISTIC c_mf_prev1_add_tu "" VALUE 0x8501c2 _REC_VAL_20_s2 262.14 _CNV_A_R_LINEAR_____38_CM -131.072 131.068 DISPLAY_IDENTIFIER C_MF_PREV1_ADD_TU FORMAT "%6.2" /end CHARACTERISTIC
/begin CHARACTERISTIC c_mf_prev2_add_tu "" VALUE 0x8501cc _REC_VAL_20_s2 262.14 _CNV_A_R_LINEAR_____38_CM -131.072 131.068 DISPLAY_IDENTIFIER C_MF_PREV2_ADD_TU FORMAT "%6.2" /end CHARACTERISTIC
/begin MEASUREMENT lv_ena_grd_ratio_tq_mf_clc "GRD_RATIO_TQ_MF calculation enabled" UBYTE _CNV_S_2_RANGE______11_CM 1 0. 0. 1. DISPLAY_IDENTIFIER LV_ENA_GRD_RATIO_TQ_MF_CLC ECU_ADDRESS 0x7fbfcb /end MEASUREMENT
/begin MEASUREMENT grd_ratio_tq_mf_lim "limited gradient of RATIO_TQ_MF" SWORD _CNV_A_R___16__8000_344_CM 1 0. -16. 15.9995 DISPLAY_IDENTIFIER GRD_RATIO_TQ_MF_LIM ECU_ADDRESS 0x7fb4a6 BYTE_ORDER MSB_LAST FORMAT "%6.4" /end MEASUREMENT
/begin MEASUREMENT ratio_tq_mf_mem_new "new memorized value of RATIO_TQ_MF for gradient calculation" SWORD _CNV_A_R___16__8000_345_CM 1 0. -16. 15.9995 DISPLAY_IDENTIFIER RATIO_TQ_MF_MEM_NEW ECU_ADDRESS 0x7fb4a8 BYTE_ORDER MSB_LAST FORMAT "%6.4" /end MEASUREMENT
/begin MEASUREMENT ratio_tq_mf_mem_old "old memorized value of RATIO_TQ_MF for gradient calculation" SWORD _CNV_A_R___16__8000_345_CM 1 0. -16. 15.9995 DISPLAY_IDENTIFIER RATIO_TQ_MF_MEM_OLD ECU_ADDRESS 0x7fb4aa BYTE_ORDER MSB_LAST FORMAT "%6.4" /end MEASUREMENT
/begin MEASUREMENT mf_tot_mem_new_grd_ratio_tq_mf "old memorized value of MF_TOT for gradient calculation" UWORD _CNV_A_R_LINEAR_____38_CM 1 0. 0. 262.14 DISPLAY_IDENTIFIER MF_TOT_MEM_NEW_GRD_RATIO_TQ_MF ECU_ADDRESS 0x7fb4ac BYTE_ORDER MSB_LAST /end MEASUREMENT
/begin MEASUREMENT mf_tot_mem_old_grd_ratio_tq_mf "new memorized value of MF_TOT for gradient calculation" UWORD _CNV_A_R_LINEAR_____38_CM 1 0. 0. 262.14 DISPLAY_IDENTIFIER MF_TOT_MEM_OLD_GRD_RATIO_TQ_MF ECU_ADDRESS 0x7fb4ae BYTE_ORDER MSB_LAST /end MEASUREMENT
/begin MEASUREMENT grd_ratio_tq_mf "gradient of RATIO_TQ_MF" SWORD _CNV_A_R___16__8000_344_CM 1 0. -16. 15.9995 DISPLAY_IDENTIFIER GRD_RATIO_TQ_MF ECU_ADDRESS 0x7fb4b0 BYTE_ORDER MSB_LAST FORMAT "%6.4" /end MEASUREMENT
/begin MEASUREMENT ratio_tq_mf_mpg_fil "filtered ratio between TQI_SP and MF_TOT corrected by ratio maps" SWORD _CNV_A_R___16__8000_345_CM 1 0. -16. 15.9995 DISPLAY_IDENTIFIER RATIO_TQ_MF_MPG_FIL ECU_ADDRESS 0x7fb4b2 BYTE_ORDER MSB_LAST FORMAT "%6.4" /end MEASUREMENT
/begin MEASUREMENT ratio_tq_mf_tot "RATIO_TQ_MF out of map for MF_TOT" SWORD _CNV_A_R___16__8000_345_CM 1 0. -16. 15.9995 DISPLAY_IDENTIFIER RATIO_TQ_MF_TOT ECU_ADDRESS 0x7fb4b4 BYTE_ORDER MSB_LAST FORMAT "%6.4" /end MEASUREMENT
/begin MEASUREMENT ratio_tq_mf_slm "RATIO_TQ_MF out of map for MF_SLM" SWORD _CNV_A_R___16__8000_345_CM 1 0. -16. 15.9995 DISPLAY_IDENTIFIER RATIO_TQ_MF_SLM ECU_ADDRESS 0x7fb4b6 BYTE_ORDER MSB_LAST FORMAT "%6.4" /end MEASUREMENT
/begin MEASUREMENT ratio_tq_mf_mpg "ratio between TQI_SP and MF_TOT corrected by ratio maps" SWORD _CNV_A_R___16__8000_345_CM 1 0. -16. 15.9995 DISPLAY_IDENTIFIER RATIO_TQ_MF_MPG ECU_ADDRESS 0x7fb4b8 BYTE_ORDER MSB_LAST FORMAT "%6.4" /end MEASUREMENT
/begin MEASUREMENT lv_ratio_tq_mf_grd_use "gradient correction used in TQI_SLM calculation" UBYTE _CNV_S_2_RANGE______11_CM 1 0. 0. 1. DISPLAY_IDENTIFIER LV_RATIO_TQ_MF_GRD_USE ECU_ADDRESS 0x7fbfcc /end MEASUREMENT
/begin MEASUREMENT lv_ena_ratio_tq_mf_clc "caculation of RATIO_TQ_MF_RAW enabled" UBYTE _CNV_S_2_RANGE______11_CM 1 0. 0. 1. DISPLAY_IDENTIFIER LV_ENA_RATIO_TQ_MF_CLC ECU_ADDRESS 0x7fbfcd /end MEASUREMENT
/begin MEASUREMENT ratio_tq_mf_raw "ratio between TQI_SP and MF_TOT; raw value" SWORD _CNV_A_R___16__8000_345_CM 1 0. -16. 15.9995 DISPLAY_IDENTIFIER RATIO_TQ_MF_RAW ECU_ADDRESS 0x7fb4ba BYTE_ORDER MSB_LAST FORMAT "%6.4" /end MEASUREMENT
/begin CHARACTERISTIC c_mf_delta_grd_ratio_tq_mf "delta fuel mass for gradient calculation" VALUE 0x85cad0 _REC_VAL_20_u2 262.14 _CNV_A_R_LINEAR_____38_CM 0. 262.14 DISPLAY_IDENTIFIER C_MF_DELTA_GRD_RATIO_TQ_MF /end CHARACTERISTIC
/begin CHARACTERISTIC c_mf_tot_min_grd_ratio_tq_mf "minimum MF_TOT for GRD_RATIO_TQ_MF calculation" VALUE 0x85cae8 _REC_VAL_20_u2 262.14 _CNV_A_R_LINEAR_____38_CM 0. 262.14 DISPLAY_IDENTIFIER C_MF_TOT_MIN_GRD_RATIO_TQ_MF /end CHARACTERISTIC
/begin CHARACTERISTIC c_grd_ratio_tq_mf_min "minimum limit for ratio_tq_mf gradient" VALUE 0x85ca42 _REC_VAL_20_s2 31.9995 _CNV_A_R___16__8000_344_CM -16. 15.9995 DISPLAY_IDENTIFIER C_GRD_RATIO_TQ_MF_MIN FORMAT "%6.4" /end CHARACTERISTIC
/begin CHARACTERISTIC c_grd_ratio_tq_mf_max "maximum limit for ratio_tq_mf gradient" VALUE 0x85ca40 _REC_VAL_20_s2 31.9995 _CNV_A_R___16__8000_344_CM -16. 15.9995 DISPLAY_IDENTIFIER C_GRD_RATIO_TQ_MF_MAX FORMAT "%6.4" /end CHARACTERISTIC
/begin CHARACTERISTIC c_mf_dif_max_grd_ratio_tq_mf "maximum difference between MF_TOT and MF_SLM for use of gradient calculation" VALUE 0x85cad2 _REC_VAL_20_u2 262.14 _CNV_A_R_LINEAR_____38_CM 0. 262.14 DISPLAY_IDENTIFIER C_MF_DIF_MAX_GRD_RATIO_TQ_MF /end CHARACTERISTIC
/begin CHARACTERISTIC c_mf_tot_min_ratio_tq_mf "minimum MF_TOT for RATIO_TQ_MF calculation" VALUE 0x85caea _REC_VAL_20_u2 262.14 _CNV_A_R_LINEAR_____38_CM 0. 262.14 DISPLAY_IDENTIFIER C_MF_TOT_MIN_RATIO_TQ_MF FORMAT "%6.4" /end CHARACTERISTIC
/begin CHARACTERISTIC ip_ratio_tq_mf_0 "TQ_MF: ratio_tq_mf for injection state 0" CURVE 0x858220 _REC_CUR_20_u2_u2 31.999512 _CNV_A_R___16__0H___346_CM -16. 15.999512 DISPLAY_IDENTIFIER IP_RATIO_TQ_MF_0 FORMAT "%6.4"
 /begin AXIS_DESCR COM_AXIS mf_slm _CNV_A_R_LINEAR_____38_CM 8 0. 262.14 AXIS_PTS_REF ldpm_mf_ip_ratio_tq_mf /end AXIS_DESCR
/end CHARACTERISTIC
/begin AXIS_PTS ldpm_mf_ip_ratio_tq_mf "" 0x842c52 mf_slm _REC_AXS_20_u2 262.14 _CNV_A_R_LINEAR_____38_CM 8 0. 262.14 /end AXIS_PTS
/begin CHARACTERISTIC ip_ratio_tq_mf_2 "TQ_MF: ratio_tq_mf for injection state 2" CURVE 0x858240 _REC_CUR_20_u2_u2 31.999512 _CNV_A_R___16__0H___346_CM -16. 15.999512 DISPLAY_IDENTIFIER IP_RATIO_TQ_MF_2 FORMAT "%6.4"
 /begin AXIS_DESCR COM_AXIS mf_slm _CNV_A_R_LINEAR_____38_CM 8 0. 262.14 AXIS_PTS_REF ldpm_mf_ip_ratio_tq_mf /end AXIS_DESCR
/end CHARACTERISTIC
/begin CHARACTERISTIC ip_ratio_tq_mf_1 "TQ_MF: ratio_tq_mf for injection state 1" CURVE 0x858230 _REC_CUR_20_u2_u2 31.999512 _CNV_A_R___16__0H___346_CM -16. 15.999512 DISPLAY_IDENTIFIER IP_RATIO_TQ_MF_1 FORMAT "%6.4"
 /begin AXIS_DESCR COM_AXIS mf_slm _CNV_A_R_LINEAR_____38_CM 8 0. 262.14 AXIS_PTS_REF ldpm_mf_ip_ratio_tq_mf /end AXIS_DESCR
/end CHARACTERISTIC
/begin CHARACTERISTIC ip_ratio_tq_mf_3 "TQ_MF: ratio_tq_mf for injection state 3" CURVE 0x858250 _REC_CUR_20_u2_u2 31.999512 _CNV_A_R___16__0H___346_CM -16. 15.999512 DISPLAY_IDENTIFIER IP_RATIO_TQ_MF_3 FORMAT "%6.4"
 /begin AXIS_DESCR COM_AXIS mf_slm _CNV_A_R_LINEAR_____38_CM 8 0. 262.14 AXIS_PTS_REF ldpm_mf_ip_ratio_tq_mf /end AXIS_DESCR
/end CHARACTERISTIC
/begin CHARACTERISTIC ip_ratio_tq_mf_4 "TQ_MF: ratio_tq_mf for injection state 4" CURVE 0x858260 _REC_CUR_20_u2_u2 31.999512 _CNV_A_R___16__0H___346_CM -16. 15.999512 DISPLAY_IDENTIFIER IP_RATIO_TQ_MF_4 FORMAT "%6.4"
 /begin AXIS_DESCR COM_AXIS mf_slm _CNV_A_R_LINEAR_____38_CM 8 0. 262.14 AXIS_PTS_REF ldpm_mf_ip_ratio_tq_mf /end AXIS_DESCR
/end CHARACTERISTIC
/begin MEASUREMENT tqi_slm "" SWORD _CNV_A_R_LINEAR_____52_CM 1 0. -1024. 1023.96875 DISPLAY_IDENTIFIER TQI_SLM ECU_ADDRESS 0x7fa2be BYTE_ORDER MSB_LAST FORMAT "%7.2" /end MEASUREMENT
/begin MEASUREMENT ratio_tq_mf_grd "ratio between TQI_SP and MF_TOT corrected by gradient calculation" SWORD _CNV_A_R___16__8000_345_CM 1 0. -16. 15.9995 DISPLAY_IDENTIFIER RATIO_TQ_MF_GRD ECU_ADDRESS 0x7fb4a4 BYTE_ORDER MSB_LAST FORMAT "%6.4" /end MEASUREMENT
/begin CHARACTERISTIC c_crlc_ratio_tq_mf "correlation constant for map based ratio_tq_mf estimation" VALUE 0x85c906 _REC_VAL_20_u2 0.9999847412109381 _CNV_A_R_LINEAR_____14_CM 0. 0.9999847412109381 DISPLAY_IDENTIFIER C_CRLC_RATIO_TQ_MF FORMAT "%6.5" /end CHARACTERISTIC
/begin CHARACTERISTIC c_ratio_tq_mf_max "correlation constant for map based ratio_tq_mf estimation" VALUE 0x85cb88 _REC_VAL_20_s2 31.9995 _CNV_A_R___16__8000_345_CM -16. 15.9995 DISPLAY_IDENTIFIER C_RATIO_TQ_MF_MAX FORMAT "%6.5" /end CHARACTERISTIC
/begin CHARACTERISTIC c_ratio_tq_mf_min "correlation constant for map based ratio_tq_mf estimation" VALUE 0x85cb8a _REC_VAL_20_s2 31.9995 _CNV_A_R___16__8000_345_CM -16. 15.9995 DISPLAY_IDENTIFIER C_RATIO_TQ_MF_MIN FORMAT "%6.5" /end CHARACTERISTIC
/begin MEASUREMENT tq_driv_sub "o v" SWORD _CNV_A_R_LINEAR_____52_CM 1 0. -1024. 1023.96875 DISPLAY_IDENTIFIER TQ_DRIV_SUB ECU_ADDRESS 0x7fa2fe BYTE_ORDER MSB_LAST FORMAT "%6.2" /end MEASUREMENT
/begin MEASUREMENT tqi_driv_sub "o v" SWORD _CNV_A_R_LINEAR_____52_CM 1 0. -1024. 1023.96875 DISPLAY_IDENTIFIER TQI_DRIV_SUB ECU_ADDRESS 0x7fa300 BYTE_ORDER MSB_LAST FORMAT "%6.2" /end MEASUREMENT
/begin MEASUREMENT lv_tq_cru_act "o v" UBYTE _CNV_S_2_RANGE______11_CM 1 0. 0. 1. DISPLAY_IDENTIFIER LV_TQ_CRU_ACT ECU_ADDRESS 0x7fbbf7 /end MEASUREMENT
/begin MEASUREMENT lv_tq_vvsl_act "o v" UBYTE _CNV_S_2_RANGE______11_CM 1 0. 0. 1. DISPLAY_IDENTIFIER LV_TQ_VVSL_ACT ECU_ADDRESS 0x7fbbf8 /end MEASUREMENT
/begin MEASUREMENT tq_dcru_req "o v" SWORD _CNV_A_R_LINEAR_____52_CM 1 0. -1024. 1023.96875 DISPLAY_IDENTIFIER TQ_DCRU_REQ ECU_ADDRESS 0x7fa302 BYTE_ORDER MSB_LAST FORMAT "%6.2" /end MEASUREMENT
/begin MEASUREMENT tq_cru_req "o v" SWORD _CNV_A_R_LINEAR_____52_CM 1 0. -1024. 1023.96875 DISPLAY_IDENTIFIER TQ_CRU_REQ ECU_ADDRESS 0x7fa304 BYTE_ORDER MSB_LAST FORMAT "%6.2" /end MEASUREMENT
/begin MEASUREMENT tq_vs_lim_req "o v" SWORD _CNV_A_R_LINEAR_____52_CM 1 0. -1024. 1023.96875 DISPLAY_IDENTIFIER TQ_VS_LIM_REQ ECU_ADDRESS 0x7fa306 BYTE_ORDER MSB_LAST FORMAT "%6.2" /end MEASUREMENT
/begin MEASUREMENT tq_req_dcru "torque request for distance cruise control intervention" SWORD _CNV_A_R_LINEAR_____52_CM 1 0. -1024. 1023.96875 DISPLAY_IDENTIFIER TQ_REQ_DCRU ECU_ADDRESS 0x7f9834 BYTE_ORDER MSB_LAST FORMAT "%6.2" /end MEASUREMENT
/begin MEASUREMENT tqi_max "" SWORD _CNV_A_R_LINEAR_____52_CM 1 0. -1024. 1023.96875 DISPLAY_IDENTIFIER TQI_MAX ECU_ADDRESS 0x7fa312 BYTE_ORDER MSB_LAST FORMAT "%7.2" /end MEASUREMENT
/begin MEASUREMENT fac_cyl_bal_ramp_tco[3] "correction factor calculated by the ramp for TCO x=0...NC_CYL_NR-1" UWORD _CNV_A_R_LINEAR_____48_CM 1 0. 0. 1.9999696 DISPLAY_IDENTIFIER FAC_CYL_BAL_RAMP_TCO_3_ ECU_ADDRESS 0x7f984c BYTE_ORDER MSB_LAST FORMAT "%5.3" /end MEASUREMENT
/begin MEASUREMENT fac_cyl_bal[3] "cylinder balancing factor x=0...NC_CYL_NR-1" UWORD _CNV_A_R_LINEAR_____48_CM 1 0. 0. 1.9999696 DISPLAY_IDENTIFIER FAC_CYL_BAL_3_ ECU_ADDRESS 0x7f983c BYTE_ORDER MSB_LAST FORMAT "%5.3" /end MEASUREMENT
/begin MEASUREMENT fac_cyl_bal_n_fdout[3] "" UWORD _CNV_A_R_LINEAR_____48_CM 1 0. 0. 1.9999696 DISPLAY_IDENTIFIER FAC_CYL_BAL_N_FDOUT_3_ ECU_ADDRESS 0x7fa60c BYTE_ORDER MSB_LAST FORMAT "%6.4" /end MEASUREMENT
/begin MEASUREMENT cyl_bal_pi[3] "output of the PI-controller x = 0...NC_CYL_NR-1" UWORD _CNV_A_R_LINEAR_____48_CM 1 0. 0. 1.9999696 DISPLAY_IDENTIFIER CYL_BAL_PI_3_ ECU_ADDRESS 0x7f9854 BYTE_ORDER MSB_LAST FORMAT "%5.3" /end MEASUREMENT
/begin MEASUREMENT cyl_bal_dif[3] "control deviation cylinder balancing x=0...NC_CYL_NR-1" SWORD _CNV_A_R_LINEAR_____374_CM 1 0. -8. 7.999755856 DISPLAY_IDENTIFIER CYL_BAL_DIF_3_ ECU_ADDRESS 0x7f9868 BYTE_ORDER MSB_LAST FORMAT "%6.5" /end MEASUREMENT
/begin MEASUREMENT cfb_pcv_mes "" UWORD _CNV_A_R_LINEAR_____380_CM 1 0. 0. 3.25 DISPLAY_IDENTIFIER CFB_PCV_MES ECU_ADDRESS 0x7fa316 BYTE_ORDER MSB_LAST FORMAT "%3.2" /end MEASUREMENT
/begin MEASUREMENT er[3] "" SWORD _CNV_A_R_LINEAR_____362_CM 1 0. -32768. 32767. DISPLAY_IDENTIFIER ER_3_ ECU_ADDRESS 0x7f99ee BYTE_ORDER MSB_LAST FORMAT "%6.0" /end MEASUREMENT
/begin MEASUREMENT seg_ad_mmv[3] "adaptation values for each segment(x = 0...NC_CYL_NR-1)" SWORD _CNV_A_R_LINEAR_____382_CM 1 0. -7.812507 7.812269 DISPLAY_IDENTIFIER SEG_AD_MMV_3_ ECU_ADDRESS 0x7f99da BYTE_ORDER MSB_LAST FORMAT "%7.5" /end MEASUREMENT
/begin MEASUREMENT seg_t_cor_buf[6] "" UWORD _CNV_A_R_LINEAR_____362_CM 1 0. 0. 65535. DISPLAY_IDENTIFIER SEG_T_COR_BUF_6_ ECU_ADDRESS 0x7f99fc BYTE_ORDER MSB_LAST FORMAT "%5.0" /end MEASUREMENT
/begin MEASUREMENT seg_t_cor_buf[7] "" UWORD _CNV_A_R_LINEAR_____362_CM 1 0. 0. 65535. DISPLAY_IDENTIFIER SEG_T_COR_BUF_7_ ECU_ADDRESS 0x7f99fe BYTE_ORDER MSB_LAST FORMAT "%5.0" /end MEASUREMENT
/begin MEASUREMENT lv_seg_t_ad_rst_ext_adj "" UBYTE _CNV_S_2_RANGE______11_CM 1 0. 0. 1. DISPLAY_IDENTIFIER LV_SEG_T_AD_RST_EXT_ADJ ECU_ADDRESS 0x7fb8af /end MEASUREMENT
/begin MEASUREMENT lv_seg_t_fast_ad_ext_adj "" UBYTE _CNV_S_2_RANGE______11_CM 1 0. 0. 1. DISPLAY_IDENTIFIER LV_SEG_T_FAST_AD_EXT_ADJ ECU_ADDRESS 0x7fb8ae /end MEASUREMENT
/begin CHARACTERISTIC lc_seg_ad_init "" VALUE 0x85cea3 _REC_VAL_20_u1 1. _CNV_A_R_LINEAR_____0_CM 0. 1. DISPLAY_IDENTIFIER LC_SEG_AD_INIT FORMAT "%1.0" /end CHARACTERISTIC
/begin CHARACTERISTIC id_clas_a_fmt "" CURVE 0x844478 _REC_CUR_20_u1_u2 255. _CNV_A_R_LINEAR_____1_CM 0. 255. DISPLAY_IDENTIFIER ID_CLAS_A_FMT FORMAT "%3.0"
 /begin AXIS_DESCR COM_AXIS online_dummy _CNV_A_R_LINEAR_____1_CM 16 0. 65535. FORMAT "%5.0" AXIS_PTS_REF ldpm_clas_a_id_clas_fmy /end AXIS_DESCR
/end CHARACTERISTIC
/begin AXIS_PTS ldpm_clas_a_id_clas_fmy "" 0x842b2c online_dummy _REC_AXS_20_u2 65535. _CNV_A_R_LINEAR_____1_CM 16 0. 65535. FORMAT "%5.0" /end AXIS_PTS
/begin CHARACTERISTIC id_clas_b_fmt "" MAP 0x844488 _REC_MAP_20_u1_u2_u2 255. _CNV_A_R_LINEAR_____1_CM 0. 255. DISPLAY_IDENTIFIER ID_CLAS_B_FMT FORMAT "%3.0"
 /begin AXIS_DESCR COM_AXIS online_dummy _CNV_A_R_LINEAR_____1_CM 16 0. 65535. FORMAT "%5.0" AXIS_PTS_REF ldpm_clas_a_id_clas_fmy /end AXIS_DESCR
 /begin AXIS_DESCR COM_AXIS online_dummy _CNV_A_R_LINEAR_____1_CM 4 0. 65535. FORMAT "%5.0" AXIS_PTS_REF ldp_clas_b_id_clas_fmy /end AXIS_DESCR
/end CHARACTERISTIC
/begin AXIS_PTS ldp_clas_b_id_clas_fmy "" 0x84147e online_dummy _REC_AXS_20_u2 65535. _CNV_A_R_LINEAR_____1_CM 4 0. 65535. FORMAT "%5.0" /end AXIS_PTS
/begin MEASUREMENT ctr_t_low_maf_frq_0_av "" UWORD _CNV_A_R_LINEAR_____0_CM 1 0. 0. 65535. DISPLAY_IDENTIFIER CTR_T_LOW_MAF_FRQ_0_AV ECU_ADDRESS 0x7fcd7c BYTE_ORDER MSB_LAST FORMAT "%5.0" /end MEASUREMENT
/begin MEASUREMENT t_atic20 "" UBYTE _CNV_A_R_LINEAR_____18_CM 1 0. -50. 205. DISPLAY_IDENTIFIER T_ATIC20 ECU_ADDRESS 0x7fce7e FORMAT "%3.0" /end MEASUREMENT
/begin MEASUREMENT v_t_atic20 "" UBYTE _CNV_A_R_LINEAR_____368_CM 1 0. 0. 4.98046875 DISPLAY_IDENTIFIER V_T_ATIC20 ECU_ADDRESS 0x7fce80 FORMAT "%3.2" /end MEASUREMENT
/begin MEASUREMENT v_t_lc "" UBYTE _CNV_A_R_LINEAR_____368_CM 1 0. 0. 4.98046875 DISPLAY_IDENTIFIER V_T_LC ECU_ADDRESS 0x7fce81 FORMAT "%3.2" /end MEASUREMENT
/begin MEASUREMENT t_lc "" UBYTE _CNV_A_R_LINEAR_____18_CM 1 0. -50. 205. DISPLAY_IDENTIFIER T_LC ECU_ADDRESS 0x7fce7f FORMAT "%3.0" /end MEASUREMENT
/begin MEASUREMENT vb_fil "" UBYTE _CNV_A_R_LINEAR_____43_CM 1 0. 0. 28.8 DISPLAY_IDENTIFIER VB_FIL ECU_ADDRESS 0x7fbb4e FORMAT "%3.1" /end MEASUREMENT
/begin MEASUREMENT lv_key_off "" UBYTE _CNV_S_2_RANGE______23_CM 1 0. 0. 1. DISPLAY_IDENTIFIER LV_KEY_OFF ECU_ADDRESS 0x7fbc7a /end MEASUREMENT
/begin AXIS_PTS ldp_v_maf_id_maf_x "" 0x8429a8 v_maf_x _REC_AXS_20_u1 15. _CNV_A_R_LINEAR_____0_CM 16 0. 15. FORMAT "%2.0" /end AXIS_PTS
/begin AXIS_PTS ldp_v_maf_id_maf_y "" 0x8429b9 v_maf_y _REC_AXS_20_u1 15. _CNV_A_R_LINEAR_____0_CM 16 0. 15. FORMAT "%2.0" /end AXIS_PTS
/begin CHARACTERISTIC id_maf_tab "mass air flow" MAP 0x850536 _REC_MAP_20_u2_u1_u1 1023.984375 _CNV_A_R_LINEAR_____110_CM 0. 1023.984375 DISPLAY_IDENTIFIER ID_MAF_TAB FORMAT "%7.2"
 /begin AXIS_DESCR COM_AXIS v_maf_x _CNV_A_R_LINEAR_____0_CM 16 0. 15. FORMAT "%2.0" AXIS_PTS_REF ldp_v_maf_id_maf_x /end AXIS_DESCR
 /begin AXIS_DESCR COM_AXIS v_maf_y _CNV_A_R_LINEAR_____0_CM 16 0. 15. FORMAT "%2.0" AXIS_PTS_REF ldp_v_maf_id_maf_y /end AXIS_DESCR
/end CHARACTERISTIC
/begin MEASUREMENT v_map "" UWORD _CNV_A_R_LINEAR_____47_CM 1 0. 0. 4.9999237 DISPLAY_IDENTIFIER V_MAP ECU_ADDRESS 0x7fa388 BYTE_ORDER MSB_LAST FORMAT "%6.5" /end MEASUREMENT
/begin MEASUREMENT can_tq_driv_sub "" UBYTE _CNV_A_R_LINEAR_____396_CM 1 0. -100. 410. DISPLAY_IDENTIFIER CAN_TQ_DRIV_SUB ECU_ADDRESS 0x7fbb2f FORMAT "%3.0" /end MEASUREMENT
/begin MEASUREMENT can_tq_req_sta "" UBYTE _CNV_S_5_RANGE______397_CM 1 0. 0. 255. DISPLAY_IDENTIFIER CAN_TQ_REQ_STA ECU_ADDRESS 0x7fbb30 /end MEASUREMENT
/begin MEASUREMENT fup_tra_dif "" SWORD _CNV_A_R_LINEAR_____290_CM 1 0. -100. 99.996948242 DISPLAY_IDENTIFIER FUP_TRA_DIF ECU_ADDRESS 0x7fa0de BYTE_ORDER MSB_LAST FORMAT "%5.3" /end MEASUREMENT
/begin MEASUREMENT lv_can_brake_abs "" UBYTE _CNV_S_2_RANGE______3_CM 1 0. 0. 1. DISPLAY_IDENTIFIER LV_CAN_BRAKE_ABS ECU_ADDRESS 0x7fbb2c /end MEASUREMENT
/begin MEASUREMENT lv_inh_egr_ctl "" UBYTE _CNV_S_2_RANGE______23_CM 1 0. 0. 1. DISPLAY_IDENTIFIER LV_INH_EGR_CTL ECU_ADDRESS 0x7fbb20 /end MEASUREMENT
/begin MEASUREMENT lv_r_heat_1 "" UBYTE _CNV_S_2_RANGE______11_CM 1 0. 0. 1. DISPLAY_IDENTIFIER LV_R_HEAT_1 ECU_ADDRESS 0x7fbb2d /end MEASUREMENT
/begin MEASUREMENT lv_r_heat_2 "" UBYTE _CNV_S_2_RANGE______11_CM 1 0. 0. 1. DISPLAY_IDENTIFIER LV_R_HEAT_2 ECU_ADDRESS 0x7fbb2e /end MEASUREMENT
/begin MEASUREMENT online_dummy "" UWORD _CNV_A_R_LINEAR_____1_CM 1 0. 0. 65535. DISPLAY_IDENTIFIER ONLINE_DUMMY ECU_ADDRESS 0x7fa0e8 BYTE_ORDER MSB_LAST FORMAT "%5.0" /end MEASUREMENT
/begin MEASUREMENT ecu_state "" UBYTE _CNV_S_6_RANGE______398_CM 1 0. 0. 5. DISPLAY_IDENTIFIER ECU_STATE ECU_ADDRESS 0x7ffd5d /end MEASUREMENT
/begin MEASUREMENT mf_bas "" UWORD _CNV_A_R_LINEAR_____38_CM 1 0. 0. 262.14 DISPLAY_IDENTIFIER MF_BAS ECU_ADDRESS 0x7fa0e0 BYTE_ORDER MSB_LAST FORMAT "%5.2" /end MEASUREMENT
/begin MEASUREMENT mf_tql "fuel mass torque limitation" UWORD _CNV_A_R_LINEAR_____38_CM 1 0. 0. 262.14 DISPLAY_IDENTIFIER MF_TQL ECU_ADDRESS 0x7fa0e6 BYTE_ORDER MSB_LAST /end MEASUREMENT
/begin AXIS_PTS ldp_amp_2_inj_x "" 0x841082 amp _REC_AXS_20_u2 5434. _CNV_A_R_LINEAR_____45_CM 1 0. 5434. FORMAT "%7.3" /end AXIS_PTS
/begin AXIS_PTS ldp_n_3_inj_x "" 0x841924 n _REC_AXS_20_u2 6375. _CNV_A_R_LINEAR_____5_CM 1 0. 6375. FORMAT "%4.0" /end AXIS_PTS
/begin AXIS_PTS ldp_n_4_inj_x "" 0x841928 n _REC_AXS_20_u2 6375. _CNV_A_R_LINEAR_____5_CM 1 0. 6375. FORMAT "%4.0" /end AXIS_PTS
/begin MEASUREMENT lv_intv_bpa[0] "" UBYTE _CNV_A_R_LINEAR_____0_CM 1 0. 0. 1. DISPLAY_IDENTIFIER LV_INTV_BPA_0_ ECU_ADDRESS 0x7fb85a FORMAT "%1.0" /end MEASUREMENT
/begin MEASUREMENT intv_bpa[0] "" SWORD _CNV_A_R_LINEAR_____12_CM 1 0. -100. 99.996948242 DISPLAY_IDENTIFIER INTV_BPA_0_ ECU_ADDRESS 0x7f9894 BYTE_ORDER MSB_LAST FORMAT "%6.2" /end MEASUREMENT
/begin MEASUREMENT lv_ad_bpa[0] "error flag for V_EGRV_j_BOL adaption out of range" UBYTE _CNV_S_2_RANGE______11_CM 1 0. 0. 1. DISPLAY_IDENTIFIER LV_AD_BPA_0_ ECU_ADDRESS 0x7fb85e /end MEASUREMENT
/begin MEASUREMENT ad_bpa_mmv[0] "" SWORD _CNV_A_R_LINEAR_____12_CM 1 0. -100. 99.996948242 DISPLAY_IDENTIFIER AD_BPA_MMV_0_ ECU_ADDRESS 0x7f98c0 BYTE_ORDER MSB_LAST FORMAT "%6.2" /end MEASUREMENT
/begin MEASUREMENT lv_ad_bpa_tol[0] "" UBYTE _CNV_A_R_LINEAR_____0_CM 1 0. 0. 1. DISPLAY_IDENTIFIER LV_AD_BPA_TOL_0_ ECU_ADDRESS 0x7fb863 FORMAT "%1.0" /end MEASUREMENT
/begin MEASUREMENT lv_v_bpa_tol_ad_orng[0] "error flag for V_EGRV_j_BOL adaption out of range" UBYTE _CNV_S_2_RANGE______11_CM 1 0. 0. 1. DISPLAY_IDENTIFIER LV_V_BPA_TOL_AD_ORNG_0_ ECU_ADDRESS 0x7fb85f /end MEASUREMENT
/begin MEASUREMENT v_bpa_tol[0] "" UWORD _CNV_A_R_LINEAR_____415_CM 1 0. 0. 319.995172 DISPLAY_IDENTIFIER V_BPA_TOL_0_ ECU_ADDRESS 0x7f98bc BYTE_ORDER MSB_LAST FORMAT "%5.2" /end MEASUREMENT
/begin MEASUREMENT lv_cdn_ad_v_bpa_tol[0] "" UBYTE _CNV_A_R_LINEAR_____0_CM 1 0. 0. 1. DISPLAY_IDENTIFIER LV_CDN_AD_V_BPA_TOL_0_ ECU_ADDRESS 0x7fb861 FORMAT "%1.0" /end MEASUREMENT
/begin MEASUREMENT v_bpa_tol_det[0] "" UWORD _CNV_A_R_LINEAR_____415_CM 1 0. 0. 319.995172 DISPLAY_IDENTIFIER V_BPA_TOL_DET_0_ ECU_ADDRESS 0x7f98c2 BYTE_ORDER MSB_LAST FORMAT "%5.2" /end MEASUREMENT
/begin MEASUREMENT t_ad_bpa_bol_av[0] "" UWORD _CNV_A_R_LINEAR_____73_CM 1 0. 0. 65.535 DISPLAY_IDENTIFIER T_AD_BPA_BOL_AV_0_ ECU_ADDRESS 0x7fa6d2 BYTE_ORDER MSB_LAST FORMAT "%5.3" /end MEASUREMENT
/begin MEASUREMENT lv_ad_bpa_bol[0] "" UBYTE _CNV_A_R_LINEAR_____0_CM 1 0. 0. 1. DISPLAY_IDENTIFIER LV_AD_BPA_BOL_0_ ECU_ADDRESS 0x7fb864 FORMAT "%1.0" /end MEASUREMENT
/begin MEASUREMENT t_ad_bpa_tol_av[0] "" UWORD _CNV_A_R_LINEAR_____73_CM 1 0. 0. 65.535 DISPLAY_IDENTIFIER T_AD_BPA_TOL_AV_0_ ECU_ADDRESS 0x7fa6d0 BYTE_ORDER MSB_LAST FORMAT "%5.3" /end MEASUREMENT
/begin MEASUREMENT lv_v_bpa_bol_ad_orng[0] "" UBYTE _CNV_A_R_LINEAR_____0_CM 1 0. 0. 1. DISPLAY_IDENTIFIER LV_V_BPA_BOL_AD_ORNG_0_ ECU_ADDRESS 0x7fb860 FORMAT "%1.0" /end MEASUREMENT
/begin MEASUREMENT v_bpa_bol[0] "" UWORD _CNV_A_R_LINEAR_____415_CM 1 0. 0. 319.995172 DISPLAY_IDENTIFIER V_BPA_BOL_0_ ECU_ADDRESS 0x7f98be BYTE_ORDER MSB_LAST FORMAT "%5.2" /end MEASUREMENT
/begin MEASUREMENT lv_cdn_ad_v_bpa_bol[0] "" UBYTE _CNV_A_R_LINEAR_____0_CM 1 0. 0. 1. DISPLAY_IDENTIFIER LV_CDN_AD_V_BPA_BOL_0_ ECU_ADDRESS 0x7fb862 FORMAT "%1.0" /end MEASUREMENT
/begin MEASUREMENT v_bpa_bol_det[0] "" UWORD _CNV_A_R_LINEAR_____415_CM 1 0. 0. 319.995172 DISPLAY_IDENTIFIER V_BPA_BOL_DET_0_ ECU_ADDRESS 0x7f98c4 BYTE_ORDER MSB_LAST FORMAT "%5.2" /end MEASUREMENT
/begin CHARACTERISTIC c_crlc_ad_bpa[0] "" VALUE 0x85c8f2 _REC_VAL_20_u2 0.9999847412109381 _CNV_A_R_LINEAR_____14_CM 0. 0.9999847412109381 DISPLAY_IDENTIFIER C_CRLC_AD_BPA_0_ FORMAT "%5.4" /end CHARACTERISTIC
/begin CHARACTERISTIC c_crlc_v_bpa_tol[0] "" VALUE 0x85c910 _REC_VAL_20_u2 0.9999847412109381 _CNV_A_R_LINEAR_____14_CM 0. 0.9999847412109381 DISPLAY_IDENTIFIER C_CRLC_V_BPA_TOL_0_ FORMAT "%5.4" /end CHARACTERISTIC
/begin CHARACTERISTIC c_v_bpa_max_ad_tol[0] "" VALUE 0x85cd56 _REC_VAL_20_u2 319.995172 _CNV_A_R_LINEAR_____415_CM 0. 319.995172 DISPLAY_IDENTIFIER C_V_BPA_MAX_AD_TOL_0_ FORMAT "%5.2" /end CHARACTERISTIC
/begin CHARACTERISTIC c_v_bpa_min_ad_tol[0] "" VALUE 0x85cd5c _REC_VAL_20_u2 319.995172 _CNV_A_R_LINEAR_____415_CM 0. 319.995172 DISPLAY_IDENTIFIER C_V_BPA_MIN_AD_TOL_0_ FORMAT "%5.2" /end CHARACTERISTIC
/begin CHARACTERISTIC lc_v_bpa_tol_sub[0] "" VALUE 0x85cec8 _REC_VAL_20_u1 1. _CNV_A_R_LINEAR_____0_CM 0. 1. DISPLAY_IDENTIFIER LC_V_BPA_TOL_SUB_0_ FORMAT "%1.0" /end CHARACTERISTIC
/begin CHARACTERISTIC c_v_bpa_tol_sub[0] "" VALUE 0x85cd62 _REC_VAL_20_u2 319.995172 _CNV_A_R_LINEAR_____415_CM 0. 319.995172 DISPLAY_IDENTIFIER C_V_BPA_TOL_SUB_0_ FORMAT "%5.2" /end CHARACTERISTIC
/begin CHARACTERISTIC c_ang_sp_ad_bpa_bol[0] "" VALUE 0x85c886 _REC_VAL_20_u2 99.99847412109381 _CNV_A_R_LINEAR_____8_CM 0. 99.99847412109381 DISPLAY_IDENTIFIER C_ANG_SP_AD_BPA_BOL_0_ FORMAT "%5.3" /end CHARACTERISTIC
/begin CHARACTERISTIC c_v_grd_bpa_st_ad_bol[0] "" VALUE 0x85cd90 _REC_VAL_20_u1 124.511719 _CNV_A_R_LINEAR_____416_CM 0. 124.511719 DISPLAY_IDENTIFIER C_V_GRD_BPA_ST_AD_BOL_0_ FORMAT "%4.1" /end CHARACTERISTIC
/begin CHARACTERISTIC c_temp_st_ad_bpa_max[0] "" VALUE 0x85cce1 _REC_VAL_20_u1 255. _CNV_A_R_LINEAR_____18_CM -50. 205. DISPLAY_IDENTIFIER C_TEMP_ST_AD_BPA_MAX_0_ FORMAT "%4.1" /end CHARACTERISTIC
/begin CHARACTERISTIC c_temp_st_ad_bpa_min[0] "" VALUE 0x85cce2 _REC_VAL_20_u1 255. _CNV_A_R_LINEAR_____18_CM -50. 205. DISPLAY_IDENTIFIER C_TEMP_ST_AD_BPA_MIN_0_ FORMAT "%4.1" /end CHARACTERISTIC
/begin CHARACTERISTIC c_v_bpa_max_st_ad_bol[0] "" VALUE 0x85cd58 _REC_VAL_20_u2 319.995172 _CNV_A_R_LINEAR_____415_CM 0. 319.995172 DISPLAY_IDENTIFIER C_V_BPA_MAX_ST_AD_BOL_0_ FORMAT "%5.2" /end CHARACTERISTIC
/begin CHARACTERISTIC c_vb_max_ad_bpa "" VALUE 0x85ce0c _REC_VAL_20_u1 28.8 _CNV_A_R_LINEAR_____43_CM 0. 28.8 DISPLAY_IDENTIFIER C_VB_MAX_AD_BPA FORMAT "%3.1" /end CHARACTERISTIC
/begin CHARACTERISTIC c_vb_min_ad_bpa "" VALUE 0x85ce10 _REC_VAL_20_u1 28.8 _CNV_A_R_LINEAR_____43_CM 0. 28.8 DISPLAY_IDENTIFIER C_VB_MIN_AD_BPA FORMAT "%3.1" /end CHARACTERISTIC
/begin CHARACTERISTIC c_t_ad_bpa_bol_ini[0] "" VALUE 0x85cbf0 _REC_VAL_20_u2 65.535 _CNV_A_R_LINEAR_____73_CM 0. 65.535 DISPLAY_IDENTIFIER C_T_AD_BPA_BOL_INI_0_ FORMAT "%5.3" /end CHARACTERISTIC
/begin CHARACTERISTIC c_ang_sp_ad_bpa_tol[0] "" VALUE 0x85c888 _REC_VAL_20_u2 99.99847412109381 _CNV_A_R_LINEAR_____8_CM 0. 99.99847412109381 DISPLAY_IDENTIFIER C_ANG_SP_AD_BPA_TOL_0_ FORMAT "%5.3" /end CHARACTERISTIC
/begin CHARACTERISTIC c_v_grd_bpa_st_ad_tol[0] "" VALUE 0x85cd91 _REC_VAL_20_u1 124.511719 _CNV_A_R_LINEAR_____416_CM 0. 124.511719 DISPLAY_IDENTIFIER C_V_GRD_BPA_ST_AD_TOL_0_ FORMAT "%4.1" /end CHARACTERISTIC
/begin CHARACTERISTIC c_v_bpa_min_st_ad_tol[0] "" VALUE 0x85cd5e _REC_VAL_20_u2 319.995172 _CNV_A_R_LINEAR_____415_CM 0. 319.995172 DISPLAY_IDENTIFIER C_V_BPA_MIN_ST_AD_TOL_0_ FORMAT "%5.2" /end CHARACTERISTIC
/begin CHARACTERISTIC c_t_ad_bpa_tol_ini[0] "" VALUE 0x85cbf4 _REC_VAL_20_u2 65.535 _CNV_A_R_LINEAR_____73_CM 0. 65.535 DISPLAY_IDENTIFIER C_T_AD_BPA_TOL_INI_0_ FORMAT "%5.3" /end CHARACTERISTIC
/begin CHARACTERISTIC c_t_ad_bpa_tol[0] "" VALUE 0x85cbf2 _REC_VAL_20_u2 65.535 _CNV_A_R_LINEAR_____73_CM 0. 65.535 DISPLAY_IDENTIFIER C_T_AD_BPA_TOL_0_ FORMAT "%5.3" /end CHARACTERISTIC
/begin CHARACTERISTIC c_crlc_v_bpa_bol[0] "" VALUE 0x85c90e _REC_VAL_20_u2 0.9999847412109381 _CNV_A_R_LINEAR_____14_CM 0. 0.9999847412109381 DISPLAY_IDENTIFIER C_CRLC_V_BPA_BOL_0_ FORMAT "%5.4" /end CHARACTERISTIC
/begin CHARACTERISTIC c_v_bpa_max_ad_bol[0] "" VALUE 0x85cd54 _REC_VAL_20_u2 319.995172 _CNV_A_R_LINEAR_____415_CM 0. 319.995172 DISPLAY_IDENTIFIER C_V_BPA_MAX_AD_BOL_0_ FORMAT "%5.2" /end CHARACTERISTIC
/begin CHARACTERISTIC c_v_bpa_min_ad_bol[0] "" VALUE 0x85cd5a _REC_VAL_20_u2 319.995172 _CNV_A_R_LINEAR_____415_CM 0. 319.995172 DISPLAY_IDENTIFIER C_V_BPA_MIN_AD_BOL_0_ FORMAT "%5.2" /end CHARACTERISTIC
/begin CHARACTERISTIC lc_v_bpa_bol_sub[0] "" VALUE 0x85cec6 _REC_VAL_20_u1 1. _CNV_A_R_LINEAR_____0_CM 0. 1. DISPLAY_IDENTIFIER LC_V_BPA_BOL_SUB_0_ FORMAT "%1.0" /end CHARACTERISTIC
/begin CHARACTERISTIC c_v_bpa_bol_sub[0] "" VALUE 0x85cd50 _REC_VAL_20_u2 319.995172 _CNV_A_R_LINEAR_____415_CM 0. 319.995172 DISPLAY_IDENTIFIER C_V_BPA_BOL_SUB_0_ FORMAT "%5.2" /end CHARACTERISTIC
/begin CHARACTERISTIC id_ad_bpa_bol__t_ad_bpa "BPA_AI: control values for adaption (BOL)" CURVE 0x850266 _REC_CUR_20_u2_u2 199.9969482 _CNV_A_R_LINEAR_____161_CM -100. 99.99694820000001 DISPLAY_IDENTIFIER ID_AD_BPA_BOL__T_AD_BPA FORMAT "%6.4"
 /begin AXIS_DESCR COM_AXIS t_ad_bpa_bol_av[0] _CNV_A_R_LINEAR_____73_CM 4 0. 65.535 FORMAT "%5.3" AXIS_PTS_REF ldp_t_ad_bpa_bol__ip_ad_bpa /end AXIS_DESCR
/end CHARACTERISTIC
/begin CHARACTERISTIC id_ad_bpa_tol__t_ad_bpa "BPA_AI: control values for adaption (TOL)" CURVE 0x85026e _REC_CUR_20_u2_u2 199.9969482 _CNV_A_R_LINEAR_____161_CM -100. 99.99694820000001 DISPLAY_IDENTIFIER ID_AD_BPA_TOL__T_AD_BPA FORMAT "%6.4"
 /begin AXIS_DESCR COM_AXIS t_ad_bpa_tol_av[0] _CNV_A_R_LINEAR_____73_CM 4 0. 65.535 FORMAT "%5.3" AXIS_PTS_REF ldp_t_ad_bpa_tol__ip_ad_bpa /end AXIS_DESCR
/end CHARACTERISTIC
/begin AXIS_PTS ldp_t_ad_bpa_tol__ip_ad_bpa "" 0x8421b2 t_ad_bpa_tol_av[0] _REC_AXS_20_u2 65.535 _CNV_A_R_LINEAR_____73_CM 4 0. 65.535 FORMAT "%5.3" /end AXIS_PTS
/begin AXIS_PTS ldp_t_ad_bpa_bol__ip_ad_bpa "" 0x8421a8 t_ad_bpa_bol_av[0] _REC_AXS_20_u2 65.535 _CNV_A_R_LINEAR_____73_CM 4 0. 65.535 FORMAT "%5.3" /end AXIS_PTS
/begin CHARACTERISTIC c_t_ad_bpa_bol[0] "" VALUE 0x85cbee _REC_VAL_20_u2 65.535 _CNV_A_R_LINEAR_____73_CM 0. 65.535 DISPLAY_IDENTIFIER C_T_AD_BPA_BOL_0_ FORMAT "%5.3" /end CHARACTERISTIC
/begin CHARACTERISTIC c_v_egrv_tol_sub[0] "" VALUE 0x85cd8e _REC_VAL_20_u2 319.995172 _CNV_A_R_LINEAR_____415_CM 0. 319.995172 DISPLAY_IDENTIFIER C_V_EGRV_TOL_SUB_0_ FORMAT "%5.2" /end CHARACTERISTIC
/begin CHARACTERISTIC lc_v_egrv_tol_sub[0] "" VALUE 0x85cecc _REC_VAL_20_u1 1. _CNV_A_R_LINEAR_____0_CM 0. 1. DISPLAY_IDENTIFIER LC_V_EGRV_TOL_SUB_0_ FORMAT "%1.0" /end CHARACTERISTIC
/begin MEASUREMENT ad_egrv_mmv[0] "" SWORD _CNV_A_R_LINEAR_____12_CM 1 0. -100. 99.996948242 DISPLAY_IDENTIFIER AD_EGRV_MMV_0_ ECU_ADDRESS 0x7f988e BYTE_ORDER MSB_LAST FORMAT "%6.2" /end MEASUREMENT
/begin CHARACTERISTIC c_crlc_v_egrv_tol[0] "" VALUE 0x85c914 _REC_VAL_20_u2 0.9999847412109381 _CNV_A_R_LINEAR_____14_CM 0. 0.9999847412109381 DISPLAY_IDENTIFIER C_CRLC_V_EGRV_TOL_0_ FORMAT "%5.4" /end CHARACTERISTIC
/begin CHARACTERISTIC c_crlc_v_egrv_bol[0] "" VALUE 0x85c912 _REC_VAL_20_u2 0.9999847412109381 _CNV_A_R_LINEAR_____14_CM 0. 0.9999847412109381 DISPLAY_IDENTIFIER C_CRLC_V_EGRV_BOL_0_ FORMAT "%5.4" /end CHARACTERISTIC
/begin CHARACTERISTIC c_v_egrv_max_st_ad_bol[0] "" VALUE 0x85cd7e _REC_VAL_20_u2 319.995172 _CNV_A_R_LINEAR_____415_CM 0. 319.995172 DISPLAY_IDENTIFIER C_V_EGRV_MAX_ST_AD_BOL_0_ FORMAT "%5.2" /end CHARACTERISTIC
/begin CHARACTERISTIC c_v_egrv_min_st_ad_tol[0] "" VALUE 0x85cd8a _REC_VAL_20_u2 319.995172 _CNV_A_R_LINEAR_____415_CM 0. 319.995172 DISPLAY_IDENTIFIER C_V_EGRV_MIN_ST_AD_TOL_0_ FORMAT "%5.2" /end CHARACTERISTIC
/begin CHARACTERISTIC c_t_ad_egrv_bol_ini[0] "" VALUE 0x85cbf8 _REC_VAL_20_u2 65.535 _CNV_A_R_LINEAR_____73_CM 0. 65.535 DISPLAY_IDENTIFIER C_T_AD_EGRV_BOL_INI_0_ FORMAT "%5.3" /end CHARACTERISTIC
/begin CHARACTERISTIC c_t_ad_egrv_tol_ini[0] "" VALUE 0x85cbfc _REC_VAL_20_u2 65.535 _CNV_A_R_LINEAR_____73_CM 0. 65.535 DISPLAY_IDENTIFIER C_T_AD_EGRV_TOL_INI_0_ FORMAT "%5.3" /end CHARACTERISTIC
/begin MEASUREMENT lv_v_egrv_tol_ad_orng[0] "error flag for V_EGRV_j_BOL adaption out of range" UBYTE _CNV_S_2_RANGE______11_CM 1 0. 0. 1. DISPLAY_IDENTIFIER LV_V_EGRV_TOL_AD_ORNG_0_ ECU_ADDRESS 0x7fbe41 /end MEASUREMENT
/begin MEASUREMENT lv_v_egrv_bol_ad_orng[0] "" UBYTE _CNV_A_R_LINEAR_____0_CM 1 0. 0. 1. DISPLAY_IDENTIFIER LV_V_EGRV_BOL_AD_ORNG_0_ ECU_ADDRESS 0x7fb855 FORMAT "%1.0" /end MEASUREMENT
/begin MEASUREMENT lv_cdn_ad_v_egrv_tol[0] "" UBYTE _CNV_A_R_LINEAR_____0_CM 1 0. 0. 1. DISPLAY_IDENTIFIER LV_CDN_AD_V_EGRV_TOL_0_ ECU_ADDRESS 0x7fbe42 FORMAT "%1.0" /end MEASUREMENT
/begin MEASUREMENT lv_cdn_ad_v_egrv_bol[0] "" UBYTE _CNV_A_R_LINEAR_____0_CM 1 0. 0. 1. DISPLAY_IDENTIFIER LV_CDN_AD_V_EGRV_BOL_0_ ECU_ADDRESS 0x7fb856 FORMAT "%1.0" /end MEASUREMENT
/begin MEASUREMENT v_egrv_tol[0] "" UWORD _CNV_A_R_LINEAR_____415_CM 1 0. 0. 319.995172 DISPLAY_IDENTIFIER V_EGRV_TOL_0_ ECU_ADDRESS 0x7f988a BYTE_ORDER MSB_LAST FORMAT "%5.2" /end MEASUREMENT
/begin MEASUREMENT v_egrv_bol[0] "" UWORD _CNV_A_R_LINEAR_____415_CM 1 0. 0. 319.995172 DISPLAY_IDENTIFIER V_EGRV_BOL_0_ ECU_ADDRESS 0x7f988c BYTE_ORDER MSB_LAST FORMAT "%5.2" /end MEASUREMENT
/begin MEASUREMENT v_egrv_bol_det[0] "" UWORD _CNV_A_R_LINEAR_____415_CM 1 0. 0. 319.995172 DISPLAY_IDENTIFIER V_EGRV_BOL_DET_0_ ECU_ADDRESS 0x7f9892 BYTE_ORDER MSB_LAST FORMAT "%5.2" /end MEASUREMENT
/begin MEASUREMENT v_egrv_tol_det[0] "" UWORD _CNV_A_R_LINEAR_____415_CM 1 0. 0. 319.995172 DISPLAY_IDENTIFIER V_EGRV_TOL_DET_0_ ECU_ADDRESS 0x7f9890 BYTE_ORDER MSB_LAST FORMAT "%5.2" /end MEASUREMENT
/begin MEASUREMENT lv_ad_egrv_tol[0] "" UBYTE _CNV_A_R_LINEAR_____0_CM 1 0. 0. 1. DISPLAY_IDENTIFIER LV_AD_EGRV_TOL_0_ ECU_ADDRESS 0x7fb857 FORMAT "%1.0" /end MEASUREMENT
/begin MEASUREMENT lv_ad_egrv_tol_req[0] "" UBYTE _CNV_A_R_LINEAR_____0_CM 1 0. 0. 1. DISPLAY_IDENTIFIER LV_AD_EGRV_TOL_REQ_0_ ECU_ADDRESS 0x7fbe3f FORMAT "%1.0" /end MEASUREMENT
/begin MEASUREMENT lv_ad_egrv_bol[0] "" UBYTE _CNV_A_R_LINEAR_____0_CM 1 0. 0. 1. DISPLAY_IDENTIFIER LV_AD_EGRV_BOL_0_ ECU_ADDRESS 0x7fb858 FORMAT "%1.0" /end MEASUREMENT
/begin MEASUREMENT lv_ad_egrv_bol_req[0] "" UBYTE _CNV_A_R_LINEAR_____0_CM 1 0. 0. 1. DISPLAY_IDENTIFIER LV_AD_EGRV_BOL_REQ_0_ ECU_ADDRESS 0x7fbe40 FORMAT "%1.0" /end MEASUREMENT
/begin MEASUREMENT t_ad_egrv_tol_av[0] "" UWORD _CNV_A_R_LINEAR_____73_CM 1 0. 0. 65.535 DISPLAY_IDENTIFIER T_AD_EGRV_TOL_AV_0_ ECU_ADDRESS 0x7fa692 BYTE_ORDER MSB_LAST FORMAT "%5.3" /end MEASUREMENT
/begin MEASUREMENT t_ad_egrv_bol_av[0] "" UWORD _CNV_A_R_LINEAR_____73_CM 1 0. 0. 65.535 DISPLAY_IDENTIFIER T_AD_EGRV_BOL_AV_0_ ECU_ADDRESS 0x7fa694 BYTE_ORDER MSB_LAST FORMAT "%5.3" /end MEASUREMENT
/begin CHARACTERISTIC c_crlc_ad_egrv[0] "" VALUE 0x85c8f4 _REC_VAL_20_u2 0.9999847412109381 _CNV_A_R_LINEAR_____14_CM 0. 0.9999847412109381 DISPLAY_IDENTIFIER C_CRLC_AD_EGRV_0_ FORMAT "%5.4" /end CHARACTERISTIC
/begin CHARACTERISTIC c_v_egrv_max_ad_tol[0] "" VALUE 0x85cd7c _REC_VAL_20_u2 319.995172 _CNV_A_R_LINEAR_____415_CM 0. 319.995172 DISPLAY_IDENTIFIER C_V_EGRV_MAX_AD_TOL_0_ FORMAT "%5.2" /end CHARACTERISTIC
/begin CHARACTERISTIC c_v_egrv_min_ad_tol[0] "" VALUE 0x85cd88 _REC_VAL_20_u2 319.995172 _CNV_A_R_LINEAR_____415_CM 0. 319.995172 DISPLAY_IDENTIFIER C_V_EGRV_MIN_AD_TOL_0_ FORMAT "%5.2" /end CHARACTERISTIC
/begin CHARACTERISTIC c_v_egrv_bol_sub[0] "" VALUE 0x85cd76 _REC_VAL_20_u2 319.995172 _CNV_A_R_LINEAR_____415_CM 0. 319.995172 DISPLAY_IDENTIFIER C_V_EGRV_BOL_SUB_0_ FORMAT "%5.2" /end CHARACTERISTIC
/begin CHARACTERISTIC lc_v_egrv_bol_sub[0] "" VALUE 0x85ceca _REC_VAL_20_u1 1. _CNV_A_R_LINEAR_____0_CM 0. 1. DISPLAY_IDENTIFIER LC_V_EGRV_BOL_SUB_0_ FORMAT "%1.0" /end CHARACTERISTIC
/begin CHARACTERISTIC c_ang_sp_ad_egrv_bol[0] "" VALUE 0x85c88a _REC_VAL_20_u2 99.99847412109381 _CNV_A_R_LINEAR_____8_CM 0. 99.99847412109381 DISPLAY_IDENTIFIER C_ANG_SP_AD_EGRV_BOL_0_ FORMAT "%5.3" /end CHARACTERISTIC
/begin CHARACTERISTIC c_temp_st_ad_egrv_max[0] "" VALUE 0x85cce3 _REC_VAL_20_u1 255. _CNV_A_R_LINEAR_____18_CM -50. 205. DISPLAY_IDENTIFIER C_TEMP_ST_AD_EGRV_MAX_0_ FORMAT "%4.1" /end CHARACTERISTIC
/begin CHARACTERISTIC c_v_grd_egrv_st_ad_bol[0] "" VALUE 0x85cd92 _REC_VAL_20_u1 124.511719 _CNV_A_R_LINEAR_____416_CM 0. 124.511719 DISPLAY_IDENTIFIER C_V_GRD_EGRV_ST_AD_BOL_0_ FORMAT "%4.1" /end CHARACTERISTIC
/begin CHARACTERISTIC c_temp_st_ad_egrv_min[0] "" VALUE 0x85cce4 _REC_VAL_20_u1 255. _CNV_A_R_LINEAR_____18_CM -50. 205. DISPLAY_IDENTIFIER C_TEMP_ST_AD_EGRV_MIN_0_ FORMAT "%4.1" /end CHARACTERISTIC
/begin CHARACTERISTIC c_t_ad_egrv_bol[0] "" VALUE 0x85cbf6 _REC_VAL_20_u2 65.535 _CNV_A_R_LINEAR_____73_CM 0. 65.535 DISPLAY_IDENTIFIER C_T_AD_EGRV_BOL_0_ FORMAT "%5.3" /end CHARACTERISTIC
/begin CHARACTERISTIC c_ang_sp_ad_egrv_tol[0] "" VALUE 0x85c88c _REC_VAL_20_u2 99.99847412109381 _CNV_A_R_LINEAR_____8_CM 0. 99.99847412109381 DISPLAY_IDENTIFIER C_ANG_SP_AD_EGRV_TOL_0_ FORMAT "%5.3" /end CHARACTERISTIC
/begin CHARACTERISTIC c_v_grd_egrv_st_ad_tol[0] "" VALUE 0x85cd93 _REC_VAL_20_u1 124.511719 _CNV_A_R_LINEAR_____416_CM 0. 124.511719 DISPLAY_IDENTIFIER C_V_GRD_EGRV_ST_AD_TOL_0_ FORMAT "%4.1" /end CHARACTERISTIC
/begin CHARACTERISTIC c_t_ad_egrv_tol[0] "" VALUE 0x85cbfa _REC_VAL_20_u2 65.535 _CNV_A_R_LINEAR_____73_CM 0. 65.535 DISPLAY_IDENTIFIER C_T_AD_EGRV_TOL_0_ FORMAT "%5.3" /end CHARACTERISTIC
/begin CHARACTERISTIC c_v_egrv_min_ad_bol[0] "" VALUE 0x85cd86 _REC_VAL_20_u2 319.995172 _CNV_A_R_LINEAR_____415_CM 0. 319.995172 DISPLAY_IDENTIFIER C_V_EGRV_MIN_AD_BOL_0_ FORMAT "%5.2" /end CHARACTERISTIC
/begin CHARACTERISTIC c_v_egrv_max_ad_bol[0] "" VALUE 0x85cd7a _REC_VAL_20_u2 319.995172 _CNV_A_R_LINEAR_____415_CM 0. 319.995172 DISPLAY_IDENTIFIER C_V_EGRV_MAX_AD_BOL_0_ FORMAT "%5.2" /end CHARACTERISTIC
/begin AXIS_PTS ldp_t_ad_egrv_tol__ip_ad_egrv "" 0x8421c6 t_ad_egrv_tol_av[0] _REC_AXS_20_u2 65.535 _CNV_A_R_LINEAR_____73_CM 4 0. 65.535 FORMAT "%5.3" /end AXIS_PTS
/begin AXIS_PTS ldp_t_ad_egrv_bol__ip_ad_egrv "" 0x8421bc t_ad_egrv_bol_av[0] _REC_AXS_20_u2 65.535 _CNV_A_R_LINEAR_____73_CM 4 0. 65.535 FORMAT "%5.3" /end AXIS_PTS
/begin CHARACTERISTIC id_ad_egrv_tol__t_ad_egrv "EGRV_AD: control values for adaption (TOL)" CURVE 0x85027e _REC_CUR_20_u2_u2 199.9969482 _CNV_A_R_LINEAR_____161_CM -100. 99.99694820000001 DISPLAY_IDENTIFIER ID_AD_EGRV_TOL__T_AD_EGRV FORMAT "%6.4"
 /begin AXIS_DESCR COM_AXIS t_ad_egrv_tol_av[0] _CNV_A_R_LINEAR_____73_CM 4 0. 65.535 FORMAT "%5.3" AXIS_PTS_REF ldp_t_ad_egrv_tol__ip_ad_egrv /end AXIS_DESCR
/end CHARACTERISTIC
/begin CHARACTERISTIC id_ad_egrv_bol__t_ad_egrv "EGRV_AD: control values for adaption (BOL)" CURVE 0x850276 _REC_CUR_20_u2_u2 199.9969482 _CNV_A_R_LINEAR_____161_CM -100. 99.99694820000001 DISPLAY_IDENTIFIER ID_AD_EGRV_BOL__T_AD_EGRV FORMAT "%6.4"
 /begin AXIS_DESCR COM_AXIS t_ad_egrv_bol_av[0] _CNV_A_R_LINEAR_____73_CM 4 0. 65.535 FORMAT "%5.3" AXIS_PTS_REF ldp_t_ad_egrv_bol__ip_ad_egrv /end AXIS_DESCR
/end CHARACTERISTIC
/begin MEASUREMENT lv_ad_egrv[0] "" UBYTE _CNV_A_R_LINEAR_____0_CM 1 0. 0. 1. DISPLAY_IDENTIFIER LV_AD_EGRV_0_ ECU_ADDRESS 0x7fb859 FORMAT "%1.0" /end MEASUREMENT
/begin CHARACTERISTIC c_vb_max_ad_egrv "" VALUE 0x85ce0d _REC_VAL_20_u1 28.8 _CNV_A_R_LINEAR_____43_CM 0. 28.8 DISPLAY_IDENTIFIER C_VB_MAX_AD_EGRV FORMAT "%3.1" /end CHARACTERISTIC
/begin CHARACTERISTIC c_vb_min_ad_egrv "" VALUE 0x85ce11 _REC_VAL_20_u1 28.8 _CNV_A_R_LINEAR_____43_CM 0. 28.8 DISPLAY_IDENTIFIER C_VB_MIN_AD_EGRV FORMAT "%3.1" /end CHARACTERISTIC
/begin MEASUREMENT lv_intv_egrv[0] "" UBYTE _CNV_A_R_LINEAR_____0_CM 1 0. 0. 1. DISPLAY_IDENTIFIER LV_INTV_EGRV_0_ ECU_ADDRESS 0x7fb87b FORMAT "%1.0" /end MEASUREMENT
/begin MEASUREMENT lv_ang_sp_egrv_intv[0] "" UBYTE _CNV_A_R_LINEAR_____0_CM 1 0. 0. 1. DISPLAY_IDENTIFIER LV_ANG_SP_EGRV_INTV_0_ ECU_ADDRESS 0x7fb87c FORMAT "%1.0" /end MEASUREMENT
/begin MEASUREMENT ang_sp_egrv_intv[0] "" UWORD _CNV_A_R_LINEAR_____8_CM 1 0. 0. 99.99847412109381 DISPLAY_IDENTIFIER ANG_SP_EGRV_INTV_0_ ECU_ADDRESS 0x7f99ba BYTE_ORDER MSB_LAST FORMAT "%6.2" /end MEASUREMENT
/begin MEASUREMENT intv_egrv[0] "" SWORD _CNV_A_R_LINEAR_____12_CM 1 0. -100. 99.996948242 DISPLAY_IDENTIFIER INTV_EGRV_0_ ECU_ADDRESS 0x7f99b8 BYTE_ORDER MSB_LAST FORMAT "%6.2" /end MEASUREMENT
/begin MEASUREMENT bpapwm_pctl_bas_tco_0 "uncorrected basic boost pressure adjustment precontrol (inj. state GES=0)" UWORD _CNV_A_R_LINEAR_____204_CM 1 0. 0. 99.972117 DISPLAY_IDENTIFIER BPAPWM_PCTL_BAS_TCO_0 ECU_ADDRESS 0x7fa720 BYTE_ORDER MSB_LAST FORMAT "%5.3" /end MEASUREMENT
/begin MEASUREMENT bpapwm_pctl_bas_tco_1 "uncorrected basic boost pressure adjustment precontrol (inj. state GES=1)" UWORD _CNV_A_R_LINEAR_____204_CM 1 0. 0. 99.972117 DISPLAY_IDENTIFIER BPAPWM_PCTL_BAS_TCO_1 ECU_ADDRESS 0x7fa722 BYTE_ORDER MSB_LAST FORMAT "%5.3" /end MEASUREMENT
/begin MEASUREMENT bpapwm_pctl_stat_mpg "boost pressure adjustment precontrol, steady state (map based)" UWORD _CNV_A_R_LINEAR_____204_CM 1 0. 0. 99.972117 DISPLAY_IDENTIFIER BPAPWM_PCTL_STAT_MPG ECU_ADDRESS 0x7fa70a BYTE_ORDER MSB_LAST FORMAT "%5.3" /end MEASUREMENT
/begin MEASUREMENT bpapwm_pctl_stat "boost pressure adjustment precontrol, steady state" UWORD _CNV_A_R_LINEAR_____204_CM 1 0. 0. 99.972117 DISPLAY_IDENTIFIER BPAPWM_PCTL_STAT ECU_ADDRESS 0x7fa718 BYTE_ORDER MSB_LAST FORMAT "%5.3" /end MEASUREMENT
/begin MEASUREMENT bpapwm_pctl_stat_mdl "boost pressure adjustment precontrol, steady state (map based)" UWORD _CNV_A_R_LINEAR_____204_CM 1 0. 0. 99.972117 DISPLAY_IDENTIFIER BPAPWM_PCTL_STAT_MDL ECU_ADDRESS 0x7fa71a BYTE_ORDER MSB_LAST FORMAT "%5.3" /end MEASUREMENT
/begin MEASUREMENT bpapwm_pctl_bas_0 "basic boost pressure adjustment precontrol (inj. state GES = 0)" UWORD _CNV_A_R_LINEAR_____204_CM 1 0. 0. 99.972117 DISPLAY_IDENTIFIER BPAPWM_PCTL_BAS_0 ECU_ADDRESS 0x7fa71c BYTE_ORDER MSB_LAST FORMAT "%5.3" /end MEASUREMENT
/begin MEASUREMENT bpapwm_pctl_bas_1 "basic boost pressure adjustment precontrol (inj. state GES = 1)" UWORD _CNV_A_R_LINEAR_____204_CM 1 0. 0. 99.972117 DISPLAY_IDENTIFIER BPAPWM_PCTL_BAS_1 ECU_ADDRESS 0x7fa71e BYTE_ORDER MSB_LAST FORMAT "%5.3" /end MEASUREMENT
/begin MEASUREMENT bpapwm_pctl_unlim "boost pressure adjustment precontrol" UWORD _CNV_A_R_LINEAR_____204_CM 1 0. 0. 99.972117 DISPLAY_IDENTIFIER BPAPWM_PCTL_UNLIM ECU_ADDRESS 0x7fa708 BYTE_ORDER MSB_LAST FORMAT "%5.3" /end MEASUREMENT
/begin MEASUREMENT bpapwm_pctl_tra "transient precontroller of BPAPWM" SWORD _CNV_A_R_LINEAR_____12_CM 1 0. -100. 99.996948242 DISPLAY_IDENTIFIER BPAPWM_PCTL_TRA ECU_ADDRESS 0x7fa70c BYTE_ORDER MSB_LAST FORMAT "%5.3" /end MEASUREMENT
/begin MEASUREMENT bpapwm_pctl_tqi "transient TQI correction for BPAPWM" SWORD _CNV_A_R_LINEAR_____12_CM 1 0. -100. 99.996948242 DISPLAY_IDENTIFIER BPAPWM_PCTL_TQI ECU_ADDRESS 0x7fa70e BYTE_ORDER MSB_LAST FORMAT "%5.3" /end MEASUREMENT
/begin MEASUREMENT kr_dt1_bpa_tqi "gain value for dynamic BPA on TQI" SWORD _CNV_A_R_LINEAR_____421_CM 1 0. -3.2768 3.2767 DISPLAY_IDENTIFIER KR_DT1_BPA_TQI ECU_ADDRESS 0x7fa710 BYTE_ORDER MSB_LAST FORMAT "%5.4" /end MEASUREMENT
/begin MEASUREMENT bpapwm_pctl_maf "transient MAF correction for BPAPWM" SWORD _CNV_A_R_LINEAR_____12_CM 1 0. -100. 99.996948242 DISPLAY_IDENTIFIER BPAPWM_PCTL_MAF ECU_ADDRESS 0x7fa712 BYTE_ORDER MSB_LAST FORMAT "%5.3" /end MEASUREMENT
/begin MEASUREMENT kr_dt1_bpa_maf "gain value for dynamic BPA on MAF_KGH" SWORD _CNV_A_R_LINEAR_____422_CM 1 0. -0.4096 0.409588 DISPLAY_IDENTIFIER KR_DT1_BPA_MAF ECU_ADDRESS 0x7fa714 BYTE_ORDER MSB_LAST FORMAT "%6.5" /end MEASUREMENT
/begin MEASUREMENT bpapwm_max "maximum limitation for BPAPWM" UWORD _CNV_A_R_LINEAR_____204_CM 1 0. 0. 99.972117 DISPLAY_IDENTIFIER BPAPWM_MAX ECU_ADDRESS 0x7f98de BYTE_ORDER MSB_LAST FORMAT "%5.3" /end MEASUREMENT
/begin MEASUREMENT bpapwm_min "minimum limitation for BPAPWM" UWORD _CNV_A_R_LINEAR_____204_CM 1 0. 0. 99.972117 DISPLAY_IDENTIFIER BPAPWM_MIN ECU_ADDRESS 0x7f98e0 BYTE_ORDER MSB_LAST FORMAT "%5.3" /end MEASUREMENT
/begin MEASUREMENT bpapwm_ctl_min "min. output of the BPA controller" SWORD _CNV_A_R_LINEAR_____12_CM 1 0. -100. 99.996948242 DISPLAY_IDENTIFIER BPAPWM_CTL_MIN ECU_ADDRESS 0x7f98e2 BYTE_ORDER MSB_LAST FORMAT "%5.3" /end MEASUREMENT
/begin MEASUREMENT bpapwm_ctl_max "max. output of the BPA controller" SWORD _CNV_A_R_LINEAR_____12_CM 1 0. -100. 99.996948242 DISPLAY_IDENTIFIER BPAPWM_CTL_MAX ECU_ADDRESS 0x7f98e4 BYTE_ORDER MSB_LAST FORMAT "%5.3" /end MEASUREMENT
/begin MEASUREMENT bpapwm_pctl "precontrol value for boost pressure adjustment" UWORD _CNV_A_R_LINEAR_____204_CM 1 0. 0. 99.972117 DISPLAY_IDENTIFIER BPAPWM_PCTL ECU_ADDRESS 0x7f98dc BYTE_ORDER MSB_LAST FORMAT "%5.3" /end MEASUREMENT
/begin MEASUREMENT bpapwm_lim_dyn "dynamic correction of BPAPWM limitation" SWORD _CNV_A_R_LINEAR_____12_CM 1 0. -100. 99.996948242 DISPLAY_IDENTIFIER BPAPWM_LIM_DYN ECU_ADDRESS 0x7fa716 BYTE_ORDER MSB_LAST FORMAT "%5.3" /end MEASUREMENT
/begin CHARACTERISTIC lc_bpapwm_pctl_stat_mpg "button for boost pressure adjustment precontrol via maps" VALUE 0x85ce57 _REC_VAL_20_u1 1. _CNV_A_R_LINEAR_____0_CM 0. 1. DISPLAY_IDENTIFIER LC_BPAPWM_PCTL_STAT_MPG FORMAT "%1.0" /end CHARACTERISTIC
/begin CHARACTERISTIC lc_bpapwm_pctl_dev "activation button for BPA precontroller during development" VALUE 0x85ce56 _REC_VAL_20_u1 1. _CNV_A_R_LINEAR_____0_CM 0. 1. DISPLAY_IDENTIFIER LC_BPAPWM_PCTL_DEV FORMAT "%1.0" /end CHARACTERISTIC
/begin CHARACTERISTIC c_fac_bpapwm_pctl_dev "boost pressure precontrol: factor for development" VALUE 0x85c9bc _REC_VAL_20_u2 1.9999696 _CNV_A_R_LINEAR_____48_CM 0. 1.9999696 DISPLAY_IDENTIFIER C_FAC_BPAPWM_PCTL_DEV FORMAT "%6.5" /end CHARACTERISTIC
/begin CHARACTERISTIC c_bpapwm_pctl_dev "boost pressure actuator precontrol for development" VALUE 0x85c8ca _REC_VAL_20_s2 199.996948242 _CNV_A_R_LINEAR_____12_CM -100. 99.996948242 DISPLAY_IDENTIFIER C_BPAPWM_PCTL_DEV FORMAT "%5.3" /end CHARACTERISTIC
/begin CHARACTERISTIC lc_bpa_dt1_tqi_on "activation button for interference block TQI" VALUE 0x85ce52 _REC_VAL_20_u1 1. _CNV_A_R_LINEAR_____0_CM 0. 1. DISPLAY_IDENTIFIER LC_BPA_DT1_TQI_ON FORMAT "%1.0" /end CHARACTERISTIC
/begin CHARACTERISTIC c_t2_dt1_bpa_tqi "(T1) time value for dynamic BPA on tqi" VALUE 0x85cbe6 _REC_VAL_20_u2 4.19424 _CNV_A_R_LINEAR_____64_CM 0. 4.19424 DISPLAY_IDENTIFIER C_T2_DT1_BPA_TQI FORMAT "%6.5" /end CHARACTERISTIC
/begin CHARACTERISTIC c_fac_bpa_dt1_tqi_fil_0 "filter factor for transient precontrol BPA (TQI)" VALUE 0x85c9ac _REC_VAL_20_u2 0.9999847412109381 _CNV_A_R_LINEAR_____14_CM 0. 0.9999847412109381 DISPLAY_IDENTIFIER C_FAC_BPA_DT1_TQI_FIL_0 FORMAT "%6.5" /end CHARACTERISTIC
/begin CHARACTERISTIC c_fac_bpa_dt1_tqi_fil_1 "filter factor for transient precontrol BPA (TQI)" VALUE 0x85c9ae _REC_VAL_20_u2 0.9999847412109381 _CNV_A_R_LINEAR_____14_CM 0. 0.9999847412109381 DISPLAY_IDENTIFIER C_FAC_BPA_DT1_TQI_FIL_1 FORMAT "%6.5" /end CHARACTERISTIC
/begin CHARACTERISTIC c_bpapwm_tqi_dt1_min "min. value for transient precontrol BPA (TQI)" VALUE 0x85c8ce _REC_VAL_20_s2 199.996948242 _CNV_A_R_LINEAR_____12_CM -100. 99.996948242 DISPLAY_IDENTIFIER C_BPAPWM_TQI_DT1_MIN FORMAT "%5.3" /end CHARACTERISTIC
/begin CHARACTERISTIC c_bpapwm_tqi_dt1_max "max. value for transient precontrol BPA (TQI)" VALUE 0x85c8cc _REC_VAL_20_s2 199.996948242 _CNV_A_R_LINEAR_____12_CM -100. 99.996948242 DISPLAY_IDENTIFIER C_BPAPWM_TQI_DT1_MAX FORMAT "%5.3" /end CHARACTERISTIC
/begin CHARACTERISTIC c_t2_dt1_bpa_maf "(T1) time value for dynamic BPA on maf" VALUE 0x85cbe4 _REC_VAL_20_u2 16.77696 _CNV_A_R_LINEAR_____423_CM 0. 16.77696 DISPLAY_IDENTIFIER C_T2_DT1_BPA_MAF FORMAT "%6.4" /end CHARACTERISTIC
/begin CHARACTERISTIC lc_bpa_dt1_maf_on "activation button for interference block MAF" VALUE 0x85ce50 _REC_VAL_20_u1 1. _CNV_A_R_LINEAR_____0_CM 0. 1. DISPLAY_IDENTIFIER LC_BPA_DT1_MAF_ON FORMAT "%1.0" /end CHARACTERISTIC
/begin CHARACTERISTIC c_fac_bpa_dt1maf1_fil "filter factor for MAF-DT1" VALUE 0x85c9b0 _REC_VAL_20_u2 0.9999847412109381 _CNV_A_R_LINEAR_____14_CM 0. 0.9999847412109381 DISPLAY_IDENTIFIER C_FAC_BPA_DT1MAF1_FIL FORMAT "%6.5" /end CHARACTERISTIC
/begin CHARACTERISTIC c_fac_bpa_dt1maf2_fil "filter factor for MAF-DT1" VALUE 0x85c9b2 _REC_VAL_20_u2 0.9999847412109381 _CNV_A_R_LINEAR_____14_CM 0. 0.9999847412109381 DISPLAY_IDENTIFIER C_FAC_BPA_DT1MAF2_FIL FORMAT "%6.5" /end CHARACTERISTIC
/begin CHARACTERISTIC c_bpapwm_maf_dt1_max "C_BPAPWM_MAF_DT1_MAX" VALUE 0x85c8c2 _REC_VAL_20_s2 199.996948242 _CNV_A_R_LINEAR_____12_CM -100. 99.996948242 DISPLAY_IDENTIFIER C_BPAPWM_MAF_DT1_MAX FORMAT "%5.3" /end CHARACTERISTIC
/begin CHARACTERISTIC c_bpapwm_maf_dt1_min "C_BPAPWM_MAF_DT1_MIN" VALUE 0x85c8c4 _REC_VAL_20_s2 199.996948242 _CNV_A_R_LINEAR_____12_CM -100. 99.996948242 DISPLAY_IDENTIFIER C_BPAPWM_MAF_DT1_MIN FORMAT "%5.3" /end CHARACTERISTIC
/begin CHARACTERISTIC c_fac_bpapwm_dyn "C_FAC_BPAPWM_DYN" VALUE 0x85c9ba _REC_VAL_20_u2 0.9999847412109381 _CNV_A_R_LINEAR_____14_CM 0. 0.9999847412109381 DISPLAY_IDENTIFIER C_FAC_BPAPWM_DYN FORMAT "%6.5" /end CHARACTERISTIC
/begin CHARACTERISTIC c_t1_td1_bpapwm_dyn "C_T1_TD1_BPAPWM_DYN" VALUE 0x85cbe2 _REC_VAL_20_u2 4.19424 _CNV_A_R_LINEAR_____64_CM 0. 4.19424 DISPLAY_IDENTIFIER C_T1_TD1_BPAPWM_DYN FORMAT "%6.5" /end CHARACTERISTIC
/begin CHARACTERISTIC c_bpapwm_lim_dyn_max "maximum actuator limitation value" VALUE 0x85c8c0 _REC_VAL_20_u2 99.972117 _CNV_A_R_LINEAR_____204_CM 0. 99.972117 DISPLAY_IDENTIFIER C_BPAPWM_LIM_DYN_MAX FORMAT "%5.3" /end CHARACTERISTIC
/begin CHARACTERISTIC c_kr_td1_bpapwm_dyn "gain for transient correction of the BPA- limits" VALUE 0x85ca48 _REC_VAL_20_s2 13.107 _CNV_A_R_LINEAR_____424_CM -6.5536 6.5534 DISPLAY_IDENTIFIER C_KR_TD1_BPAPWM_DYN FORMAT "%5.4" /end CHARACTERISTIC
/begin CHARACTERISTIC ip_bpapwm_pctl_stat_mdl "BPA_PRE: BPA precontrol value from model" CURVE 0x851986 _REC_CUR_20_u2_u2 99.972117 _CNV_A_R_LINEAR_____204_CM 0. 99.972117 DISPLAY_IDENTIFIER IP_BPAPWM_PCTL_STAT_MDL FORMAT "%5.3"
 /begin AXIS_DESCR COM_AXIS bpa_psn_sp_mmv _CNV_A_R_LINEAR_____204_CM 16 0. 99.972117 FORMAT "%5.3" AXIS_PTS_REF ldp_bpa_pos_sp /end AXIS_DESCR
/end CHARACTERISTIC
/begin AXIS_PTS ldp_bpa_pos_sp "" 0x841422 bpa_psn_sp_mmv _REC_AXS_20_u2 99.972117 _CNV_A_R_LINEAR_____204_CM 16 0. 99.972117 FORMAT "%5.3" /end AXIS_PTS
/begin CHARACTERISTIC ip_fac_tran_bpapwm_pctl_0 "BPA_PRE: transition factor for the basic BPA precontrol (inj. region 0)" CURVE 0x8530c2 _REC_CUR_20_u2_u1 1.9999696 _CNV_A_R_LINEAR_____48_CM 0. 1.9999696 DISPLAY_IDENTIFIER IP_FAC_TRAN_BPAPWM_PCTL_0 FORMAT "%6.5"
 /begin AXIS_DESCR COM_AXIS tco _CNV_A_R_LINEAR_____18_CM 8 -50. 205. FORMAT "%3.0" AXIS_PTS_REF ldp_tco_ip_fac_tran_bpapwm_0 /end AXIS_DESCR
/end CHARACTERISTIC
/begin AXIS_PTS ldp_tco_ip_fac_tran_bpapwm_0 "" 0x84231d tco _REC_AXS_20_u1 255. _CNV_A_R_LINEAR_____18_CM 8 -50. 205. FORMAT "%3.0" /end AXIS_PTS
/begin CHARACTERISTIC ip_fac_bpapwm_pctl_cor_amp_0 "BPA_PRE: BPA- precontrol correction factor for ambient pressure (inj. region GES = 0)" CURVE 0x8523ce _REC_CUR_20_u2_u2 0.9999847412109381 _CNV_A_R_LINEAR_____14_CM 0. 0.9999847412109381 DISPLAY_IDENTIFIER IP_FAC_BPAPWM_PCTL_COR_AMP_0 FORMAT "%6.5"
 /begin AXIS_DESCR COM_AXIS amp _CNV_A_R_LINEAR_____45_CM 8 0. 5434. FORMAT "%6.2" AXIS_PTS_REF ldp_amp_ip_fac_bpapwm_pctl_0 /end AXIS_DESCR
/end CHARACTERISTIC
/begin AXIS_PTS ldp_amp_ip_fac_bpapwm_pctl_0 "" 0x8410b2 amp _REC_AXS_20_u2 5434. _CNV_A_R_LINEAR_____45_CM 8 0. 5434. FORMAT "%6.2" /end AXIS_PTS
/begin CHARACTERISTIC ip_fac_bpapwm_pctl_cor_tgas_0 "BPA_PRE: BPA- precontrol correction factor for temperature of the intake air (inj. region GES = 0)" CURVE 0x8523ee _REC_CUR_20_u2_u1 0.9999847412109381 _CNV_A_R_LINEAR_____14_CM 0. 0.9999847412109381 DISPLAY_IDENTIFIER IP_FAC_BPAPWM_PCTL_COR_TGAS_0 FORMAT "%6.5"
 /begin AXIS_DESCR COM_AXIS tgas _CNV_A_R_LINEAR_____18_CM 8 -50. 205. FORMAT "%3.0" AXIS_PTS_REF ldp_tgas_ip_fac_bpapwm_pctl_0 /end AXIS_DESCR
/end CHARACTERISTIC
/begin AXIS_PTS ldp_tgas_ip_fac_bpapwm_pctl_0 "" 0x84249a tgas _REC_AXS_20_u1 255. _CNV_A_R_LINEAR_____18_CM 8 -50. 205. FORMAT "%3.0" /end AXIS_PTS
/begin CHARACTERISTIC ip_fac_tran_bpapwm_pctl_1 "BPA_PRE: transition factor for the basic BPA precontrol (inj. region 1)" CURVE 0x8530d2 _REC_CUR_20_u2_u1 1.9999696 _CNV_A_R_LINEAR_____48_CM 0. 1.9999696 DISPLAY_IDENTIFIER IP_FAC_TRAN_BPAPWM_PCTL_1 FORMAT "%6.5"
 /begin AXIS_DESCR COM_AXIS tco _CNV_A_R_LINEAR_____18_CM 8 -50. 205. FORMAT "%3.0" AXIS_PTS_REF ldp_tco_ip_fac_tran_bpapwm_1 /end AXIS_DESCR
/end CHARACTERISTIC
/begin AXIS_PTS ldp_tco_ip_fac_tran_bpapwm_1 "" 0x842326 tco _REC_AXS_20_u1 255. _CNV_A_R_LINEAR_____18_CM 8 -50. 205. FORMAT "%3.0" /end AXIS_PTS
/begin CHARACTERISTIC ip_fac_bpapwm_pctl_cor_amp_1 "BPA_PRE: BPA- precontrol correction factor for ambient pressure (inj. region GES = 1)" CURVE 0x8523de _REC_CUR_20_u2_u2 0.9999847412109381 _CNV_A_R_LINEAR_____14_CM 0. 0.9999847412109381 DISPLAY_IDENTIFIER IP_FAC_BPAPWM_PCTL_COR_AMP_1 FORMAT "%6.5"
 /begin AXIS_DESCR COM_AXIS amp _CNV_A_R_LINEAR_____45_CM 8 0. 5434. FORMAT "%6.2" AXIS_PTS_REF ldp_amp_ip_fac_bpapwm_pctl_1 /end AXIS_DESCR
/end CHARACTERISTIC
/begin AXIS_PTS ldp_amp_ip_fac_bpapwm_pctl_1 "" 0x8410c4 amp _REC_AXS_20_u2 5434. _CNV_A_R_LINEAR_____45_CM 8 0. 5434. FORMAT "%6.2" /end AXIS_PTS
/begin CHARACTERISTIC ip_fac_bpapwm_pctl_cor_tgas_1 "BPA_PRE: BPA- precontrol correction factor for temperature of the intake air (inj. region GES = 1)" CURVE 0x8523fe _REC_CUR_20_u2_u1 0.9999847412109381 _CNV_A_R_LINEAR_____14_CM 0. 0.9999847412109381 DISPLAY_IDENTIFIER IP_FAC_BPAPWM_PCTL_COR_TGAS_1 FORMAT "%6.5"
 /begin AXIS_DESCR COM_AXIS tgas _CNV_A_R_LINEAR_____18_CM 8 -50. 205. FORMAT "%3.0" AXIS_PTS_REF ldp_tgas_ip_fac_bpapwm_pctl_1 /end AXIS_DESCR
/end CHARACTERISTIC
/begin AXIS_PTS ldp_tgas_ip_fac_bpapwm_pctl_1 "" 0x8424a3 tgas _REC_AXS_20_u1 255. _CNV_A_R_LINEAR_____18_CM 8 -50. 205. FORMAT "%3.0" /end AXIS_PTS
/begin CHARACTERISTIC ip_bpapwm_pctl_bas_0_1 "BPA_PRE: basic BPA precontrol value for warm engine (inj. region GES = 0)" MAP 0x851182 _REC_MAP_20_u2_u2_u2 100. _CNV_A_R_LINEAR_____134_CM 0. 100. DISPLAY_IDENTIFIER IP_BPAPWM_PCTL_BAS_0_1 FORMAT "%5.3"
 /begin AXIS_DESCR COM_AXIS n _CNV_A_R_LINEAR_____5_CM 16 0. 6375. FORMAT "%4.0" AXIS_PTS_REF ldpm_n_ip_bpapwm_pctl_0 /end AXIS_DESCR
 /begin AXIS_DESCR COM_AXIS tqi_bpa _CNV_A_R_LINEAR_____52_CM 16 0. 1023.96875 FORMAT "%6.2" AXIS_PTS_REF ldpm_tqi_ip_bpapwm_pctl_0 /end AXIS_DESCR
/end CHARACTERISTIC
/begin AXIS_PTS ldpm_n_ip_bpapwm_pctl_0 "" 0x842f2e n _REC_AXS_20_u2 6375. _CNV_A_R_LINEAR_____5_CM 16 0. 6375. FORMAT "%4.0" /end AXIS_PTS
/begin AXIS_PTS ldpm_tqi_ip_bpapwm_pctl_0 "" 0x84389e tqi_bpa _REC_AXS_20_u2 1023.96875 _CNV_A_R_LINEAR_____52_CM 16 0. 1023.96875 FORMAT "%6.2" /end AXIS_PTS
/begin CHARACTERISTIC ip_bpapwm_pctl_bas_0_2 "BPA_PRE: basic BPA precontrol value for cold engine (inj. region GES = 0)" MAP 0x851382 _REC_MAP_20_u2_u2_u2 100. _CNV_A_R_LINEAR_____134_CM 0. 100. DISPLAY_IDENTIFIER IP_BPAPWM_PCTL_BAS_0_2 FORMAT "%5.3"
 /begin AXIS_DESCR COM_AXIS n _CNV_A_R_LINEAR_____5_CM 1 0. 6375. FORMAT "%4.0" AXIS_PTS_REF ldpm_n_ip_bpapwm_pctl_short /end AXIS_DESCR
 /begin AXIS_DESCR COM_AXIS tqi_bpa _CNV_A_R_LINEAR_____52_CM 1 0. 1023.96875 FORMAT "%6.2" AXIS_PTS_REF ldpm_tqi_ip_bpapwm_pctl_short /end AXIS_DESCR
/end CHARACTERISTIC
/begin CHARACTERISTIC ip_bpapwm_pctl_bas_0_0 "BPA_PRE: basic BPA precontrol value for hot engine (inj. region GES = 0)" MAP 0x850f82 _REC_MAP_20_u2_u2_u2 100. _CNV_A_R_LINEAR_____134_CM 0. 100. DISPLAY_IDENTIFIER IP_BPAPWM_PCTL_BAS_0_0 FORMAT "%5.3"
 /begin AXIS_DESCR COM_AXIS n _CNV_A_R_LINEAR_____5_CM 16 0. 6375. FORMAT "%4.0" AXIS_PTS_REF ldpm_n_ip_bpapwm_pctl_0 /end AXIS_DESCR
 /begin AXIS_DESCR COM_AXIS tqi_bpa _CNV_A_R_LINEAR_____52_CM 16 0. 1023.96875 FORMAT "%6.2" AXIS_PTS_REF ldpm_tqi_ip_bpapwm_pctl_0 /end AXIS_DESCR
/end CHARACTERISTIC
/begin CHARACTERISTIC ip_bpapwm_pctl_cor_amp_0 "BPA_PRE: basic BPA precontrol correction map for ambient pressure (inj. region GES = 0)" MAP 0x851786 _REC_MAP_20_u2_u2_u2 99.99847412 _CNV_A_R_LINEAR_____140_CM -50. 49.99847412 DISPLAY_IDENTIFIER IP_BPAPWM_PCTL_COR_AMP_0 FORMAT "%5.3"
 /begin AXIS_DESCR COM_AXIS n _CNV_A_R_LINEAR_____5_CM 8 0. 6375. FORMAT "%4.0" AXIS_PTS_REF ldp_n_ip_bpapwm_pctl_amp_0 /end AXIS_DESCR
 /begin AXIS_DESCR COM_AXIS tqi_bpa _CNV_A_R_LINEAR_____52_CM 8 0. 1023.96875 FORMAT "%6.2" AXIS_PTS_REF ldp_tqi_ip_bpapwm_pctl_amp_0 /end AXIS_DESCR
/end CHARACTERISTIC
/begin AXIS_PTS ldp_n_ip_bpapwm_pctl_amp_0 "" 0x84196e n _REC_AXS_20_u2 6375. _CNV_A_R_LINEAR_____5_CM 8 0. 6375. FORMAT "%4.0" /end AXIS_PTS
/begin AXIS_PTS ldp_tqi_ip_bpapwm_pctl_amp_0 "" 0x842600 tqi_bpa _REC_AXS_20_u2 1023.96875 _CNV_A_R_LINEAR_____52_CM 8 0. 1023.96875 FORMAT "%6.2" /end AXIS_PTS
/begin CHARACTERISTIC ip_bpapwm_pctl_cor_tgas_0 "BPA_PRE: basic BPA precontrol correction map for temperature of the intake gas (inj. region GES = 0)" MAP 0x851886 _REC_MAP_20_u2_u2_u2 99.99847412 _CNV_A_R_LINEAR_____140_CM -50. 49.99847412 DISPLAY_IDENTIFIER IP_BPAPWM_PCTL_COR_TGAS_0 FORMAT "%5.3"
 /begin AXIS_DESCR COM_AXIS n _CNV_A_R_LINEAR_____5_CM 8 0. 6375. FORMAT "%4.0" AXIS_PTS_REF ldp_n_ip_bpapwm_pctl_tgas_0 /end AXIS_DESCR
 /begin AXIS_DESCR COM_AXIS tqi_bpa _CNV_A_R_LINEAR_____52_CM 8 0. 1023.96875 FORMAT "%6.2" AXIS_PTS_REF ldp_tqi_ip_bpapwm_pctl_tgas_0 /end AXIS_DESCR
/end CHARACTERISTIC
/begin AXIS_PTS ldp_n_ip_bpapwm_pctl_tgas_0 "" 0x841992 n _REC_AXS_20_u2 6375. _CNV_A_R_LINEAR_____5_CM 8 0. 6375. FORMAT "%4.0" /end AXIS_PTS
/begin AXIS_PTS ldp_tqi_ip_bpapwm_pctl_tgas_0 "" 0x842624 tqi_bpa _REC_AXS_20_u2 1023.96875 _CNV_A_R_LINEAR_____52_CM 8 0. 1023.96875 FORMAT "%6.2" /end AXIS_PTS
/begin CHARACTERISTIC ip_bpapwm_pctl_bas_1_1 "BPA_PRE: basic BPA precontrol value for warm engine (inj. region GES = 1)" MAP 0x851584 _REC_MAP_20_u2_u2_u2 100. _CNV_A_R_LINEAR_____134_CM 0. 100. DISPLAY_IDENTIFIER IP_BPAPWM_PCTL_BAS_1_1 FORMAT "%5.3"
 /begin AXIS_DESCR COM_AXIS n _CNV_A_R_LINEAR_____5_CM 16 0. 6375. FORMAT "%4.0" AXIS_PTS_REF ldpm_n_ip_bpapwm_pctl_1 /end AXIS_DESCR
 /begin AXIS_DESCR COM_AXIS tqi_bpa _CNV_A_R_LINEAR_____52_CM 16 0. 1023.96875 FORMAT "%6.2" AXIS_PTS_REF ldpm_tqi_ip_bpapwm_pctl_1 /end AXIS_DESCR
/end CHARACTERISTIC
/begin AXIS_PTS ldpm_n_ip_bpapwm_pctl_1 "" 0x842f50 n _REC_AXS_20_u2 6375. _CNV_A_R_LINEAR_____5_CM 16 0. 6375. FORMAT "%4.0" /end AXIS_PTS
/begin AXIS_PTS ldpm_tqi_ip_bpapwm_pctl_1 "" 0x8438c0 tqi_bpa _REC_AXS_20_u2 1023.96875 _CNV_A_R_LINEAR_____52_CM 16 0. 1023.96875 FORMAT "%6.2" /end AXIS_PTS
/begin CHARACTERISTIC ip_bpapwm_pctl_bas_1_2 "BPA_PRE: basic BPA precontrol value for cold engine (inj. region GES = 1)" MAP 0x851784 _REC_MAP_20_u2_u2_u2 100. _CNV_A_R_LINEAR_____134_CM 0. 100. DISPLAY_IDENTIFIER IP_BPAPWM_PCTL_BAS_1_2 FORMAT "%5.3"
 /begin AXIS_DESCR COM_AXIS n _CNV_A_R_LINEAR_____5_CM 1 0. 6375. FORMAT "%4.0" AXIS_PTS_REF ldpm_n_ip_bpapwm_pctl_short /end AXIS_DESCR
 /begin AXIS_DESCR COM_AXIS tqi_bpa _CNV_A_R_LINEAR_____52_CM 1 0. 1023.96875 FORMAT "%6.2" AXIS_PTS_REF ldpm_tqi_ip_bpapwm_pctl_short /end AXIS_DESCR
/end CHARACTERISTIC
/begin CHARACTERISTIC ip_bpapwm_pctl_bas_1_0 "BPA_PRE: basic BPA precontrol value for hot engine (inj. region GES = 1)" MAP 0x851384 _REC_MAP_20_u2_u2_u2 100. _CNV_A_R_LINEAR_____134_CM 0. 100. DISPLAY_IDENTIFIER IP_BPAPWM_PCTL_BAS_1_0 FORMAT "%5.3"
 /begin AXIS_DESCR COM_AXIS n _CNV_A_R_LINEAR_____5_CM 16 0. 6375. FORMAT "%4.0" AXIS_PTS_REF ldpm_n_ip_bpapwm_pctl_1 /end AXIS_DESCR
 /begin AXIS_DESCR COM_AXIS tqi_bpa _CNV_A_R_LINEAR_____52_CM 16 0. 1023.96875 FORMAT "%6.2" AXIS_PTS_REF ldpm_tqi_ip_bpapwm_pctl_1 /end AXIS_DESCR
/end CHARACTERISTIC
/begin CHARACTERISTIC ip_bpapwm_pctl_cor_amp_1 "BPA_PRE: basic BPA precontrol correction map for ambient pressure (inj. region GES = 1)" MAP 0x851806 _REC_MAP_20_u2_u2_u2 99.99847412 _CNV_A_R_LINEAR_____140_CM -50. 49.99847412 DISPLAY_IDENTIFIER IP_BPAPWM_PCTL_COR_AMP_1 FORMAT "%5.3"
 /begin AXIS_DESCR COM_AXIS n _CNV_A_R_LINEAR_____5_CM 8 0. 6375. FORMAT "%4.0" AXIS_PTS_REF ldp_n_ip_bpapwm_pctl_amp_1 /end AXIS_DESCR
 /begin AXIS_DESCR COM_AXIS tqi_bpa _CNV_A_R_LINEAR_____52_CM 8 0. 1023.96875 FORMAT "%6.2" AXIS_PTS_REF ldp_tqi_ip_bpapwm_pctl_amp_1 /end AXIS_DESCR
/end CHARACTERISTIC
/begin AXIS_PTS ldp_n_ip_bpapwm_pctl_amp_1 "" 0x841980 n _REC_AXS_20_u2 6375. _CNV_A_R_LINEAR_____5_CM 8 0. 6375. FORMAT "%4.0" /end AXIS_PTS
/begin AXIS_PTS ldp_tqi_ip_bpapwm_pctl_amp_1 "" 0x842612 tqi_bpa _REC_AXS_20_u2 1023.96875 _CNV_A_R_LINEAR_____52_CM 8 0. 1023.96875 FORMAT "%6.2" /end AXIS_PTS
/begin CHARACTERISTIC ip_bpapwm_pctl_cor_tgas_1 "BPA_PRE: basic BPA precontrol correction map for temperature of the intake gas (inj. region GES = 1)" MAP 0x851906 _REC_MAP_20_u2_u2_u2 99.99847412 _CNV_A_R_LINEAR_____140_CM -50. 49.99847412 DISPLAY_IDENTIFIER IP_BPAPWM_PCTL_COR_TGAS_1 FORMAT "%5.3"
 /begin AXIS_DESCR COM_AXIS n _CNV_A_R_LINEAR_____5_CM 8 0. 6375. FORMAT "%4.0" AXIS_PTS_REF ldp_n_ip_bpapwm_pctl_tgas_1 /end AXIS_DESCR
 /begin AXIS_DESCR COM_AXIS tqi_bpa _CNV_A_R_LINEAR_____52_CM 8 0. 1023.96875 FORMAT "%6.2" AXIS_PTS_REF ldp_tqi_ip_bpapwm_pctl_tgas_1 /end AXIS_DESCR
/end CHARACTERISTIC
/begin AXIS_PTS ldp_n_ip_bpapwm_pctl_tgas_1 "" 0x8419a4 n _REC_AXS_20_u2 6375. _CNV_A_R_LINEAR_____5_CM 8 0. 6375. FORMAT "%4.0" /end AXIS_PTS
/begin AXIS_PTS ldp_tqi_ip_bpapwm_pctl_tgas_1 "" 0x842636 tqi_bpa _REC_AXS_20_u2 1023.96875 _CNV_A_R_LINEAR_____52_CM 8 0. 1023.96875 FORMAT "%6.2" /end AXIS_PTS
/begin CHARACTERISTIC ip_kr_dt1_bpa_tqi "BPA_PRE: gain value for dynamic bpa on tqi" MAP 0x8533f4 _REC_MAP_20_u2_u2_u2 6.5535 _CNV_A_R_LINEAR_____425_CM -3.2768 3.2767 DISPLAY_IDENTIFIER IP_KR_DT1_BPA_TQI FORMAT "%5.4"
 /begin AXIS_DESCR COM_AXIS n _CNV_A_R_LINEAR_____5_CM 8 0. 6375. FORMAT "%4.0" AXIS_PTS_REF ldp_n_ip_kr_dt1_bpa_tqi /end AXIS_DESCR
 /begin AXIS_DESCR COM_AXIS tqi_bpa _CNV_A_R_LINEAR_____52_CM 8 0. 1023.96875 FORMAT "%6.2" AXIS_PTS_REF ldp_tqi_ip_kr_dt1_bpa_tqi /end AXIS_DESCR
/end CHARACTERISTIC
/begin AXIS_PTS ldp_n_ip_kr_dt1_bpa_tqi "" 0x841a86 n _REC_AXS_20_u2 6375. _CNV_A_R_LINEAR_____5_CM 8 0. 6375. FORMAT "%4.0" /end AXIS_PTS
/begin AXIS_PTS ldp_tqi_ip_kr_dt1_bpa_tqi "" 0x8426a2 tqi_bpa _REC_AXS_20_u2 1023.96875 _CNV_A_R_LINEAR_____52_CM 8 0. 1023.96875 FORMAT "%6.2" /end AXIS_PTS
/begin CHARACTERISTIC ip_kr_dt1_bpa_maf "BPA_PRE: gain value for dynamic bpa on maf" MAP 0x853374 _REC_MAP_20_u2_u2_u2 0.8191875 _CNV_A_R_LINEAR_____426_CM -0.4096 0.4095875 DISPLAY_IDENTIFIER IP_KR_DT1_BPA_MAF FORMAT "%6.5"
 /begin AXIS_DESCR COM_AXIS n _CNV_A_R_LINEAR_____5_CM 8 0. 6375. FORMAT "%4.0" AXIS_PTS_REF ldp_n_ip_kr_dt1_bpa_maf /end AXIS_DESCR
 /begin AXIS_DESCR COM_AXIS tqi_bpa _CNV_A_R_LINEAR_____52_CM 8 0. 1023.96875 FORMAT "%6.2" AXIS_PTS_REF ldp_tqi_ip_kr_dt1_bpa_maf /end AXIS_DESCR
/end CHARACTERISTIC
/begin AXIS_PTS ldp_n_ip_kr_dt1_bpa_maf "" 0x841a74 n _REC_AXS_20_u2 6375. _CNV_A_R_LINEAR_____5_CM 8 0. 6375. FORMAT "%4.0" /end AXIS_PTS
/begin AXIS_PTS ldp_tqi_ip_kr_dt1_bpa_maf "" 0x842690 tqi_bpa _REC_AXS_20_u2 1023.96875 _CNV_A_R_LINEAR_____52_CM 8 0. 1023.96875 FORMAT "%6.2" /end AXIS_PTS
/begin CHARACTERISTIC ip_bpapwm_min "BPA_PRE: minimum actuator output" MAP 0x850d82 _REC_MAP_20_u2_u2_u2 99.972117 _CNV_A_R_LINEAR_____204_CM 0. 99.972117 DISPLAY_IDENTIFIER IP_BPAPWM_MIN FORMAT "%5.3"
 /begin AXIS_DESCR COM_AXIS n _CNV_A_R_LINEAR_____5_CM 16 0. 6375. FORMAT "%4.0" AXIS_PTS_REF ldpm_n_ip_bpapwm_lim /end AXIS_DESCR
 /begin AXIS_DESCR COM_AXIS tqi_bpa _CNV_A_R_LINEAR_____52_CM 16 0. 1023.96875 FORMAT "%6.2" AXIS_PTS_REF ldpm_tqi_ip_bpapwm_lim /end AXIS_DESCR
/end CHARACTERISTIC
/begin AXIS_PTS ldpm_n_ip_bpapwm_lim "" 0x842f0c n _REC_AXS_20_u2 6375. _CNV_A_R_LINEAR_____5_CM 16 0. 6375. FORMAT "%4.0" /end AXIS_PTS
/begin AXIS_PTS ldpm_tqi_ip_bpapwm_lim "" 0x84387c tqi_bpa _REC_AXS_20_u2 1023.96875 _CNV_A_R_LINEAR_____52_CM 16 0. 1023.96875 FORMAT "%6.2" /end AXIS_PTS
/begin CHARACTERISTIC ip_bpapwm_max "BPA_PRE: maximum actuator output" MAP 0x850b82 _REC_MAP_20_u2_u2_u2 99.972117 _CNV_A_R_LINEAR_____204_CM 0. 99.972117 DISPLAY_IDENTIFIER IP_BPAPWM_MAX FORMAT "%5.3"
 /begin AXIS_DESCR COM_AXIS n _CNV_A_R_LINEAR_____5_CM 16 0. 6375. FORMAT "%4.0" AXIS_PTS_REF ldpm_n_ip_bpapwm_lim /end AXIS_DESCR
 /begin AXIS_DESCR COM_AXIS tqi_bpa _CNV_A_R_LINEAR_____52_CM 16 0. 1023.96875 FORMAT "%6.2" AXIS_PTS_REF ldpm_tqi_ip_bpapwm_lim /end AXIS_DESCR
/end CHARACTERISTIC
/begin AXIS_PTS ldpm_n_ip_bpapwm_pctl_short "" 0x842f72 n _REC_AXS_20_u2 6375. _CNV_A_R_LINEAR_____5_CM 1 0. 6375. FORMAT "%4.0" /end AXIS_PTS
/begin AXIS_PTS ldpm_tqi_ip_bpapwm_pctl_short "" 0x8438e2 tqi_bpa _REC_AXS_20_u2 1023.96875 _CNV_A_R_LINEAR_____52_CM 1 0. 1023.96875 FORMAT "%6.2" /end AXIS_PTS
/begin CHARACTERISTIC c_bpa_pwm_man[0] "" VALUE 0x85c8b2 _REC_VAL_20_u2 99.99847412109381 _CNV_A_R_LINEAR_____8_CM 0. 99.99847412109381 DISPLAY_IDENTIFIER C_BPA_0_PWM_MAN FORMAT "%6.4" /end CHARACTERISTIC
/begin CHARACTERISTIC c_bpa_pwm_man[1] "" VALUE 0x85c8b4 _REC_VAL_20_u2 99.99847412109381 _CNV_A_R_LINEAR_____8_CM 0. 99.99847412109381 DISPLAY_IDENTIFIER C_BPA_1_PWM_MAN FORMAT "%6.4" /end CHARACTERISTIC
/begin CHARACTERISTIC lc_bpa_psn_ctl "" VALUE 0x85ce53 _REC_VAL_20_u1 1. _CNV_A_R_LINEAR_____1_CM 0. 1. DISPLAY_IDENTIFIER LC_BPA_PSN_CTL FORMAT "%1.0" /end CHARACTERISTIC
/begin CHARACTERISTIC lc_bpapwm_ivs "" VALUE 0x85ce54 _REC_VAL_20_u1 1. _CNV_A_R_LINEAR_____0_CM 0. 1. DISPLAY_IDENTIFIER LC_BPAPWM_IVS FORMAT "%1.0" /end CHARACTERISTIC
/begin CHARACTERISTIC lc_bpapwm_man "" VALUE 0x85ce55 _REC_VAL_20_u1 1. _CNV_A_R_LINEAR_____0_CM 0. 1. DISPLAY_IDENTIFIER LC_BPAPWM_MAN FORMAT "%1.0" /end CHARACTERISTIC
/begin MEASUREMENT lv_bpapwm_lim_diag "" UBYTE _CNV_S_2_RANGE______11_CM 1 0. 0. 1. DISPLAY_IDENTIFIER LV_BPAPWM_LIM_DIAG ECU_ADDRESS 0x7fb866 /end MEASUREMENT
/begin MEASUREMENT bpa_pwm[0] "" UWORD _CNV_A_R_LINEAR_____8_CM 1 0. 0. 99.99847412109381 DISPLAY_IDENTIFIER BPA_PWM_0_ ECU_ADDRESS 0x7f98da BYTE_ORDER MSB_LAST FORMAT "%5.2" /end MEASUREMENT
/begin MEASUREMENT bpa_pwm_bas[0] "" UWORD _CNV_A_R_LINEAR_____8_CM 1 0. 0. 99.99847412109381 DISPLAY_IDENTIFIER BPA_PWM_BAS_0_ ECU_ADDRESS 0x7f98d8 BYTE_ORDER MSB_LAST FORMAT "%5.2" /end MEASUREMENT
/begin MEASUREMENT fac_egrv_pwm_cor[0] "" UWORD _CNV_A_R_LINEAR_____15_CM 1 0. 0. 3.99993896484375 DISPLAY_IDENTIFIER FAC_EGRV_PWM_COR_0_ ECU_ADDRESS 0x7f98f2 BYTE_ORDER MSB_LAST FORMAT "%5.4" /end MEASUREMENT
/begin CHARACTERISTIC c_fac_egrv_pwm_cor[0] "" VALUE 0x85c9d4 _REC_VAL_20_u2 3.99993896484375 _CNV_A_R_LINEAR_____15_CM 0. 3.99993896484375 DISPLAY_IDENTIFIER C_FAC_EGRV_0_PWM_COR FORMAT "%5.4" /end CHARACTERISTIC
/begin CHARACTERISTIC c_egrv_pwm_cor[0] "" VALUE 0x85c996 _REC_VAL_20_s2 199.99695 _CNV_A_R_LINEAR_____9_CM -100. 99.99695 DISPLAY_IDENTIFIER C_EGRV_0_PWM_COR FORMAT "%7.4" /end CHARACTERISTIC
/begin MEASUREMENT egrv_pwm_cor[0] "" SWORD _CNV_A_R_LINEAR_____9_CM 1 0. -100. 99.99695 DISPLAY_IDENTIFIER EGRV_PWM_COR_0_ ECU_ADDRESS 0x7f98ee BYTE_ORDER MSB_LAST FORMAT "%5.2" /end MEASUREMENT
/begin MEASUREMENT lv_egr_out_man "" UBYTE _CNV_S_2_RANGE______23_CM 1 0. 0. 1. DISPLAY_IDENTIFIER LV_EGR_OUT_MAN ECU_ADDRESS 0x7fb86d /end MEASUREMENT
/begin MEASUREMENT thr_pwm_cor[0] "" SWORD _CNV_A_R_LINEAR_____12_CM 1 0. -100. 99.996948242 DISPLAY_IDENTIFIER THR_PWM_COR_0_ ECU_ADDRESS 0x7f98f0 BYTE_ORDER MSB_LAST FORMAT "%5.2" /end MEASUREMENT
/begin MEASUREMENT fac_thr_pwm_cor[0] "" UWORD _CNV_A_R_LINEAR_____15_CM 1 0. 0. 3.99993896484375 DISPLAY_IDENTIFIER FAC_THR_PWM_COR_0_ ECU_ADDRESS 0x7f98f4 BYTE_ORDER MSB_LAST FORMAT "%5.4" /end MEASUREMENT
/begin CHARACTERISTIC c_fac_thr_pwm_cor[0] "" VALUE 0x85ca12 _REC_VAL_20_u2 3.99993896484375 _CNV_A_R_LINEAR_____15_CM 0. 3.99993896484375 DISPLAY_IDENTIFIER C_FAC_THR_0_PWM_COR FORMAT "%5.4" /end CHARACTERISTIC
/begin CHARACTERISTIC c_thr_pwm_cor[0] "" VALUE 0x85cd08 _REC_VAL_20_s2 199.99695 _CNV_A_R_LINEAR_____9_CM -100. 99.99695 DISPLAY_IDENTIFIER C_THR_0_PWM_COR FORMAT "%7.4" /end CHARACTERISTIC
/begin CHARACTERISTIC lc_egr_out_man "" VALUE 0x85ce75 _REC_VAL_20_u1 1. _CNV_A_R_LINEAR_____0_CM 0. 1. DISPLAY_IDENTIFIER LC_EGR_OUT_MAN FORMAT "%1.0" /end CHARACTERISTIC
/begin AXIS_PTS ldp_n_ip_egrvpwm "" 0x8419fe n _REC_AXS_20_u2 6375. _CNV_A_R_LINEAR_____5_CM 10 0. 6375. FORMAT "%4.0" /end AXIS_PTS
/begin AXIS_PTS ldp_mafpwm_ip_egrvpwm "" 0x8417e4 mafpwm _REC_AXS_20_u2 99.9969482421875 _CNV_A_R_LINEAR_____136_CM 16 0. 99.9969482421875 FORMAT "%4.2" /end AXIS_PTS
/begin CHARACTERISTIC ip_egrvpwm__n__mafpwm "EGRV_OUT: EGR-valve output" MAP 0x852222 _REC_MAP_20_u2_u2_u2 99.99847412109381 _CNV_A_R_LINEAR_____8_CM 0. 99.99847412109381 DISPLAY_IDENTIFIER IP_EGRVPWM__N__MAFPWM FORMAT "%4.2"
 /begin AXIS_DESCR COM_AXIS n _CNV_A_R_LINEAR_____5_CM 10 0. 6375. FORMAT "%4.0" AXIS_PTS_REF ldp_n_ip_egrvpwm /end AXIS_DESCR
 /begin AXIS_DESCR COM_AXIS mafpwm _CNV_A_R_LINEAR_____136_CM 16 0. 99.9969482421875 FORMAT "%4.2" AXIS_PTS_REF ldp_mafpwm_ip_egrvpwm /end AXIS_DESCR
/end CHARACTERISTIC
/begin MEASUREMENT egrvpwm "" UWORD _CNV_A_R_LINEAR_____8_CM 1 0. 0. 99.99847412109381 DISPLAY_IDENTIFIER EGRVPWM ECU_ADDRESS 0x7f99c4 BYTE_ORDER MSB_LAST FORMAT "%4.2" /end MEASUREMENT
/begin MEASUREMENT egrv_pwm[0] "" UWORD _CNV_A_R_LINEAR_____8_CM 1 0. 0. 99.99847412109381 DISPLAY_IDENTIFIER EGRV_PWM_0_ ECU_ADDRESS 0x7f99c6 BYTE_ORDER MSB_LAST FORMAT "%5.2" /end MEASUREMENT
/begin AXIS_PTS ldp_ar_egrv_ip_egrvpwm "" 0x8413ee ar_egrv_ctl_the _REC_AXS_20_u2 78.08 _CNV_A_R_LINEAR_____7_CM 12 0. 78.08 FORMAT "%6.4" /end AXIS_PTS
/begin CHARACTERISTIC ip_egrvpwm__ar_egrv "EGRV_OUT: EGR-valve output as function of the cross section" CURVE 0x85220a _REC_CUR_20_u2_u2 99.99847412109381 _CNV_A_R_LINEAR_____8_CM 0. 99.99847412109381 DISPLAY_IDENTIFIER IP_EGRVPWM__AR_EGRV FORMAT "%4.2"
 /begin AXIS_DESCR COM_AXIS ar_egrv_ctl_the _CNV_A_R_LINEAR_____7_CM 12 0. 78.08 FORMAT "%6.4" AXIS_PTS_REF ldp_ar_egrv_ip_egrvpwm /end AXIS_DESCR
/end CHARACTERISTIC
/begin MEASUREMENT lv_egrvpwm_lim_diag "" UBYTE _CNV_S_2_RANGE______11_CM 1 0. 0. 1. DISPLAY_IDENTIFIER LV_EGRVPWM_LIM_DIAG ECU_ADDRESS 0x7fbe76 /end MEASUREMENT
/begin MEASUREMENT egrvpwm_egr "" UWORD _CNV_A_R_LINEAR_____8_CM 1 0. 0. 99.99847412109381 DISPLAY_IDENTIFIER EGRVPWM_EGR ECU_ADDRESS 0x7fbe74 BYTE_ORDER MSB_LAST FORMAT "%4.2" /end MEASUREMENT
/begin CHARACTERISTIC c_egrv_pwm_man[0] "" VALUE 0x85c998 _REC_VAL_20_u2 99.99847412109381 _CNV_A_R_LINEAR_____8_CM 0. 99.99847412109381 DISPLAY_IDENTIFIER C_EGRV_0_PWM_MAN FORMAT "%5.3" /end CHARACTERISTIC
/begin CHARACTERISTIC c_egrv_pwm_man[1] "" VALUE 0x85c99a _REC_VAL_20_u2 99.99847412109381 _CNV_A_R_LINEAR_____8_CM 0. 99.99847412109381 DISPLAY_IDENTIFIER C_EGRV_1_PWM_MAN FORMAT "%5.3" /end CHARACTERISTIC
/begin CHARACTERISTIC c_fac_egrvpwm_es_close "" VALUE 0x85c9d6 _REC_VAL_20_u2 0.9999847412109381 _CNV_A_R_LINEAR_____14_CM 0. 0.9999847412109381 DISPLAY_IDENTIFIER C_FAC_EGRVPWM_ES_CLOSE FORMAT "%6.4" /end CHARACTERISTIC
/begin CHARACTERISTIC lc_egrv_psn_ctl "" VALUE 0x85ce77 _REC_VAL_20_u1 1. _CNV_A_R_LINEAR_____0_CM 0. 1. DISPLAY_IDENTIFIER LC_EGRV_PSN_CTL FORMAT "%1.0" /end CHARACTERISTIC
/begin MEASUREMENT ang_sp_thr[0] "setpoint of position controller" UWORD _CNV_A_R_LINEAR_____8_CM 1 0. 0. 99.99847412109381 DISPLAY_IDENTIFIER ANG_SP_THR_0_ ECU_ADDRESS 0x7f9878 BYTE_ORDER MSB_LAST FORMAT "%5.3" /end MEASUREMENT
/begin MEASUREMENT test_thr[0] "test signal for closed-loop positon control" UWORD _CNV_A_R_LINEAR_____8_CM 1 0. 0. 99.99847412109381 DISPLAY_IDENTIFIER TEST_THR_0_ ECU_ADDRESS 0x7fa664 BYTE_ORDER MSB_LAST FORMAT "%5.3" /end MEASUREMENT
/begin MEASUREMENT ctl_dif_thr[0] "controller deviation" SWORD _CNV_A_R_LINEAR_____12_CM 1 0. -100. 99.996948242 DISPLAY_IDENTIFIER CTL_DIF_THR_0_ ECU_ADDRESS 0x7f987a BYTE_ORDER MSB_LAST FORMAT "%5.3" /end MEASUREMENT
/begin MEASUREMENT ctl_thr[0] "controller output with pre-controller" SWORD _CNV_A_R_LINEAR_____402_CM 1 0. -200. 199.99389 DISPLAY_IDENTIFIER CTL_THR_0_ ECU_ADDRESS 0x7fa666 BYTE_ORDER MSB_LAST /end MEASUREMENT
/begin MEASUREMENT pi_dt1_thr[0] "output PI controller and DT1 function" SWORD _CNV_A_R_LINEAR_____402_CM 1 0. -200. 199.99389 DISPLAY_IDENTIFIER PI_DT1_THR_0_ ECU_ADDRESS 0x7fa66a BYTE_ORDER MSB_LAST /end MEASUREMENT
/begin MEASUREMENT dt1_thr[0] "output DT1 function" SWORD _CNV_A_R_LINEAR_____402_CM 1 0. -200. 199.99389 DISPLAY_IDENTIFIER DT1_THR_0_ ECU_ADDRESS 0x7fa668 BYTE_ORDER MSB_LAST /end MEASUREMENT
/begin MEASUREMENT pi_thr[0] "output PI controller" SWORD _CNV_A_R_LINEAR_____402_CM 1 0. -200. 199.99389 DISPLAY_IDENTIFIER PI_THR_0_ ECU_ADDRESS 0x7fa66c BYTE_ORDER MSB_LAST /end MEASUREMENT
/begin MEASUREMENT tq_mot_thr[0] "torque of DC motor" UWORD _CNV_A_R_LINEAR_____403_CM 1 0. 0. 999.98474 DISPLAY_IDENTIFIER TQ_MOT_THR_0_ ECU_ADDRESS 0x7fa672 BYTE_ORDER MSB_LAST FORMAT "%5.2" /end MEASUREMENT
/begin MEASUREMENT v_mot_thr[0] "voltage DC motor of THR_j" UWORD _CNV_A_R_LINEAR_____404_CM 1 0. 0. 99.99847412109381 DISPLAY_IDENTIFIER V_MOT_THR_0_ ECU_ADDRESS 0x7fa674 BYTE_ORDER MSB_LAST FORMAT "%5.3" /end MEASUREMENT
/begin MEASUREMENT r_mot_cor_thr[0] "corrected resistance of DC motor" UWORD _CNV_A_R_LINEAR_____405_CM 1 0. 0. 9.999874 DISPLAY_IDENTIFIER R_MOT_COR_THR_0_ ECU_ADDRESS 0x7f987e BYTE_ORDER MSB_LAST FORMAT "%5.4" /end MEASUREMENT
/begin MEASUREMENT pctl_thr[0] "output of the pre-controller" SWORD _CNV_A_R_LINEAR_____402_CM 1 0. -200. 199.99389 DISPLAY_IDENTIFIER PCTL_THR_0_ ECU_ADDRESS 0x7fa66e BYTE_ORDER MSB_LAST /end MEASUREMENT
/begin MEASUREMENT ctl_lim_bas_thr[0] "limited controller output" SWORD _CNV_A_R_LINEAR_____12_CM 1 0. -100. 99.996948242 DISPLAY_IDENTIFIER CTL_LIM_BAS_THR_0_ ECU_ADDRESS 0x7fa676 BYTE_ORDER MSB_LAST FORMAT "%5.3" /end MEASUREMENT
/begin MEASUREMENT lim_dif_thr[0] "difference between limited and unlimited controller output" SWORD _CNV_A_R_LINEAR_____12_CM 1 0. -100. 99.996948242 DISPLAY_IDENTIFIER LIM_DIF_THR_0_ ECU_ADDRESS 0x7fa670 BYTE_ORDER MSB_LAST FORMAT "%5.3" /end MEASUREMENT
/begin MEASUREMENT ctl_lim_thr[0] "limited controller output" SWORD _CNV_A_R_LINEAR_____12_CM 1 0. -100. 99.996948242 DISPLAY_IDENTIFIER CTL_LIM_THR_0_ ECU_ADDRESS 0x7f987c BYTE_ORDER MSB_LAST FORMAT "%5.3" /end MEASUREMENT
/begin MEASUREMENT ctl_thr_pre_lim[0] "THR control output before limitation" SWORD _CNV_A_R_LINEAR_____402_CM 1 0. -200. 199.99389 DISPLAY_IDENTIFIER CTL_THR_PRE_LIM_0_ ECU_ADDRESS 0x7fa67e BYTE_ORDER MSB_LAST /end MEASUREMENT
/begin MEASUREMENT ctl_dyn_lim_thr[0] "Dynamic THR output limitation" SWORD _CNV_A_R_LINEAR_____402_CM 1 0. -200. 199.99389 DISPLAY_IDENTIFIER CTL_DYN_LIM_THR_0_ ECU_ADDRESS 0x7fa680 BYTE_ORDER MSB_LAST /end MEASUREMENT
/begin CHARACTERISTIC lc_test_thr[0] "" VALUE 0x85ceb2 _REC_VAL_20_u1 1. _CNV_A_R_LINEAR_____0_CM 0. 1. DISPLAY_IDENTIFIER LC_TEST_THR_0_ FORMAT "%1.0" /end CHARACTERISTIC
/begin CHARACTERISTIC c_test_fac_thr[0] "" VALUE 0x85ccf4 _REC_VAL_20_u2 99.99847412109381 _CNV_A_R_LINEAR_____8_CM 0. 99.99847412109381 DISPLAY_IDENTIFIER C_TEST_FAC_THR_0_ FORMAT "%5.3" /end CHARACTERISTIC
/begin CHARACTERISTIC c_test_add_thr[0] "" VALUE 0x85ccee _REC_VAL_20_u2 99.99847412109381 _CNV_A_R_LINEAR_____8_CM 0. 99.99847412109381 DISPLAY_IDENTIFIER C_TEST_ADD_THR_0_ FORMAT "%5.3" /end CHARACTERISTIC
/begin CHARACTERISTIC lc_dt1_thr_on[0] "" VALUE 0x85ce6e _REC_VAL_20_u1 1. _CNV_A_R_LINEAR_____0_CM 0. 1. DISPLAY_IDENTIFIER LC_DT1_THR_ON_0_ FORMAT "%1.0" /end CHARACTERISTIC
/begin CHARACTERISTIC lc_pi_thr_on[0] "" VALUE 0x85ce9e _REC_VAL_20_u1 1. _CNV_A_R_LINEAR_____0_CM 0. 1. DISPLAY_IDENTIFIER LC_PI_THR_ON_0_ FORMAT "%1.0" /end CHARACTERISTIC
/begin CHARACTERISTIC c_thr_ini[0] "" VALUE 0x85cd06 _REC_VAL_20_s2 399.99389 _CNV_A_R_LINEAR_____402_CM -200. 199.99389 DISPLAY_IDENTIFIER C_THR_INI_0_ /end CHARACTERISTIC
/begin CHARACTERISTIC c_gear_trans_ratio_thr "gear transition ratio" VALUE 0x85ca3e _REC_VAL_20_u2 99.99847412109381 _CNV_A_R_LINEAR_____406_CM 0. 99.99847412109381 DISPLAY_IDENTIFIER C_GEAR_TRANS_RATIO_THR FORMAT "%5.3" /end CHARACTERISTIC
/begin CHARACTERISTIC c_temp_mot_thr_ref "reference temperature DC motor" VALUE 0x85cce0 _REC_VAL_20_u1 255. _CNV_A_R_LINEAR_____18_CM -50. 205. DISPLAY_IDENTIFIER C_TEMP_MOT_THR_REF FORMAT "%3.0" /end CHARACTERISTIC
/begin CHARACTERISTIC c_r_mot_thr "resistance DC motor" VALUE 0x85cb84 _REC_VAL_20_u2 9.999874 _CNV_A_R_LINEAR_____405_CM 0. 9.999874 DISPLAY_IDENTIFIER C_R_MOT_THR FORMAT "%5.4" /end CHARACTERISTIC
/begin CHARACTERISTIC lc_pctl_thr_lih "indicates the used precontrol value during LIH" VALUE 0x85ce9b _REC_VAL_20_u1 1. _CNV_A_R_LINEAR_____0_CM 0. 1. DISPLAY_IDENTIFIER LC_PCTL_THR_LIH FORMAT "%1.0" /end CHARACTERISTIC
/begin CHARACTERISTIC c_pctl_thr_lih "precontrol value during LIH" VALUE 0x85cb62 _REC_VAL_20_s2 399.99389 _CNV_A_R_LINEAR_____402_CM -200. 199.99389 DISPLAY_IDENTIFIER C_PCTL_THR_LIH /end CHARACTERISTIC
/begin CHARACTERISTIC c_temp_mot_thr[0] "" VALUE 0x85ccdf _REC_VAL_20_u1 255. _CNV_A_R_LINEAR_____18_CM -50. 205. DISPLAY_IDENTIFIER C_TEMP_MOT_THR_0_ FORMAT "%3.0" /end CHARACTERISTIC
/begin CHARACTERISTIC lc_pctl_phys_thr_on[0] "" VALUE 0x85ce9a _REC_VAL_20_u1 1. _CNV_A_R_LINEAR_____0_CM 0. 1. DISPLAY_IDENTIFIER LC_PCTL_PHYS_THR_ON_0_ FORMAT "%1.0" /end CHARACTERISTIC
/begin CHARACTERISTIC c_fac_ctl_lim_thr "correction factor" VALUE 0x85c9c8 _REC_VAL_20_s2 3.999939 _CNV_A_R_LINEAR_____408_CM -2. 1.999939 DISPLAY_IDENTIFIER C_FAC_CTL_LIM_THR FORMAT "%6.5" /end CHARACTERISTIC
/begin CHARACTERISTIC c_ctl_lim_thr_add "additive correction" VALUE 0x85c946 _REC_VAL_20_s2 199.996948242 _CNV_A_R_LINEAR_____12_CM -100. 99.996948242 DISPLAY_IDENTIFIER C_CTL_LIM_THR_ADD FORMAT "%5.3" /end CHARACTERISTIC
/begin CHARACTERISTIC lc_ctl_lim_thr_man "activation of the manual output for the THR- position controller" VALUE 0x85ce63 _REC_VAL_20_u1 1. _CNV_A_R_LINEAR_____0_CM 0. 1. DISPLAY_IDENTIFIER LC_CTL_LIM_THR_MAN FORMAT "%1.0" /end CHARACTERISTIC
/begin CHARACTERISTIC c_ctl_lim_thr_man[0] "" VALUE 0x85c948 _REC_VAL_20_s2 199.996948242 _CNV_A_R_LINEAR_____12_CM -100. 99.996948242 DISPLAY_IDENTIFIER C_CTL_LIM_THR_MAN_0_ FORMAT "%5.3" /end CHARACTERISTIC
/begin CHARACTERISTIC c_t_lim_dyn_thr[0] "" VALUE 0x85cc52 _REC_VAL_20_u2 65535. _CNV_A_R_LINEAR_____417_CM 0. 65535. DISPLAY_IDENTIFIER C_T_LIM_DYN_THR_0_ FORMAT "%5.0" /end CHARACTERISTIC
/begin CHARACTERISTIC c_lim_dyn_max_thr[0] "" VALUE 0x85ca8a _REC_VAL_20_u1 255. _CNV_A_R_LINEAR_____267_CM 0. 255. DISPLAY_IDENTIFIER C_LIM_DYN_MAX_THR_0_ FORMAT "%3.0" /end CHARACTERISTIC
/begin CHARACTERISTIC ip_kr_dt1_thr__ctl_dif "GE_TCLP: gain for DT1 function" CURVE 0x853484 _REC_CUR_20_u2_u2 4.19424 _CNV_A_R_LINEAR_____419_CM 0. 4.19424 DISPLAY_IDENTIFIER IP_KR_DT1_THR__CTL_DIF FORMAT "%6.5"
 /begin AXIS_DESCR COM_AXIS ctl_dif_thr[0] _CNV_A_R_LINEAR_____161_CM 8 -100. 99.99694820000001 FORMAT "%5.3" AXIS_PTS_REF ldp_ctl_dif__ip_kr_dt1_thr /end AXIS_DESCR
/end CHARACTERISTIC
/begin AXIS_PTS ldp_ctl_dif__ip_kr_dt1_thr "" 0x8414b8 ctl_dif_thr[0] _REC_AXS_20_u2 199.9969482 _CNV_A_R_LINEAR_____161_CM 8 -100. 99.99694820000001 FORMAT "%5.3" /end AXIS_PTS
/begin CHARACTERISTIC ip_t1_dt1_thr__ctl_dif "GE_TCLP: time value for DT1 function" CURVE 0x85b03a _REC_CUR_20_u2_u2 0.125 _CNV_A_R_LINEAR_____410_CM 0. 0.125 DISPLAY_IDENTIFIER IP_T1_DT1_THR__CTL_DIF FORMAT "%7.6"
 /begin AXIS_DESCR COM_AXIS ctl_dif_thr[0] _CNV_A_R_LINEAR_____161_CM 8 -100. 99.99694820000001 FORMAT "%5.3" AXIS_PTS_REF ldp_ctl_dif__ip_t1_dt1_thr /end AXIS_DESCR
/end CHARACTERISTIC
/begin AXIS_PTS ldp_ctl_dif__ip_t1_dt1_thr "" 0x841530 ctl_dif_thr[0] _REC_AXS_20_u2 199.9969482 _CNV_A_R_LINEAR_____161_CM 8 -100. 99.99694820000001 FORMAT "%5.3" /end AXIS_PTS
/begin CHARACTERISTIC ip_kr_pi_thr__ctl_dif "GE_TCLP: proportional value for PI contoller" CURVE 0x8536d6 _REC_CUR_20_u2_u2 15.999755 _CNV_A_R_LINEAR_____13_CM 0. 15.999755 DISPLAY_IDENTIFIER IP_KR_PI_THR__CTL_DIF FORMAT "%6.4"
 /begin AXIS_DESCR COM_AXIS ctl_dif_thr[0] _CNV_A_R_LINEAR_____161_CM 9 -100. 99.99694820000001 FORMAT "%5.3" AXIS_PTS_REF ldp_ctl_dif__ip_kr_pi_thr /end AXIS_DESCR
/end CHARACTERISTIC
/begin AXIS_PTS ldp_ctl_dif__ip_kr_pi_thr "" 0x8414f8 ctl_dif_thr[0] _REC_AXS_20_u2 199.9969482 _CNV_A_R_LINEAR_____161_CM 9 -100. 99.99694820000001 FORMAT "%5.3" /end AXIS_PTS
/begin CHARACTERISTIC ip_tn_pi_thr__ctl_dif "GE_TCLP: integral value for PI contoller" CURVE 0x85b6be _REC_CUR_20_u2_u2 15.999755 _CNV_A_R_LINEAR_____411_CM 0. 15.999755 DISPLAY_IDENTIFIER IP_TN_PI_THR__CTL_DIF FORMAT "%6.4"
 /begin AXIS_DESCR COM_AXIS ctl_dif_thr[0] _CNV_A_R_LINEAR_____161_CM 9 -100. 99.99694820000001 FORMAT "%5.3" AXIS_PTS_REF ldp_ctl_dif__ip_tn_pi_thr /end AXIS_DESCR
/end CHARACTERISTIC
/begin AXIS_PTS ldp_ctl_dif__ip_tn_pi_thr "" 0x841570 ctl_dif_thr[0] _REC_AXS_20_u2 199.9969482 _CNV_A_R_LINEAR_____161_CM 9 -100. 99.99694820000001 FORMAT "%5.3" /end AXIS_PTS
/begin CHARACTERISTIC ip_tq_spr_thr__ang_sp_thr "GE_TCLP: characteristic of spring" CURVE 0x85b83c _REC_CUR_20_u2_u2 999.98474 _CNV_A_R_LINEAR_____403_CM 0. 999.98474 DISPLAY_IDENTIFIER IP_TQ_SPR_THR__ANG_SP_THR FORMAT "%5.2"
 /begin AXIS_DESCR COM_AXIS ang_sp_thr[0] _CNV_A_R_LINEAR_____8_CM 4 0. 99.99847412109381 FORMAT "%5.3" AXIS_PTS_REF ldp_ang_sp_thr_ip_tq_spr_thr /end AXIS_DESCR
/end CHARACTERISTIC
/begin AXIS_PTS ldp_ang_sp_thr_ip_tq_spr_thr "" 0x8413b4 ang_sp_thr[0] _REC_AXS_20_u2 99.99847412109381 _CNV_A_R_LINEAR_____8_CM 4 0. 99.99847412109381 FORMAT "%5.3" /end AXIS_PTS
/begin CHARACTERISTIC ip_cur_mot_thr__tq_mot "GE_TCLP: current of DC motor" CURVE 0x851da6 _REC_CUR_20_u2_u2 9.999874 _CNV_A_R_LINEAR_____412_CM 0. 9.999874 DISPLAY_IDENTIFIER IP_CUR_MOT_THR__TQ_MOT FORMAT "%5.4"
 /begin AXIS_DESCR COM_AXIS tq_mot_thr[0] _CNV_A_R_LINEAR_____403_CM 4 0. 999.98474 FORMAT "%5.2" AXIS_PTS_REF ldp_tq_mot_thr__ip_cur_mot /end AXIS_DESCR
/end CHARACTERISTIC
/begin AXIS_PTS ldp_tq_mot_thr__ip_cur_mot "" 0x8425ba tq_mot_thr[0] _REC_AXS_20_u2 999.98474 _CNV_A_R_LINEAR_____403_CM 4 0. 999.98474 FORMAT "%5.2" /end AXIS_PTS
/begin CHARACTERISTIC ip_pctl_thr__v_mot_thr "GE_TCLP: characteristic of power inverter" CURVE 0x8580fa _REC_CUR_20_u2_u2 399.993897 _CNV_A_R_LINEAR_____413_CM -200. 199.993897 DISPLAY_IDENTIFIER IP_PCTL_THR__V_MOT_THR
 /begin AXIS_DESCR COM_AXIS v_mot_egrv[0] _CNV_A_R_LINEAR_____404_CM 4 0. 99.99847412109381 FORMAT "%5.3" AXIS_PTS_REF ldp_v_mot_thr__ip_pctl_thr /end AXIS_DESCR
/end CHARACTERISTIC
/begin AXIS_PTS ldp_v_mot_thr__ip_pctl_thr "" 0x8429e4 v_mot_egrv[0] _REC_AXS_20_u2 99.99847412109381 _CNV_A_R_LINEAR_____404_CM 4 0. 99.99847412109381 FORMAT "%5.3" /end AXIS_PTS
/begin CHARACTERISTIC ip_pctl_thr__ang_sp_thr "GE_TCLP: precontrol for pneumatic actuator" CURVE 0x8580ea _REC_CUR_20_u2_u2 399.993897 _CNV_A_R_LINEAR_____413_CM -200. 199.993897 DISPLAY_IDENTIFIER IP_PCTL_THR__ANG_SP_THR
 /begin AXIS_DESCR COM_AXIS ang_sp_thr[0] _CNV_A_R_LINEAR_____8_CM 8 0. 99.99847412109381 FORMAT "%5.3" AXIS_PTS_REF ldp_ang_sp_thr_ip_pctl_thr /end AXIS_DESCR
/end CHARACTERISTIC
/begin AXIS_PTS ldp_ang_sp_thr_ip_pctl_thr "" 0x8413a2 ang_sp_thr[0] _REC_AXS_20_u2 99.99847412109381 _CNV_A_R_LINEAR_____8_CM 8 0. 99.99847412109381 FORMAT "%5.3" /end AXIS_PTS
/begin CHARACTERISTIC ip_ctl_min_thr_0__temp "GE_TCLP: minimum limit of THR_j controller output" CURVE 0x851d72 _REC_CUR_20_u1_u1 199.21875 _CNV_A_R_LINEAR_____414_CM -100. 99.21875 DISPLAY_IDENTIFIER IP_CTL_MIN_THR_0__TEMP FORMAT "%3.1"
 /begin AXIS_DESCR COM_AXIS tco _CNV_A_R_LINEAR_____18_CM 4 -50. 205. FORMAT "%3.0" AXIS_PTS_REF ldpm_temp__ip_ctl_thr /end AXIS_DESCR
/end CHARACTERISTIC
/begin AXIS_PTS ldpm_temp__ip_ctl_thr "" 0x8437ce tco _REC_AXS_20_u1 255. _CNV_A_R_LINEAR_____18_CM 4 -50. 205. FORMAT "%3.0" /end AXIS_PTS
/begin CHARACTERISTIC ip_ctl_max_thr_0__temp "GE_TCLP: maximum limit of THR_j controller output" CURVE 0x851d5e _REC_CUR_20_u1_u1 199.21875 _CNV_A_R_LINEAR_____414_CM -100. 99.21875 DISPLAY_IDENTIFIER IP_CTL_MAX_THR_0__TEMP FORMAT "%3.1"
 /begin AXIS_DESCR COM_AXIS tco _CNV_A_R_LINEAR_____18_CM 4 -50. 205. FORMAT "%3.0" AXIS_PTS_REF ldpm_temp__ip_ctl_thr /end AXIS_DESCR
/end CHARACTERISTIC
/begin CHARACTERISTIC ip_ctl_dyn_lim_thr_0__temp "GE_TCLP: maximum limit of THR_j controller output_a" CURVE 0x851d4a _REC_CUR_20_u1_u1 199.21875 _CNV_A_R_LINEAR_____414_CM -100. 99.21875 DISPLAY_IDENTIFIER IP_CTL_DYN_LIM_THR_0__TEMP FORMAT "%3.1"
 /begin AXIS_DESCR COM_AXIS tco _CNV_A_R_LINEAR_____18_CM 4 -50. 205. FORMAT "%3.0" AXIS_PTS_REF ldpm_temp__ip_ctl_thr /end AXIS_DESCR
/end CHARACTERISTIC
/begin CHARACTERISTIC lc_ctl_lim_thr_grd "enable of the gradient limitation" VALUE 0x85ce62 _REC_VAL_20_u1 1. _CNV_A_R_LINEAR_____0_CM 0. 1. DISPLAY_IDENTIFIER LC_CTL_LIM_THR_GRD FORMAT "%1.0" /end CHARACTERISTIC
/begin MEASUREMENT tqi_max_1 "" SWORD _CNV_A_R_LINEAR_____52_CM 1 0. -1024. 1023.96875 DISPLAY_IDENTIFIER TQI_MAX_1 ECU_ADDRESS 0x7fa30e BYTE_ORDER MSB_LAST FORMAT "%7.2" /end MEASUREMENT
/begin CHARACTERISTIC ip_tqi_clc_prev_main__n__mf "TQ: MF_to_TQI pre inj" MAP 0x85bdbc _REC_MAP_20_u2_u2_u2 2047.96875 _CNV_A_R_LINEAR_____86_CM -1024. 1023.96875 DISPLAY_IDENTIFIER IP_TQI_CLC_PREV_MAIN__N__MF FORMAT "%7.2"
 /begin AXIS_DESCR COM_AXIS n _CNV_A_R_LINEAR_____5_CM 12 0. 6375. FORMAT "%4.0" AXIS_PTS_REF ldpm_n_ip_tqi_clc /end AXIS_DESCR
 /begin AXIS_DESCR COM_AXIS mf_tql _CNV_A_R_LINEAR_____38_CM 21 0. 262.14 FORMAT "%4.0" AXIS_PTS_REF ldpm_mf_ip_tqi_clc /end AXIS_DESCR
/end CHARACTERISTIC
/begin CHARACTERISTIC ip_tqi_add_prev_main__n__tco "TQ: MF_to_TQI TCO correction  pre inj" MAP 0x85ba3c _REC_MAP_20_u2_u2_u1 2047.96875 _CNV_A_R_LINEAR_____86_CM -1024. 1023.96875 DISPLAY_IDENTIFIER IP_TQI_ADD_PREV_MAIN__N__TCO FORMAT "%7.2"
 /begin AXIS_DESCR COM_AXIS n _CNV_A_R_LINEAR_____5_CM 12 0. 6375. FORMAT "%4.0" AXIS_PTS_REF ldpm_n_ip_tqi_clc /end AXIS_DESCR
 /begin AXIS_DESCR COM_AXIS tco _CNV_A_R_LINEAR_____18_CM 4 -50. 205. FORMAT "%3.0" AXIS_PTS_REF ldpm_tco_ip_tqi_clc /end AXIS_DESCR
/end CHARACTERISTIC
/begin CHARACTERISTIC ip_tqi_clc_main__n__mf "TQ: MF_to_TQI" MAP 0x85bbc4 _REC_MAP_20_u2_u2_u2 2047.96875 _CNV_A_R_LINEAR_____86_CM -1024. 1023.96875 DISPLAY_IDENTIFIER IP_TQI_CLC_MAIN__N__MF FORMAT "%7.2"
 /begin AXIS_DESCR COM_AXIS n _CNV_A_R_LINEAR_____5_CM 12 0. 6375. FORMAT "%4.0" AXIS_PTS_REF ldpm_n_ip_tqi_clc /end AXIS_DESCR
 /begin AXIS_DESCR COM_AXIS mf_tql _CNV_A_R_LINEAR_____38_CM 21 0. 262.14 FORMAT "%4.0" AXIS_PTS_REF ldpm_mf_ip_tqi_clc /end AXIS_DESCR
/end CHARACTERISTIC
/begin CHARACTERISTIC ip_tqi_add_main__n__tco "TQ: MF_to_TQI TCO correction" MAP 0x85b9dc _REC_MAP_20_u2_u2_u1 2047.96875 _CNV_A_R_LINEAR_____86_CM -1024. 1023.96875 DISPLAY_IDENTIFIER IP_TQI_ADD_MAIN__N__TCO FORMAT "%7.2"
 /begin AXIS_DESCR COM_AXIS n _CNV_A_R_LINEAR_____5_CM 12 0. 6375. FORMAT "%4.0" AXIS_PTS_REF ldpm_n_ip_tqi_clc /end AXIS_DESCR
 /begin AXIS_DESCR COM_AXIS tco _CNV_A_R_LINEAR_____18_CM 4 -50. 205. FORMAT "%3.0" AXIS_PTS_REF ldpm_tco_ip_tqi_clc /end AXIS_DESCR
/end CHARACTERISTIC
/begin AXIS_PTS ldpm_tco_ip_tqi_clc "" 0x8437bf tco _REC_AXS_20_u1 255. _CNV_A_R_LINEAR_____18_CM 4 -50. 205. FORMAT "%3.0" /end AXIS_PTS
/begin AXIS_PTS ldpm_mf_ip_tqi_clc "" 0x842c86 mf_tql _REC_AXS_20_u2 262.14 _CNV_A_R_LINEAR_____38_CM 21 0. 262.14 FORMAT "%4.0" /end AXIS_PTS
/begin AXIS_PTS ldpm_n_ip_tqi_clc "" 0x843638 n _REC_AXS_20_u2 6375. _CNV_A_R_LINEAR_____5_CM 12 0. 6375. FORMAT "%4.0" /end AXIS_PTS
/begin COMPU_METHOD _CNV_A_R_LINEAR_____0_CM "" RAT_FUNC "%6.3" "[-]" COEFFS 0 1. 0. 0 0 1 /end COMPU_METHOD
/begin COMPU_METHOD _CNV_A_R_LINEAR_____1_CM "" RAT_FUNC "%6.3" "-" COEFFS 0 1. 0. 0 0 1 /end COMPU_METHOD
/begin COMPU_METHOD _CNV_S_2_RANGE______3_CM "" TAB_VERB "%6.3" "[-]" COMPU_TAB_REF _CNV_S_2_RANGE______3 /end COMPU_METHOD
/begin COMPU_VTAB _CNV_S_2_RANGE______3 "" TAB_VERB 2 0 "" 1 "1" /end COMPU_VTAB
/begin COMPU_METHOD _CNV_A_R_LINEAR_____4_CM "" RAT_FUNC "%6.3" "[*100ms]" COEFFS 0 1. 0. 0 0 1 /end COMPU_METHOD
/begin COMPU_METHOD _CNV_A_R_LINEAR_____5_CM "" RAT_FUNC "%6.3" "[rpm]" COEFFS 0 1. 0. 0 0 1 /end COMPU_METHOD
/begin COMPU_METHOD _CNV_A_R_LINEAR_____6_CM "" RAT_FUNC "%6.3" "[ms]" COEFFS 0 2.e-003 0. 0 0 1 /end COMPU_METHOD
/begin COMPU_METHOD _CNV_A_R_LINEAR_____7_CM "" RAT_FUNC "%6.3" "[cm^2]" COEFFS 0 839.3314549180328 0. 0 0 1 /end COMPU_METHOD
/begin COMPU_METHOD _CNV_A_R_LINEAR_____8_CM "" RAT_FUNC "%6.3" "[%]" COEFFS 0 655.3599999999997 0. 0 0 1 /end COMPU_METHOD
/begin COMPU_METHOD _CNV_A_R_LINEAR_____9_CM "" RAT_FUNC "%6.3" "[%]" COEFFS 0 327.6799971199561 -2.880043939512689e-004 0 0 1 /end COMPU_METHOD
/begin COMPU_METHOD _CNV_S_2_RANGE______11_CM "" TAB_VERB "%6.3" "[-]" COMPU_TAB_REF _CNV_S_2_RANGE______11 /end COMPU_METHOD
/begin COMPU_VTAB _CNV_S_2_RANGE______11 "" TAB_VERB 2 0 "0" 1 "1" /end COMPU_VTAB
/begin COMPU_METHOD _CNV_A_R_LINEAR_____12_CM "" RAT_FUNC "%6.3" "[%]" COEFFS 0 327.6800000003072 3.071909304708242e-008 0 0 1 /end COMPU_METHOD
/begin COMPU_METHOD _CNV_A_R_LINEAR_____13_CM "" RAT_FUNC "%6.3" "[-]" COEFFS 0 4096.000220003369 0. 0 0 1 /end COMPU_METHOD
/begin COMPU_METHOD _CNV_A_R_LINEAR_____14_CM "" RAT_FUNC "%6.3" "[-]" COEFFS 0 65535.99999999996 0. 0 0 1 /end COMPU_METHOD
/begin COMPU_METHOD _CNV_A_R_LINEAR_____15_CM "" RAT_FUNC "%6.3" "[-]" COEFFS 0 16384. 0. 0 0 1 /end COMPU_METHOD
/begin COMPU_METHOD _CNV_A_R_LINEAR_____16_CM "" RAT_FUNC "%6.3" "[s]" COEFFS 0 1. 0. 0 0 1 /end COMPU_METHOD
/begin COMPU_METHOD _CNV_A_R_LINEAR_____17_CM "" RAT_FUNC "%6.3" "[°C/s]" COEFFS 0 1. 0. 0 0 1 /end COMPU_METHOD
/begin COMPU_METHOD _CNV_A_R_LINEAR_____18_CM "" RAT_FUNC "%6.3" "[°C]" COEFFS 0 1. 50. 0 0 1 /end COMPU_METHOD
/begin COMPU_METHOD _CNV_A_R_LINEAR_____19_CM "" RAT_FUNC "%6.3" "[s]" COEFFS 0 10. 0. 0 0 1 /end COMPU_METHOD
/begin COMPU_METHOD _CNV_A_R_LINEAR_____20_CM "" RAT_FUNC "%6.3" "[°C]" COEFFS 0 1. 0. 0 0 1 /end COMPU_METHOD
/begin COMPU_METHOD _CNV_S_2_RANGE______23_CM "" TAB_VERB "%6.3" "[-]" COMPU_TAB_REF _CNV_S_2_RANGE______23 /end COMPU_METHOD
/begin COMPU_VTAB _CNV_S_2_RANGE______23 "" TAB_VERB 2 0 "passive" 1 "active" /end COMPU_VTAB
/begin COMPU_METHOD _CNV_A_R_LINEAR_____28_CM "" RAT_FUNC "%6.3" "[V]" COEFFS 0 204.8 0. 0 0 1 /end COMPU_METHOD
/begin COMPU_METHOD _CNV_A_R_LINEAR_____29_CM "" RAT_FUNC "%6.3" "[-]" COEFFS 0 256. 0. 0 0 1 /end COMPU_METHOD
/begin COMPU_METHOD _CNV_A_R_LINEAR_____30_CM "" RAT_FUNC "%6.3" "[1/min]" COEFFS 0 3.125e-002 0. 0 0 1 /end COMPU_METHOD
/begin COMPU_METHOD _CNV_A_R_LINEAR_____31_CM "" RAT_FUNC "%6.3" "[%]" COEFFS 0 10.24 0. 0 0 1 /end COMPU_METHOD
/begin COMPU_METHOD _CNV_A_R_LINEAR_____32_CM "" RAT_FUNC "%6.3" "[-]" COEFFS 0 8192. 0. 0 0 1 /end COMPU_METHOD
/begin COMPU_METHOD _CNV_A_R_LINEAR_____33_CM "" RAT_FUNC "%6.3" "[V]" COEFFS 0 204.8000076875076 1.921876901178621e-005 0 0 1 /end COMPU_METHOD
/begin COMPU_METHOD _CNV_A_R_LINEAR_____34_CM "" RAT_FUNC "%6.3" "[km/h]" COEFFS 0 1. 0. 0 0 1 /end COMPU_METHOD
/begin COMPU_METHOD _CNV_A_R_LINEAR_____35_CM "" RAT_FUNC "%6.3" "[V]" COEFFS 0 102.4000448438124 0. 0 0 1 /end COMPU_METHOD
/begin COMPU_METHOD _CNV_A_R_LINEAR_____38_CM "" RAT_FUNC "%6.3" "[mg/stk]" COEFFS 0 250. 0. 0 0 1 /end COMPU_METHOD
/begin COMPU_METHOD _CNV_A_R_LINEAR_____39_CM "" RAT_FUNC "%6.3" "[%]" COEFFS 0 2.55 0. 0 0 1 /end COMPU_METHOD
/begin COMPU_METHOD _CNV_A_R_LINEAR_____43_CM "" RAT_FUNC "%6.3" "[V]" COEFFS 0 8.854166666666666 0. 0 0 1 /end COMPU_METHOD
/begin COMPU_METHOD _CNV_A_R_LINEAR_____45_CM "" RAT_FUNC "%6.3" "[hPa]" COEFFS 0 12.06017666543982 0. 0 0 1 /end COMPU_METHOD
/begin COMPU_METHOD _CNV_A_R_LINEAR_____47_CM "" RAT_FUNC "%6.3" "[V]" COEFFS 0 13107.20001587224 0. 0 0 1 /end COMPU_METHOD
/begin COMPU_METHOD _CNV_A_R_LINEAR_____48_CM "" RAT_FUNC "%6.3" "[-]" COEFFS 0 32767.99807357072 0. 0 0 1 /end COMPU_METHOD
/begin COMPU_METHOD _CNV_A_R_LINEAR_____50_CM "" RAT_FUNC "%6.3" "[mg/stk]" COEFFS 0 1000. 0. 0 0 1 /end COMPU_METHOD
/begin COMPU_METHOD _CNV_A_R_LINEAR_____52_CM "" RAT_FUNC "%6.3" "[Nm]" COEFFS 0 32. 0. 0 0 1 /end COMPU_METHOD
/begin COMPU_METHOD _CNV_A_R_LINEAR_____56_CM "" RAT_FUNC "%6.3" "[s]" COEFFS 0 100. 0. 0 0 1 /end COMPU_METHOD
/begin COMPU_METHOD _CNV_A_R_LINEAR_____64_CM "" RAT_FUNC "%6.3" "[s]" COEFFS 0 15625. 0. 0 0 1 /end COMPU_METHOD
/begin COMPU_METHOD _CNV_P_8_TABLE_______68_CM "" TAB_NOINTP "%6.3" "[-]" COMPU_TAB_REF _CNV_P_8_TABLE_______68 /end COMPU_METHOD
/begin COMPU_TAB _CNV_P_8_TABLE_______68 "" TAB_NOINTP 8 0 0. 1 1. 2 2. 3 3. 4 4. 5 5. 6 6. 15 15. /end COMPU_TAB
/begin COMPU_METHOD _CNV_A_R_LINEAR_____69_CM "" RAT_FUNC "%6.3" "[(km/h)/rpm]" COEFFS 0 655360.0007936121 3.96806062781252e-005 0 0 1 /end COMPU_METHOD
/begin COMPU_METHOD _CNV_A_R_LINEAR_____70_CM "" RAT_FUNC "%6.3" "[(km/h)/rpm]" COEFFS 0 655350. 0. 0 0 1 /end COMPU_METHOD
/begin COMPU_METHOD _CNV_A_R_LINEAR_____71_CM "" RAT_FUNC "%6.3" "[km/h]" COEFFS 0 100. 0. 0 0 1 /end COMPU_METHOD
/begin COMPU_METHOD _CNV_A_R_LINEAR_____73_CM "" RAT_FUNC "%6.3" "[s]" COEFFS 0 1000. 0. 0 0 1 /end COMPU_METHOD
/begin COMPU_METHOD _CNV_A_R_LINEAR_____74_CM "" RAT_FUNC "%6.3" "[km/h]" COEFFS 0 10. 0. 0 0 1 /end COMPU_METHOD
/begin COMPU_METHOD _CNV_A_R_LINEAR_____75_CM "" RAT_FUNC "%6.3" "[rpm/100ms]" COEFFS 0 1. 0. 0 0 1 /end COMPU_METHOD
/begin COMPU_METHOD _CNV_A_R_LINEAR_____76_CM "" RAT_FUNC "%6.3" "[1/km]" COEFFS 0 1. 0. 0 0 1 /end COMPU_METHOD
/begin COMPU_METHOD _CNV_A_R_LINEAR_____78_CM "" RAT_FUNC "%6.3" "[%]" COEFFS 0 10.23 0. 0 0 1 /end COMPU_METHOD
/begin COMPU_METHOD _CNV_S_2_RANGE__0___85_CM "" TAB_VERB "%6.3" "-" COMPU_TAB_REF _CNV_S_2_RANGE__0___85 /end COMPU_METHOD
/begin COMPU_VTAB _CNV_S_2_RANGE__0___85 "" TAB_VERB 2 0 "0" 1 "1" /end COMPU_VTAB
/begin COMPU_METHOD _CNV_A_R_LINEAR_____86_CM "" RAT_FUNC "%6.3" "[Nm]" COEFFS 0 32. 32768. 0 0 1 /end COMPU_METHOD
/begin COMPU_METHOD _CNV_A_R_LINEAR_____88_CM "" RAT_FUNC "%6.3" "[-]" COEFFS 0 32767. 0. 0 0 1 /end COMPU_METHOD
/begin COMPU_METHOD _CNV_A_R_LINEAR_____90_CM "" RAT_FUNC "%6.3" "[Nm]" COEFFS 0 4. 0. 0 0 1 /end COMPU_METHOD
/begin COMPU_METHOD _CNV_A_R_LINEAR_____110_CM "" RAT_FUNC "%6.3" "[kg/h]" COEFFS 0 64. 0. 0 0 1 /end COMPU_METHOD
/begin COMPU_METHOD _CNV_S_8_gearbox_ty_112_CM "" TAB_VERB "%6.3" "[-]" COMPU_TAB_REF _CNV_S_8_gearbox_ty_112 /end COMPU_METHOD
/begin COMPU_VTAB _CNV_S_8_gearbox_ty_112 "" TAB_VERB 9 1 "Manual" 2 "Automatic" 4 "CVT" 5 "CVT" 8 "Robotized" 16 "Off Road" 32 "Reserved" 64 "Reserved" 128 "GB controled" /end COMPU_VTAB
/begin COMPU_METHOD _CNV_A_R_LINEAR_____115_CM "" RAT_FUNC "%6.3" "[km]" COEFFS 0 10000. 0. 0 0 1 /end COMPU_METHOD
/begin COMPU_METHOD _CNV_A_R_LINEAR_____118_CM "" RAT_FUNC "%6.3" "[°CRK]" COEFFS 0 42.66666666666666 5120. 0 0 1 /end COMPU_METHOD
/begin COMPU_METHOD _CNV_A_R_LINEAR_____134_CM "" RAT_FUNC "%6.3" "[%]" COEFFS 0 655.35 0. 0 0 1 /end COMPU_METHOD
/begin COMPU_METHOD _CNV_A_R_LINEAR_____136_CM "" RAT_FUNC "%6.3" "[%]" COEFFS 0 327.68 0. 0 0 1 /end COMPU_METHOD
/begin COMPU_METHOD _CNV_A_R_LINEAR_____140_CM "" RAT_FUNC "%6.3" "[%]" COEFFS 0 655.3600000071681 32768.00000035841 0 0 1 /end COMPU_METHOD
/begin COMPU_METHOD _CNV_A_R_LINEAR_____154_CM "" RAT_FUNC "%6.3" "rpm" COEFFS 0 1. 0. 0 0 1 /end COMPU_METHOD
/begin COMPU_METHOD _CNV_A_R_LINEAR_____157_CM "" RAT_FUNC "%6.3" "[°C]" COEFFS 0 64. 0. 0 0 1 /end COMPU_METHOD
/begin COMPU_METHOD _CNV_A_R_LINEAR_____161_CM "" RAT_FUNC "%6.3" "[%]" COEFFS 0 327.680000069121 32768.0000069121 0 0 1 /end COMPU_METHOD
/begin COMPU_METHOD _CNV_A_R_LINEAR_____162_CM "" RAT_FUNC "%6.3" "[-]" COEFFS 0 1000. 0. 0 0 1 /end COMPU_METHOD
/begin COMPU_METHOD _CNV_A_R_LINEAR_____201_CM "" RAT_FUNC "%6.3" "[°C]" COEFFS 0 64. 3200. 0 0 1 /end COMPU_METHOD
/begin COMPU_METHOD _CNV_A_R_LINEAR_____204_CM "" RAT_FUNC "%6.3" "[%]" COEFFS 0 327.7613897082924 0. 0 0 1 /end COMPU_METHOD
/begin COMPU_METHOD _CNV_A_R_LINEAR_____238_CM "" RAT_FUNC "%6.3" "[°C/100ms]" COEFFS 0 1. 0. 0 0 1 /end COMPU_METHOD
/begin COMPU_METHOD _CNV_A_R_LINEAR_____267_CM "" RAT_FUNC "%6.3" "[%]" COEFFS 0 1. 0. 0 0 1 /end COMPU_METHOD
/begin COMPU_METHOD _CNV_A_R_LINEAR_____269_CM "" RAT_FUNC "%6.3" "[V]" COEFFS 0 10.62059202605951 0. 0 0 1 /end COMPU_METHOD
/begin COMPU_METHOD _CNV_A_R_LINEAR_____289_CM "" RAT_FUNC "%6.3" "-" COEFFS 0 32767.99807357072 0. 0 0 1 /end COMPU_METHOD
/begin COMPU_METHOD _CNV_A_R_LINEAR_____290_CM "" RAT_FUNC "%6.3" "[MPa]" COEFFS 0 327.6800000003072 3.071909304708242e-008 0 0 1 /end COMPU_METHOD
/begin COMPU_METHOD _CNV_A_R_LINEAR_____291_CM "" RAT_FUNC "%6.3" "-" COEFFS 0 32768. 0. 0 0 1 /end COMPU_METHOD
/begin COMPU_METHOD _CNV_A_R_LINEAR_____292_CM "" RAT_FUNC "%6.3" "[Hz]" COEFFS 0 4294.967361262757 0. 0 0 1 /end COMPU_METHOD
/begin COMPU_METHOD _CNV_A_R___16__8000_344_CM "" RAT_FUNC "%6.3" "[Nm/mg/stk/mg/stk]" COEFFS 0 2048.000750011719 1.200018750387244e-002 0 0 1 /end COMPU_METHOD
/begin COMPU_METHOD _CNV_A_R___16__8000_345_CM "" RAT_FUNC "%6.3" "[Nm/mg/stk]" COEFFS 0 2048.000750011719 1.200018750387244e-002 0 0 1 /end COMPU_METHOD
/begin COMPU_METHOD _CNV_A_R___16__0H___346_CM "" RAT_FUNC "%6.3" "[Nm/mg/stk]" COEFFS 0 2047.999981999726 32767.99971199561 0 0 1 /end COMPU_METHOD
/begin COMPU_METHOD _CNV_A_R_LINEAR_____362_CM "" RAT_FUNC "%6.3" "[us]" COEFFS 0 1. 0. 0 0 1 /end COMPU_METHOD
/begin COMPU_METHOD _CNV_A_R_LINEAR_____368_CM "" RAT_FUNC "%6.3" "[V]" COEFFS 0 51.2 0. 0 0 1 /end COMPU_METHOD
/begin COMPU_METHOD _CNV_A_R_LINEAR_____374_CM "" RAT_FUNC "%6.3" "[-]" COEFFS 0 4096.000000864013 6.912101525813341e-006 0 0 1 /end COMPU_METHOD
/begin COMPU_METHOD _CNV_A_R_LINEAR_____380_CM "" RAT_FUNC "%6.3" "[A]" COEFFS 0 314.7692307692308 0. 0 0 1 /end COMPU_METHOD
/begin COMPU_METHOD _CNV_A_R_LINEAR_____382_CM "" RAT_FUNC "%6.3" "[°/oo]" COEFFS 0 4194.300129486656 -8.782845907262527e-004 0 0 1 /end COMPU_METHOD
/begin COMPU_METHOD _CNV_A_R_LINEAR_____396_CM "" RAT_FUNC "%6.3" "[Nm]" COEFFS 0 0.5 50. 0 0 1 /end COMPU_METHOD
/begin COMPU_METHOD _CNV_S_5_RANGE______397_CM "" TAB_VERB "%6.3" "[-]" COMPU_TAB_REF _CNV_S_5_RANGE______397 /end COMPU_METHOD
/begin COMPU_VTAB _CNV_S_5_RANGE______397 "" TAB_VERB 256 0 "NO_TQ_REQ" 1 "ERR_REQ" 2 "ERR_REQ" 3 "ERR_REQ" 4 "ERR_REQ" 5 "ASR_REQ" 6 "MSR_REQ" 7 "ERR_REQ" 8 "ERR_REQ" 9 "ERR_REQ" 10 "ERR_REQ" 11 "ERR_REQ" 12 "ERR_REQ" 13 "ERR_REQ" 14 "ERR_REQ" 15 "ERR_REQ" 16 "ERR_REQ" 17 "ERR_REQ" 18 "ERR_REQ" 19 "ERR_REQ" 20 "ERR_REQ" 21 "ERR_REQ" 22 "ERR_REQ" 23 "ERR_REQ" 24 "ERR_REQ" 25 "ERR_REQ" 26 "ERR_REQ" 27 "ERR_REQ" 28 "ERR_REQ" 29 "ERR_REQ" 30 "ERR_REQ" 31 "ERR_REQ" 32 "ERR_REQ" 33 "ERR_REQ" 34 "ERR_REQ" 35 "ERR_REQ" 36 "ERR_REQ" 37 "ERR_REQ" 38 "ERR_REQ" 39 "ERR_REQ" 40 "ERR_REQ" 41 "ERR_REQ" 42 "ERR_REQ" 43 "ERR_REQ" 44 "ERR_REQ" 45 "ERR_REQ" 46 "ERR_REQ" 47 "ERR_REQ" 48 "ERR_REQ" 49 "ERR_REQ" 50 "ERR_REQ" 51 "ERR_REQ" 52 "ERR_REQ" 53 "ERR_REQ" 54 "ERR_REQ" 55 "ERR_REQ" 56 "ERR_REQ" 57 "ERR_REQ" 58 "ERR_REQ" 59 "ERR_REQ" 60 "ERR_REQ" 61 "ERR_REQ" 62 "ERR_REQ" 63 "ERR_REQ" 64 "ERR_REQ" 65 "ERR_REQ" 66 "ERR_REQ" 67 "ERR_REQ" 68 "ERR_REQ" 69 "ERR_REQ" 70 "ERR_REQ" 71 "ERR_REQ" 72 "ERR_REQ" 73 "ERR_REQ" 74 "ERR_REQ" 75 "ERR_REQ" 76 "ERR_REQ" 77 "ERR_REQ" 78 "ERR_REQ" 79 "ERR_REQ" 80 "ERR_REQ" 81 "ERR_REQ" 82 "ERR_REQ" 83 "ERR_REQ" 84 "ERR_REQ" 85 "ERR_REQ" 86 "ERR_REQ" 87 "ERR_REQ" 88 "ERR_REQ" 89 "ERR_REQ" 90 "ERR_REQ" 91 "ERR_REQ" 92 "ERR_REQ" 93 "ERR_REQ" 94 "ERR_REQ" 95 "ERR_REQ" 96 "ERR_REQ" 97 "ERR_REQ" 98 "ERR_REQ" 99 "ERR_REQ" 100 "ERR_REQ" 101 "ERR_REQ" 102 "ERR_REQ" 103 "ERR_REQ" 104 "ERR_REQ" 105 "ERR_REQ" 106 "ERR_REQ" 107 "ERR_REQ" 108 "ERR_REQ" 109 "ERR_REQ" 110 "ERR_REQ" 111 "ERR_REQ" 112 "ERR_REQ" 113 "ERR_REQ" 114 "ERR_REQ" 115 "ERR_REQ" 116 "ERR_REQ" 117 "ERR_REQ" 118 "ERR_REQ" 119 "ERR_REQ" 120 "ERR_REQ" 121 "ERR_REQ" 122 "ERR_REQ" 123 "ERR_REQ" 124 "ERR_REQ" 125 "ERR_REQ" 126 "ERR_REQ" 127 "ERR_REQ" 128 "ERR_REQ" 129 "ERR_REQ" 130 "ERR_REQ" 131 "ERR_REQ" 132 "ERR_REQ" 133 "ERR_REQ" 134 "ERR_REQ" 135 "ERR_REQ" 136 "ERR_REQ" 137 "ERR_REQ" 138 "ERR_REQ" 139 "ERR_REQ" 140 "ERR_REQ" 141 "ERR_REQ" 142 "ERR_REQ" 143 "ERR_REQ" 144 "ERR_REQ" 145 "ERR_REQ" 146 "ERR_REQ" 147 "ERR_REQ" 148 "ERR_REQ" 149 "ERR_REQ" 150 "ERR_REQ" 151 "ERR_REQ" 152 "ERR_REQ" 153 "ERR_REQ" 154 "ERR_REQ" 155 "ERR_REQ" 156 "ERR_REQ" 157 "ERR_REQ" 158 "ERR_REQ" 159 "ERR_REQ" 160 "ERR_REQ" 161 "ERR_REQ" 162 "ERR_REQ" 163 "ERR_REQ" 164 "ERR_REQ" 165 "ERR_REQ" 166 "ERR_REQ" 167 "ERR_REQ" 168 "ERR_REQ" 169 "ERR_REQ" 170 "ERR_REQ" 171 "ERR_REQ" 172 "ERR_REQ" 173 "ERR_REQ" 174 "ERR_REQ" 175 "ERR_REQ" 176 "ERR_REQ" 177 "ERR_REQ" 178 "ERR_REQ" 179 "ERR_REQ" 180 "ERR_REQ" 181 "ERR_REQ" 182 "ERR_REQ" 183 "ERR_REQ" 184 "ERR_REQ" 185 "ERR_REQ" 186 "ERR_REQ" 187 "ERR_REQ" 188 "ERR_REQ" 189 "ERR_REQ" 190 "ERR_REQ" 191 "ERR_REQ" 192 "ERR_REQ" 193 "ERR_REQ" 194 "ERR_REQ" 195 "ERR_REQ" 196 "ERR_REQ" 197 "ERR_REQ" 198 "ERR_REQ" 199 "ERR_REQ" 200 "ERR_REQ" 201 "ERR_REQ" 202 "ERR_REQ" 203 "ERR_REQ" 204 "ERR_REQ" 205 "ERR_REQ" 206 "ERR_REQ" 207 "ERR_REQ" 208 "ERR_REQ" 209 "ERR_REQ" 210 "ERR_REQ" 211 "ERR_REQ" 212 "ERR_REQ" 213 "ERR_REQ" 214 "ERR_REQ" 215 "ERR_REQ" 216 "ERR_REQ" 217 "ERR_REQ" 218 "ERR_REQ" 219 "ERR_REQ" 220 "ERR_REQ" 221 "ERR_REQ" 222 "ERR_REQ" 223 "ERR_REQ" 224 "ERR_REQ" 225 "ERR_REQ" 226 "ERR_REQ" 227 "ERR_REQ" 228 "ERR_REQ" 229 "ERR_REQ" 230 "ERR_REQ" 231 "ERR_REQ" 232 "ERR_REQ" 233 "ERR_REQ" 234 "ERR_REQ" 235 "ERR_REQ" 236 "ERR_REQ" 237 "ERR_REQ" 238 "ERR_REQ" 239 "ERR_REQ" 240 "ERR_REQ" 241 "ERR_REQ" 242 "ERR_REQ" 243 "ERR_REQ" 244 "ERR_REQ" 245 "ERR_REQ" 246 "ERR_REQ" 247 "ERR_REQ" 248 "ERR_REQ" 249 "ERR_REQ" 250 "ERR_REQ" 251 "ERR_REQ" 252 "ERR_REQ" 253 "ERR_REQ" 254 "ERR_REQ" 255 "ERR_REQ" /end COMPU_VTAB
/begin COMPU_METHOD _CNV_S_6_RANGE______398_CM "" TAB_VERB "%6.3" "[-]" COMPU_TAB_REF _CNV_S_6_RANGE______398 /end COMPU_METHOD
/begin COMPU_VTAB _CNV_S_6_RANGE______398 "" TAB_VERB 6 0 "ES_ON" 1 "CRK" 2 "ERU_ON" 3 "ERU_OFF" 4 "PWL" 5 "LOCK" /end COMPU_VTAB
/begin COMPU_METHOD _CNV_A_R_LINEAR_____402_CM "" RAT_FUNC "%6.3" "[%]" COEFFS 0 163.8400026560406 5.312081193551421e-004 0 0 1 /end COMPU_METHOD
/begin COMPU_METHOD _CNV_A_R_LINEAR_____403_CM "" RAT_FUNC "%6.3" "[mNm]" COEFFS 0 65.53600007936122 0. 0 0 1 /end COMPU_METHOD
/begin COMPU_METHOD _CNV_A_R_LINEAR_____404_CM "" RAT_FUNC "%6.3" "[V]" COEFFS 0 655.3599999999997 0. 0 0 1 /end COMPU_METHOD
/begin COMPU_METHOD _CNV_A_R_LINEAR_____405_CM "" RAT_FUNC "%6.3" "[ohm]" COEFFS 0 6553.582575140446 0. 0 0 1 /end COMPU_METHOD
/begin COMPU_METHOD _CNV_A_R_LINEAR_____406_CM "" RAT_FUNC "%6.3" "[-]" COEFFS 0 655.3599999999997 0. 0 0 1 /end COMPU_METHOD
/begin COMPU_METHOD _CNV_A_R_LINEAR_____408_CM "" RAT_FUNC "%6.3" "[-]" COEFFS 0 16383.99985599781 -2.880043903132901e-004 0 0 1 /end COMPU_METHOD
/begin COMPU_METHOD _CNV_A_R_LINEAR_____410_CM "" RAT_FUNC "%6.3" "[s]" COEFFS 0 524280. 0. 0 0 1 /end COMPU_METHOD
/begin COMPU_METHOD _CNV_A_R_LINEAR_____411_CM "" RAT_FUNC "%6.3" "[s]" COEFFS 0 4096.000220003369 0. 0 0 1 /end COMPU_METHOD
/begin COMPU_METHOD _CNV_A_R_LINEAR_____412_CM "" RAT_FUNC "%6.3" "[A]" COEFFS 0 6553.582575140446 0. 0 0 1 /end COMPU_METHOD
/begin COMPU_METHOD _CNV_A_R_LINEAR_____413_CM "" RAT_FUNC "%6.3" "[%]" COEFFS 0 163.8399997887968 32767.99995775936 0 0 1 /end COMPU_METHOD
/begin COMPU_METHOD _CNV_A_R_LINEAR_____414_CM "" RAT_FUNC "%6.3" "[%]" COEFFS 0 1.28 128. 0 0 1 /end COMPU_METHOD
/begin COMPU_METHOD _CNV_A_R_LINEAR_____415_CM "" RAT_FUNC "%6.3" "[V]" COEFFS 0 204.7999649194707 0. 0 0 1 /end COMPU_METHOD
/begin COMPU_METHOD _CNV_A_R_LINEAR_____416_CM "" RAT_FUNC "%6.3" "[V/s]" COEFFS 0 2.047999995887937 0. 0 0 1 /end COMPU_METHOD
/begin COMPU_METHOD _CNV_A_R_LINEAR_____417_CM "" RAT_FUNC "%6.3" "[ms]" COEFFS 0 1. 0. 0 0 1 /end COMPU_METHOD
/begin COMPU_METHOD _CNV_A_R_LINEAR_____419_CM "" RAT_FUNC "%6.3" "[-]" COEFFS 0 15625. 0. 0 0 1 /end COMPU_METHOD
/begin COMPU_METHOD _CNV_A_R_LINEAR_____421_CM "" RAT_FUNC "%6.3" "[%*s/(N*m)]" COEFFS 0 10000. 0. 0 0 1 /end COMPU_METHOD
/begin COMPU_METHOD _CNV_A_R_LINEAR_____422_CM "" RAT_FUNC "%6.3" "[%*s/(kg/h)]" COEFFS 0 79999.95117115973 -2.000029297414585e-002 0 0 1 /end COMPU_METHOD
/begin COMPU_METHOD _CNV_A_R_LINEAR_____423_CM "" RAT_FUNC "%6.3" "[s]" COEFFS 0 3906.250000000001 0. 0 0 1 /end COMPU_METHOD
/begin COMPU_METHOD _CNV_A_R_LINEAR_____424_CM "" RAT_FUNC "%6.3" "[%*s/(N*m)]" COEFFS 0 5000. 0. 0 0 1 /end COMPU_METHOD
/begin COMPU_METHOD _CNV_A_R_LINEAR_____425_CM "" RAT_FUNC "%6.3" "[%*s/(N*m)]" COEFFS 0 10000. 32768. 0 0 1 /end COMPU_METHOD
/begin COMPU_METHOD _CNV_A_R_LINEAR_____426_CM "" RAT_FUNC "%6.3" "[%*s/(kg/h)]" COEFFS 0 80000. 32768. 0 0 1 /end COMPU_METHOD
/begin RECORD_LAYOUT _REC_VAL_20_u1 FNC_VALUES 1 UBYTE COLUMN_DIR DIRECT /end RECORD_LAYOUT
/begin RECORD_LAYOUT _REC_AXS_20_u2 NO_AXIS_PTS_X 1 UWORD AXIS_PTS_X 2 UWORD INDEX_INCR DIRECT /end RECORD_LAYOUT
/begin RECORD_LAYOUT _REC_MAP_20_u2_u2_u2 FNC_VALUES 1 UWORD COLUMN_DIR DIRECT /end RECORD_LAYOUT
/begin RECORD_LAYOUT _REC_VAL_20_u2 FNC_VALUES 1 UWORD COLUMN_DIR DIRECT /end RECORD_LAYOUT
/begin RECORD_LAYOUT _REC_VAL_20_s2 FNC_VALUES 1 SWORD COLUMN_DIR DIRECT /end RECORD_LAYOUT
/begin RECORD_LAYOUT _REC_AXS_20_u1 NO_AXIS_PTS_X 1 UBYTE AXIS_PTS_X 2 UBYTE INDEX_INCR DIRECT /end RECORD_LAYOUT
/begin RECORD_LAYOUT _REC_CUR_20_u2_u2 FNC_VALUES 1 UWORD COLUMN_DIR DIRECT /end RECORD_LAYOUT
/begin RECORD_LAYOUT _REC_CUR_20_u2_u1 FNC_VALUES 1 UWORD COLUMN_DIR DIRECT /end RECORD_LAYOUT
/begin RECORD_LAYOUT _REC_MAP_20_u1_u2_u2 FNC_VALUES 1 UBYTE COLUMN_DIR DIRECT /end RECORD_LAYOUT
/begin RECORD_LAYOUT _REC_MAP_20_u2_u1_u1 FNC_VALUES 1 UWORD COLUMN_DIR DIRECT /end RECORD_LAYOUT
/begin RECORD_LAYOUT _REC_MAP_20_u2_u2_u1 FNC_VALUES 1 UWORD COLUMN_DIR DIRECT /end RECORD_LAYOUT
/begin RECORD_LAYOUT _REC_CUR_20_u1_u2 FNC_VALUES 1 UBYTE COLUMN_DIR DIRECT /end RECORD_LAYOUT
/begin RECORD_LAYOUT _REC_CUR_20_u1_u1 FNC_VALUES 1 UBYTE COLUMN_DIR DIRECT /end RECORD_LAYOUT
/begin FUNCTION CR_Generic ""
 /begin DEF_CHARACTERISTIC c_ctr_max_wup_cyc ldp_fmy_dtc lc_abc_bench id_err_dtc_mis c_obd_state_1 c_obd_state_2 lc_ena_scdn lc_clr_fmy lc_clr_his_fmy c_conf_mil c_conf_wal_1 c_conf_wal_2 lc_inh_wal_st c_dly_inh_iv_mis lc_ad_clr c_nvmy_inst_chk ldpm_n_ip_mf_pf c_dly_mil_ready_1 c_dly_mil_ready_2 lc_egrv_pctl_on c_bpapwm_min_diag c_bpapwm_max_diag c_fac_ar_egrv_pctl_fil c_thrpwm_min_diag c_thrpwm_max_diag c_ctr_inh_temp_diag c_tco_mes_grd_diag c_tco_mes_st_diag c_t_ast_tco_diag c_tco_plaus_inc_diag ldp_fmy_envd c_tco_wup_thd c_tco_wup_inc c_abc_inc_pvs_l_1 c_abc_max_pvs_l_1 c_abc_inc_pvs_l_2 c_abc_max_pvs_l_2 c_abc_inc_pvs_h_1 c_abc_max_pvs_h_1 c_abc_inc_pvs_h_2 c_abc_max_pvs_h_2 c_abc_inc_pvs_ratio c_abc_max_pvs_ratio c_abc_inc_pvs_bls_bts c_abc_max_pvs_bls_bts c_abc_inc_pvs_move c_abc_max_pvs_move c_crlc_pvs_1_move c_crlc_pvs_2_move c_ctr_max_pv_av_con c_ctr_max_pvs_bls_bts_plaus c_ctr_max_pvs_h_r_1 c_ctr_max_pvs_h_r_2 c_ctr_max_pvs_is_rng c_ctr_max_pvs_move c_ctr_max_pvs_move_err c_n_pvs_bls_bts_plaus c_pv_av_hys_bls_bts_plaus c_pv_av_pvs_bls_bts_plaus c_pvs_ratio_fac c_v_pvs_max_diag_1 c_v_pvs_max_diag_2 c_v_pvs_min_diag_1 c_v_pvs_min_diag_2 c_v_pvs_min_diag_min_1 c_v_pvs_min_diag_min_2 c_v_pvs_move_hys_1 c_v_pvs_move_hys_2 c_v_pvs_ratio_ofs c_v_pvs_thd_move_1 c_vs_pvs_bls_bts_plaus lc_poti lc_pvs_bls_bts_plaus_ena ldp_v_pvs_min_ip_pvs_ratio_hys ip_pvs_ratio_hys__v_pvs_min c_abc_inc_vcc_1 c_abc_max_vcc_1 c_abc_inc_vcc_2 c_abc_max_vcc_2 c_vcc_min_diag c_vcc_max_diag c_amp_sub_diag ip_amp_mes__v_amp ldp_v_amp_ip_amp_mes c_abc_inc_cyl_bal_0 c_abc_max_cyl_bal_0 c_abc_inc_cyl_bal_1 c_abc_max_cyl_bal_1 c_abc_inc_cyl_bal_2 c_abc_max_cyl_bal_2 c_abc_inc_cyl_bal_3 c_abc_max_cyl_bal_3 c_ctr_eve_cyl_bal_max c_ctr_bas_cyl_bal_max c_fac_is_fil_neg c_fac_is_fil_pos c_t_is_fil_ais_req id_fac_pl_is__dri ip_fac_fil_pl_is__tco ip_fac_fil_st_is__tco id_dri__vs_n c_vs_n_grd_fil_thd lc_dri c_fac_fil_vs_n_grd lc_dri_sub c_dri_sub c_t_max_vs_n c_vs_n_hys c_t_max_vs_n_diag c_vs_n_hys_diag c_t_upd_vs_abs c_vs_lih_grd c_vs_lih c_fac_vs_fil lc_ac_fil c_vs_det_min c_vs_puls_div c_buf_size_vs c_abc_inc_vs c_abc_max_vs c_mf_tot_vs_cor_diag c_vs_max_diag c_vs_min_diag c_n_vs_cor_diag c_n_dif_vs_cor_diag c_tco_vs_cor_diag c_t_max_vs_cor_diag c_fac_vs lc_can_vs_abs lc_can_ac_abs lc_can_dist_abs ldpm_n_ip_tqfr lc_efp_ctl_on lc_efp_rly_man_on c_t_efp_reset_st c_t_efp_reset_es c_crlc_tqfr ip_tqfr_add__n_mmv__toil ip_tqfr_add__n_mmv__tco ip_tqfr__n ldpm_n_mmv_ip_tqfr_add ldp_toil_ip_tqfr_add ldp_tco_ip_tqfr_add c_tq_max_sca lc_tq_tra_act c_fac_pv_av_dif_tra c_pv_av_max lc_tq_tra_pv_av_lim c_n_dif_max c_fac_n_dif_tra lc_n_mmv_tra_act lc_tq_tra_n_lim c_t_dly_diag_tcs_dec c_t_max_tcs_inc c_tq_inc_sum_max_tcs c_vs_min_tcs_inc lc_tcs_dec_act lc_tcs_inc_act lc_tcs_inc_di_clu c_thd_ctr_vs_dist c_fac_vb_fil ip_n_prev1_inh__vb_fil ip_n_main2_inh__vb_fil ip_n_main1_inh__vb_fil ip_n_prev2_inh__vb_fil ip_n_post1_inh__vb_fil ip_n_post2_inh__vb_fil c_fac_thermo_down_egrv c_fac_thermo_up_egrv ip_fac_temp_egr_cool c_abc_inc_v_tba_rng c_abc_max_v_tba_rng c_abc_inc_tba_mes_grd c_abc_max_tba_mes_grd c_v_tba_max_diag c_v_tba_min_diag c_tba_mes_grd_diag c_frq_pwm_ect c_frq_pwm_ecf_1 c_frq_pwm_ecf_2 c_frq_pwm_gl c_frq_pwm_acc_b lc_ad_clr_ensd c_mf_prev1_add_tu c_mf_prev2_add_tu c_mf_delta_grd_ratio_tq_mf c_mf_tot_min_grd_ratio_tq_mf c_grd_ratio_tq_mf_min c_grd_ratio_tq_mf_max c_mf_dif_max_grd_ratio_tq_mf c_mf_tot_min_ratio_tq_mf ip_ratio_tq_mf_0 ldpm_mf_ip_ratio_tq_mf ip_ratio_tq_mf_2 ip_ratio_tq_mf_1 ip_ratio_tq_mf_3 ip_ratio_tq_mf_4 c_crlc_ratio_tq_mf c_ratio_tq_mf_max c_ratio_tq_mf_min lc_seg_ad_init id_clas_a_fmt id_clas_b_fmt id_maf_tab ldp_amp_2_inj_x ldp_n_3_inj_x ldp_n_4_inj_x c_crlc_ad_bpa[0] c_crlc_v_bpa_tol[0] c_v_bpa_max_ad_tol[0] c_v_bpa_min_ad_tol[0] lc_v_bpa_tol_sub[0] c_v_bpa_tol_sub[0] c_ang_sp_ad_bpa_bol[0] c_v_grd_bpa_st_ad_bol[0] c_temp_st_ad_bpa_max[0] c_temp_st_ad_bpa_min[0] c_v_bpa_max_st_ad_bol[0] c_vb_max_ad_bpa c_vb_min_ad_bpa c_t_ad_bpa_bol_ini[0] c_ang_sp_ad_bpa_tol[0] c_v_grd_bpa_st_ad_tol[0] c_v_bpa_min_st_ad_tol[0] c_t_ad_bpa_tol_ini[0] c_t_ad_bpa_tol[0] c_crlc_v_bpa_bol[0] c_v_bpa_max_ad_bol[0] c_v_bpa_min_ad_bol[0] lc_v_bpa_bol_sub[0] c_v_bpa_bol_sub[0] id_ad_bpa_bol__t_ad_bpa id_ad_bpa_tol__t_ad_bpa c_t_ad_bpa_bol[0] c_v_egrv_tol_sub[0] lc_v_egrv_tol_sub[0] c_crlc_v_egrv_tol[0] c_crlc_v_egrv_bol[0] c_v_egrv_max_st_ad_bol[0] c_v_egrv_min_st_ad_tol[0] c_t_ad_egrv_bol_ini[0] c_t_ad_egrv_tol_ini[0] c_crlc_ad_egrv[0] c_v_egrv_max_ad_tol[0] c_v_egrv_min_ad_tol[0] c_v_egrv_bol_sub[0] lc_v_egrv_bol_sub[0] c_ang_sp_ad_egrv_bol[0] c_temp_st_ad_egrv_max[0] c_v_grd_egrv_st_ad_bol[0] c_temp_st_ad_egrv_min[0] c_t_ad_egrv_bol[0] c_ang_sp_ad_egrv_tol[0] c_v_grd_egrv_st_ad_tol[0] c_t_ad_egrv_tol[0] c_v_egrv_min_ad_bol[0] c_v_egrv_max_ad_bol[0] id_ad_egrv_tol__t_ad_egrv id_ad_egrv_bol__t_ad_egrv c_vb_max_ad_egrv c_vb_min_ad_egrv lc_bpapwm_pctl_stat_mpg lc_bpapwm_pctl_dev c_fac_bpapwm_pctl_dev c_bpapwm_pctl_dev lc_bpa_dt1_tqi_on c_t2_dt1_bpa_tqi c_fac_bpa_dt1_tqi_fil_0 c_fac_bpa_dt1_tqi_fil_1 c_bpapwm_tqi_dt1_min c_bpapwm_tqi_dt1_max c_t2_dt1_bpa_maf lc_bpa_dt1_maf_on c_fac_bpa_dt1maf1_fil c_fac_bpa_dt1maf2_fil c_bpapwm_maf_dt1_max c_bpapwm_maf_dt1_min c_fac_bpapwm_dyn c_t1_td1_bpapwm_dyn c_bpapwm_lim_dyn_max c_kr_td1_bpapwm_dyn ip_bpapwm_pctl_stat_mdl ldp_bpa_pos_sp ip_fac_tran_bpapwm_pctl_0 ldp_tco_ip_fac_tran_bpapwm_0 ip_fac_bpapwm_pctl_cor_amp_0 ldp_amp_ip_fac_bpapwm_pctl_0 ip_fac_bpapwm_pctl_cor_tgas_0 ldp_tgas_ip_fac_bpapwm_pctl_0 ip_fac_tran_bpapwm_pctl_1 ldp_tco_ip_fac_tran_bpapwm_1 ip_fac_bpapwm_pctl_cor_amp_1 ldp_amp_ip_fac_bpapwm_pctl_1 ip_fac_bpapwm_pctl_cor_tgas_1 ldp_tgas_ip_fac_bpapwm_pctl_1 ip_bpapwm_pctl_bas_0_1 ldpm_n_ip_bpapwm_pctl_0 ldpm_tqi_ip_bpapwm_pctl_0 ip_bpapwm_pctl_bas_0_2 ip_bpapwm_pctl_bas_0_0 ip_bpapwm_pctl_cor_amp_0 ldp_n_ip_bpapwm_pctl_amp_0 ldp_tqi_ip_bpapwm_pctl_amp_0 ip_bpapwm_pctl_cor_tgas_0 ldp_n_ip_bpapwm_pctl_tgas_0 ldp_tqi_ip_bpapwm_pctl_tgas_0 ip_bpapwm_pctl_bas_1_1 ldpm_n_ip_bpapwm_pctl_1 ldpm_tqi_ip_bpapwm_pctl_1 ip_bpapwm_pctl_bas_1_2 ip_bpapwm_pctl_bas_1_0 ip_bpapwm_pctl_cor_amp_1 ldp_n_ip_bpapwm_pctl_amp_1 ldp_tqi_ip_bpapwm_pctl_amp_1 ip_bpapwm_pctl_cor_tgas_1 ldp_n_ip_bpapwm_pctl_tgas_1 ldp_tqi_ip_bpapwm_pctl_tgas_1 ip_kr_dt1_bpa_tqi ldp_n_ip_kr_dt1_bpa_tqi ldp_tqi_ip_kr_dt1_bpa_tqi ip_kr_dt1_bpa_maf ldp_n_ip_kr_dt1_bpa_maf ldp_tqi_ip_kr_dt1_bpa_maf ip_bpapwm_min ldpm_n_ip_bpapwm_lim ldpm_tqi_ip_bpapwm_lim ip_bpapwm_max ldpm_n_ip_bpapwm_pctl_short ldpm_tqi_ip_bpapwm_pctl_short c_bpa_pwm_man[0] c_bpa_pwm_man[1] lc_bpa_psn_ctl lc_bpapwm_ivs lc_bpapwm_man c_fac_egrv_pwm_cor[0] c_egrv_pwm_cor[0] c_fac_thr_pwm_cor[0] c_thr_pwm_cor[0] lc_egr_out_man ip_egrvpwm__n__mafpwm ip_egrvpwm__ar_egrv c_egrv_pwm_man[0] c_egrv_pwm_man[1] c_fac_egrvpwm_es_close lc_egrv_psn_ctl lc_test_thr[0] c_test_fac_thr[0] c_test_add_thr[0] lc_dt1_thr_on[0] lc_pi_thr_on[0] c_thr_ini[0] c_gear_trans_ratio_thr c_temp_mot_thr_ref c_r_mot_thr lc_pctl_thr_lih c_pctl_thr_lih c_temp_mot_thr[0] lc_pctl_phys_thr_on[0] c_fac_ctl_lim_thr c_ctl_lim_thr_add lc_ctl_lim_thr_man c_ctl_lim_thr_man[0] c_t_lim_dyn_thr[0] c_lim_dyn_max_thr[0] ip_kr_dt1_thr__ctl_dif ldp_ctl_dif__ip_kr_dt1_thr ip_t1_dt1_thr__ctl_dif ldp_ctl_dif__ip_t1_dt1_thr ip_kr_pi_thr__ctl_dif ldp_ctl_dif__ip_kr_pi_thr ip_tn_pi_thr__ctl_dif ldp_ctl_dif__ip_tn_pi_thr ip_tq_spr_thr__ang_sp_thr ldp_ang_sp_thr_ip_tq_spr_thr ip_cur_mot_thr__tq_mot ldp_tq_mot_thr__ip_cur_mot ip_pctl_thr__v_mot_thr ldp_v_mot_thr__ip_pctl_thr ip_pctl_thr__ang_sp_thr ldp_ang_sp_thr_ip_pctl_thr ip_ctl_min_thr_0__temp ldpm_temp__ip_ctl_thr ip_ctl_max_thr_0__temp ip_ctl_dyn_lim_thr_0__temp lc_ctl_lim_thr_grd ip_tqi_clc_prev_main__n__mf ip_tqi_add_prev_main__n__tco ip_tqi_clc_main__n__mf ip_tqi_add_main__n__tco ldpm_tco_ip_tqi_clc ldpm_mf_ip_tqi_clc ldpm_n_ip_tqi_clc /end DEF_CHARACTERISTIC
 /begin OUT_MEASUREMENT temp_up_egrv_sp quo_mfw_down_egrv quo_mfw_up_egrv_sp quo_mfw_down_egrv_sp quo_mfw_up_egrv lv_err_tba_mes vb_mmv v_pvs_1_bas v_pvs_2_bas v_dcdc tq_loss_dip_pf lv_act_ico lv_act_byp fac_byppwm_iah_mmv thrpwm_iah_clc byppwm_iah_clc temp_cyl temp_up_ico temp_up_cmp lv_cdn_act_bpa_pf bpapwm_pctl_post map_sp_post map_sp_bas_pf tba_sp_pf thrpwm_pctl_post thrpwm_pctl_bas_pf fup_sp_cor_post fac_mf_post2_cor_1 fac_mf_post2_cor_0 t_rgn_deact_mf_pf t_rgn_deact_soi_pf t_rgn_deact_fup_pf t_rgn_deact_map_sp_pf t_rgn_act_mf_pf t_rgn_act_soi_pf t_rgn_act_fup_pf t_rgn_act_map_sp_pf mf_prev1_pf mf_prev2_pf mf_main1_pf mf_main2_pf mf_post1_pf mf_post2_pf soi_prev1_pf soi_prev2_pf soi_main1_pf soi_main2_pf soi_post1_pf soi_post2_pf lv_req_egr_pf lv_req_thr_pf lv_req_bpa_pf lv_req_post_act lv_cmd_gl_ext pwm_gl_ext n_max_etc n_max_mt n_max_tqi lv_req_ti_min_cyl_0 lv_req_ti_min_cyl_1 lv_req_ti_min_cyl_2 lv_req_ti_min_cyl_3 lv_ena_grd_ratio_tq_mf_clc grd_ratio_tq_mf_lim ratio_tq_mf_mem_new ratio_tq_mf_mem_old mf_tot_mem_new_grd_ratio_tq_mf mf_tot_mem_old_grd_ratio_tq_mf grd_ratio_tq_mf ratio_tq_mf_mpg_fil ratio_tq_mf_tot ratio_tq_mf_slm ratio_tq_mf_mpg lv_ratio_tq_mf_grd_use lv_ena_ratio_tq_mf_clc ratio_tq_mf_raw tqi_slm ratio_tq_mf_grd tq_driv_sub tqi_driv_sub lv_tq_cru_act lv_tq_vvsl_act tq_dcru_req tq_cru_req tq_vs_lim_req tq_req_dcru tqi_max cfb_pcv_mes lv_seg_t_ad_rst_ext_adj lv_seg_t_fast_ad_ext_adj ctr_t_low_maf_frq_0_av vb_fil lv_key_off v_map fup_tra_dif lv_inh_egr_ctl online_dummy ecu_state mf_bas mf_tql lv_intv_bpa[0] intv_bpa[0] lv_ad_bpa[0] ad_bpa_mmv[0] lv_ad_bpa_tol[0] lv_v_bpa_tol_ad_orng[0] v_bpa_tol[0] lv_cdn_ad_v_bpa_tol[0] v_bpa_tol_det[0] t_ad_bpa_bol_av[0] lv_ad_bpa_bol[0] t_ad_bpa_tol_av[0] lv_v_bpa_bol_ad_orng[0] v_bpa_bol[0] lv_cdn_ad_v_bpa_bol[0] v_bpa_bol_det[0] ad_egrv_mmv[0] lv_v_egrv_tol_ad_orng[0] lv_v_egrv_bol_ad_orng[0] lv_cdn_ad_v_egrv_tol[0] lv_cdn_ad_v_egrv_bol[0] v_egrv_tol[0] v_egrv_bol[0] v_egrv_bol_det[0] v_egrv_tol_det[0] lv_ad_egrv_tol[0] lv_ad_egrv_tol_req[0] lv_ad_egrv_bol[0] lv_ad_egrv_bol_req[0] t_ad_egrv_tol_av[0] t_ad_egrv_bol_av[0] lv_ad_egrv[0] lv_intv_egrv[0] lv_ang_sp_egrv_intv[0] ang_sp_egrv_intv[0] intv_egrv[0] bpapwm_pctl_bas_tco_0 bpapwm_pctl_bas_tco_1 bpapwm_pctl_stat_mpg bpapwm_pctl_stat bpapwm_pctl_stat_mdl bpapwm_pctl_bas_0 bpapwm_pctl_bas_1 bpapwm_pctl_unlim bpapwm_pctl_tra bpapwm_pctl_tqi kr_dt1_bpa_tqi bpapwm_pctl_maf kr_dt1_bpa_maf bpapwm_max bpapwm_min bpapwm_ctl_min bpapwm_ctl_max bpapwm_pctl bpapwm_lim_dyn lv_bpapwm_lim_diag bpa_pwm[0] bpa_pwm_bas[0] fac_egrv_pwm_cor[0] egrv_pwm_cor[0] lv_egr_out_man thr_pwm_cor[0] fac_thr_pwm_cor[0] egrvpwm egrv_pwm[0] lv_egrvpwm_lim_diag egrvpwm_egr ang_sp_thr[0] test_thr[0] ctl_dif_thr[0] ctl_thr[0] pi_dt1_thr[0] dt1_thr[0] pi_thr[0] tq_mot_thr[0] v_mot_thr[0] r_mot_cor_thr[0] pctl_thr[0] ctl_lim_bas_thr[0] lim_dif_thr[0] ctl_lim_thr[0] ctl_thr_pre_lim[0] ctl_dyn_lim_thr[0] tqi_max_1 /end OUT_MEASUREMENT
/end FUNCTION
/begin FUNCTION PPDDOI_Generic "" /end FUNCTION
/begin FUNCTION PPDSOI_Generic "" /begin DEF_CHARACTERISTIC ldp_n_wiv_ip_toil_mdl /end DEF_CHARACTERISTIC /end FUNCTION
/begin FUNCTION CR_Generic_4_Cyl ""
 /begin OUT_MEASUREMENT ctr_bas_cyl_bal[3] ctr_eve_cyl_bal[3] fac_cyl_bal_ramp_tco[3] fac_cyl_bal[3] fac_cyl_bal_n_fdout[3] cyl_bal_pi[3] cyl_bal_dif[3] er[3] seg_ad_mmv[3] seg_t_cor_buf[6] seg_t_cor_buf[7] /end OUT_MEASUREMENT
/end FUNCTION
/begin FUNCTION PCR_Generic ""
 /begin OUT_MEASUREMENT lv_efp_rly lv_efp_reset lv_efp_reset_st lv_efp_reset_es ctr_max_ti_min_0 ctr_max_ti_min_1 ctr_max_ti_min_2 ctr_max_ti_min_3 t_atic20 v_t_atic20 v_t_lc t_lc can_tq_driv_sub can_tq_req_sta lv_can_brake_abs lv_r_heat_1 lv_r_heat_2 /end OUT_MEASUREMENT
/end FUNCTION
/begin FUNCTION PSA_PN0 "" /end FUNCTION
/begin FUNCTION C_0_BGO "" /end FUNCTION
/begin FUNCTION C_1_GEN "C_1_GEN"
 /begin SUB_FUNCTION GEN_Variant_Coding GEN_Variant_Coding_DS GEN_Init_Variables_Non_Impl_Fct GEN_System_Overview GEN_Appl_System /end SUB_FUNCTION
/end FUNCTION
/begin FUNCTION GEN_Variant_Coding "Variant_Coding"
 /begin DEF_CHARACTERISTIC c_dsk_byte_1 c_dsk_byte_2 c_dsk_byte_3 c_dsk_byte_4 c_dsk_byte_0 c_var_code_2 c_var_code_3 c_var_code_5 c_var_code_6 c_var_code_7 c_var_code_8 c_var_code_9 c_var_code_10 c_var_code_11 c_var_code_12 c_var_code_13 c_var_code_14 c_var_code_15 c_var_code_1 c_var_code_16 c_var_code_4 /end DEF_CHARACTERISTIC
 /begin OUT_MEASUREMENT lv_var_sap lv_var_sav lv_var_egr lv_var_knks_2 lv_var_mil lv_var_pwl lv_var_cps lv_var_cs lv_var_can lv_var_can_vecu lv_var_rr_sw lv_var_ac lv_var_syn lv_var_climatronic lv_var_can_tcs lv_var_can_acu lv_var_can_ccu lv_var_can_tcu lv_at lv_var_asr lv_var_ect lv_var_can_bem lv_var_vim lv_var_vim_1 lv_var_vim_2 lv_var_ecfpwm lv_var_ecfpwm_1 lv_var_ecfpwm_2 lv_dct lv_cvt lv_var_msr lv_var_vim_fb lv_var_can_tog lv_var_can_stans lv_var_vcv lv_var_port lv_var_cwp lv_var_aeb lv_var_tldp lv_var_can_if_cft lv_var_can_dt_ccp lv_var_can_ccp lv_var_can_icl lv_var_can_eilu /end OUT_MEASUREMENT
/end FUNCTION
/begin FUNCTION GEN_Variant_Coding_DS "Variant_Coding"
 /begin DEF_CHARACTERISTIC c_conf_gb c_conf_heat lc_var_can_cs lc_acc_is_can_aut_ena lc_acc_is_can_state_ena lc_acc_is_can_req_ena lc_acc_is_driv_req_ena lc_gl_var lc_var_can_whl lc_var_can_sys_info lc_var_can_nom_sys lc_var_egr_conf lc_var_maf_conf lc_var_rms_conf lc_var_egr_hbr_conf /end DEF_CHARACTERISTIC
 /begin OUT_MEASUREMENT sf_conf_gb sf_conf_acc sf_conf_heat lv_var_can_cs lv_acc_is_can_aut_ena lv_acc_is_can_state_ena lv_acc_is_can_req_ena lv_acc_is_driv_req_ena lv_gl_var lv_var_can_whl lv_var_can_sys_info lv_var_can_nom_sys lv_var_egr_conf lv_var_egr_hbr_conf lv_var_maf_conf lv_var_rms_conf lv_var_can_ac /end OUT_MEASUREMENT
/end FUNCTION
/begin FUNCTION GEN_Init_Variables_Non_Impl_Fct "Init_Variables_Non_Impl_Fct" /end FUNCTION
/begin FUNCTION GEN_System_Overview "System_Overview" /end FUNCTION
/begin FUNCTION GEN_Appl_System "Appl_System" /end FUNCTION
/begin FUNCTION C_2_BIO "" /begin SUB_FUNCTION SYS_ETC_MONITORING_ECM2 BIO_Key_Position_Determination /end SUB_FUNCTION /end FUNCTION
/begin FUNCTION SYS_ETC_MONITORING_ECM2 "" /end FUNCTION
/end MODULE
/end PROJECT
