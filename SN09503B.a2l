ASAP2_VERSION 1 41
/begin PROJECT SN0 "SIMOS PPD"
/begin HEADER "_default_HeaderComment" PROJECT_NO PRJ_NUM /end HEADER
/begin MODULE _default_ModuleName "_default_ModuleLongIdentifier"
/begin MOD_COMMON "_default_ModCommonComment" DEPOSIT ABSOLUTE BYTE_ORDER MSB_FIRST ALIGNMENT_BYTE 1 ALIGNMENT_WORD 2 ALIGNMENT_LONG 4 ALIGNMENT_FLOAT32_IEEE 4 ALIGNMENT_FLOAT64_IEEE 8 /end MOD_COMMON
/begin AXIS_PTS ldp_1_id_err_dtc_mis "" 0x84106c online_dummy _REC_AXS_20_u2 65535. _CNV_A_R_LINEAR_____1_CM 2 0. 65535. FORMAT "%5.0" /end AXIS_PTS
/begin AXIS_PTS ldp_2_id_err_dtc_mis "" 0x841072 online_dummy _REC_AXS_20_u2 65535. _CNV_A_R_LINEAR_____1_CM 7 0. 65535. FORMAT "%5.0" /end AXIS_PTS
/begin CHARACTERISTIC lc_test_hbr[0] "" VALUE 0x85ceb0 _REC_VAL_20_u1 1. _CNV_A_R_LINEAR_____0_CM 0. 1. DISPLAY_IDENTIFIER LC_TEST_HBR_0_ FORMAT "%1.0" /end CHARACTERISTIC
/begin CHARACTERISTIC lc_test_hbr[1] "" VALUE 0x85ceb1 _REC_VAL_20_u1 1. _CNV_A_R_LINEAR_____0_CM 0. 1. DISPLAY_IDENTIFIER LC_TEST_HBR_1_ FORMAT "%1.0" /end CHARACTERISTIC
/begin CHARACTERISTIC lc_dir_chg_hbr[0] "" VALUE 0x85ce68 _REC_VAL_20_u1 1. _CNV_A_R_LINEAR_____0_CM 0. 1. DISPLAY_IDENTIFIER LC_DIR_CHG_HBR_0_ FORMAT "%1.0" /end CHARACTERISTIC
/begin CHARACTERISTIC lc_dir_chg_hbr[1] "" VALUE 0x85ce69 _REC_VAL_20_u1 1. _CNV_A_R_LINEAR_____0_CM 0. 1. DISPLAY_IDENTIFIER LC_DIR_CHG_HBR_1_ FORMAT "%1.0" /end CHARACTERISTIC
/begin CHARACTERISTIC c_test_hbr[0] "" VALUE 0x85ccf6 _REC_VAL_20_s2 199.996948242 _CNV_A_R_LINEAR_____12_CM -100. 99.996948242 DISPLAY_IDENTIFIER C_TEST_HBR_0_ FORMAT "%7.3" /end CHARACTERISTIC
/begin CHARACTERISTIC c_test_hbr[1] "" VALUE 0x85ccf8 _REC_VAL_20_s2 199.996948242 _CNV_A_R_LINEAR_____12_CM -100. 99.996948242 DISPLAY_IDENTIFIER C_TEST_HBR_1_ FORMAT "%7.3" /end CHARACTERISTIC
/begin CHARACTERISTIC c_crlc_cor_hbr[0] "" VALUE 0x85c8fa _REC_VAL_20_u2 0.9999847412109381 _CNV_A_R_LINEAR_____14_CM 0. 0.9999847412109381 DISPLAY_IDENTIFIER C_CRLC_COR_HBR_0_ FORMAT "%6.5" /end CHARACTERISTIC
/begin CHARACTERISTIC c_crlc_cor_hbr[1] "" VALUE 0x85c8fc _REC_VAL_20_u2 0.9999847412109381 _CNV_A_R_LINEAR_____14_CM 0. 0.9999847412109381 DISPLAY_IDENTIFIER C_CRLC_COR_HBR_1_ FORMAT "%6.5" /end CHARACTERISTIC
/begin CHARACTERISTIC lc_err_det_upd "logical constant to manage some functionality as the visualisation of sporadic error" VALUE 0x85012a _REC_VAL_20_u1 1. _CNV_A_R_LINEAR_____0_CM 0. 1. DISPLAY_IDENTIFIER LC_ERR_DET_UPD FORMAT "%2.0" /end CHARACTERISTIC
/begin CHARACTERISTIC lc_clr_err_intm "" VALUE 0x85010d _REC_VAL_20_u1 1. _CNV_A_R_LINEAR_____0_CM 0. 1. DISPLAY_IDENTIFIER LC_CLR_ERR_INTM FORMAT "%2.0" /end CHARACTERISTIC
/begin MEASUREMENT err_intm_diag_inst[0] "array of diagnosis instances for intermittent failures" ULONG _CNV_S_180_CONV_DIAG__21_CM 1 0. 0. 179. DISPLAY_IDENTIFIER ERR_INTM_0_DIAG_INST ECU_ADDRESS 0x7fc49c BYTE_ORDER MSB_LAST /end MEASUREMENT
/begin MEASUREMENT err_intm_diag_inst[1] "array of diagnosis instances for intermittent failures" ULONG _CNV_S_180_CONV_DIAG__21_CM 1 0. 0. 179. DISPLAY_IDENTIFIER ERR_INTM_1_DIAG_INST ECU_ADDRESS 0x7fc4a0 BYTE_ORDER MSB_LAST /end MEASUREMENT
/begin MEASUREMENT err_intm_diag_inst[2] "array of diagnosis instances for intermittent failures" ULONG _CNV_S_180_CONV_DIAG__21_CM 1 0. 0. 179. DISPLAY_IDENTIFIER ERR_INTM_2_DIAG_INST ECU_ADDRESS 0x7fc4a4 BYTE_ORDER MSB_LAST /end MEASUREMENT
/begin MEASUREMENT err_intm_diag_inst[3] "array of diagnosis instances for intermittent failures" ULONG _CNV_S_180_CONV_DIAG__21_CM 1 0. 0. 179. DISPLAY_IDENTIFIER ERR_INTM_3_DIAG_INST ECU_ADDRESS 0x7fc4a8 BYTE_ORDER MSB_LAST /end MEASUREMENT
/begin MEASUREMENT err_intm_diag_inst[4] "array of diagnosis instances for intermittent failures" ULONG _CNV_S_180_CONV_DIAG__21_CM 1 0. 0. 179. DISPLAY_IDENTIFIER ERR_INTM_4_DIAG_INST ECU_ADDRESS 0x7fc4ac BYTE_ORDER MSB_LAST /end MEASUREMENT
/begin MEASUREMENT err_intm_diag_inst[5] "array of diagnosis instances for intermittent failures" ULONG _CNV_S_180_CONV_DIAG__21_CM 1 0. 0. 179. DISPLAY_IDENTIFIER ERR_INTM_5_DIAG_INST ECU_ADDRESS 0x7fc4b0 BYTE_ORDER MSB_LAST /end MEASUREMENT
/begin MEASUREMENT err_intm_diag_inst[6] "array of diagnosis instances for intermittent failures" ULONG _CNV_S_180_CONV_DIAG__21_CM 1 0. 0. 179. DISPLAY_IDENTIFIER ERR_INTM_6_DIAG_INST ECU_ADDRESS 0x7fc4b4 BYTE_ORDER MSB_LAST /end MEASUREMENT
/begin MEASUREMENT err_intm_diag_inst[7] "array of diagnosis instances for intermittent failures" ULONG _CNV_S_180_CONV_DIAG__21_CM 1 0. 0. 179. DISPLAY_IDENTIFIER ERR_INTM_7_DIAG_INST ECU_ADDRESS 0x7fc4b8 BYTE_ORDER MSB_LAST /end MEASUREMENT
/begin MEASUREMENT err_intm_diag_inst[8] "array of diagnosis instances for intermittent failures" ULONG _CNV_S_180_CONV_DIAG__21_CM 1 0. 0. 179. DISPLAY_IDENTIFIER ERR_INTM_8_DIAG_INST ECU_ADDRESS 0x7fc4bc BYTE_ORDER MSB_LAST /end MEASUREMENT
/begin MEASUREMENT err_intm_diag_inst[9] "array of diagnosis instances for intermittent failures" ULONG _CNV_S_180_CONV_DIAG__21_CM 1 0. 0. 179. DISPLAY_IDENTIFIER ERR_INTM_9_DIAG_INST ECU_ADDRESS 0x7fc4c0 BYTE_ORDER MSB_LAST /end MEASUREMENT
/begin MEASUREMENT err_intm_ctr_frc[0] "frequency of reappearence of failure stored in intermittente memory" UBYTE _CNV_A_R_LINEAR_____0_CM 1 0. 0. 255. DISPLAY_IDENTIFIER ERR_INTM_0_CTR_FRC ECU_ADDRESS 0x7fc4c4 FORMAT "%3.0" /end MEASUREMENT
/begin MEASUREMENT err_intm_ctr_frc[1] "frequency of reappearence of failure stored in intermittente memory" UBYTE _CNV_A_R_LINEAR_____0_CM 1 0. 0. 255. DISPLAY_IDENTIFIER ERR_INTM_1_CTR_FRC ECU_ADDRESS 0x7fc4c5 FORMAT "%3.0" /end MEASUREMENT
/begin MEASUREMENT err_intm_ctr_frc[2] "frequency of reappearence of failure stored in intermittente memory" UBYTE _CNV_A_R_LINEAR_____0_CM 1 0. 0. 255. DISPLAY_IDENTIFIER ERR_INTM_2_CTR_FRC ECU_ADDRESS 0x7fc4c6 FORMAT "%3.0" /end MEASUREMENT
/begin MEASUREMENT err_intm_ctr_frc[3] "frequency of reappearence of failure stored in intermittente memory" UBYTE _CNV_A_R_LINEAR_____0_CM 1 0. 0. 255. DISPLAY_IDENTIFIER ERR_INTM_3_CTR_FRC ECU_ADDRESS 0x7fc4c7 FORMAT "%3.0" /end MEASUREMENT
/begin MEASUREMENT err_intm_ctr_frc[4] "frequency of reappearence of failure stored in intermittente memory" UBYTE _CNV_A_R_LINEAR_____0_CM 1 0. 0. 255. DISPLAY_IDENTIFIER ERR_INTM_4_CTR_FRC ECU_ADDRESS 0x7fc4c8 FORMAT "%3.0" /end MEASUREMENT
/begin MEASUREMENT err_intm_ctr_frc[5] "frequency of reappearence of failure stored in intermittente memory" UBYTE _CNV_A_R_LINEAR_____0_CM 1 0. 0. 255. DISPLAY_IDENTIFIER ERR_INTM_5_CTR_FRC ECU_ADDRESS 0x7fc4c9 FORMAT "%3.0" /end MEASUREMENT
/begin MEASUREMENT err_intm_ctr_frc[6] "frequency of reappearence of failure stored in intermittente memory" UBYTE _CNV_A_R_LINEAR_____0_CM 1 0. 0. 255. DISPLAY_IDENTIFIER ERR_INTM_6_CTR_FRC ECU_ADDRESS 0x7fc4ca FORMAT "%3.0" /end MEASUREMENT
/begin MEASUREMENT err_intm_ctr_frc[7] "frequency of reappearence of failure stored in intermittente memory" UBYTE _CNV_A_R_LINEAR_____0_CM 1 0. 0. 255. DISPLAY_IDENTIFIER ERR_INTM_7_CTR_FRC ECU_ADDRESS 0x7fc4cb FORMAT "%3.0" /end MEASUREMENT
/begin MEASUREMENT err_intm_ctr_frc[8] "frequency of reappearence of failure stored in intermittente memory" UBYTE _CNV_A_R_LINEAR_____0_CM 1 0. 0. 255. DISPLAY_IDENTIFIER ERR_INTM_8_CTR_FRC ECU_ADDRESS 0x7fc4cc FORMAT "%3.0" /end MEASUREMENT
/begin MEASUREMENT err_intm_ctr_frc[9] "frequency of reappearence of failure stored in intermittente memory" UBYTE _CNV_A_R_LINEAR_____0_CM 1 0. 0. 255. DISPLAY_IDENTIFIER ERR_INTM_9_CTR_FRC ECU_ADDRESS 0x7fc4cd FORMAT "%3.0" /end MEASUREMENT
/begin MEASUREMENT ctr_err_intm_nr "actual number of failures stored in intermittent memory" UBYTE _CNV_A_R_LINEAR_____0_CM 1 0. 0. 255. DISPLAY_IDENTIFIER CTR_ERR_INTM_NR ECU_ADDRESS 0x7fc4ce FORMAT "%3.0" /end MEASUREMENT
/begin AXIS_PTS ldp_dri_id_fac_pl_is "" 0x84160a dri _REC_AXS_20_u1 15. _CNV_P_8_TABLE_______68_CM 7 0. 15. FORMAT "%2.0" /end AXIS_PTS
/begin AXIS_PTS ldp_tco_ip_fac_fil_pl_is "" 0x84229a tco _REC_AXS_20_u1 255. _CNV_A_R_LINEAR_____18_CM 8 -50. 205. FORMAT "%4.0" /end AXIS_PTS
/begin AXIS_PTS ldp_tco_ip_fac_fil_st_is "" 0x8422a3 tco _REC_AXS_20_u1 255. _CNV_A_R_LINEAR_____18_CM 8 -50. 205. FORMAT "%4.0" /end AXIS_PTS
/begin AXIS_PTS ldp_vs_n_id_dri "" 0x842ad4 vs_n _REC_AXS_20_u2 9.e-002 _CNV_A_R_LINEAR_____70_CM 13 0. 0.1 FORMAT "%7.6" /end AXIS_PTS
/begin MEASUREMENT lv_vs_n_con_diag "" UBYTE _CNV_S_2_RANGE______11_CM 1 0. 0. 1. DISPLAY_IDENTIFIER LV_VS_N_CON_DIAG ECU_ADDRESS 0x7fbb53 /end MEASUREMENT
/begin MEASUREMENT tq_req_clu_cor "" SWORD _CNV_A_R_LINEAR_____52_CM 1 0. -1024. 1023.96875 DISPLAY_IDENTIFIER TQ_REQ_CLU_COR ECU_ADDRESS 0x7fa2ba BYTE_ORDER MSB_LAST FORMAT "%7.2" /end MEASUREMENT
/begin MEASUREMENT lv_tcs_hold "" UBYTE _CNV_S_2_RANGE______11_CM 1 0. 0. 1. DISPLAY_IDENTIFIER LV_TCS_HOLD ECU_ADDRESS 0x7fbbf0 /end MEASUREMENT
/begin AXIS_PTS ldpm_dri_aj "" 0x842b4e dri _REC_AXS_20_u1 6. _CNV_A_R_LINEAR_____0_CM 7 0. 6. FORMAT "%1.0" /end AXIS_PTS
/begin AXIS_PTS ldpm_vb_fil_ip_n_inh "" 0x843f32 vb_fil _REC_AXS_20_u1 28.8 _CNV_A_R_LINEAR_____43_CM 5 0. 28.8 FORMAT "%5.3" /end AXIS_PTS
/begin AXIS_PTS ldp_quo_mfw_ip_fac_temp_egr "" 0x84210e quo_mfw_down_egrv_sp _REC_AXS_20_u2 65.535 _CNV_A_R_LINEAR_____162_CM 12 0. 65.535 FORMAT "%6.5" /end AXIS_PTS
/begin MEASUREMENT tqi_av "" SWORD _CNV_A_R_LINEAR_____52_CM 1 0. -1024. 1023.96875 DISPLAY_IDENTIFIER TQI_AV ECU_ADDRESS 0x7f980e BYTE_ORDER MSB_LAST FORMAT "%4.2" /end MEASUREMENT
/begin MEASUREMENT tqi_ems "" SWORD _CNV_A_R_LINEAR_____52_CM 1 0. -1024. 1023.96875 DISPLAY_IDENTIFIER TQI_EMS ECU_ADDRESS 0x7f9810 BYTE_ORDER MSB_LAST /end MEASUREMENT
/begin MEASUREMENT tqi_ref_max "" SWORD _CNV_A_R_LINEAR_____52_CM 1 0. -1024. 1023.96875 DISPLAY_IDENTIFIER TQI_REF_MAX ECU_ADDRESS 0x7f9812 BYTE_ORDER MSB_LAST /end MEASUREMENT
/begin MEASUREMENT eff_iga_bas_cor "" UWORD _CNV_A_R_LINEAR_____48_CM 1 0. 0. 1.9999696 DISPLAY_IDENTIFIER EFF_IGA_BAS_COR ECU_ADDRESS 0x7f9814 BYTE_ORDER MSB_LAST /end MEASUREMENT
/begin MEASUREMENT tqi_ref_iga_min_lamb "" SWORD _CNV_A_R_LINEAR_____52_CM 1 0. -1024. 1023.96875 DISPLAY_IDENTIFIER TQI_REF_IGA_MIN_LAMB ECU_ADDRESS 0x7f9816 BYTE_ORDER MSB_LAST /end MEASUREMENT
/begin MEASUREMENT vs_high_res "Fahrzeuggeschwindigkeit" UWORD _CNV_A_R_LINEAR_____71_CM 1 0. 0. 327.67 DISPLAY_IDENTIFIER VS_HIGH_RES ECU_ADDRESS 0x7f981a BYTE_ORDER MSB_LAST /end MEASUREMENT
/begin MEASUREMENT tps_av "Drosselklappenwinkel" UWORD _CNV_A_R_LINEAR_____235_CM 1 0. 0. 119.5 DISPLAY_IDENTIFIER TPS_AV ECU_ADDRESS 0x7f981c BYTE_ORDER MSB_LAST /end MEASUREMENT
/begin MEASUREMENT tqi_bas "" SWORD _CNV_A_R_LINEAR_____52_CM 1 0. -1024. 1023.96875 DISPLAY_IDENTIFIER TQI_BAS ECU_ADDRESS 0x7f9818 BYTE_ORDER MSB_LAST /end MEASUREMENT
/begin MEASUREMENT amp_ad "" UWORD _CNV_A_R_LINEAR_____45_CM 1 0. 0. 5434. DISPLAY_IDENTIFIER AMP_AD ECU_ADDRESS 0x7f981e BYTE_ORDER MSB_LAST /end MEASUREMENT
/begin MEASUREMENT lv_ct "Leergasinformation" UBYTE _CNV_A_R_LINEAR_____0_CM 1 0. 0. 1. DISPLAY_IDENTIFIER LV_CT ECU_ADDRESS 0x7fb7b7 FORMAT "%1.0" /end MEASUREMENT
/begin MEASUREMENT lv_ac_cru_sp_ena "GRA-Bremseingriff Freigabe" UBYTE _CNV_S_2_RANGE__0___85_CM 1 0. 0. 1. DISPLAY_IDENTIFIER LV_AC_CRU_SP_ENA ECU_ADDRESS 0x7fb7b8 BIT_MASK 0x1 /end MEASUREMENT
/begin MEASUREMENT lv_acc_red_cmd "Leistungsreduzierung Klimakompressor" UBYTE _CNV_S_2_RANGE__0___85_CM 1 0. 0. 1. DISPLAY_IDENTIFIER LV_ACC_RED_CMD ECU_ADDRESS 0x7fb7ba BIT_MASK 0x1 /end MEASUREMENT
/begin MEASUREMENT lv_temp_pwal "heissleuchtenvorwarnung" UBYTE _CNV_S_2_RANGE__0___85_CM 1 0. 0. 1. DISPLAY_IDENTIFIER LV_TEMP_PWAL ECU_ADDRESS 0x7fb7bb BIT_MASK 0x1 /end MEASUREMENT
/begin MEASUREMENT gen_load_resp_ems1 "Motor Wunschdrehzahl Prioritaet" UBYTE _CNV_A_R_LINEAR_____0_CM 1 0. 0. 3. DISPLAY_IDENTIFIER GEN_LOAD_RESP_EMS1 ECU_ADDRESS 0x7fb7b4 FORMAT "%2.0" BIT_MASK 0x1 /end MEASUREMENT
/begin MEASUREMENT alter_inh "lastabwurf generatorspannung" UBYTE _CNV_A_R_LINEAR_____0_CM 1 0. 0. 3. DISPLAY_IDENTIFIER ALTER_INH ECU_ADDRESS 0x7fb7b5 FORMAT "%2.0" BIT_MASK 0x1 /end MEASUREMENT
/begin MEASUREMENT lv_alter_act "einschalten generator" UBYTE _CNV_S_2_RANGE__0___85_CM 1 0. 0. 1. DISPLAY_IDENTIFIER LV_ALTER_ACT ECU_ADDRESS 0x7fb7bc BIT_MASK 0x1 /end MEASUREMENT
/begin MEASUREMENT lv_heat_inh "lastabwurf heizsysteme" UBYTE _CNV_S_2_RANGE__0___85_CM 1 0. 0. 1. DISPLAY_IDENTIFIER LV_HEAT_INH ECU_ADDRESS 0x7fb7bd BIT_MASK 0x1 /end MEASUREMENT
/begin MEASUREMENT lv_vs_lim_act "geschwindigkeitsbegrenzung aktiv" UBYTE _CNV_S_2_RANGE__0___85_CM 1 0. 0. 1. DISPLAY_IDENTIFIER LV_VS_LIM_ACT ECU_ADDRESS 0x7fb7be BIT_MASK 0x1 /end MEASUREMENT
/begin MEASUREMENT lv_tqi_stnd "doppelte momente" UBYTE _CNV_S_2_RANGE__0___85_CM 1 0. 0. 1. DISPLAY_IDENTIFIER LV_TQI_STND ECU_ADDRESS 0x7fb7bf BIT_MASK 0x1 /end MEASUREMENT
/begin MEASUREMENT lv_err_amp "fehler umgebungsluftdruck" UBYTE _CNV_S_2_RANGE__0___85_CM 1 0. 0. 1. DISPLAY_IDENTIFIER LV_ERR_AMP ECU_ADDRESS 0x7fb7c0 BIT_MASK 0x1 /end MEASUREMENT
/begin MEASUREMENT lv_n_max_req_tcu "Motor Wunschdrehzahl Prioritaet" UBYTE _CNV_S_2_RANGE__0___85_CM 1 0. 0. 1. DISPLAY_IDENTIFIER LV_N_MAX_REQ_TCU ECU_ADDRESS 0x7fb7b9 BIT_MASK 0x1 /end MEASUREMENT
/begin MEASUREMENT n_max_req_tcu "motor wunschdrehzahl (FFh=fehlerwert)" UBYTE _CNV_A_R_LINEAR_____236_CM 1 0. 0. 6350. DISPLAY_IDENTIFIER N_MAX_REQ_TCU ECU_ADDRESS 0x7fb7b3 FORMAT "%4.0" BIT_MASK 0x1 /end MEASUREMENT
/begin MEASUREMENT tco_stop "TCO threshold for cancellation of power latch pahse 2" UBYTE _CNV_A_R_LINEAR_____241_CM 1 0. -48. 142.5 DISPLAY_IDENTIFIER TCO_STOP ECU_ADDRESS 0x7fbc18 FORMAT "%5.1" /end MEASUREMENT
/begin MEASUREMENT tco_warn "Coolant temperature for overheating protection" UBYTE _CNV_A_R_LINEAR_____241_CM 1 0. -48. 142.5 DISPLAY_IDENTIFIER TCO_WARN ECU_ADDRESS 0x7fbc1a FORMAT "%5.1" /end MEASUREMENT
/begin MEASUREMENT t_ast_stop "Time after exit start to after start saved in the non-volatile memory at engine shut down" UWORD _CNV_A_R_LINEAR_____240_CM 1 0. 0. 6553.5 DISPLAY_IDENTIFIER T_AST_STOP ECU_ADDRESS 0x7fa326 BYTE_ORDER MSB_LAST FORMAT "%6.1" /end MEASUREMENT
/begin MEASUREMENT v_hvr "Heater request (Poti)" UWORD _CNV_A_R_LINEAR_____28_CM 1 0. 0. 4.9951171875 DISPLAY_IDENTIFIER V_HVR ECU_ADDRESS 0x7fa320 BYTE_ORDER MSB_LAST FORMAT "%6.5" /end MEASUREMENT
/begin MEASUREMENT tqi_req_slow "Torque request" SWORD _CNV_A_R_LINEAR_____52_CM 1 0. -1024. 1023.96875 DISPLAY_IDENTIFIER TQI_REQ_SLOW ECU_ADDRESS 0x7fa322 BYTE_ORDER MSB_LAST FORMAT "%8.4" /end MEASUREMENT
/begin MEASUREMENT tqi_req_tra "Torque request" SWORD _CNV_A_R_LINEAR_____52_CM 1 0. -1024. 1023.96875 DISPLAY_IDENTIFIER TQI_REQ_TRA ECU_ADDRESS 0x7fa324 BYTE_ORDER MSB_LAST FORMAT "%8.4" /end MEASUREMENT
/begin MEASUREMENT lv_accin_on "Air conditioning on" UBYTE _CNV_S_2_RANGE__0___85_CM 1 0. 0. 1. DISPLAY_IDENTIFIER LV_ACCIN_ON ECU_ADDRESS 0x7fbc19 BIT_MASK 0x1 /end MEASUREMENT
/begin CHARACTERISTIC ip_tco_warn "Coolant temperature for overheating protection" MAP 0x84f4ba _REC_MAP_20_u1_u1_u2 190.5 _CNV_A_R_LINEAR_____241_CM -48. 142.5 DISPLAY_IDENTIFIER IP_TCO_WARN FORMAT "%5.1"
 /begin AXIS_DESCR COM_AXIS tco _CNV_A_R_LINEAR_____18_CM 6 -50. 205. AXIS_PTS_REF ldp_tco_ip_tco_warn /end AXIS_DESCR
 /begin AXIS_DESCR COM_AXIS fco_t _CNV_A_R_LINEAR_____255_CM 6 0. 16.38375 FORMAT "%7.2" AXIS_PTS_REF ldp_fco_t_ip_tco_warn /end AXIS_DESCR
/end CHARACTERISTIC
/begin AXIS_PTS ldp_tco_ip_tco_warn "" 0x8442a4 tco _REC_AXS_20_u1 255. _CNV_A_R_LINEAR_____18_CM 6 -50. 205. /end AXIS_PTS
/begin AXIS_PTS ldp_fco_t_ip_tco_warn "" 0x844014 fco_t _REC_AXS_20_u2 16.38375 _CNV_A_R_LINEAR_____255_CM 6 0. 16.38375 FORMAT "%7.2" /end AXIS_PTS
/begin MEASUREMENT toil_mdl "Model For Oil Temperature" UBYTE _CNV_A_R_LINEAR_____300_CM 1 0. -60. 195. DISPLAY_IDENTIFIER TOIL_MDL ECU_ADDRESS 0x7fbb6b FORMAT "%3.0" /end MEASUREMENT
/begin CHARACTERISTIC c_tqi_sp_max_toil_mdl "Upper Limit for Rev. Time" VALUE 0x850072 _REC_VAL_20_s2 2047.96875 _CNV_A_R_LINEAR_____52_CM -1024. 1023.96875 DISPLAY_IDENTIFIER C_TQI_SP_MAX_TOIL_MDL FORMAT "%8.4" /end CHARACTERISTIC
/begin CHARACTERISTIC c_tqi_sp_min_toil_mdl "Lower Limit for rev. Time" VALUE 0x850074 _REC_VAL_20_s2 2047.96875 _CNV_A_R_LINEAR_____52_CM -1024. 1023.96875 DISPLAY_IDENTIFIER C_TQI_SP_MIN_TOIL_MDL FORMAT "%8.4" /end CHARACTERISTIC
/begin CHARACTERISTIC c_n_max_toil_mdl "Maximal Zulassige Drehzahl fuer TOIL_MDL." VALUE 0x84fdf7 _REC_VAL_20_u1 8160. _CNV_A_R_LINEAR_____81_CM 0. 8160. DISPLAY_IDENTIFIER C_N_MAX_TOIL_MDL FORMAT "%4.0" /end CHARACTERISTIC
/begin CHARACTERISTIC c_n_min_toil_mdl "Minimale Zulassige Drehzahl fuer TOIL_MDL." VALUE 0x84fdf9 _REC_VAL_20_u1 8160. _CNV_A_R_LINEAR_____81_CM 0. 8160. DISPLAY_IDENTIFIER C_N_MIN_TOIL_MDL FORMAT "%4.0" /end CHARACTERISTIC
/begin CHARACTERISTIC ip_toil_mdl "Data Map For OIl Temperature Model" MAP 0x84f69a _REC_MAP_20_u1_u2_u2 255. _CNV_A_R_LINEAR_____20_CM 0. 255. DISPLAY_IDENTIFIER IP_TOIL_MDL FORMAT "%3.0"
 /begin AXIS_DESCR COM_AXIS n _CNV_A_R_LINEAR_____154_CM 10 0. 8160. FORMAT "%4.0" AXIS_PTS_REF ldp_n_wiv_ip_toil_mdl /end AXIS_DESCR
 /begin AXIS_DESCR COM_AXIS tqi_sp _CNV_A_R_LINEAR_____80_CM 5 -1024. 1023.97875 FORMAT "%8.2" AXIS_PTS_REF ldp_tqi_sp /end AXIS_DESCR
/end CHARACTERISTIC
/begin AXIS_PTS ldp_n_wiv_ip_toil_mdl "X Axis LDP for IP_TOIL_MDL" 0x841fba n _REC_AXS_20_u2 8160. _CNV_A_R_LINEAR_____154_CM 10 0. 8160. FORMAT "%4.0" /end AXIS_PTS
/begin AXIS_PTS ldp_tqi_sp "Y Axis LDP for IP_TOIL_MDL" 0x84278c tqi_sp _REC_AXS_20_u2 2047.97875 _CNV_A_R_LINEAR_____80_CM 5 -1024. 1023.97875 FORMAT "%8.2" /end AXIS_PTS
/begin CHARACTERISTIC c_fac_toil_mdl "Filter Factor for Oil Temperature" VALUE 0x84fd4e _REC_VAL_20_u2 0.9999847412109381 _CNV_A_R_LINEAR_____137_CM 0. 0.9999847412109381 DISPLAY_IDENTIFIER C_FAC_TOIL_MDL FORMAT "%7.5" /end CHARACTERISTIC
/begin CHARACTERISTIC c_toil_mdl_sub "Replacement Value for Oil Temperature" VALUE 0x850048 _REC_VAL_20_u1 255. _CNV_A_R_LINEAR_____300_CM -60. 195. DISPLAY_IDENTIFIER C_TOIL_MDL_SUB FORMAT "%3.0" /end CHARACTERISTIC
/begin MEASUREMENT mff_sp_mv "Mass fuel flow set point after combustoin selection" UWORD _CNV_A_R_LINEAR_____60_CM 1 0. 0. 1389. DISPLAY_IDENTIFIER MFF_SP_MV ECU_ADDRESS 0x7fa330 BYTE_ORDER MSB_LAST FORMAT "%4.0" /end MEASUREMENT
/begin MEASUREMENT eff_scc_av "Actual authorized efficiency fuel cut off" UWORD _CNV_A_R_LINEAR_____318_CM 1 0. 0. 1.999969 DISPLAY_IDENTIFIER EFF_SCC_AV ECU_ADDRESS 0x7fa332 BYTE_ORDER MSB_LAST FORMAT "%1.6" /end MEASUREMENT
/begin MEASUREMENT vs_used "used vehicle speed signal" UBYTE _CNV_A_R_LINEAR_____1_CM 1 0. 0. 4. DISPLAY_IDENTIFIER VS_USED ECU_ADDRESS 0x7fbb72 FORMAT "%1.0" /end MEASUREMENT
/begin MEASUREMENT fac_cyl_bal_fdout_mf "correction of cylinder balancing factors as function of fuelmass" UWORD _CNV_A_R_LINEAR_____375_CM 1 0. 0. 1. DISPLAY_IDENTIFIER FAC_CYL_BAL_FDOUT_MF ECU_ADDRESS 0x7fa60e BYTE_ORDER MSB_LAST FORMAT "%5.4" /end MEASUREMENT
/begin AXIS_PTS ldpm_n_32__drv2_er "ER: weighting factor for engine roughness curvature component calculation (correction amount), MT vehicle" 0x842ec0 n_32 _REC_AXS_20_u1 8160. _CNV_A_R_LINEAR_____55_CM 4 0. 8160. FORMAT "%4.0" /end AXIS_PTS
/begin AXIS_PTS ldpm_clas_a_id_clas_fmy "" 0x842b2c online_dummy _REC_AXS_20_u2 65535. _CNV_A_R_LINEAR_____1_CM 16 0. 65535. FORMAT "%5.0" /end AXIS_PTS
/begin AXIS_PTS ldp_clas_b_id_clas_fmy "" 0x84147e online_dummy _REC_AXS_20_u2 65535. _CNV_A_R_LINEAR_____1_CM 4 0. 65535. FORMAT "%5.0" /end AXIS_PTS
/begin AXIS_PTS ldp_n_32_n_grd_thd "Engine speed gradient threshold for filtering of basic engine speed gradient" 0x84191d n_32 _REC_AXS_20_u1 8160. _CNV_A_R_LINEAR_____30_CM 6 0. 8160. FORMAT "%4.0" /end AXIS_PTS
/begin AXIS_PTS ldpm_gear "P-control parameter for N_MAX-controller automatic transmission" 0x842ba4 dri _REC_AXS_20_u1 255. _CNV_A_R_LINEAR_____0_CM 9 0. 255. FORMAT "%3.0" /end AXIS_PTS
/begin MEASUREMENT lv_vb_jump "jump start recognition status" UBYTE _CNV_S_2_RANGE______395_CM 1 0. 0. 255. DISPLAY_IDENTIFIER LV_VB_JUMP ECU_ADDRESS 0x7fbb4b /end MEASUREMENT
/begin AXIS_PTS ldp_v_maf_id_maf_x "" 0x8429a8 v_maf_x _REC_AXS_20_u1 15. _CNV_A_R_LINEAR_____0_CM 16 0. 15. FORMAT "%2.0" /end AXIS_PTS
/begin AXIS_PTS ldp_v_maf_id_maf_y "" 0x8429b9 v_maf_y _REC_AXS_20_u1 15. _CNV_A_R_LINEAR_____0_CM 16 0. 15. FORMAT "%2.0" /end AXIS_PTS
/begin AXIS_PTS ldp_tco_2_inj_x "" 0x842272 tco _REC_AXS_20_u1 255. _CNV_A_R_LINEAR_____18_CM 1 -50. 205. FORMAT "%3.0" /end AXIS_PTS
/begin AXIS_PTS ldp_tco_3_inj_x "" 0x842274 tco _REC_AXS_20_u1 255. _CNV_A_R_LINEAR_____18_CM 1 -50. 205. FORMAT "%3.0" /end AXIS_PTS
/begin AXIS_PTS ldp_t_ad_bpa_tol__ip_ad_bpa "" 0x8421b2 t_ad_bpa_tol_av[0] _REC_AXS_20_u2 65.535 _CNV_A_R_LINEAR_____73_CM 4 0. 65.535 FORMAT "%5.3" /end AXIS_PTS
/begin AXIS_PTS ldp_t_ad_bpa_bol__ip_ad_bpa "" 0x8421a8 t_ad_bpa_bol_av[0] _REC_AXS_20_u2 65.535 _CNV_A_R_LINEAR_____73_CM 4 0. 65.535 FORMAT "%5.3" /end AXIS_PTS
/begin AXIS_PTS ldp_t_ad_egrv_tol__ip_ad_egrv "" 0x8421c6 t_ad_egrv_tol_av[0] _REC_AXS_20_u2 65.535 _CNV_A_R_LINEAR_____73_CM 4 0. 65.535 FORMAT "%5.3" /end AXIS_PTS
/begin AXIS_PTS ldp_t_ad_egrv_bol__ip_ad_egrv "" 0x8421bc t_ad_egrv_bol_av[0] _REC_AXS_20_u2 65.535 _CNV_A_R_LINEAR_____73_CM 4 0. 65.535 FORMAT "%5.3" /end AXIS_PTS
/begin AXIS_PTS ldp_n_ip_egrvpwm "" 0x8419fe n _REC_AXS_20_u2 6375. _CNV_A_R_LINEAR_____5_CM 10 0. 6375. FORMAT "%4.0" /end AXIS_PTS
/begin AXIS_PTS ldp_mafpwm_ip_egrvpwm "" 0x8417e4 mafpwm _REC_AXS_20_u2 99.9969482421875 _CNV_A_R_LINEAR_____136_CM 16 0. 99.9969482421875 FORMAT "%4.2" /end AXIS_PTS
/begin AXIS_PTS ldp_ar_egrv_ip_egrvpwm "" 0x8413ee ar_egrv_ctl_the _REC_AXS_20_u2 78.08 _CNV_A_R_LINEAR_____7_CM 12 0. 78.08 FORMAT "%6.4" /end AXIS_PTS
/begin MEASUREMENT lv_vs_whl_lim_can "Geschwindigkeitsbegrenzung" UBYTE _CNV_S_2_RANGE__0___85_CM 1 0. 0. 1. DISPLAY_IDENTIFIER LV_VS_WHL_LIM_CAN ECU_ADDRESS 0x7fb7c4 /end MEASUREMENT
/begin MEASUREMENT lv_whl_can_vld "Flag fuer 'Allrad 1'-Botschaft gueltig " UBYTE _CNV_S_2_RANGE__0___85_CM 1 0. 0. 1. DISPLAY_IDENTIFIER LV_WHL_CAN_VLD ECU_ADDRESS 0x7fb7c5 /end MEASUREMENT
/begin MEASUREMENT lv_tcu_conf_can "getriebesteuergeraet im CAN netwerk" UBYTE _CNV_S_2_RANGE__0___85_CM 1 0. 0. 1. DISPLAY_IDENTIFIER LV_TCU_CONF_CAN ECU_ADDRESS 0x7fb7e0 BIT_MASK 0x1 /end MEASUREMENT
/begin MEASUREMENT lv_clima_conf_can "klimasteuergeraet komfort im CAN netwerk" UBYTE _CNV_S_2_RANGE__0___85_CM 1 0. 0. 1. DISPLAY_IDENTIFIER LV_CLIMA_CONF_CAN ECU_ADDRESS 0x7fb7e2 BIT_MASK 0x1 /end MEASUREMENT
/begin MEASUREMENT lv_nom_sys_can_vld "flag fuer 'sollverbauliste_neu'  botschaft gueltig " UBYTE _CNV_S_2_RANGE__0___85_CM 1 0. 0. 1. DISPLAY_IDENTIFIER LV_NOM_SYS_CAN_VLD ECU_ADDRESS 0x7fb7e1 BIT_MASK 0x1 /end MEASUREMENT
/begin MEASUREMENT lv_conf_info_vld "Verbauinformation gueltig" UBYTE _CNV_S_2_RANGE__0___85_CM 1 0. 0. 1. DISPLAY_IDENTIFIER LV_CONF_INFO_VLD ECU_ADDRESS 0x7fb7c6 BIT_MASK 0x1 /end MEASUREMENT
/begin MEASUREMENT lv_sys_info_can_vld "Flag fuer 'Systeminfo 1'-Botschaft gueltig " UBYTE _CNV_S_2_RANGE__0___85_CM 1 0. 0. 1. DISPLAY_IDENTIFIER LV_SYS_INFO_CAN_VLD ECU_ADDRESS 0x7fb7c7 BIT_MASK 0x1 /end MEASUREMENT
/begin CHARACTERISTIC c_can_imob_data_req_max "" VALUE 0x84fbe0 _REC_VAL_20_u1 255. _CNV_A_R_LINEAR_____1_CM 0. 255. DISPLAY_IDENTIFIER C_CAN_IMOB_DATA_REQ_MAX FORMAT "%3.0" /end CHARACTERISTIC
/begin CHARACTERISTIC c_imob4_max_req_time "" VALUE 0x84fd6a _REC_VAL_20_u2 254. _CNV_A_R_LINEAR_____240_CM 1. 255. DISPLAY_IDENTIFIER C_IMOB4_MAX_REQ_TIME FORMAT "%6.1" /end CHARACTERISTIC
/begin CHARACTERISTIC lc_ena_dwnld "" VALUE 0x850123 _REC_VAL_20_u1 1. _CNV_A_R_LINEAR_____1_CM 0. 1. DISPLAY_IDENTIFIER LC_ENA_DWNLD FORMAT "%1.0" /end CHARACTERISTIC
/begin CHARACTERISTIC c_marken_id "Fahrzeugmarke" VALUE 0x84fdd6 _REC_VAL_20_u1 5. _CNV_S_6_STATE_C_MA_538_CM 1. 6. DISPLAY_IDENTIFIER C_MARKEN_ID /end CHARACTERISTIC
/begin CHARACTERISTIC c_p_klasse "" VALUE 0x84febd _REC_VAL_20_u1 255. _CNV_A_R_LINEAR_____1_CM 0. 255. DISPLAY_IDENTIFIER C_P_KLASSE FORMAT "%3.0" /end CHARACTERISTIC
/begin MEASUREMENT lv_err_imob "" UBYTE _CNV_S_2_RANGE__0___85_CM 1 0. 0. 1. DISPLAY_IDENTIFIER LV_ERR_IMOB ECU_ADDRESS 0x7fb8b1 BIT_MASK 0x1 /end MEASUREMENT
/begin MEASUREMENT lv_imob_inj_off "" UBYTE _CNV_S_2_RANGE__0___85_CM 1 0. 0. 1. DISPLAY_IDENTIFIER LV_IMOB_INJ_OFF ECU_ADDRESS 0x7fbaae BIT_MASK 0x1 /end MEASUREMENT
/begin MEASUREMENT lv_imob_igc_off "" UBYTE _CNV_S_2_RANGE__0___85_CM 1 0. 0. 1. DISPLAY_IDENTIFIER LV_IMOB_IGC_OFF ECU_ADDRESS 0x7fbaaf BIT_MASK 0x1 /end MEASUREMENT
/begin CHARACTERISTIC lc_ena_retrain_ecu "" VALUE 0x850126 _REC_VAL_20_u1 1. _CNV_A_R_LINEAR_____1_CM 0. 1. DISPLAY_IDENTIFIER LC_ENA_RETRAIN_ECU FORMAT "%1.0" /end CHARACTERISTIC
/begin CHARACTERISTIC lc_ena_retrain_ims "" VALUE 0x850127 _REC_VAL_20_u1 1. _CNV_A_R_LINEAR_____1_CM 0. 1. DISPLAY_IDENTIFIER LC_ENA_RETRAIN_IMS FORMAT "%1.0" /end CHARACTERISTIC
/begin MEASUREMENT burst_mes_mode "burst measurement mode" UBYTE _CNV_A_R_LINEAR_____0_CM 1 0. 0. 5. DISPLAY_IDENTIFIER BURST_MES_MODE ECU_ADDRESS 0x7fbacb FORMAT "%1.0" /end MEASUREMENT
/begin MEASUREMENT burst_mes_mode_[0] "burst measurement mode (cylinder individual)" UBYTE _CNV_A_R_LINEAR_____0_CM 1 0. 0. 5. DISPLAY_IDENTIFIER BURST_MES_MODE__0_ ECU_ADDRESS 0x7fbacc FORMAT "%1.0" /end MEASUREMENT
/begin MEASUREMENT burst_mes_mode_[1] "burst measurement mode (cylinder individual)" UBYTE _CNV_A_R_LINEAR_____0_CM 1 0. 0. 5. DISPLAY_IDENTIFIER BURST_MES_MODE__1_ ECU_ADDRESS 0x7fbacd FORMAT "%1.0" /end MEASUREMENT
/begin MEASUREMENT burst_mes_mode_[2] "burst measurement mode (cylinder individual)" UBYTE _CNV_A_R_LINEAR_____0_CM 1 0. 0. 5. DISPLAY_IDENTIFIER BURST_MES_MODE__2_ ECU_ADDRESS 0x7fbace FORMAT "%1.0" /end MEASUREMENT
/begin MEASUREMENT burst_mes_mode_[3] "burst measurement mode (cylinder individual)" UBYTE _CNV_A_R_LINEAR_____0_CM 1 0. 0. 5. DISPLAY_IDENTIFIER BURST_MES_MODE__3_ ECU_ADDRESS 0x7fbacf FORMAT "%1.0" /end MEASUREMENT
/begin MEASUREMENT sf_t_iv_close_ctl_sel "status word for injection valve close controller selection" UWORD _CNV_A_R_LINEAR_____0_CM 1 0. 0. 65535. DISPLAY_IDENTIFIER SF_T_IV_CLOSE_CTL_SEL ECU_ADDRESS 0x7f9f1c BYTE_ORDER MSB_LAST FORMAT "%5.0" /end MEASUREMENT
/begin MEASUREMENT sf_iv_foc_ctl_sel "status word for thrust controller selection" UWORD _CNV_A_R_LINEAR_____0_CM 1 0. 0. 65535. DISPLAY_IDENTIFIER SF_IV_FOC_CTL_SEL ECU_ADDRESS 0x7f9f26 BYTE_ORDER MSB_LAST FORMAT "%5.0" /end MEASUREMENT
/begin MEASUREMENT sf_pui_acq_sel "status word for peco data acquisition selection" UWORD _CNV_A_R_LINEAR_____0_CM 1 0. 0. 65535. DISPLAY_IDENTIFIER SF_PUI_ACQ_SEL ECU_ADDRESS 0x7f9f24 BYTE_ORDER MSB_LAST FORMAT "%5.0" /end MEASUREMENT
/begin MEASUREMENT sf_egy_ctl_sel "status word for energy controller selection" UWORD _CNV_A_R_LINEAR_____0_CM 1 0. 0. 65535. DISPLAY_IDENTIFIER SF_EGY_CTL_SEL ECU_ADDRESS 0x7f9f20 BYTE_ORDER MSB_LAST FORMAT "%5.0" /end MEASUREMENT
/begin MEASUREMENT sf_egy_mes_sel "status word for energy measurement selection" UWORD _CNV_A_R_LINEAR_____0_CM 1 0. 0. 65535. DISPLAY_IDENTIFIER SF_EGY_MES_SEL ECU_ADDRESS 0x7f9f1e BYTE_ORDER MSB_LAST FORMAT "%5.0" /end MEASUREMENT
/begin MEASUREMENT sf_stk_ctl_sel "status word for stroke controller selection" UWORD _CNV_A_R_LINEAR_____0_CM 1 0. 0. 65535. DISPLAY_IDENTIFIER SF_STK_CTL_SEL ECU_ADDRESS 0x7f9f22 BYTE_ORDER MSB_LAST FORMAT "%5.0" /end MEASUREMENT
/begin MEASUREMENT seg_nr_peco_cord "actual segment number of peco coordinator" UBYTE _CNV_A_R_LINEAR_____0_CM 1 0. 0. 15. DISPLAY_IDENTIFIER SEG_NR_PECO_CORD ECU_ADDRESS 0x7fbeff FORMAT "%1.0" /end MEASUREMENT
/begin MEASUREMENT sf_eng_state_[0] "cylinder individual engine states (01: ES; 02: ST; 04: IS; 08: PL)" UBYTE _CNV_S_4_Engine_Sta_342_CM 1 0. 1. 8. DISPLAY_IDENTIFIER SF_ENG_STATE__0_ ECU_ADDRESS 0x7fbad0 /end MEASUREMENT
/begin MEASUREMENT sf_eng_state_[1] "cylinder individual engine states (01: ES; 02: ST; 04: IS; 08: PL)" UBYTE _CNV_S_4_Engine_Sta_342_CM 1 0. 1. 8. DISPLAY_IDENTIFIER SF_ENG_STATE__1_ ECU_ADDRESS 0x7fbad1 /end MEASUREMENT
/begin MEASUREMENT sf_eng_state_[2] "cylinder individual engine states (01: ES; 02: ST; 04: IS; 08: PL)" UBYTE _CNV_S_4_Engine_Sta_342_CM 1 0. 1. 8. DISPLAY_IDENTIFIER SF_ENG_STATE__2_ ECU_ADDRESS 0x7fbad2 /end MEASUREMENT
/begin MEASUREMENT sf_eng_state_[3] "cylinder individual engine states (01: ES; 02: ST; 04: IS; 08: PL)" UBYTE _CNV_S_4_Engine_Sta_342_CM 1 0. 1. 8. DISPLAY_IDENTIFIER SF_ENG_STATE__3_ ECU_ADDRESS 0x7fbad3 /end MEASUREMENT
/begin MEASUREMENT lv_num_stk_ast_act "number of strokes after start exceeds limit value" UBYTE _CNV_S_2_RANGE______11_CM 1 0. 0. 1. DISPLAY_IDENTIFIER LV_NUM_STK_AST_ACT ECU_ADDRESS 0x7fbad4 /end MEASUREMENT
/begin CHARACTERISTIC c_num_stk_ast "limit value for number of strokes after start" VALUE 0x84feae _REC_VAL_20_u2 65535. _CNV_A_R_LINEAR_____0_CM 0. 65535. DISPLAY_IDENTIFIER C_NUM_STK_AST FORMAT "%5.0" /end CHARACTERISTIC
/begin MEASUREMENT t_dcha_test_pls "Discharging time of test pulse" UBYTE _CNV_A_R_LINEAR_____223_CM 1 0. 0. 0.31 DISPLAY_IDENTIFIER T_DCHA_TEST_PLS ECU_ADDRESS 0x7fbad7 FORMAT "%3.2" /end MEASUREMENT
/begin MEASUREMENT t_cha_test_pls "Charging time of test pulse" UBYTE _CNV_A_R_LINEAR_____223_CM 1 0. 0. 0.31 DISPLAY_IDENTIFIER T_CHA_TEST_PLS ECU_ADDRESS 0x7fbad6 FORMAT "%3.2" /end MEASUREMENT
/begin MEASUREMENT sf_test_pls_act "indicates active test pulse generation of each injector" UWORD _CNV_A_R_LINEAR_____0_CM 1 0. 0. 65535. DISPLAY_IDENTIFIER SF_TEST_PLS_ACT ECU_ADDRESS 0x7f9f36 BYTE_ORDER MSB_LAST FORMAT "%5.0" /end MEASUREMENT
/begin MEASUREMENT lv_test_pls_act "indicates active test pulse generation" UBYTE _CNV_S_2_RANGE______11_CM 1 0. 0. 1. DISPLAY_IDENTIFIER LV_TEST_PLS_ACT ECU_ADDRESS 0x7fbad5 /end MEASUREMENT
/begin MEASUREMENT t_soi_burst_mes_dly "burst measurement delay after test pulse SOI (mode 2 and 3)" UWORD _CNV_A_R_LINEAR_____211_CM 1 0. 0. 32.767 DISPLAY_IDENTIFIER T_SOI_BURST_MES_DLY ECU_ADDRESS 0x7f9f38 BYTE_ORDER MSB_LAST FORMAT "%5.3" /end MEASUREMENT
/begin MEASUREMENT t_eoi_burst_mes_dly "burst measurement delay after test pulse EOI (mode 1 and 3)" UWORD _CNV_A_R_LINEAR_____211_CM 1 0. 0. 32.767 DISPLAY_IDENTIFIER T_EOI_BURST_MES_DLY ECU_ADDRESS 0x7f9f3a BYTE_ORDER MSB_LAST FORMAT "%5.3" /end MEASUREMENT
/begin MEASUREMENT seg_nr_test_pls "actual segment number for module PECO_TEPL" UBYTE _CNV_A_R_LINEAR_____0_CM 1 0. 0. 15. DISPLAY_IDENTIFIER SEG_NR_TEST_PLS ECU_ADDRESS 0x7fbf02 FORMAT "%1.0" /end MEASUREMENT
/begin MEASUREMENT test_pls_act_ctr "working cycle counter (when test pulse is enabled)" UBYTE _CNV_A_R_LINEAR_____0_CM 1 0. 0. 255. DISPLAY_IDENTIFIER TEST_PLS_ACT_CTR ECU_ADDRESS 0x7fbf03 FORMAT "%3.0" /end MEASUREMENT
/begin MEASUREMENT test_pls_wait_ctr "working cycle counter (when test pulse is disabled)" UBYTE _CNV_A_R_LINEAR_____0_CM 1 0. 0. 255. DISPLAY_IDENTIFIER TEST_PLS_WAIT_CTR ECU_ADDRESS 0x7fbf04 FORMAT "%3.0" /end MEASUREMENT
/begin MEASUREMENT lv_test_pls_vld "engine and activation conditions for test pulse generation are valid (1), else (0)" UBYTE _CNV_S_2_RANGE______11_CM 1 0. 0. 1. DISPLAY_IDENTIFIER LV_TEST_PLS_VLD ECU_ADDRESS 0x7fbf0a /end MEASUREMENT
/begin AXIS_PTS ldpm_n_ip_t_burst_dly "" 0x843526 n _REC_AXS_20_u2 6375. _CNV_A_R_LINEAR_____5_CM 5 0. 6375. FORMAT "%4.0" /end AXIS_PTS
/begin CHARACTERISTIC c_num_fil_value_stk_ma[0] "moving average T_IV_CLOSE_MV-FIR filter numerator coefficient vector" VALUE 0x84fe6a _REC_VAL_20_s2 2. _CNV_A_R_LINEAR_____15_CM -1. 1. DISPLAY_IDENTIFIER C_NUM_FIL_VALUE_STK_MA_0_ FORMAT "%6.5" /end CHARACTERISTIC
/begin CHARACTERISTIC c_num_fil_value_stk_ma[1] "moving average T_IV_CLOSE_MV-FIR filter numerator coefficient vector" VALUE 0x84fe6c _REC_VAL_20_s2 2. _CNV_A_R_LINEAR_____15_CM -1. 1. DISPLAY_IDENTIFIER C_NUM_FIL_VALUE_STK_MA_1_ FORMAT "%6.5" /end CHARACTERISTIC
/begin CHARACTERISTIC c_num_fil_value_stk_ma[2] "moving average T_IV_CLOSE_MV-FIR filter numerator coefficient vector" VALUE 0x84fe6e _REC_VAL_20_s2 2. _CNV_A_R_LINEAR_____15_CM -1. 1. DISPLAY_IDENTIFIER C_NUM_FIL_VALUE_STK_MA_2_ FORMAT "%6.5" /end CHARACTERISTIC
/begin CHARACTERISTIC c_num_fil_value_stk_ma[3] "moving average T_IV_CLOSE_MV-FIR filter numerator coefficient vector" VALUE 0x84fe70 _REC_VAL_20_s2 2. _CNV_A_R_LINEAR_____15_CM -1. 1. DISPLAY_IDENTIFIER C_NUM_FIL_VALUE_STK_MA_3_ FORMAT "%6.5" /end CHARACTERISTIC
/begin CHARACTERISTIC c_dnom_fil_value_stk_ma[0] "moving average T_IV_CLOSE_MV-FIR filter denominator coefficient vector" VALUE 0x84fc3a _REC_VAL_20_s2 2. _CNV_A_R_LINEAR_____15_CM -1. 1. DISPLAY_IDENTIFIER C_DNOM_FIL_VALUE_STK_MA_0_ FORMAT "%6.5" /end CHARACTERISTIC
/begin CHARACTERISTIC c_dnom_fil_value_stk_ma[1] "moving average T_IV_CLOSE_MV-FIR filter denominator coefficient vector" VALUE 0x84fc3c _REC_VAL_20_s2 2. _CNV_A_R_LINEAR_____15_CM -1. 1. DISPLAY_IDENTIFIER C_DNOM_FIL_VALUE_STK_MA_1_ FORMAT "%6.5" /end CHARACTERISTIC
/begin CHARACTERISTIC c_dnom_fil_value_stk_ma[2] "moving average T_IV_CLOSE_MV-FIR filter denominator coefficient vector" VALUE 0x84fc3e _REC_VAL_20_s2 2. _CNV_A_R_LINEAR_____15_CM -1. 1. DISPLAY_IDENTIFIER C_DNOM_FIL_VALUE_STK_MA_2_ FORMAT "%6.5" /end CHARACTERISTIC
/begin CHARACTERISTIC c_dnom_fil_value_stk_ma[3] "moving average T_IV_CLOSE_MV-FIR filter denominator coefficient vector" VALUE 0x84fc40 _REC_VAL_20_s2 2. _CNV_A_R_LINEAR_____15_CM -1. 1. DISPLAY_IDENTIFIER C_DNOM_FIL_VALUE_STK_MA_3_ FORMAT "%6.5" /end CHARACTERISTIC
/begin MEASUREMENT fac_pwm_dcha_[0] "cylinder individual PWM discharge factor" UWORD _CNV_A_R_LINEAR_____59_CM 1 0. 0. 3.99998471 DISPLAY_IDENTIFIER FAC_PWM_DCHA__0_ ECU_ADDRESS 0x7f9f90 BYTE_ORDER MSB_LAST FORMAT "%6.5" /end MEASUREMENT
/begin MEASUREMENT fac_pwm_dcha_[1] "cylinder individual PWM discharge factor" UWORD _CNV_A_R_LINEAR_____59_CM 1 0. 0. 3.99998471 DISPLAY_IDENTIFIER FAC_PWM_DCHA__1_ ECU_ADDRESS 0x7f9f92 BYTE_ORDER MSB_LAST FORMAT "%6.5" /end MEASUREMENT
/begin MEASUREMENT fac_pwm_dcha_[2] "cylinder individual PWM discharge factor" UWORD _CNV_A_R_LINEAR_____59_CM 1 0. 0. 3.99998471 DISPLAY_IDENTIFIER FAC_PWM_DCHA__2_ ECU_ADDRESS 0x7f9f94 BYTE_ORDER MSB_LAST FORMAT "%6.5" /end MEASUREMENT
/begin MEASUREMENT fac_pwm_dcha_[3] "cylinder individual PWM discharge factor" UWORD _CNV_A_R_LINEAR_____59_CM 1 0. 0. 3.99998471 DISPLAY_IDENTIFIER FAC_PWM_DCHA__3_ ECU_ADDRESS 0x7f9f96 BYTE_ORDER MSB_LAST FORMAT "%6.5" /end MEASUREMENT
/begin MEASUREMENT step_nr_cha_frze_prev1_ctl_[0] "cylinder individual number of charge steps for pulse FROM ZERO PREV1" UBYTE _CNV_A_R_LINEAR_____0_CM 1 0. 0. 30. DISPLAY_IDENTIFIER STEP_NR_CHA_FRZE_PREV1_CTL__0_ ECU_ADDRESS 0x7fbad9 FORMAT "%2.0" /end MEASUREMENT
/begin MEASUREMENT step_nr_cha_frze_prev1_ctl_[1] "cylinder individual number of charge steps for pulse FROM ZERO PREV1" UBYTE _CNV_A_R_LINEAR_____0_CM 1 0. 0. 30. DISPLAY_IDENTIFIER STEP_NR_CHA_FRZE_PREV1_CTL__1_ ECU_ADDRESS 0x7fbada FORMAT "%2.0" /end MEASUREMENT
/begin MEASUREMENT step_nr_cha_frze_prev1_ctl_[2] "cylinder individual number of charge steps for pulse FROM ZERO PREV1" UBYTE _CNV_A_R_LINEAR_____0_CM 1 0. 0. 30. DISPLAY_IDENTIFIER STEP_NR_CHA_FRZE_PREV1_CTL__2_ ECU_ADDRESS 0x7fbadb FORMAT "%2.0" /end MEASUREMENT
/begin MEASUREMENT step_nr_cha_frze_prev1_ctl_[3] "cylinder individual number of charge steps for pulse FROM ZERO PREV1" UBYTE _CNV_A_R_LINEAR_____0_CM 1 0. 0. 30. DISPLAY_IDENTIFIER STEP_NR_CHA_FRZE_PREV1_CTL__3_ ECU_ADDRESS 0x7fbadc FORMAT "%2.0" /end MEASUREMENT
/begin MEASUREMENT step_nr_cha_frze_main1_ctl_[0] "cylinder individual number of charge steps for pulse FROM ZERO MAIN1" UBYTE _CNV_A_R_LINEAR_____0_CM 1 0. 0. 30. DISPLAY_IDENTIFIER STEP_NR_CHA_FRZE_MAIN1_CTL__0_ ECU_ADDRESS 0x7fbae1 FORMAT "%2.0" /end MEASUREMENT
/begin MEASUREMENT step_nr_cha_frze_main1_ctl_[1] "cylinder individual number of charge steps for pulse FROM ZERO MAIN1" UBYTE _CNV_A_R_LINEAR_____0_CM 1 0. 0. 30. DISPLAY_IDENTIFIER STEP_NR_CHA_FRZE_MAIN1_CTL__1_ ECU_ADDRESS 0x7fbae2 FORMAT "%2.0" /end MEASUREMENT
/begin MEASUREMENT step_nr_cha_frze_main1_ctl_[2] "cylinder individual number of charge steps for pulse FROM ZERO MAIN1" UBYTE _CNV_A_R_LINEAR_____0_CM 1 0. 0. 30. DISPLAY_IDENTIFIER STEP_NR_CHA_FRZE_MAIN1_CTL__2_ ECU_ADDRESS 0x7fbae3 FORMAT "%2.0" /end MEASUREMENT
/begin MEASUREMENT step_nr_cha_frze_main1_ctl_[3] "cylinder individual number of charge steps for pulse FROM ZERO MAIN1" UBYTE _CNV_A_R_LINEAR_____0_CM 1 0. 0. 30. DISPLAY_IDENTIFIER STEP_NR_CHA_FRZE_MAIN1_CTL__3_ ECU_ADDRESS 0x7fbae4 FORMAT "%2.0" /end MEASUREMENT
/begin MEASUREMENT step_nr_cha_frze_post1_ctl_[0] "cylinder individual number of charge steps for pulse FROM ZERO POST1" UBYTE _CNV_A_R_LINEAR_____0_CM 1 0. 0. 30. DISPLAY_IDENTIFIER STEP_NR_CHA_FRZE_POST1_CTL__0_ ECU_ADDRESS 0x7fbae9 FORMAT "%2.0" /end MEASUREMENT
/begin MEASUREMENT step_nr_cha_frze_post1_ctl_[1] "cylinder individual number of charge steps for pulse FROM ZERO POST1" UBYTE _CNV_A_R_LINEAR_____0_CM 1 0. 0. 30. DISPLAY_IDENTIFIER STEP_NR_CHA_FRZE_POST1_CTL__1_ ECU_ADDRESS 0x7fbaea FORMAT "%2.0" /end MEASUREMENT
/begin MEASUREMENT step_nr_cha_frze_post1_ctl_[2] "cylinder individual number of charge steps for pulse FROM ZERO POST1" UBYTE _CNV_A_R_LINEAR_____0_CM 1 0. 0. 30. DISPLAY_IDENTIFIER STEP_NR_CHA_FRZE_POST1_CTL__2_ ECU_ADDRESS 0x7fbaeb FORMAT "%2.0" /end MEASUREMENT
/begin MEASUREMENT step_nr_cha_frze_post1_ctl_[3] "cylinder individual number of charge steps for pulse FROM ZERO POST1" UBYTE _CNV_A_R_LINEAR_____0_CM 1 0. 0. 30. DISPLAY_IDENTIFIER STEP_NR_CHA_FRZE_POST1_CTL__3_ ECU_ADDRESS 0x7fbaec FORMAT "%2.0" /end MEASUREMENT
/begin MEASUREMENT t_hld_frze_prev1_ctl_[0] "cylinder individual hold time of pulse FROM ZERO PREV1" UWORD _CNV_A_R_LINEAR_____211_CM 1 0. 0. 32.767 DISPLAY_IDENTIFIER T_HLD_FRZE_PREV1_CTL__0_ ECU_ADDRESS 0x7f9f54 BYTE_ORDER MSB_LAST FORMAT "%5.3" /end MEASUREMENT
/begin MEASUREMENT t_hld_frze_prev1_ctl_[1] "cylinder individual hold time of pulse FROM ZERO PREV1" UWORD _CNV_A_R_LINEAR_____211_CM 1 0. 0. 32.767 DISPLAY_IDENTIFIER T_HLD_FRZE_PREV1_CTL__1_ ECU_ADDRESS 0x7f9f56 BYTE_ORDER MSB_LAST FORMAT "%5.3" /end MEASUREMENT
/begin MEASUREMENT t_hld_frze_prev1_ctl_[2] "cylinder individual hold time of pulse FROM ZERO PREV1" UWORD _CNV_A_R_LINEAR_____211_CM 1 0. 0. 32.767 DISPLAY_IDENTIFIER T_HLD_FRZE_PREV1_CTL__2_ ECU_ADDRESS 0x7f9f58 BYTE_ORDER MSB_LAST FORMAT "%5.3" /end MEASUREMENT
/begin MEASUREMENT t_hld_frze_prev1_ctl_[3] "cylinder individual hold time of pulse FROM ZERO PREV1" UWORD _CNV_A_R_LINEAR_____211_CM 1 0. 0. 32.767 DISPLAY_IDENTIFIER T_HLD_FRZE_PREV1_CTL__3_ ECU_ADDRESS 0x7f9f5a BYTE_ORDER MSB_LAST FORMAT "%5.3" /end MEASUREMENT
/begin MEASUREMENT t_hld_frze_main1_ctl_[0] "cylinder individual hold time of pulse FROM ZERO MAIN1" UWORD _CNV_A_R_LINEAR_____211_CM 1 0. 0. 32.767 DISPLAY_IDENTIFIER T_HLD_FRZE_MAIN1_CTL__0_ ECU_ADDRESS 0x7f9f64 BYTE_ORDER MSB_LAST FORMAT "%5.3" /end MEASUREMENT
/begin MEASUREMENT t_hld_frze_main1_ctl_[1] "cylinder individual hold time of pulse FROM ZERO MAIN1" UWORD _CNV_A_R_LINEAR_____211_CM 1 0. 0. 32.767 DISPLAY_IDENTIFIER T_HLD_FRZE_MAIN1_CTL__1_ ECU_ADDRESS 0x7f9f66 BYTE_ORDER MSB_LAST FORMAT "%5.3" /end MEASUREMENT
/begin MEASUREMENT t_hld_frze_main1_ctl_[2] "cylinder individual hold time of pulse FROM ZERO MAIN1" UWORD _CNV_A_R_LINEAR_____211_CM 1 0. 0. 32.767 DISPLAY_IDENTIFIER T_HLD_FRZE_MAIN1_CTL__2_ ECU_ADDRESS 0x7f9f68 BYTE_ORDER MSB_LAST FORMAT "%5.3" /end MEASUREMENT
/begin MEASUREMENT t_hld_frze_main1_ctl_[3] "cylinder individual hold time of pulse FROM ZERO MAIN1" UWORD _CNV_A_R_LINEAR_____211_CM 1 0. 0. 32.767 DISPLAY_IDENTIFIER T_HLD_FRZE_MAIN1_CTL__3_ ECU_ADDRESS 0x7f9f6a BYTE_ORDER MSB_LAST FORMAT "%5.3" /end MEASUREMENT
/begin MEASUREMENT t_hld_frze_post1_ctl_[0] "cylinder individual hold time of pulse FROM ZERO POST1" UWORD _CNV_A_R_LINEAR_____211_CM 1 0. 0. 32.767 DISPLAY_IDENTIFIER T_HLD_FRZE_POST1_CTL__0_ ECU_ADDRESS 0x7f9f74 BYTE_ORDER MSB_LAST FORMAT "%5.3" /end MEASUREMENT
/begin MEASUREMENT t_hld_frze_post1_ctl_[1] "cylinder individual hold time of pulse FROM ZERO POST1" UWORD _CNV_A_R_LINEAR_____211_CM 1 0. 0. 32.767 DISPLAY_IDENTIFIER T_HLD_FRZE_POST1_CTL__1_ ECU_ADDRESS 0x7f9f76 BYTE_ORDER MSB_LAST FORMAT "%5.3" /end MEASUREMENT
/begin MEASUREMENT t_hld_frze_post1_ctl_[2] "cylinder individual hold time of pulse FROM ZERO POST1" UWORD _CNV_A_R_LINEAR_____211_CM 1 0. 0. 32.767 DISPLAY_IDENTIFIER T_HLD_FRZE_POST1_CTL__2_ ECU_ADDRESS 0x7f9f78 BYTE_ORDER MSB_LAST FORMAT "%5.3" /end MEASUREMENT
/begin MEASUREMENT t_hld_frze_post1_ctl_[3] "cylinder individual hold time of pulse FROM ZERO POST1" UWORD _CNV_A_R_LINEAR_____211_CM 1 0. 0. 32.767 DISPLAY_IDENTIFIER T_HLD_FRZE_POST1_CTL__3_ ECU_ADDRESS 0x7f9f7a BYTE_ORDER MSB_LAST FORMAT "%5.3" /end MEASUREMENT
/begin MEASUREMENT step_nr_dcha_prev1_ctl_[0] "cylinder individual number of discharge steps for pulse PREV1" UBYTE _CNV_A_R_LINEAR_____0_CM 1 0. 0. 30. DISPLAY_IDENTIFIER STEP_NR_DCHA_PREV1_CTL__0_ ECU_ADDRESS 0x7fbadd FORMAT "%2.0" /end MEASUREMENT
/begin MEASUREMENT step_nr_dcha_prev1_ctl_[1] "cylinder individual number of discharge steps for pulse PREV1" UBYTE _CNV_A_R_LINEAR_____0_CM 1 0. 0. 30. DISPLAY_IDENTIFIER STEP_NR_DCHA_PREV1_CTL__1_ ECU_ADDRESS 0x7fbade FORMAT "%2.0" /end MEASUREMENT
/begin MEASUREMENT step_nr_dcha_prev1_ctl_[2] "cylinder individual number of discharge steps for pulse PREV1" UBYTE _CNV_A_R_LINEAR_____0_CM 1 0. 0. 30. DISPLAY_IDENTIFIER STEP_NR_DCHA_PREV1_CTL__2_ ECU_ADDRESS 0x7fbadf FORMAT "%2.0" /end MEASUREMENT
/begin MEASUREMENT step_nr_dcha_prev1_ctl_[3] "cylinder individual number of discharge steps for pulse PREV1" UBYTE _CNV_A_R_LINEAR_____0_CM 1 0. 0. 30. DISPLAY_IDENTIFIER STEP_NR_DCHA_PREV1_CTL__3_ ECU_ADDRESS 0x7fbae0 FORMAT "%2.0" /end MEASUREMENT
/begin MEASUREMENT step_nr_dcha_main1_ctl_[0] "cylinder individual number of discharge steps for pulse MAIN1" UBYTE _CNV_A_R_LINEAR_____0_CM 1 0. 0. 30. DISPLAY_IDENTIFIER STEP_NR_DCHA_MAIN1_CTL__0_ ECU_ADDRESS 0x7fbae5 FORMAT "%2.0" /end MEASUREMENT
/begin MEASUREMENT step_nr_dcha_main1_ctl_[1] "cylinder individual number of discharge steps for pulse MAIN1" UBYTE _CNV_A_R_LINEAR_____0_CM 1 0. 0. 30. DISPLAY_IDENTIFIER STEP_NR_DCHA_MAIN1_CTL__1_ ECU_ADDRESS 0x7fbae6 FORMAT "%2.0" /end MEASUREMENT
/begin MEASUREMENT step_nr_dcha_main1_ctl_[2] "cylinder individual number of discharge steps for pulse MAIN1" UBYTE _CNV_A_R_LINEAR_____0_CM 1 0. 0. 30. DISPLAY_IDENTIFIER STEP_NR_DCHA_MAIN1_CTL__2_ ECU_ADDRESS 0x7fbae7 FORMAT "%2.0" /end MEASUREMENT
/begin MEASUREMENT step_nr_dcha_main1_ctl_[3] "cylinder individual number of discharge steps for pulse MAIN1" UBYTE _CNV_A_R_LINEAR_____0_CM 1 0. 0. 30. DISPLAY_IDENTIFIER STEP_NR_DCHA_MAIN1_CTL__3_ ECU_ADDRESS 0x7fbae8 FORMAT "%2.0" /end MEASUREMENT
/begin MEASUREMENT step_nr_dcha_post1_ctl_[0] "cylinder individual number of discharge steps for pulse POST1" UBYTE _CNV_A_R_LINEAR_____0_CM 1 0. 0. 30. DISPLAY_IDENTIFIER STEP_NR_DCHA_POST1_CTL__0_ ECU_ADDRESS 0x7fbaed FORMAT "%2.0" /end MEASUREMENT
/begin MEASUREMENT step_nr_dcha_post1_ctl_[1] "cylinder individual number of discharge steps for pulse POST1" UBYTE _CNV_A_R_LINEAR_____0_CM 1 0. 0. 30. DISPLAY_IDENTIFIER STEP_NR_DCHA_POST1_CTL__1_ ECU_ADDRESS 0x7fbaee FORMAT "%2.0" /end MEASUREMENT
/begin MEASUREMENT step_nr_dcha_post1_ctl_[2] "cylinder individual number of discharge steps for pulse POST1" UBYTE _CNV_A_R_LINEAR_____0_CM 1 0. 0. 30. DISPLAY_IDENTIFIER STEP_NR_DCHA_POST1_CTL__2_ ECU_ADDRESS 0x7fbaef FORMAT "%2.0" /end MEASUREMENT
/begin MEASUREMENT step_nr_dcha_post1_ctl_[3] "cylinder individual number of discharge steps for pulse POST1" UBYTE _CNV_A_R_LINEAR_____0_CM 1 0. 0. 30. DISPLAY_IDENTIFIER STEP_NR_DCHA_POST1_CTL__3_ ECU_ADDRESS 0x7fbaf0 FORMAT "%2.0" /end MEASUREMENT
/begin MEASUREMENT t_hld_toze_prev1_ctl_[0] "cylinder individual hold time of pulse TO ZERO PREV1" UWORD _CNV_A_R_LINEAR_____211_CM 1 0. 0. 32.767 DISPLAY_IDENTIFIER T_HLD_TOZE_PREV1_CTL__0_ ECU_ADDRESS 0x7f9f5c BYTE_ORDER MSB_LAST FORMAT "%5.3" /end MEASUREMENT
/begin MEASUREMENT t_hld_toze_prev1_ctl_[1] "cylinder individual hold time of pulse TO ZERO PREV1" UWORD _CNV_A_R_LINEAR_____211_CM 1 0. 0. 32.767 DISPLAY_IDENTIFIER T_HLD_TOZE_PREV1_CTL__1_ ECU_ADDRESS 0x7f9f5e BYTE_ORDER MSB_LAST FORMAT "%5.3" /end MEASUREMENT
/begin MEASUREMENT t_hld_toze_prev1_ctl_[2] "cylinder individual hold time of pulse TO ZERO PREV1" UWORD _CNV_A_R_LINEAR_____211_CM 1 0. 0. 32.767 DISPLAY_IDENTIFIER T_HLD_TOZE_PREV1_CTL__2_ ECU_ADDRESS 0x7f9f60 BYTE_ORDER MSB_LAST FORMAT "%5.3" /end MEASUREMENT
/begin MEASUREMENT t_hld_toze_prev1_ctl_[3] "cylinder individual hold time of pulse TO ZERO PREV1" UWORD _CNV_A_R_LINEAR_____211_CM 1 0. 0. 32.767 DISPLAY_IDENTIFIER T_HLD_TOZE_PREV1_CTL__3_ ECU_ADDRESS 0x7f9f62 BYTE_ORDER MSB_LAST FORMAT "%5.3" /end MEASUREMENT
/begin MEASUREMENT t_hld_toze_main1_ctl_[0] "cylinder individual hold time of pulse TO ZERO MAIN1" UWORD _CNV_A_R_LINEAR_____211_CM 1 0. 0. 32.767 DISPLAY_IDENTIFIER T_HLD_TOZE_MAIN1_CTL__0_ ECU_ADDRESS 0x7f9f6c BYTE_ORDER MSB_LAST FORMAT "%5.3" /end MEASUREMENT
/begin MEASUREMENT t_hld_toze_main1_ctl_[1] "cylinder individual hold time of pulse TO ZERO MAIN1" UWORD _CNV_A_R_LINEAR_____211_CM 1 0. 0. 32.767 DISPLAY_IDENTIFIER T_HLD_TOZE_MAIN1_CTL__1_ ECU_ADDRESS 0x7f9f6e BYTE_ORDER MSB_LAST FORMAT "%5.3" /end MEASUREMENT
/begin MEASUREMENT t_hld_toze_main1_ctl_[2] "cylinder individual hold time of pulse TO ZERO MAIN1" UWORD _CNV_A_R_LINEAR_____211_CM 1 0. 0. 32.767 DISPLAY_IDENTIFIER T_HLD_TOZE_MAIN1_CTL__2_ ECU_ADDRESS 0x7f9f70 BYTE_ORDER MSB_LAST FORMAT "%5.3" /end MEASUREMENT
/begin MEASUREMENT t_hld_toze_main1_ctl_[3] "cylinder individual hold time of pulse TO ZERO MAIN1" UWORD _CNV_A_R_LINEAR_____211_CM 1 0. 0. 32.767 DISPLAY_IDENTIFIER T_HLD_TOZE_MAIN1_CTL__3_ ECU_ADDRESS 0x7f9f72 BYTE_ORDER MSB_LAST FORMAT "%5.3" /end MEASUREMENT
/begin MEASUREMENT t_hld_toze_post1_ctl_[0] "cylinder individual hold time of pulse TO ZERO POST1" UWORD _CNV_A_R_LINEAR_____211_CM 1 0. 0. 32.767 DISPLAY_IDENTIFIER T_HLD_TOZE_POST1_CTL__0_ ECU_ADDRESS 0x7f9f7c BYTE_ORDER MSB_LAST FORMAT "%5.3" /end MEASUREMENT
/begin MEASUREMENT t_hld_toze_post1_ctl_[1] "cylinder individual hold time of pulse TO ZERO POST1" UWORD _CNV_A_R_LINEAR_____211_CM 1 0. 0. 32.767 DISPLAY_IDENTIFIER T_HLD_TOZE_POST1_CTL__1_ ECU_ADDRESS 0x7f9f7e BYTE_ORDER MSB_LAST FORMAT "%5.3" /end MEASUREMENT
/begin MEASUREMENT t_hld_toze_post1_ctl_[2] "cylinder individual hold time of pulse TO ZERO POST1" UWORD _CNV_A_R_LINEAR_____211_CM 1 0. 0. 32.767 DISPLAY_IDENTIFIER T_HLD_TOZE_POST1_CTL__2_ ECU_ADDRESS 0x7f9f80 BYTE_ORDER MSB_LAST FORMAT "%5.3" /end MEASUREMENT
/begin MEASUREMENT t_hld_toze_post1_ctl_[3] "cylinder individual hold time of pulse TO ZERO POST1" UWORD _CNV_A_R_LINEAR_____211_CM 1 0. 0. 32.767 DISPLAY_IDENTIFIER T_HLD_TOZE_POST1_CTL__3_ ECU_ADDRESS 0x7f9f82 BYTE_ORDER MSB_LAST FORMAT "%5.3" /end MEASUREMENT
/begin MEASUREMENT seg_nr_stk_mes "actual segment number for measurement of stroke controller" UBYTE _CNV_A_R_LINEAR_____0_CM 1 0. 0. 15. DISPLAY_IDENTIFIER SEG_NR_STK_MES ECU_ADDRESS 0x7fbf10 FORMAT "%2.0" /end MEASUREMENT
/begin MEASUREMENT t_hld_frze_mv "hold time of a partial charge stroke (mean value)" UWORD _CNV_A_R_LINEAR_____211_CM 1 0. 0. 32.767 DISPLAY_IDENTIFIER T_HLD_FRZE_MV ECU_ADDRESS 0x7f9f8c BYTE_ORDER MSB_LAST FORMAT "%5.3" /end MEASUREMENT
/begin MEASUREMENT t_hld_toze_mv "hold time of a partial discharge stroke (mean value)" UWORD _CNV_A_R_LINEAR_____211_CM 1 0. 0. 32.767 DISPLAY_IDENTIFIER T_HLD_TOZE_MV ECU_ADDRESS 0x7f9f8e BYTE_ORDER MSB_LAST FORMAT "%5.3" /end MEASUREMENT
/begin MEASUREMENT seg_nr_stk_ctl "actual segment number for stroke controller" UBYTE _CNV_A_R_LINEAR_____0_CM 1 0. 0. 15. DISPLAY_IDENTIFIER SEG_NR_STK_CTL ECU_ADDRESS 0x7fbf11 FORMAT "%2.0" /end MEASUREMENT
/begin MEASUREMENT t_per_stk_dcha "cycle duration of the first period of a discharge partial stroke" UWORD _CNV_A_R_LINEAR_____211_CM 1 0. 0. 32.767 DISPLAY_IDENTIFIER T_PER_STK_DCHA ECU_ADDRESS 0x7f9f84 BYTE_ORDER MSB_LAST FORMAT "%5.3" /end MEASUREMENT
/begin MEASUREMENT v_ampl_stk_dcha "amplitude of the first period of a discharge partial stroke" UWORD _CNV_A_R_LINEAR_____539_CM 1 0. 0. 255. DISPLAY_IDENTIFIER V_AMPL_STK_DCHA ECU_ADDRESS 0x7f9f86 BYTE_ORDER MSB_LAST /end MEASUREMENT
/begin MEASUREMENT step_nr_cha_frze_ctl_bas "number of charge steps of a partial stroke (base value)" UBYTE _CNV_A_R_LINEAR_____0_CM 1 0. 0. 30. DISPLAY_IDENTIFIER STEP_NR_CHA_FRZE_CTL_BAS ECU_ADDRESS 0x7fbf12 FORMAT "%2.0" /end MEASUREMENT
/begin MEASUREMENT step_nr_dcha_ctl_bas "number of discharge steps of a partial stroke (base value)" UBYTE _CNV_A_R_LINEAR_____0_CM 1 0. 0. 30. DISPLAY_IDENTIFIER STEP_NR_DCHA_CTL_BAS ECU_ADDRESS 0x7fbf13 FORMAT "%2.0" /end MEASUREMENT
/begin MEASUREMENT t_iv_opg_min "minimal discharge time so that the injection valve closes" UWORD _CNV_A_R_LINEAR_____540_CM 1 0. 0. 0.512 DISPLAY_IDENTIFIER T_IV_OPG_MIN ECU_ADDRESS 0x7f9f88 BYTE_ORDER MSB_LAST FORMAT "%4.3" /end MEASUREMENT
/begin MEASUREMENT t_iv_close_mv_mv "mean value of T_IV_CLOSE_MV_x averaged over all NC_CYL_NR cylinders" UWORD _CNV_A_R_LINEAR_____540_CM 1 0. 0. 0.512 DISPLAY_IDENTIFIER T_IV_CLOSE_MV_MV ECU_ADDRESS 0x7f9f8a BYTE_ORDER MSB_LAST FORMAT "%4.3" /end MEASUREMENT
/begin CHARACTERISTIC c_fac_pwm_dcha_man "manual value for PWM discharge factor" VALUE 0x84fd42 _REC_VAL_20_u2 3.99998471 _CNV_A_R_LINEAR_____59_CM 0. 3.99998471 DISPLAY_IDENTIFIER C_FAC_PWM_DCHA_MAN FORMAT "%6.5" /end CHARACTERISTIC
/begin CHARACTERISTIC c_fac_t_per_t_hld_frze "factor for calculating T_HLD_FRZE_MV from T_PER_STK_DCHA" VALUE 0x84fd4a _REC_VAL_20_u1 1.9921875 _CNV_A_R_LINEAR_____101_CM 0. 1.9921875 DISPLAY_IDENTIFIER C_FAC_T_PER_T_HLD_FRZE FORMAT "%4.3" /end CHARACTERISTIC
/begin CHARACTERISTIC c_fac_t_per_t_hld_toze "factor for calculating T_HLD_TOZE_MV from T_PER_STK_DCHA" VALUE 0x84fd4b _REC_VAL_20_u1 1.9921875 _CNV_A_R_LINEAR_____101_CM 0. 1.9921875 DISPLAY_IDENTIFIER C_FAC_T_PER_T_HLD_TOZE FORMAT "%4.3" /end CHARACTERISTIC
/begin CHARACTERISTIC c_step_nr_cha_frze_main1_man "manual value for number of charge steps for pulse FROM ZERO MAIN1" VALUE 0x84ff01 _REC_VAL_20_u1 30. _CNV_A_R_LINEAR_____0_CM 0. 30. DISPLAY_IDENTIFIER C_STEP_NR_CHA_FRZE_MAIN1_MAN FORMAT "%2.0" /end CHARACTERISTIC
/begin CHARACTERISTIC c_step_nr_cha_frze_post1_man "manual value for number of charge steps for pulse FROM ZERO POST1" VALUE 0x84ff02 _REC_VAL_20_u1 30. _CNV_A_R_LINEAR_____0_CM 0. 30. DISPLAY_IDENTIFIER C_STEP_NR_CHA_FRZE_POST1_MAN FORMAT "%2.0" /end CHARACTERISTIC
/begin CHARACTERISTIC c_step_nr_cha_frze_prev1_man "manual value for number of charge steps for pulse FROM ZERO PREV1" VALUE 0x84ff03 _REC_VAL_20_u1 30. _CNV_A_R_LINEAR_____0_CM 0. 30. DISPLAY_IDENTIFIER C_STEP_NR_CHA_FRZE_PREV1_MAN FORMAT "%2.0" /end CHARACTERISTIC
/begin CHARACTERISTIC c_step_nr_dcha_main1_man "manual value for number of discharge steps for pulse MAIN1" VALUE 0x84ff04 _REC_VAL_20_u1 30. _CNV_A_R_LINEAR_____0_CM 0. 30. DISPLAY_IDENTIFIER C_STEP_NR_DCHA_MAIN1_MAN FORMAT "%2.0" /end CHARACTERISTIC
/begin CHARACTERISTIC c_step_nr_dcha_post1_man "manual value for number of discharge steps for pulse POST1" VALUE 0x84ff05 _REC_VAL_20_u1 30. _CNV_A_R_LINEAR_____0_CM 0. 30. DISPLAY_IDENTIFIER C_STEP_NR_DCHA_POST1_MAN FORMAT "%2.0" /end CHARACTERISTIC
/begin CHARACTERISTIC c_step_nr_dcha_prev1_man "manual value for number of discharge steps for pulse PREV1" VALUE 0x84ff06 _REC_VAL_20_u1 30. _CNV_A_R_LINEAR_____0_CM 0. 30. DISPLAY_IDENTIFIER C_STEP_NR_DCHA_PREV1_MAN FORMAT "%2.0" /end CHARACTERISTIC
/begin CHARACTERISTIC c_stk_ma_fil_ini "initialisation value for T_IV_CLOSE_MV filter state variables" VALUE 0x84ff0a _REC_VAL_20_u2 0.512 _CNV_A_R_LINEAR_____540_CM 0. 0.512 DISPLAY_IDENTIFIER C_STK_MA_FIL_INI FORMAT "%4.3" /end CHARACTERISTIC
/begin CHARACTERISTIC c_t_hld_frze_main1_stk_man "manual value for hold time of pulse FROM ZERO MAIN1" VALUE 0x84ff86 _REC_VAL_20_u2 32.767 _CNV_A_R_LINEAR_____211_CM 0. 32.767 DISPLAY_IDENTIFIER C_T_HLD_FRZE_MAIN1_STK_MAN FORMAT "%5.3" /end CHARACTERISTIC
/begin CHARACTERISTIC c_t_hld_frze_post1_stk_man "manual value for hold time of pulse FROM ZERO POST1" VALUE 0x84ff88 _REC_VAL_20_u2 32.767 _CNV_A_R_LINEAR_____211_CM 0. 32.767 DISPLAY_IDENTIFIER C_T_HLD_FRZE_POST1_STK_MAN FORMAT "%5.3" /end CHARACTERISTIC
/begin CHARACTERISTIC c_t_hld_frze_prev1_stk_man "manual value for hold time of pulse FROM ZERO PREV1" VALUE 0x84ff8a _REC_VAL_20_u2 32.767 _CNV_A_R_LINEAR_____211_CM 0. 32.767 DISPLAY_IDENTIFIER C_T_HLD_FRZE_PREV1_STK_MAN FORMAT "%5.3" /end CHARACTERISTIC
/begin CHARACTERISTIC c_t_hld_toze_main1_stk_man "manual value for hold time of pulse TO ZERO MAIN1" VALUE 0x84ff92 _REC_VAL_20_u2 32.767 _CNV_A_R_LINEAR_____211_CM 0. 32.767 DISPLAY_IDENTIFIER C_T_HLD_TOZE_MAIN1_STK_MAN FORMAT "%5.3" /end CHARACTERISTIC
/begin CHARACTERISTIC c_t_hld_toze_post1_stk_man "manual value for hold time of pulse TO ZERO POST1" VALUE 0x84ff96 _REC_VAL_20_u2 32.767 _CNV_A_R_LINEAR_____211_CM 0. 32.767 DISPLAY_IDENTIFIER C_T_HLD_TOZE_POST1_STK_MAN FORMAT "%5.3" /end CHARACTERISTIC
/begin CHARACTERISTIC c_t_hld_toze_prev1_stk_man "manual value for hold time of pulse TO ZERO PREV1" VALUE 0x84ff9a _REC_VAL_20_u2 32.767 _CNV_A_R_LINEAR_____211_CM 0. 32.767 DISPLAY_IDENTIFIER C_T_HLD_TOZE_PREV1_STK_MAN FORMAT "%5.3" /end CHARACTERISTIC
/begin CHARACTERISTIC lc_tun_stk_ctl_man "button for setting manual values for all output variables of stroke control" VALUE 0x850177 _REC_VAL_20_u1 1. _CNV_A_R_LINEAR_____0_CM 0. 1. DISPLAY_IDENTIFIER LC_TUN_STK_CTL_MAN FORMAT "%1.0" /end CHARACTERISTIC
/begin CHARACTERISTIC ip_fac_t_iv_opg_min_cor__tfu "PECO_STCO: TFU correction factor for T_IV_OPG_MIN" CURVE 0x848418 _REC_CUR_20_u1_u1 1.9921875 _CNV_A_R_LINEAR_____101_CM 0. 1.9921875 DISPLAY_IDENTIFIER IP_FAC_T_IV_OPG_MIN_COR__TFU FORMAT "%4.3"
 /begin AXIS_DESCR COM_AXIS tfu _CNV_A_R_LINEAR_____18_CM 5 -50. 205. FORMAT "%3.0" AXIS_PTS_REF ldp_tfu_ip_fac_t_iv_opg_min_cor /end AXIS_DESCR
/end CHARACTERISTIC
/begin AXIS_PTS ldp_tfu_ip_fac_t_iv_opg_min_cor "" 0x84246e tfu _REC_AXS_20_u1 255. _CNV_A_R_LINEAR_____18_CM 5 -50. 205. FORMAT "%3.0" /end AXIS_PTS
/begin CHARACTERISTIC ip_fac_step_nr_cha_frze__n__tfu "PECO_STCO: factor for step number (FROM ZERO PREV/MAIN1/POST1) calculated by stroke control" MAP 0x8483d0 _REC_MAP_20_u1_u2_u1 1.9921875 _CNV_A_R_LINEAR_____101_CM 0. 1.9921875 DISPLAY_IDENTIFIER IP_FAC_STEP_NR_CHA_FRZE__N__TFU FORMAT "%4.3"
 /begin AXIS_DESCR COM_AXIS n _CNV_A_R_LINEAR_____5_CM 8 0. 6375. FORMAT "%4.0" AXIS_PTS_REF ldp_n_ip_fac_step_nr_cha_frze /end AXIS_DESCR
 /begin AXIS_DESCR COM_AXIS tfu _CNV_A_R_LINEAR_____18_CM 5 -50. 205. FORMAT "%3.0" AXIS_PTS_REF ldp_tfu_ip_fac_step_nr_cha_frze /end AXIS_DESCR
/end CHARACTERISTIC
/begin AXIS_PTS ldp_n_ip_fac_step_nr_cha_frze "" 0x841a50 n _REC_AXS_20_u2 6375. _CNV_A_R_LINEAR_____5_CM 8 0. 6375. FORMAT "%4.0" /end AXIS_PTS
/begin AXIS_PTS ldp_tfu_ip_fac_step_nr_cha_frze "" 0x842468 tfu _REC_AXS_20_u1 255. _CNV_A_R_LINEAR_____18_CM 5 -50. 205. FORMAT "%3.0" /end AXIS_PTS
/begin CHARACTERISTIC ip_t_iv_opg_min__n__soi "PECO_STCO: interpolation map for determining minimal injection valve opening time" MAP 0x84ef10 _REC_MAP_20_u2_u2_u2 0.512 _CNV_A_R_LINEAR_____540_CM 0. 0.512 DISPLAY_IDENTIFIER IP_T_IV_OPG_MIN__N__SOI FORMAT "%4.3"
 /begin AXIS_DESCR COM_AXIS n _CNV_A_R_LINEAR_____5_CM 8 0. 6375. FORMAT "%4.0" AXIS_PTS_REF ldp_n_ip_t_iv_opg_min /end AXIS_DESCR
 /begin AXIS_DESCR COM_AXIS soi_main1_pwr_on_tu _CNV_A_R_LINEAR_____118_CM 14 -120. 240. FORMAT "%5.2" AXIS_PTS_REF ldp_soi_ip_t_iv_opg_min /end AXIS_DESCR
/end CHARACTERISTIC
/begin AXIS_PTS ldp_n_ip_t_iv_opg_min "" 0x841e9a n _REC_AXS_20_u2 6375. _CNV_A_R_LINEAR_____5_CM 8 0. 6375. FORMAT "%4.0" /end AXIS_PTS
/begin AXIS_PTS ldp_soi_ip_t_iv_opg_min "" 0x84217e soi_main1_pwr_on_tu _REC_AXS_20_u2 360. _CNV_A_R_LINEAR_____118_CM 14 -120. 240. FORMAT "%5.2" /end AXIS_PTS
/begin CHARACTERISTIC c_n_stk_ctl_act_max "upper engine speed limit for stroke control" VALUE 0x84fe26 _REC_VAL_20_u2 6375. _CNV_A_R_LINEAR_____5_CM 0. 6375. DISPLAY_IDENTIFIER C_N_STK_CTL_ACT_MAX FORMAT "%4.0" /end CHARACTERISTIC
/begin CHARACTERISTIC ip_fac_t_iv_opg_min_cor__n "PECO_STCO: N correction factor for T_IV_OPG_MIN" CURVE 0x848408 _REC_CUR_20_u2_u2 3.99998471 _CNV_A_R_LINEAR_____59_CM 0. 3.99998471 DISPLAY_IDENTIFIER IP_FAC_T_IV_OPG_MIN_COR__N FORMAT "%5.3"
 /begin AXIS_DESCR COM_AXIS n _CNV_A_R_LINEAR_____5_CM 8 0. 6375. FORMAT "%4.0" AXIS_PTS_REF ldp_n_ip_fac_t_iv_opg_min_cor /end AXIS_DESCR
/end CHARACTERISTIC
/begin AXIS_PTS ldp_n_ip_fac_t_iv_opg_min_cor "" 0x841a62 n _REC_AXS_20_u2 6375. _CNV_A_R_LINEAR_____5_CM 8 0. 6375. FORMAT "%4.0" /end AXIS_PTS
/begin CHARACTERISTIC c_pv_av_stk_ctl_act_max "max pedal value to activate stroke controller" VALUE 0x843f38 _REC_VAL_20_u2 99.90000000000001 _CNV_A_R_LINEAR_____266_CM 0. 99.90000000000001 DISPLAY_IDENTIFIER C_PV_AV_STK_CTL_ACT_MAX FORMAT "%4.2" /end CHARACTERISTIC
/begin MEASUREMENT dummy_peco "dummy peco" UWORD _CNV_A_R_LINEAR_____0_CM 1 0. 0. 65535. DISPLAY_IDENTIFIER DUMMY_PECO ECU_ADDRESS 0x7f9f28 BYTE_ORDER MSB_LAST FORMAT "%5.0" /end MEASUREMENT
/begin MEASUREMENT egy_sp_bas_iv_foc_ctl_[0] "set point for energy controller computed by IV_FOC controller (cylinder individual)" UWORD _CNV_A_R_LINEAR_____541_CM 1 0. 0. 522.7750632 DISPLAY_IDENTIFIER EGY_SP_BAS_IV_FOC_CTL__0_ ECU_ADDRESS 0x7f9f98 BYTE_ORDER MSB_LAST /end MEASUREMENT
/begin MEASUREMENT egy_sp_bas_iv_foc_ctl_[1] "set point for energy controller computed by IV_FOC controller (cylinder individual)" UWORD _CNV_A_R_LINEAR_____541_CM 1 0. 0. 522.7750632 DISPLAY_IDENTIFIER EGY_SP_BAS_IV_FOC_CTL__1_ ECU_ADDRESS 0x7f9f9a BYTE_ORDER MSB_LAST /end MEASUREMENT
/begin MEASUREMENT egy_sp_bas_iv_foc_ctl_[2] "set point for energy controller computed by IV_FOC controller (cylinder individual)" UWORD _CNV_A_R_LINEAR_____541_CM 1 0. 0. 522.7750632 DISPLAY_IDENTIFIER EGY_SP_BAS_IV_FOC_CTL__2_ ECU_ADDRESS 0x7f9f9c BYTE_ORDER MSB_LAST /end MEASUREMENT
/begin MEASUREMENT egy_sp_bas_iv_foc_ctl_[3] "set point for energy controller computed by IV_FOC controller (cylinder individual)" UWORD _CNV_A_R_LINEAR_____541_CM 1 0. 0. 522.7750632 DISPLAY_IDENTIFIER EGY_SP_BAS_IV_FOC_CTL__3_ ECU_ADDRESS 0x7f9f9e BYTE_ORDER MSB_LAST /end MEASUREMENT
/begin MEASUREMENT sf_egy_sp_man_iv_foc_ctl "status word for manual energy set point computed by IV_FOC controller" UWORD _CNV_A_R_LINEAR_____0_CM 1 0. 0. 65535. DISPLAY_IDENTIFIER SF_EGY_SP_MAN_IV_FOC_CTL ECU_ADDRESS 0x7f9fa0 BYTE_ORDER MSB_LAST FORMAT "%5.0" /end MEASUREMENT
/begin MEASUREMENT egy_sp_err_iv_foc_ctl_[0] "closed loop IV_FOC controller´s output (cylinder individual)" SWORD _CNV_A_R_LINEAR_____543_CM 1 0. -261.3875315 261.3875315 DISPLAY_IDENTIFIER EGY_SP_ERR_IV_FOC_CTL__0_ ECU_ADDRESS 0x7fab22 BYTE_ORDER MSB_LAST /end MEASUREMENT
/begin MEASUREMENT egy_sp_err_iv_foc_ctl_[1] "closed loop IV_FOC controller´s output (cylinder individual)" SWORD _CNV_A_R_LINEAR_____543_CM 1 0. -261.3875315 261.3875315 DISPLAY_IDENTIFIER EGY_SP_ERR_IV_FOC_CTL__1_ ECU_ADDRESS 0x7fab24 BYTE_ORDER MSB_LAST /end MEASUREMENT
/begin MEASUREMENT egy_sp_err_iv_foc_ctl_[2] "closed loop IV_FOC controller´s output (cylinder individual)" SWORD _CNV_A_R_LINEAR_____543_CM 1 0. -261.3875315 261.3875315 DISPLAY_IDENTIFIER EGY_SP_ERR_IV_FOC_CTL__2_ ECU_ADDRESS 0x7fab26 BYTE_ORDER MSB_LAST /end MEASUREMENT
/begin MEASUREMENT egy_sp_err_iv_foc_ctl_[3] "closed loop IV_FOC controller´s output (cylinder individual)" SWORD _CNV_A_R_LINEAR_____543_CM 1 0. -261.3875315 261.3875315 DISPLAY_IDENTIFIER EGY_SP_ERR_IV_FOC_CTL__3_ ECU_ADDRESS 0x7fab28 BYTE_ORDER MSB_LAST /end MEASUREMENT
/begin MEASUREMENT i_ctl_iv_foc_[0] "integral part of IV_FOC controller (cylinder individual)" SWORD _CNV_A_R_LINEAR_____543_CM 1 0. -261.3875315 261.3875315 DISPLAY_IDENTIFIER I_CTL_IV_FOC__0_ ECU_ADDRESS 0x7fab2a BYTE_ORDER MSB_LAST /end MEASUREMENT
/begin MEASUREMENT i_ctl_iv_foc_[1] "integral part of IV_FOC controller (cylinder individual)" SWORD _CNV_A_R_LINEAR_____543_CM 1 0. -261.3875315 261.3875315 DISPLAY_IDENTIFIER I_CTL_IV_FOC__1_ ECU_ADDRESS 0x7fab2c BYTE_ORDER MSB_LAST /end MEASUREMENT
/begin MEASUREMENT i_ctl_iv_foc_[2] "integral part of IV_FOC controller (cylinder individual)" SWORD _CNV_A_R_LINEAR_____543_CM 1 0. -261.3875315 261.3875315 DISPLAY_IDENTIFIER I_CTL_IV_FOC__2_ ECU_ADDRESS 0x7fab2e BYTE_ORDER MSB_LAST /end MEASUREMENT
/begin MEASUREMENT i_ctl_iv_foc_[3] "integral part of IV_FOC controller (cylinder individual)" SWORD _CNV_A_R_LINEAR_____543_CM 1 0. -261.3875315 261.3875315 DISPLAY_IDENTIFIER I_CTL_IV_FOC__3_ ECU_ADDRESS 0x7fab30 BYTE_ORDER MSB_LAST /end MEASUREMENT
/begin MEASUREMENT p_ctl_iv_foc_[0] "proportional part of IV_FOC controller (cylinder individual)" SWORD _CNV_A_R_LINEAR_____543_CM 1 0. -261.3875315 261.3875315 DISPLAY_IDENTIFIER P_CTL_IV_FOC__0_ ECU_ADDRESS 0x7fab32 BYTE_ORDER MSB_LAST /end MEASUREMENT
/begin MEASUREMENT p_ctl_iv_foc_[1] "proportional part of IV_FOC controller (cylinder individual)" SWORD _CNV_A_R_LINEAR_____543_CM 1 0. -261.3875315 261.3875315 DISPLAY_IDENTIFIER P_CTL_IV_FOC__1_ ECU_ADDRESS 0x7fab34 BYTE_ORDER MSB_LAST /end MEASUREMENT
/begin MEASUREMENT p_ctl_iv_foc_[2] "proportional part of IV_FOC controller (cylinder individual)" SWORD _CNV_A_R_LINEAR_____543_CM 1 0. -261.3875315 261.3875315 DISPLAY_IDENTIFIER P_CTL_IV_FOC__2_ ECU_ADDRESS 0x7fab36 BYTE_ORDER MSB_LAST /end MEASUREMENT
/begin MEASUREMENT p_ctl_iv_foc_[3] "proportional part of IV_FOC controller (cylinder individual)" SWORD _CNV_A_R_LINEAR_____543_CM 1 0. -261.3875315 261.3875315 DISPLAY_IDENTIFIER P_CTL_IV_FOC__3_ ECU_ADDRESS 0x7fab38 BYTE_ORDER MSB_LAST /end MEASUREMENT
/begin MEASUREMENT seg_nr_iv_foc_ctl "actual segment number of IV_FOC controller" UBYTE _CNV_A_R_LINEAR_____0_CM 1 0. 0. 15. DISPLAY_IDENTIFIER SEG_NR_IV_FOC_CTL ECU_ADDRESS 0x7fbf14 FORMAT "%2.0" /end MEASUREMENT
/begin MEASUREMENT sf_iv_foc_ctl_act "status word for active IV_FOC controller" UWORD _CNV_A_R_LINEAR_____0_CM 1 0. 0. 65535. DISPLAY_IDENTIFIER SF_IV_FOC_CTL_ACT ECU_ADDRESS 0x7fab3a BYTE_ORDER MSB_LAST FORMAT "%5.0" /end MEASUREMENT
/begin MEASUREMENT sf_mes_iv_foc_vld "status word for valid IV_FOC measurement" UWORD _CNV_A_R_LINEAR_____0_CM 1 0. 0. 65535. DISPLAY_IDENTIFIER SF_MES_IV_FOC_VLD ECU_ADDRESS 0x7fab3c BYTE_ORDER MSB_LAST FORMAT "%5.0" /end MEASUREMENT
/begin MEASUREMENT sf_pi_ctl_iv_foc_max "status word for max reached in IV_FOC controller" UWORD _CNV_A_R_LINEAR_____0_CM 1 0. 0. 65535. DISPLAY_IDENTIFIER SF_PI_CTL_IV_FOC_MAX ECU_ADDRESS 0x7fab3e BYTE_ORDER MSB_LAST FORMAT "%5.0" /end MEASUREMENT
/begin MEASUREMENT sf_pi_ctl_iv_foc_min "status word for min reached in IV_FOC controller" UWORD _CNV_A_R_LINEAR_____0_CM 1 0. 0. 65535. DISPLAY_IDENTIFIER SF_PI_CTL_IV_FOC_MIN ECU_ADDRESS 0x7fab40 BYTE_ORDER MSB_LAST FORMAT "%5.0" /end MEASUREMENT
/begin MEASUREMENT v_delta_dif_[0] "control deviation of IV_FOC controller (cylinder individual)" SWORD _CNV_A_R_LINEAR_____551_CM 1 0. -128. 127.9960938 DISPLAY_IDENTIFIER V_DELTA_DIF__0_ ECU_ADDRESS 0x7fab42 BYTE_ORDER MSB_LAST /end MEASUREMENT
/begin MEASUREMENT v_delta_dif_[1] "control deviation of IV_FOC controller (cylinder individual)" SWORD _CNV_A_R_LINEAR_____551_CM 1 0. -128. 127.9960938 DISPLAY_IDENTIFIER V_DELTA_DIF__1_ ECU_ADDRESS 0x7fab44 BYTE_ORDER MSB_LAST /end MEASUREMENT
/begin MEASUREMENT v_delta_dif_[2] "control deviation of IV_FOC controller (cylinder individual)" SWORD _CNV_A_R_LINEAR_____551_CM 1 0. -128. 127.9960938 DISPLAY_IDENTIFIER V_DELTA_DIF__2_ ECU_ADDRESS 0x7fab46 BYTE_ORDER MSB_LAST /end MEASUREMENT
/begin MEASUREMENT v_delta_dif_[3] "control deviation of IV_FOC controller (cylinder individual)" SWORD _CNV_A_R_LINEAR_____551_CM 1 0. -128. 127.9960938 DISPLAY_IDENTIFIER V_DELTA_DIF__3_ ECU_ADDRESS 0x7fab48 BYTE_ORDER MSB_LAST /end MEASUREMENT
/begin MEASUREMENT v_delta_mv_[0] "measurement value for IV_FOC controller (filtered, cylinder individual)" UWORD _CNV_A_R_LINEAR_____539_CM 1 0. 0. 255. DISPLAY_IDENTIFIER V_DELTA_MV__0_ ECU_ADDRESS 0x7fab4a BYTE_ORDER MSB_LAST /end MEASUREMENT
/begin MEASUREMENT v_delta_mv_[1] "measurement value for IV_FOC controller (filtered, cylinder individual)" UWORD _CNV_A_R_LINEAR_____539_CM 1 0. 0. 255. DISPLAY_IDENTIFIER V_DELTA_MV__1_ ECU_ADDRESS 0x7fab4c BYTE_ORDER MSB_LAST /end MEASUREMENT
/begin MEASUREMENT v_delta_mv_[2] "measurement value for IV_FOC controller (filtered, cylinder individual)" UWORD _CNV_A_R_LINEAR_____539_CM 1 0. 0. 255. DISPLAY_IDENTIFIER V_DELTA_MV__2_ ECU_ADDRESS 0x7fab4e BYTE_ORDER MSB_LAST /end MEASUREMENT
/begin MEASUREMENT v_delta_mv_[3] "measurement value for IV_FOC controller (filtered, cylinder individual)" UWORD _CNV_A_R_LINEAR_____539_CM 1 0. 0. 255. DISPLAY_IDENTIFIER V_DELTA_MV__3_ ECU_ADDRESS 0x7fab50 BYTE_ORDER MSB_LAST /end MEASUREMENT
/begin MEASUREMENT v_delta_sp_mv_[0] "set point for IV_FOC controller (filtered, cylinder individual)" UWORD _CNV_A_R_LINEAR_____539_CM 1 0. 0. 255. DISPLAY_IDENTIFIER V_DELTA_SP_MV__0_ ECU_ADDRESS 0x7fab52 BYTE_ORDER MSB_LAST /end MEASUREMENT
/begin MEASUREMENT v_delta_sp_mv_[1] "set point for IV_FOC controller (filtered, cylinder individual)" UWORD _CNV_A_R_LINEAR_____539_CM 1 0. 0. 255. DISPLAY_IDENTIFIER V_DELTA_SP_MV__1_ ECU_ADDRESS 0x7fab54 BYTE_ORDER MSB_LAST /end MEASUREMENT
/begin MEASUREMENT v_delta_sp_mv_[2] "set point for IV_FOC controller (filtered, cylinder individual)" UWORD _CNV_A_R_LINEAR_____539_CM 1 0. 0. 255. DISPLAY_IDENTIFIER V_DELTA_SP_MV__2_ ECU_ADDRESS 0x7fab56 BYTE_ORDER MSB_LAST /end MEASUREMENT
/begin MEASUREMENT v_delta_sp_mv_[3] "set point for IV_FOC controller (filtered, cylinder individual)" UWORD _CNV_A_R_LINEAR_____539_CM 1 0. 0. 255. DISPLAY_IDENTIFIER V_DELTA_SP_MV__3_ ECU_ADDRESS 0x7fab58 BYTE_ORDER MSB_LAST /end MEASUREMENT
/begin CHARACTERISTIC c_dnom_fil_value_v_delta_mmv[0] "MMV of DELTA_V - FIR filter denominator coefficient vector" VALUE 0x84fc6a _REC_VAL_20_s2 2. _CNV_A_R_LINEAR_____15_CM -1. 1. DISPLAY_IDENTIFIER C_DNOM_FIL_VALUE_V_DELTA_MMV_0_ FORMAT "%6.5" /end CHARACTERISTIC
/begin CHARACTERISTIC c_dnom_fil_value_v_delta_mmv[1] "MMV of DELTA_V - FIR filter denominator coefficient vector" VALUE 0x84fc6c _REC_VAL_20_s2 2. _CNV_A_R_LINEAR_____15_CM -1. 1. DISPLAY_IDENTIFIER C_DNOM_FIL_VALUE_V_DELTA_MMV_1_ FORMAT "%6.5" /end CHARACTERISTIC
/begin CHARACTERISTIC c_dnom_fil_value_v_delta_mmv[2] "MMV of DELTA_V - FIR filter denominator coefficient vector" VALUE 0x84fc6e _REC_VAL_20_s2 2. _CNV_A_R_LINEAR_____15_CM -1. 1. DISPLAY_IDENTIFIER C_DNOM_FIL_VALUE_V_DELTA_MMV_2_ FORMAT "%6.5" /end CHARACTERISTIC
/begin CHARACTERISTIC c_dnom_fil_value_v_delta_mmv[3] "MMV of DELTA_V - FIR filter denominator coefficient vector" VALUE 0x84fc70 _REC_VAL_20_s2 2. _CNV_A_R_LINEAR_____15_CM -1. 1. DISPLAY_IDENTIFIER C_DNOM_FIL_VALUE_V_DELTA_MMV_3_ FORMAT "%6.5" /end CHARACTERISTIC
/begin CHARACTERISTIC c_dnom_fil_value_v_delta_mmv[4] "MMV of DELTA_V - FIR filter denominator coefficient vector" VALUE 0x84fc72 _REC_VAL_20_s2 2. _CNV_A_R_LINEAR_____15_CM -1. 1. DISPLAY_IDENTIFIER C_DNOM_FIL_VALUE_V_DELTA_MMV_4_ FORMAT "%6.5" /end CHARACTERISTIC
/begin CHARACTERISTIC c_dnom_fil_value_v_delta_mmv[5] "MMV of DELTA_V - FIR filter denominator coefficient vector" VALUE 0x84fc74 _REC_VAL_20_s2 2. _CNV_A_R_LINEAR_____15_CM -1. 1. DISPLAY_IDENTIFIER C_DNOM_FIL_VALUE_V_DELTA_MMV_5_ FORMAT "%6.5" /end CHARACTERISTIC
/begin CHARACTERISTIC c_dnom_fil_value_v_delta_mmv[6] "MMV of DELTA_V - FIR filter denominator coefficient vector" VALUE 0x84fc76 _REC_VAL_20_s2 2. _CNV_A_R_LINEAR_____15_CM -1. 1. DISPLAY_IDENTIFIER C_DNOM_FIL_VALUE_V_DELTA_MMV_6_ FORMAT "%6.5" /end CHARACTERISTIC
/begin CHARACTERISTIC c_dnom_fil_value_v_delta_mmv[7] "MMV of DELTA_V - FIR filter denominator coefficient vector" VALUE 0x84fc78 _REC_VAL_20_s2 2. _CNV_A_R_LINEAR_____15_CM -1. 1. DISPLAY_IDENTIFIER C_DNOM_FIL_VALUE_V_DELTA_MMV_7_ FORMAT "%6.5" /end CHARACTERISTIC
/begin CHARACTERISTIC c_dnom_fil_value_v_delta_mmv[8] "MMV of DELTA_V - FIR filter denominator coefficient vector" VALUE 0x84fc7a _REC_VAL_20_s2 2. _CNV_A_R_LINEAR_____15_CM -1. 1. DISPLAY_IDENTIFIER C_DNOM_FIL_VALUE_V_DELTA_MMV_8_ FORMAT "%6.5" /end CHARACTERISTIC
/begin CHARACTERISTIC c_dnom_fil_value_v_delta_mmv[9] "MMV of DELTA_V - FIR filter denominator coefficient vector" VALUE 0x84fc7c _REC_VAL_20_s2 2. _CNV_A_R_LINEAR_____15_CM -1. 1. DISPLAY_IDENTIFIER C_DNOM_FIL_VALUE_V_DELTA_MMV_9_ FORMAT "%6.5" /end CHARACTERISTIC
/begin CHARACTERISTIC c_kr_pi_iv_foc_ctl "IV_FOC_CTL PI amplification" VALUE 0x84fd7c _REC_VAL_20_s2 199.996948242 _CNV_A_R_LINEAR_____552_CM -100. 99.996948242 DISPLAY_IDENTIFIER C_KR_PI_IV_FOC_CTL FORMAT "%5.3" /end CHARACTERISTIC
/begin CHARACTERISTIC c_lim_egy_sp_err_iv_foc_ctl_max "IV_FOC controller output maximum limit" VALUE 0x84fd9c _REC_VAL_20_u2 261.3875315 _CNV_A_R_LINEAR_____553_CM 0. 261.3875315 DISPLAY_IDENTIFIER C_LIM_EGY_SP_ERR_IV_FOC_CTL_MAX /end CHARACTERISTIC
/begin CHARACTERISTIC c_lim_egy_sp_err_iv_foc_ctl_min "IV_FOC controller output minimum limit" VALUE 0x84fd9e _REC_VAL_20_s2 261.3875315 _CNV_A_R_LINEAR_____554_CM -261.3875315 0. DISPLAY_IDENTIFIER C_LIM_EGY_SP_ERR_IV_FOC_CTL_MIN FORMAT "%4.3" /end CHARACTERISTIC
/begin CHARACTERISTIC c_lim_pi_iv_foc_ctl_max "IV_FOC controller integrator maximum limit" VALUE 0x84fda8 _REC_VAL_20_u2 261.3875315 _CNV_A_R_LINEAR_____553_CM 0. 261.3875315 DISPLAY_IDENTIFIER C_LIM_PI_IV_FOC_CTL_MAX /end CHARACTERISTIC
/begin CHARACTERISTIC c_lim_pi_iv_foc_ctl_min "IV_FOC controller integrator minimum limit" VALUE 0x84fdaa _REC_VAL_20_s2 261.3875315 _CNV_A_R_LINEAR_____554_CM -261.3875315 0. DISPLAY_IDENTIFIER C_LIM_PI_IV_FOC_CTL_MIN FORMAT "%4.3" /end CHARACTERISTIC
/begin CHARACTERISTIC c_num_fil_value_v_delta_mmv[0] "MMV of DELTA_V - FIR filter numerator coefficient vector" VALUE 0x84fe9a _REC_VAL_20_s2 2. _CNV_A_R_LINEAR_____15_CM -1. 1. DISPLAY_IDENTIFIER C_NUM_FIL_VALUE_V_DELTA_MMV_0_ FORMAT "%6.5" /end CHARACTERISTIC
/begin CHARACTERISTIC c_num_fil_value_v_delta_mmv[1] "MMV of DELTA_V - FIR filter numerator coefficient vector" VALUE 0x84fe9c _REC_VAL_20_s2 2. _CNV_A_R_LINEAR_____15_CM -1. 1. DISPLAY_IDENTIFIER C_NUM_FIL_VALUE_V_DELTA_MMV_1_ FORMAT "%6.5" /end CHARACTERISTIC
/begin CHARACTERISTIC c_num_fil_value_v_delta_mmv[2] "MMV of DELTA_V - FIR filter numerator coefficient vector" VALUE 0x84fe9e _REC_VAL_20_s2 2. _CNV_A_R_LINEAR_____15_CM -1. 1. DISPLAY_IDENTIFIER C_NUM_FIL_VALUE_V_DELTA_MMV_2_ FORMAT "%6.5" /end CHARACTERISTIC
/begin CHARACTERISTIC c_num_fil_value_v_delta_mmv[3] "MMV of DELTA_V - FIR filter numerator coefficient vector" VALUE 0x84fea0 _REC_VAL_20_s2 2. _CNV_A_R_LINEAR_____15_CM -1. 1. DISPLAY_IDENTIFIER C_NUM_FIL_VALUE_V_DELTA_MMV_3_ FORMAT "%6.5" /end CHARACTERISTIC
/begin CHARACTERISTIC c_num_fil_value_v_delta_mmv[4] "MMV of DELTA_V - FIR filter numerator coefficient vector" VALUE 0x84fea2 _REC_VAL_20_s2 2. _CNV_A_R_LINEAR_____15_CM -1. 1. DISPLAY_IDENTIFIER C_NUM_FIL_VALUE_V_DELTA_MMV_4_ FORMAT "%6.5" /end CHARACTERISTIC
/begin CHARACTERISTIC c_num_fil_value_v_delta_mmv[5] "MMV of DELTA_V - FIR filter numerator coefficient vector" VALUE 0x84fea4 _REC_VAL_20_s2 2. _CNV_A_R_LINEAR_____15_CM -1. 1. DISPLAY_IDENTIFIER C_NUM_FIL_VALUE_V_DELTA_MMV_5_ FORMAT "%6.5" /end CHARACTERISTIC
/begin CHARACTERISTIC c_num_fil_value_v_delta_mmv[6] "MMV of DELTA_V - FIR filter numerator coefficient vector" VALUE 0x84fea6 _REC_VAL_20_s2 2. _CNV_A_R_LINEAR_____15_CM -1. 1. DISPLAY_IDENTIFIER C_NUM_FIL_VALUE_V_DELTA_MMV_6_ FORMAT "%6.5" /end CHARACTERISTIC
/begin CHARACTERISTIC c_num_fil_value_v_delta_mmv[7] "MMV of DELTA_V - FIR filter numerator coefficient vector" VALUE 0x84fea8 _REC_VAL_20_s2 2. _CNV_A_R_LINEAR_____15_CM -1. 1. DISPLAY_IDENTIFIER C_NUM_FIL_VALUE_V_DELTA_MMV_7_ FORMAT "%6.5" /end CHARACTERISTIC
/begin CHARACTERISTIC c_num_fil_value_v_delta_mmv[8] "MMV of DELTA_V - FIR filter numerator coefficient vector" VALUE 0x84feaa _REC_VAL_20_s2 2. _CNV_A_R_LINEAR_____15_CM -1. 1. DISPLAY_IDENTIFIER C_NUM_FIL_VALUE_V_DELTA_MMV_8_ FORMAT "%6.5" /end CHARACTERISTIC
/begin CHARACTERISTIC c_num_fil_value_v_delta_mmv[9] "MMV of DELTA_V - FIR filter numerator coefficient vector" VALUE 0x84feac _REC_VAL_20_s2 2. _CNV_A_R_LINEAR_____15_CM -1. 1. DISPLAY_IDENTIFIER C_NUM_FIL_VALUE_V_DELTA_MMV_9_ FORMAT "%6.5" /end CHARACTERISTIC
/begin CHARACTERISTIC c_v_delta_max "maximum value of acceptable DELTA_V" VALUE 0x850094 _REC_VAL_20_u2 255. _CNV_A_R_LINEAR_____539_CM 0. 255. DISPLAY_IDENTIFIER C_V_DELTA_MAX /end CHARACTERISTIC
/begin CHARACTERISTIC c_v_delta_min "minimum value of acceptable DELTA_V" VALUE 0x850096 _REC_VAL_20_u2 255. _CNV_A_R_LINEAR_____539_CM 0. 255. DISPLAY_IDENTIFIER C_V_DELTA_MIN /end CHARACTERISTIC
/begin CHARACTERISTIC c_v_delta_mmv_fil_ini "initialisation value for MMF state variables of DELTA_V" VALUE 0x850098 _REC_VAL_20_u2 255. _CNV_A_R_LINEAR_____539_CM 0. 255. DISPLAY_IDENTIFIER C_V_DELTA_MMV_FIL_INI /end CHARACTERISTIC
/begin CHARACTERISTIC c_v_delta_mmv_inp_max_lim "maximum input value for MMF of V_DELTA" VALUE 0x85009a _REC_VAL_20_u2 255. _CNV_A_R_LINEAR_____539_CM 0. 255. DISPLAY_IDENTIFIER C_V_DELTA_MMV_INP_MAX_LIM /end CHARACTERISTIC
/begin CHARACTERISTIC c_v_delta_mmv_inp_min_lim "minimum input value for MMF of V_DELTA" VALUE 0x85009c _REC_VAL_20_u2 255. _CNV_A_R_LINEAR_____539_CM 0. 255. DISPLAY_IDENTIFIER C_V_DELTA_MMV_INP_MIN_LIM /end CHARACTERISTIC
/begin CHARACTERISTIC c_v_delta_mmv_out_max_lim "maximum output value of MMF of V_DELTA" VALUE 0x85009e _REC_VAL_20_u2 255. _CNV_A_R_LINEAR_____539_CM 0. 255. DISPLAY_IDENTIFIER C_V_DELTA_MMV_OUT_MAX_LIM /end CHARACTERISTIC
/begin CHARACTERISTIC c_v_delta_mmv_out_min_lim "minimum output value of MMF of V_DELTA" VALUE 0x8500a0 _REC_VAL_20_u2 255. _CNV_A_R_LINEAR_____539_CM 0. 255. DISPLAY_IDENTIFIER C_V_DELTA_MMV_OUT_MIN_LIM /end CHARACTERISTIC
/begin CHARACTERISTIC lc_iv_foc_ctl_on "switch on IV_FOC control" VALUE 0x85014c _REC_VAL_20_u1 1. _CNV_A_R_LINEAR_____0_CM 0. 1. DISPLAY_IDENTIFIER LC_IV_FOC_CTL_ON FORMAT "%1.0" /end CHARACTERISTIC
/begin CHARACTERISTIC lc_v_delta_rel_iv_foc_ctl_on "switch to DELTA_V_REL_x input for IV_FOC_CTL" VALUE 0x85017d _REC_VAL_20_u1 1. _CNV_A_R_LINEAR_____0_CM 0. 1. DISPLAY_IDENTIFIER LC_V_DELTA_REL_IV_FOC_CTL_ON FORMAT "%1.0" /end CHARACTERISTIC
/begin CHARACTERISTIC ip_egy_sp_ofs_foc_ctl__tco "PECO_FOCO: IV_FOC_CTL energy set point offset depending on TCO" CURVE 0x847e8e _REC_CUR_20_u2_u1 522.7750630000001 _CNV_A_R_LINEAR_____555_CM -261.3875315 261.3875315 DISPLAY_IDENTIFIER IP_EGY_SP_OFS_FOC_CTL__TCO
 /begin AXIS_DESCR COM_AXIS tco _CNV_A_R_LINEAR_____18_CM 5 -50. 205. FORMAT "%3.0" AXIS_PTS_REF ldpm_tco_ip_egy_sp_foc_ctl /end AXIS_DESCR
/end CHARACTERISTIC
/begin AXIS_PTS ldpm_tco_ip_egy_sp_foc_ctl "" 0x8437a9 tco _REC_AXS_20_u1 255. _CNV_A_R_LINEAR_____18_CM 5 -50. 205. FORMAT "%3.0" /end AXIS_PTS
/begin CHARACTERISTIC ip_tn_pi_neg_iv_foc_ctl__n "PECO_FOCO: IV_FOC control error integral time at negative deviation" CURVE 0x84f5f2 _REC_CUR_20_u2_u2 3276.7 _CNV_A_R_LINEAR_____548_CM 0. 3276.7 DISPLAY_IDENTIFIER IP_TN_PI_NEG_IV_FOC_CTL__N FORMAT "%5.1"
 /begin AXIS_DESCR COM_AXIS n _CNV_A_R_LINEAR_____5_CM 10 0. 6375. FORMAT "%4.0" AXIS_PTS_REF ldpm_n_ip_tn_pi_iv_foc_ctl /end AXIS_DESCR
/end CHARACTERISTIC
/begin AXIS_PTS ldpm_n_ip_tn_pi_iv_foc_ctl "" 0x84358c n _REC_AXS_20_u2 6375. _CNV_A_R_LINEAR_____5_CM 10 0. 6375. FORMAT "%4.0" /end AXIS_PTS
/begin CHARACTERISTIC ip_tn_pi_pos_iv_foc_ctl__n "PECO_FOCO: IV_FOC control error integral time at positive deviation" CURVE 0x84f642 _REC_CUR_20_u2_u2 3276.7 _CNV_A_R_LINEAR_____548_CM 0. 3276.7 DISPLAY_IDENTIFIER IP_TN_PI_POS_IV_FOC_CTL__N FORMAT "%5.1"
 /begin AXIS_DESCR COM_AXIS n _CNV_A_R_LINEAR_____5_CM 10 0. 6375. FORMAT "%4.0" AXIS_PTS_REF ldpm_n_ip_tn_pi_iv_foc_ctl /end AXIS_DESCR
/end CHARACTERISTIC
/begin CHARACTERISTIC ip_egy_sp_foc_ctl__n__doi "PECO_FOCO: IV_FOC_CTL energy set point depending on N and DOI" MAP 0x847e2a _REC_MAP_20_u2_u2_u2 522.7750632 _CNV_A_R_LINEAR_____541_CM 0. 522.7750632 DISPLAY_IDENTIFIER IP_EGY_SP_FOC_CTL__N__DOI
 /begin AXIS_DESCR COM_AXIS n _CNV_A_R_LINEAR_____5_CM 5 0. 6375. FORMAT "%4.0" AXIS_PTS_REF ldpm_n_ip_egy_sp_foc_ctl /end AXIS_DESCR
 /begin AXIS_DESCR COM_AXIS dummy_peco _CNV_A_R_LINEAR_____119_CM 5 0. 360. FORMAT "%5.2" AXIS_PTS_REF ldp_doi_ip_egy_sp_foc_ctl /end AXIS_DESCR
/end CHARACTERISTIC
/begin AXIS_PTS ldpm_n_ip_egy_sp_foc_ctl "" 0x843072 n _REC_AXS_20_u2 6375. _CNV_A_R_LINEAR_____5_CM 5 0. 6375. FORMAT "%4.0" /end AXIS_PTS
/begin AXIS_PTS ldp_doi_ip_egy_sp_foc_ctl "" 0x8415e6 dummy_peco _REC_AXS_20_u2 360. _CNV_A_R_LINEAR_____119_CM 5 0. 360. FORMAT "%5.2" /end AXIS_PTS
/begin CHARACTERISTIC ip_egy_sp_foc_ctl__n__soi "PECO_FOCO: IV_FOC_CTL energy set point depending on N and SOI" MAP 0x847e5c _REC_MAP_20_u2_u2_u2 522.7750632 _CNV_A_R_LINEAR_____541_CM 0. 522.7750632 DISPLAY_IDENTIFIER IP_EGY_SP_FOC_CTL__N__SOI
 /begin AXIS_DESCR COM_AXIS n _CNV_A_R_LINEAR_____5_CM 5 0. 6375. FORMAT "%4.0" AXIS_PTS_REF ldpm_n_ip_egy_sp_foc_ctl /end AXIS_DESCR
 /begin AXIS_DESCR COM_AXIS soi_main1_pwr_on_tu _CNV_A_R_LINEAR_____118_CM 5 -120. 240. FORMAT "%5.2" AXIS_PTS_REF ldp_soi_ip_egy_sp_foc_ctl /end AXIS_DESCR
/end CHARACTERISTIC
/begin AXIS_PTS ldp_soi_ip_egy_sp_foc_ctl "" 0x842166 soi_main1_pwr_on_tu _REC_AXS_20_u2 360. _CNV_A_R_LINEAR_____118_CM 5 -120. 240. FORMAT "%5.2" /end AXIS_PTS
/begin CHARACTERISTIC ip_fac_egy_sp_foc__tco__capa "PECO_FOCO: IV_FOC_CTL energy set point tuning depending on TCO and CAPA representing the piezo temperature" MAP 0x84808a _REC_MAP_20_u2_u1_u1 1.9999696 _CNV_A_R_LINEAR_____48_CM 0. 1.9999696 DISPLAY_IDENTIFIER IP_FAC_EGY_SP_FOC__TCO__CAPA FORMAT "%6.5"
 /begin AXIS_DESCR COM_AXIS tco _CNV_A_R_LINEAR_____18_CM 5 -50. 205. FORMAT "%3.0" AXIS_PTS_REF ldpm_tco_ip_egy_sp_foc_ctl /end AXIS_DESCR
 /begin AXIS_DESCR COM_AXIS dummy_peco _CNV_A_R_LINEAR_____120_CM 5 0. 31.96875 FORMAT "%3.1" AXIS_PTS_REF ldp_capa_ip_egy_sp_foc_ctl /end AXIS_DESCR
/end CHARACTERISTIC
/begin AXIS_PTS ldp_capa_ip_egy_sp_foc_ctl "" 0x84146c dummy_peco _REC_AXS_20_u1 31.96875 _CNV_A_R_LINEAR_____120_CM 5 0. 31.96875 FORMAT "%3.1" /end AXIS_PTS
/begin CHARACTERISTIC ip_v_delta_sp__n__doi "PECO_FOCO: V_DELTA set point depending on N and DOI" MAP 0x84f8de _REC_MAP_20_u2_u2_u2 255. _CNV_A_R_LINEAR_____539_CM 0. 255. DISPLAY_IDENTIFIER IP_V_DELTA_SP__N__DOI
 /begin AXIS_DESCR COM_AXIS n _CNV_A_R_LINEAR_____5_CM 5 0. 6375. FORMAT "%4.0" AXIS_PTS_REF ldpm_n_ip_v_delta_sp /end AXIS_DESCR
 /begin AXIS_DESCR COM_AXIS dummy_peco _CNV_A_R_LINEAR_____119_CM 5 0. 360. FORMAT "%5.2" AXIS_PTS_REF ldp_doi_ip_v_delta_sp /end AXIS_DESCR
/end CHARACTERISTIC
/begin AXIS_PTS ldpm_n_ip_v_delta_sp "" 0x843712 n _REC_AXS_20_u2 6375. _CNV_A_R_LINEAR_____5_CM 5 0. 6375. FORMAT "%4.0" /end AXIS_PTS
/begin AXIS_PTS ldp_doi_ip_v_delta_sp "" 0x8415fe dummy_peco _REC_AXS_20_u2 360. _CNV_A_R_LINEAR_____119_CM 5 0. 360. FORMAT "%5.2" /end AXIS_PTS
/begin CHARACTERISTIC ip_v_delta_sp__n__soi "PECO_FOCO: V_DELTA set point depending on N and SOI" MAP 0x84f910 _REC_MAP_20_u2_u2_u2 255. _CNV_A_R_LINEAR_____539_CM 0. 255. DISPLAY_IDENTIFIER IP_V_DELTA_SP__N__SOI
 /begin AXIS_DESCR COM_AXIS n _CNV_A_R_LINEAR_____5_CM 5 0. 6375. FORMAT "%4.0" AXIS_PTS_REF ldpm_n_ip_v_delta_sp /end AXIS_DESCR
 /begin AXIS_DESCR COM_AXIS soi_main1_pwr_on_tu _CNV_A_R_LINEAR_____118_CM 5 -120. 240. FORMAT "%5.2" AXIS_PTS_REF ldp_soi_ip_v_delta_sp /end AXIS_DESCR
/end CHARACTERISTIC
/begin AXIS_PTS ldp_soi_ip_v_delta_sp "" 0x84219c soi_main1_pwr_on_tu _REC_AXS_20_u2 360. _CNV_A_R_LINEAR_____118_CM 5 -120. 240. FORMAT "%5.2" /end AXIS_PTS
/begin CHARACTERISTIC ip_v_delta_sp__tco__capa "PECO_FOCO: V_DELTA set point depending on TCO and CAPA_INJ representing piezo temperature" MAP 0x84f942 _REC_MAP_20_u2_u1_u1 255. _CNV_A_R_LINEAR_____539_CM 0. 255. DISPLAY_IDENTIFIER IP_V_DELTA_SP__TCO__CAPA
 /begin AXIS_DESCR COM_AXIS tco _CNV_A_R_LINEAR_____18_CM 5 -50. 205. FORMAT "%3.0" AXIS_PTS_REF ldp_tco_ip_v_delta_sp /end AXIS_DESCR
 /begin AXIS_DESCR COM_AXIS dummy_peco _CNV_A_R_LINEAR_____120_CM 5 0. 31.96875 FORMAT "%3.1" AXIS_PTS_REF ldp_capa_ip_v_delta_sp /end AXIS_DESCR
/end CHARACTERISTIC
/begin AXIS_PTS ldp_tco_ip_v_delta_sp "" 0x842413 tco _REC_AXS_20_u1 255. _CNV_A_R_LINEAR_____18_CM 5 -50. 205. FORMAT "%3.0" /end AXIS_PTS
/begin AXIS_PTS ldp_capa_ip_v_delta_sp "" 0x841478 dummy_peco _REC_AXS_20_u1 31.96875 _CNV_A_R_LINEAR_____120_CM 5 0. 31.96875 FORMAT "%3.1" /end AXIS_PTS
/begin CHARACTERISTIC lc_v_delta_iv_foc_sel "select v_delta input (1: v_delta_iv_foc_stat_mean_, 0: v_delta_iv_foc_ )" VALUE 0x85017c _REC_VAL_20_u1 255. _CNV_A_R_LINEAR_____0_CM 0. 255. DISPLAY_IDENTIFIER LC_V_DELTA_IV_FOC_SEL FORMAT "%1.0" /end CHARACTERISTIC
/begin CHARACTERISTIC lc_v_delta_iv_foc_ast_sel "select v_delta input after start (1: 'mes=sp', 0: no start strategy )" VALUE 0x85017b _REC_VAL_20_u1 1. _CNV_A_R_LINEAR_____0_CM 0. 1. DISPLAY_IDENTIFIER LC_V_DELTA_IV_FOC_AST_SEL FORMAT "%1.0" /end CHARACTERISTIC
/begin MEASUREMENT t_soi_ofs_ctl_[0] "cylinder individual SOI correction for all injections" SWORD _CNV_A_R_LINEAR_____540_CM 1 0. -32.768 32.767 DISPLAY_IDENTIFIER T_SOI_OFS_CTL__0_ ECU_ADDRESS 0x7f9fa2 BYTE_ORDER MSB_LAST FORMAT "%5.3" /end MEASUREMENT
/begin MEASUREMENT t_soi_ofs_ctl_[1] "cylinder individual SOI correction for all injections" SWORD _CNV_A_R_LINEAR_____540_CM 1 0. -32.768 32.767 DISPLAY_IDENTIFIER T_SOI_OFS_CTL__1_ ECU_ADDRESS 0x7f9fa4 BYTE_ORDER MSB_LAST FORMAT "%5.3" /end MEASUREMENT
/begin MEASUREMENT t_soi_ofs_ctl_[2] "cylinder individual SOI correction for all injections" SWORD _CNV_A_R_LINEAR_____540_CM 1 0. -32.768 32.767 DISPLAY_IDENTIFIER T_SOI_OFS_CTL__2_ ECU_ADDRESS 0x7f9fa6 BYTE_ORDER MSB_LAST FORMAT "%5.3" /end MEASUREMENT
/begin MEASUREMENT t_soi_ofs_ctl_[3] "cylinder individual SOI correction for all injections" SWORD _CNV_A_R_LINEAR_____540_CM 1 0. -32.768 32.767 DISPLAY_IDENTIFIER T_SOI_OFS_CTL__3_ ECU_ADDRESS 0x7f9fa8 BYTE_ORDER MSB_LAST FORMAT "%5.3" /end MEASUREMENT
/begin MEASUREMENT lv_iv_foc_iv_close_ctl_sel "selected kind of IV control (1: IV_FOC_CTL and SOI_CTL, 0: only IV_CLOSE_CTL)" UBYTE _CNV_S_2_RANGE______11_CM 1 0. 0. 1. DISPLAY_IDENTIFIER LV_IV_FOC_IV_CLOSE_CTL_SEL ECU_ADDRESS 0x7fbaf1 /end MEASUREMENT
/begin MEASUREMENT egy_sp_bas_iv_close_ctl_[0] "base set point value for energy controller computed by IV_CLOSE controller (cylinder individual)" UWORD _CNV_A_R_LINEAR_____541_CM 1 0. 0. 522.7750632 DISPLAY_IDENTIFIER EGY_SP_BAS_IV_CLOSE_CTL__0_ ECU_ADDRESS 0x7f9faa BYTE_ORDER MSB_LAST /end MEASUREMENT
/begin MEASUREMENT egy_sp_bas_iv_close_ctl_[1] "base set point value for energy controller computed by IV_CLOSE controller (cylinder individual)" UWORD _CNV_A_R_LINEAR_____541_CM 1 0. 0. 522.7750632 DISPLAY_IDENTIFIER EGY_SP_BAS_IV_CLOSE_CTL__1_ ECU_ADDRESS 0x7f9fac BYTE_ORDER MSB_LAST /end MEASUREMENT
/begin MEASUREMENT egy_sp_bas_iv_close_ctl_[2] "base set point value for energy controller computed by IV_CLOSE controller (cylinder individual)" UWORD _CNV_A_R_LINEAR_____541_CM 1 0. 0. 522.7750632 DISPLAY_IDENTIFIER EGY_SP_BAS_IV_CLOSE_CTL__2_ ECU_ADDRESS 0x7f9fae BYTE_ORDER MSB_LAST /end MEASUREMENT
/begin MEASUREMENT egy_sp_bas_iv_close_ctl_[3] "base set point value for energy controller computed by IV_CLOSE controller (cylinder individual)" UWORD _CNV_A_R_LINEAR_____541_CM 1 0. 0. 522.7750632 DISPLAY_IDENTIFIER EGY_SP_BAS_IV_CLOSE_CTL__3_ ECU_ADDRESS 0x7f9fb0 BYTE_ORDER MSB_LAST /end MEASUREMENT
/begin MEASUREMENT sf_egy_sp_man_iv_close_ctl "status word for manual energy set point computed by IV_CLOSE controller" UWORD _CNV_A_R_LINEAR_____0_CM 1 0. 0. 65535. DISPLAY_IDENTIFIER SF_EGY_SP_MAN_IV_CLOSE_CTL ECU_ADDRESS 0x7f9fb2 BYTE_ORDER MSB_LAST FORMAT "%5.0" /end MEASUREMENT
/begin MEASUREMENT t_iv_close_mv_[0] "cylinder individual mean value of the injection valve closing time" UWORD _CNV_A_R_LINEAR_____540_CM 1 0. 0. 0.512 DISPLAY_IDENTIFIER T_IV_CLOSE_MV__0_ ECU_ADDRESS 0x7f9fb4 BYTE_ORDER MSB_LAST FORMAT "%4.3" /end MEASUREMENT
/begin MEASUREMENT t_iv_close_mv_[1] "cylinder individual mean value of the injection valve closing time" UWORD _CNV_A_R_LINEAR_____540_CM 1 0. 0. 0.512 DISPLAY_IDENTIFIER T_IV_CLOSE_MV__1_ ECU_ADDRESS 0x7f9fb6 BYTE_ORDER MSB_LAST FORMAT "%4.3" /end MEASUREMENT
/begin MEASUREMENT t_iv_close_mv_[2] "cylinder individual mean value of the injection valve closing time" UWORD _CNV_A_R_LINEAR_____540_CM 1 0. 0. 0.512 DISPLAY_IDENTIFIER T_IV_CLOSE_MV__2_ ECU_ADDRESS 0x7f9fb8 BYTE_ORDER MSB_LAST FORMAT "%4.3" /end MEASUREMENT
/begin MEASUREMENT t_iv_close_mv_[3] "cylinder individual mean value of the injection valve closing time" UWORD _CNV_A_R_LINEAR_____540_CM 1 0. 0. 0.512 DISPLAY_IDENTIFIER T_IV_CLOSE_MV__3_ ECU_ADDRESS 0x7f9fba BYTE_ORDER MSB_LAST FORMAT "%4.3" /end MEASUREMENT
/begin MEASUREMENT sf_mes_iv_close_vld "status word for injection valve close controller measurement valid" UWORD _CNV_A_R_LINEAR_____0_CM 1 0. 0. 65535. DISPLAY_IDENTIFIER SF_MES_IV_CLOSE_VLD ECU_ADDRESS 0x7f9fbc BYTE_ORDER MSB_LAST FORMAT "%5.0" /end MEASUREMENT
/begin MEASUREMENT egy_sp_err_t_iv_close_ctl_[0] "closed loop T_IV_CLOSE controller´s output (cylinder individual)" SWORD _CNV_A_R_LINEAR_____543_CM 1 0. -261.3875315 261.3875315 DISPLAY_IDENTIFIER EGY_SP_ERR_T_IV_CLOSE_CTL__0_ ECU_ADDRESS 0x7fab62 BYTE_ORDER MSB_LAST /end MEASUREMENT
/begin MEASUREMENT egy_sp_err_t_iv_close_ctl_[1] "closed loop T_IV_CLOSE controller´s output (cylinder individual)" SWORD _CNV_A_R_LINEAR_____543_CM 1 0. -261.3875315 261.3875315 DISPLAY_IDENTIFIER EGY_SP_ERR_T_IV_CLOSE_CTL__1_ ECU_ADDRESS 0x7fab64 BYTE_ORDER MSB_LAST /end MEASUREMENT
/begin MEASUREMENT egy_sp_err_t_iv_close_ctl_[2] "closed loop T_IV_CLOSE controller´s output (cylinder individual)" SWORD _CNV_A_R_LINEAR_____543_CM 1 0. -261.3875315 261.3875315 DISPLAY_IDENTIFIER EGY_SP_ERR_T_IV_CLOSE_CTL__2_ ECU_ADDRESS 0x7fab66 BYTE_ORDER MSB_LAST /end MEASUREMENT
/begin MEASUREMENT egy_sp_err_t_iv_close_ctl_[3] "closed loop T_IV_CLOSE controller´s output (cylinder individual)" SWORD _CNV_A_R_LINEAR_____543_CM 1 0. -261.3875315 261.3875315 DISPLAY_IDENTIFIER EGY_SP_ERR_T_IV_CLOSE_CTL__3_ ECU_ADDRESS 0x7fab68 BYTE_ORDER MSB_LAST /end MEASUREMENT
/begin MEASUREMENT i_ctl_iv_close_[0] "integral part of T_IV_CLOSE controller (cylinder individual)" SWORD _CNV_A_R_LINEAR_____543_CM 1 0. -261.3875315 261.3875315 DISPLAY_IDENTIFIER I_CTL_IV_CLOSE__0_ ECU_ADDRESS 0x7fab6a BYTE_ORDER MSB_LAST /end MEASUREMENT
/begin MEASUREMENT i_ctl_iv_close_[1] "integral part of T_IV_CLOSE controller (cylinder individual)" SWORD _CNV_A_R_LINEAR_____543_CM 1 0. -261.3875315 261.3875315 DISPLAY_IDENTIFIER I_CTL_IV_CLOSE__1_ ECU_ADDRESS 0x7fab6c BYTE_ORDER MSB_LAST /end MEASUREMENT
/begin MEASUREMENT i_ctl_iv_close_[2] "integral part of T_IV_CLOSE controller (cylinder individual)" SWORD _CNV_A_R_LINEAR_____543_CM 1 0. -261.3875315 261.3875315 DISPLAY_IDENTIFIER I_CTL_IV_CLOSE__2_ ECU_ADDRESS 0x7fab6e BYTE_ORDER MSB_LAST /end MEASUREMENT
/begin MEASUREMENT i_ctl_iv_close_[3] "integral part of T_IV_CLOSE controller (cylinder individual)" SWORD _CNV_A_R_LINEAR_____543_CM 1 0. -261.3875315 261.3875315 DISPLAY_IDENTIFIER I_CTL_IV_CLOSE__3_ ECU_ADDRESS 0x7fab70 BYTE_ORDER MSB_LAST /end MEASUREMENT
/begin MEASUREMENT i_ctl_soi_[0] "integral part of SOI controller (cylinder individual)" SWORD _CNV_A_R_LINEAR_____540_CM 1 0. -32.768 32.767 DISPLAY_IDENTIFIER I_CTL_SOI__0_ ECU_ADDRESS 0x7fab72 BYTE_ORDER MSB_LAST FORMAT "%5.3" /end MEASUREMENT
/begin MEASUREMENT i_ctl_soi_[1] "integral part of SOI controller (cylinder individual)" SWORD _CNV_A_R_LINEAR_____540_CM 1 0. -32.768 32.767 DISPLAY_IDENTIFIER I_CTL_SOI__1_ ECU_ADDRESS 0x7fab74 BYTE_ORDER MSB_LAST FORMAT "%5.3" /end MEASUREMENT
/begin MEASUREMENT i_ctl_soi_[2] "integral part of SOI controller (cylinder individual)" SWORD _CNV_A_R_LINEAR_____540_CM 1 0. -32.768 32.767 DISPLAY_IDENTIFIER I_CTL_SOI__2_ ECU_ADDRESS 0x7fab76 BYTE_ORDER MSB_LAST FORMAT "%5.3" /end MEASUREMENT
/begin MEASUREMENT i_ctl_soi_[3] "integral part of SOI controller (cylinder individual)" SWORD _CNV_A_R_LINEAR_____540_CM 1 0. -32.768 32.767 DISPLAY_IDENTIFIER I_CTL_SOI__3_ ECU_ADDRESS 0x7fab78 BYTE_ORDER MSB_LAST FORMAT "%5.3" /end MEASUREMENT
/begin MEASUREMENT p_ctl_iv_close_[0] "proportional part of T_IV_CLOSE controller (cylinder individual)" SWORD _CNV_A_R_LINEAR_____543_CM 1 0. -261.3875315 261.3875315 DISPLAY_IDENTIFIER P_CTL_IV_CLOSE__0_ ECU_ADDRESS 0x7fab7a BYTE_ORDER MSB_LAST /end MEASUREMENT
/begin MEASUREMENT p_ctl_iv_close_[1] "proportional part of T_IV_CLOSE controller (cylinder individual)" SWORD _CNV_A_R_LINEAR_____543_CM 1 0. -261.3875315 261.3875315 DISPLAY_IDENTIFIER P_CTL_IV_CLOSE__1_ ECU_ADDRESS 0x7fab7c BYTE_ORDER MSB_LAST /end MEASUREMENT
/begin MEASUREMENT p_ctl_iv_close_[2] "proportional part of T_IV_CLOSE controller (cylinder individual)" SWORD _CNV_A_R_LINEAR_____543_CM 1 0. -261.3875315 261.3875315 DISPLAY_IDENTIFIER P_CTL_IV_CLOSE__2_ ECU_ADDRESS 0x7fab7e BYTE_ORDER MSB_LAST /end MEASUREMENT
/begin MEASUREMENT p_ctl_iv_close_[3] "proportional part of T_IV_CLOSE controller (cylinder individual)" SWORD _CNV_A_R_LINEAR_____543_CM 1 0. -261.3875315 261.3875315 DISPLAY_IDENTIFIER P_CTL_IV_CLOSE__3_ ECU_ADDRESS 0x7fab80 BYTE_ORDER MSB_LAST /end MEASUREMENT
/begin MEASUREMENT p_ctl_soi_[0] "proportional part of SOI controller (cylinder individual)" SWORD _CNV_A_R_LINEAR_____540_CM 1 0. -32.768 32.767 DISPLAY_IDENTIFIER P_CTL_SOI__0_ ECU_ADDRESS 0x7fab82 BYTE_ORDER MSB_LAST FORMAT "%5.3" /end MEASUREMENT
/begin MEASUREMENT p_ctl_soi_[1] "proportional part of SOI controller (cylinder individual)" SWORD _CNV_A_R_LINEAR_____540_CM 1 0. -32.768 32.767 DISPLAY_IDENTIFIER P_CTL_SOI__1_ ECU_ADDRESS 0x7fab84 BYTE_ORDER MSB_LAST FORMAT "%5.3" /end MEASUREMENT
/begin MEASUREMENT p_ctl_soi_[2] "proportional part of SOI controller (cylinder individual)" SWORD _CNV_A_R_LINEAR_____540_CM 1 0. -32.768 32.767 DISPLAY_IDENTIFIER P_CTL_SOI__2_ ECU_ADDRESS 0x7fab86 BYTE_ORDER MSB_LAST FORMAT "%5.3" /end MEASUREMENT
/begin MEASUREMENT p_ctl_soi_[3] "proportional part of SOI controller (cylinder individual)" SWORD _CNV_A_R_LINEAR_____540_CM 1 0. -32.768 32.767 DISPLAY_IDENTIFIER P_CTL_SOI__3_ ECU_ADDRESS 0x7fab88 BYTE_ORDER MSB_LAST FORMAT "%5.3" /end MEASUREMENT
/begin MEASUREMENT seg_nr_t_iv_close_ctl "actual segment number of T_IV_CLOSE controller" UBYTE _CNV_A_R_LINEAR_____0_CM 1 0. 0. 15. DISPLAY_IDENTIFIER SEG_NR_T_IV_CLOSE_CTL ECU_ADDRESS 0x7fbf15 FORMAT "%2.0" /end MEASUREMENT
/begin MEASUREMENT sf_iv_close_ctl_act "status word for active T_IV_CLOSE controller" UWORD _CNV_A_R_LINEAR_____0_CM 1 0. 0. 65535. DISPLAY_IDENTIFIER SF_IV_CLOSE_CTL_ACT ECU_ADDRESS 0x7fab8a BYTE_ORDER MSB_LAST FORMAT "%5.0" /end MEASUREMENT
/begin MEASUREMENT sf_pi_ctl_iv_close_max "status word for max reached in T_IV_CLOSE controller" UWORD _CNV_A_R_LINEAR_____0_CM 1 0. 0. 65535. DISPLAY_IDENTIFIER SF_PI_CTL_IV_CLOSE_MAX ECU_ADDRESS 0x7fab8c BYTE_ORDER MSB_LAST FORMAT "%5.0" /end MEASUREMENT
/begin MEASUREMENT sf_pi_ctl_iv_close_min "status word for min reached in T_IV_CLOSE controller" UWORD _CNV_A_R_LINEAR_____0_CM 1 0. 0. 65535. DISPLAY_IDENTIFIER SF_PI_CTL_IV_CLOSE_MIN ECU_ADDRESS 0x7fab8e BYTE_ORDER MSB_LAST FORMAT "%5.0" /end MEASUREMENT
/begin MEASUREMENT sf_pi_ctl_soi_max "status word for max reached in SOI controller" UWORD _CNV_A_R_LINEAR_____0_CM 1 0. 0. 65535. DISPLAY_IDENTIFIER SF_PI_CTL_SOI_MAX ECU_ADDRESS 0x7fab90 BYTE_ORDER MSB_LAST FORMAT "%5.0" /end MEASUREMENT
/begin MEASUREMENT sf_pi_ctl_soi_min "status word for min reached in SOI controller" UWORD _CNV_A_R_LINEAR_____0_CM 1 0. 0. 65535. DISPLAY_IDENTIFIER SF_PI_CTL_SOI_MIN ECU_ADDRESS 0x7fab92 BYTE_ORDER MSB_LAST FORMAT "%5.0" /end MEASUREMENT
/begin MEASUREMENT sf_soi_ctl_act "status word for active SOI controller" UWORD _CNV_A_R_LINEAR_____0_CM 1 0. 0. 65535. DISPLAY_IDENTIFIER SF_SOI_CTL_ACT ECU_ADDRESS 0x7fab94 BYTE_ORDER MSB_LAST FORMAT "%5.0" /end MEASUREMENT
/begin MEASUREMENT t_iv_close_dif_[0] "control deviation of T_IV_CLOSE controller (cylinder individual)" SWORD _CNV_A_R_LINEAR_____540_CM 1 0. -0.512 0.512 DISPLAY_IDENTIFIER T_IV_CLOSE_DIF__0_ ECU_ADDRESS 0x7fab96 BYTE_ORDER MSB_LAST FORMAT "%4.3" /end MEASUREMENT
/begin MEASUREMENT t_iv_close_dif_[1] "control deviation of T_IV_CLOSE controller (cylinder individual)" SWORD _CNV_A_R_LINEAR_____540_CM 1 0. -0.512 0.512 DISPLAY_IDENTIFIER T_IV_CLOSE_DIF__1_ ECU_ADDRESS 0x7fab98 BYTE_ORDER MSB_LAST FORMAT "%4.3" /end MEASUREMENT
/begin MEASUREMENT t_iv_close_dif_[2] "control deviation of T_IV_CLOSE controller (cylinder individual)" SWORD _CNV_A_R_LINEAR_____540_CM 1 0. -0.512 0.512 DISPLAY_IDENTIFIER T_IV_CLOSE_DIF__2_ ECU_ADDRESS 0x7fab9a BYTE_ORDER MSB_LAST FORMAT "%4.3" /end MEASUREMENT
/begin MEASUREMENT t_iv_close_dif_[3] "control deviation of T_IV_CLOSE controller (cylinder individual)" SWORD _CNV_A_R_LINEAR_____540_CM 1 0. -0.512 0.512 DISPLAY_IDENTIFIER T_IV_CLOSE_DIF__3_ ECU_ADDRESS 0x7fab9c BYTE_ORDER MSB_LAST FORMAT "%4.3" /end MEASUREMENT
/begin MEASUREMENT t_iv_close_soi_ctl_dif_[0] "control deviation of SOI controller (cylinder individual)" SWORD _CNV_A_R_LINEAR_____540_CM 1 0. -32.768 32.767 DISPLAY_IDENTIFIER T_IV_CLOSE_SOI_CTL_DIF__0_ ECU_ADDRESS 0x7fab9e BYTE_ORDER MSB_LAST FORMAT "%5.3" /end MEASUREMENT
/begin MEASUREMENT t_iv_close_soi_ctl_dif_[1] "control deviation of SOI controller (cylinder individual)" SWORD _CNV_A_R_LINEAR_____540_CM 1 0. -32.768 32.767 DISPLAY_IDENTIFIER T_IV_CLOSE_SOI_CTL_DIF__1_ ECU_ADDRESS 0x7faba0 BYTE_ORDER MSB_LAST FORMAT "%5.3" /end MEASUREMENT
/begin MEASUREMENT t_iv_close_soi_ctl_dif_[2] "control deviation of SOI controller (cylinder individual)" SWORD _CNV_A_R_LINEAR_____540_CM 1 0. -32.768 32.767 DISPLAY_IDENTIFIER T_IV_CLOSE_SOI_CTL_DIF__2_ ECU_ADDRESS 0x7faba2 BYTE_ORDER MSB_LAST FORMAT "%5.3" /end MEASUREMENT
/begin MEASUREMENT t_iv_close_soi_ctl_dif_[3] "control deviation of SOI controller (cylinder individual)" SWORD _CNV_A_R_LINEAR_____540_CM 1 0. -32.768 32.767 DISPLAY_IDENTIFIER T_IV_CLOSE_SOI_CTL_DIF__3_ ECU_ADDRESS 0x7faba4 BYTE_ORDER MSB_LAST FORMAT "%5.3" /end MEASUREMENT
/begin MEASUREMENT t_iv_close_sp_mv_[0] "cylinder individual mean value of the injection valve closing time set point" UWORD _CNV_A_R_LINEAR_____540_CM 1 0. 0. 0.512 DISPLAY_IDENTIFIER T_IV_CLOSE_SP_MV__0_ ECU_ADDRESS 0x7faba6 BYTE_ORDER MSB_LAST FORMAT "%4.3" /end MEASUREMENT
/begin MEASUREMENT t_iv_close_sp_mv_[1] "cylinder individual mean value of the injection valve closing time set point" UWORD _CNV_A_R_LINEAR_____540_CM 1 0. 0. 0.512 DISPLAY_IDENTIFIER T_IV_CLOSE_SP_MV__1_ ECU_ADDRESS 0x7faba8 BYTE_ORDER MSB_LAST FORMAT "%4.3" /end MEASUREMENT
/begin MEASUREMENT t_iv_close_sp_mv_[2] "cylinder individual mean value of the injection valve closing time set point" UWORD _CNV_A_R_LINEAR_____540_CM 1 0. 0. 0.512 DISPLAY_IDENTIFIER T_IV_CLOSE_SP_MV__2_ ECU_ADDRESS 0x7fabaa BYTE_ORDER MSB_LAST FORMAT "%4.3" /end MEASUREMENT
/begin MEASUREMENT t_iv_close_sp_mv_[3] "cylinder individual mean value of the injection valve closing time set point" UWORD _CNV_A_R_LINEAR_____540_CM 1 0. 0. 0.512 DISPLAY_IDENTIFIER T_IV_CLOSE_SP_MV__3_ ECU_ADDRESS 0x7fabac BYTE_ORDER MSB_LAST FORMAT "%4.3" /end MEASUREMENT
/begin CHARACTERISTIC c_dnom_fil_value_t_iv_close_mmv[0] "MMV of T_IV_CLOSE - FIR filter denominator coefficient vector" VALUE 0x84fc42 _REC_VAL_20_s2 2. _CNV_A_R_LINEAR_____15_CM -1. 1. DISPLAY_IDENTIFIER C_DNOM_FIL_VALUE_T_IV_CLOSE_MMV_0_ FORMAT "%6.5" /end CHARACTERISTIC
/begin CHARACTERISTIC c_dnom_fil_value_t_iv_close_mmv[1] "MMV of T_IV_CLOSE - FIR filter denominator coefficient vector" VALUE 0x84fc44 _REC_VAL_20_s2 2. _CNV_A_R_LINEAR_____15_CM -1. 1. DISPLAY_IDENTIFIER C_DNOM_FIL_VALUE_T_IV_CLOSE_MMV_1_ FORMAT "%6.5" /end CHARACTERISTIC
/begin CHARACTERISTIC c_dnom_fil_value_t_iv_close_mmv[2] "MMV of T_IV_CLOSE - FIR filter denominator coefficient vector" VALUE 0x84fc46 _REC_VAL_20_s2 2. _CNV_A_R_LINEAR_____15_CM -1. 1. DISPLAY_IDENTIFIER C_DNOM_FIL_VALUE_T_IV_CLOSE_MMV_2_ FORMAT "%6.5" /end CHARACTERISTIC
/begin CHARACTERISTIC c_dnom_fil_value_t_iv_close_mmv[3] "MMV of T_IV_CLOSE - FIR filter denominator coefficient vector" VALUE 0x84fc48 _REC_VAL_20_s2 2. _CNV_A_R_LINEAR_____15_CM -1. 1. DISPLAY_IDENTIFIER C_DNOM_FIL_VALUE_T_IV_CLOSE_MMV_3_ FORMAT "%6.5" /end CHARACTERISTIC
/begin CHARACTERISTIC c_dnom_fil_value_t_iv_close_mmv[4] "MMV of T_IV_CLOSE - FIR filter denominator coefficient vector" VALUE 0x84fc4a _REC_VAL_20_s2 2. _CNV_A_R_LINEAR_____15_CM -1. 1. DISPLAY_IDENTIFIER C_DNOM_FIL_VALUE_T_IV_CLOSE_MMV_4_ FORMAT "%6.5" /end CHARACTERISTIC
/begin CHARACTERISTIC c_dnom_fil_value_t_iv_close_mmv[5] "MMV of T_IV_CLOSE - FIR filter denominator coefficient vector" VALUE 0x84fc4c _REC_VAL_20_s2 2. _CNV_A_R_LINEAR_____15_CM -1. 1. DISPLAY_IDENTIFIER C_DNOM_FIL_VALUE_T_IV_CLOSE_MMV_5_ FORMAT "%6.5" /end CHARACTERISTIC
/begin CHARACTERISTIC c_dnom_fil_value_t_iv_close_mmv[6] "MMV of T_IV_CLOSE - FIR filter denominator coefficient vector" VALUE 0x84fc4e _REC_VAL_20_s2 2. _CNV_A_R_LINEAR_____15_CM -1. 1. DISPLAY_IDENTIFIER C_DNOM_FIL_VALUE_T_IV_CLOSE_MMV_6_ FORMAT "%6.5" /end CHARACTERISTIC
/begin CHARACTERISTIC c_dnom_fil_value_t_iv_close_mmv[7] "MMV of T_IV_CLOSE - FIR filter denominator coefficient vector" VALUE 0x84fc50 _REC_VAL_20_s2 2. _CNV_A_R_LINEAR_____15_CM -1. 1. DISPLAY_IDENTIFIER C_DNOM_FIL_VALUE_T_IV_CLOSE_MMV_7_ FORMAT "%6.5" /end CHARACTERISTIC
/begin CHARACTERISTIC c_dnom_fil_value_t_iv_close_mmv[8] "MMV of T_IV_CLOSE - FIR filter denominator coefficient vector" VALUE 0x84fc52 _REC_VAL_20_s2 2. _CNV_A_R_LINEAR_____15_CM -1. 1. DISPLAY_IDENTIFIER C_DNOM_FIL_VALUE_T_IV_CLOSE_MMV_8_ FORMAT "%6.5" /end CHARACTERISTIC
/begin CHARACTERISTIC c_dnom_fil_value_t_iv_close_mmv[9] "MMV of T_IV_CLOSE - FIR filter denominator coefficient vector" VALUE 0x84fc54 _REC_VAL_20_s2 2. _CNV_A_R_LINEAR_____15_CM -1. 1. DISPLAY_IDENTIFIER C_DNOM_FIL_VALUE_T_IV_CLOSE_MMV_9_ FORMAT "%6.5" /end CHARACTERISTIC
/begin CHARACTERISTIC c_kr_pi_soi_ctl "SOI control PI amplification" VALUE 0x84fd7e _REC_VAL_20_s2 1999.96948 _CNV_A_R_LINEAR_____556_CM -1000. 999.96948 DISPLAY_IDENTIFIER C_KR_PI_SOI_CTL FORMAT "%5.2" /end CHARACTERISTIC
/begin CHARACTERISTIC c_kr_pi_t_iv_close_ctl "T_IV_CLOSE_CTL PI amplification" VALUE 0x84fd80 _REC_VAL_20_s2 1999.96948 _CNV_A_R_LINEAR_____557_CM -1000. 999.96948 DISPLAY_IDENTIFIER C_KR_PI_T_IV_CLOSE_CTL FORMAT "%5.2" /end CHARACTERISTIC
/begin CHARACTERISTIC c_lim_egy_sp_err_t_iv_ctl_max "T_IV_CLOSE_CTL error output maximum limit" VALUE 0x84fda0 _REC_VAL_20_u2 261.3875315 _CNV_A_R_LINEAR_____553_CM 0. 261.3875315 DISPLAY_IDENTIFIER C_LIM_EGY_SP_ERR_T_IV_CTL_MAX /end CHARACTERISTIC
/begin CHARACTERISTIC c_lim_egy_sp_err_t_iv_ctl_min "T_IV_CLOSE_CTL error output minimum limit" VALUE 0x84fda2 _REC_VAL_20_s2 261.3875315 _CNV_A_R_LINEAR_____554_CM -261.3875315 0. DISPLAY_IDENTIFIER C_LIM_EGY_SP_ERR_T_IV_CTL_MIN FORMAT "%4.3" /end CHARACTERISTIC
/begin CHARACTERISTIC c_lim_pi_t_iv_close_ctl_max "T_IV_CLOSE_CTL integrator maximum limit" VALUE 0x84fdac _REC_VAL_20_u2 261.3875315 _CNV_A_R_LINEAR_____553_CM 0. 261.3875315 DISPLAY_IDENTIFIER C_LIM_PI_T_IV_CLOSE_CTL_MAX /end CHARACTERISTIC
/begin CHARACTERISTIC c_lim_pi_t_iv_close_ctl_min "T_IV_CLOSE_CTL integrator minimum limit" VALUE 0x84fdae _REC_VAL_20_s2 261.3875315 _CNV_A_R_LINEAR_____554_CM -261.3875315 0. DISPLAY_IDENTIFIER C_LIM_PI_T_IV_CLOSE_CTL_MIN FORMAT "%4.3" /end CHARACTERISTIC
/begin CHARACTERISTIC c_lim_t_pi_soi_ctl_max "SOI controller integrator maximum time" VALUE 0x84fdb4 _REC_VAL_20_s2 65.535 _CNV_A_R_LINEAR_____540_CM -32.768 32.767 DISPLAY_IDENTIFIER C_LIM_T_PI_SOI_CTL_MAX FORMAT "%5.3" /end CHARACTERISTIC
/begin CHARACTERISTIC c_lim_t_pi_soi_ctl_min "SOI controller integrator minimum time" VALUE 0x84fdb6 _REC_VAL_20_s2 65.535 _CNV_A_R_LINEAR_____540_CM -32.768 32.767 DISPLAY_IDENTIFIER C_LIM_T_PI_SOI_CTL_MIN FORMAT "%5.3" /end CHARACTERISTIC
/begin CHARACTERISTIC c_lim_t_soi_ofs_soi_ctl_max "SOI controller output maximum time" VALUE 0x84fdb8 _REC_VAL_20_s2 65.535 _CNV_A_R_LINEAR_____540_CM -32.768 32.767 DISPLAY_IDENTIFIER C_LIM_T_SOI_OFS_SOI_CTL_MAX FORMAT "%5.3" /end CHARACTERISTIC
/begin CHARACTERISTIC c_lim_t_soi_ofs_soi_ctl_min "SOI controller output minimum time" VALUE 0x84fdba _REC_VAL_20_s2 65.535 _CNV_A_R_LINEAR_____540_CM -32.768 32.767 DISPLAY_IDENTIFIER C_LIM_T_SOI_OFS_SOI_CTL_MIN FORMAT "%5.3" /end CHARACTERISTIC
/begin CHARACTERISTIC c_num_fil_value_t_iv_close_mmv[0] "MMV of T_IV_CLOSE - FIR filter numerator coefficient vector" VALUE 0x84fe72 _REC_VAL_20_s2 2. _CNV_A_R_LINEAR_____15_CM -1. 1. DISPLAY_IDENTIFIER C_NUM_FIL_VALUE_T_IV_CLOSE_MMV_0_ FORMAT "%6.5" /end CHARACTERISTIC
/begin CHARACTERISTIC c_num_fil_value_t_iv_close_mmv[1] "MMV of T_IV_CLOSE - FIR filter numerator coefficient vector" VALUE 0x84fe74 _REC_VAL_20_s2 2. _CNV_A_R_LINEAR_____15_CM -1. 1. DISPLAY_IDENTIFIER C_NUM_FIL_VALUE_T_IV_CLOSE_MMV_1_ FORMAT "%6.5" /end CHARACTERISTIC
/begin CHARACTERISTIC c_num_fil_value_t_iv_close_mmv[2] "MMV of T_IV_CLOSE - FIR filter numerator coefficient vector" VALUE 0x84fe76 _REC_VAL_20_s2 2. _CNV_A_R_LINEAR_____15_CM -1. 1. DISPLAY_IDENTIFIER C_NUM_FIL_VALUE_T_IV_CLOSE_MMV_2_ FORMAT "%6.5" /end CHARACTERISTIC
/begin CHARACTERISTIC c_num_fil_value_t_iv_close_mmv[3] "MMV of T_IV_CLOSE - FIR filter numerator coefficient vector" VALUE 0x84fe78 _REC_VAL_20_s2 2. _CNV_A_R_LINEAR_____15_CM -1. 1. DISPLAY_IDENTIFIER C_NUM_FIL_VALUE_T_IV_CLOSE_MMV_3_ FORMAT "%6.5" /end CHARACTERISTIC
/begin CHARACTERISTIC c_num_fil_value_t_iv_close_mmv[4] "MMV of T_IV_CLOSE - FIR filter numerator coefficient vector" VALUE 0x84fe7a _REC_VAL_20_s2 2. _CNV_A_R_LINEAR_____15_CM -1. 1. DISPLAY_IDENTIFIER C_NUM_FIL_VALUE_T_IV_CLOSE_MMV_4_ FORMAT "%6.5" /end CHARACTERISTIC
/begin CHARACTERISTIC c_num_fil_value_t_iv_close_mmv[5] "MMV of T_IV_CLOSE - FIR filter numerator coefficient vector" VALUE 0x84fe7c _REC_VAL_20_s2 2. _CNV_A_R_LINEAR_____15_CM -1. 1. DISPLAY_IDENTIFIER C_NUM_FIL_VALUE_T_IV_CLOSE_MMV_5_ FORMAT "%6.5" /end CHARACTERISTIC
/begin CHARACTERISTIC c_num_fil_value_t_iv_close_mmv[6] "MMV of T_IV_CLOSE - FIR filter numerator coefficient vector" VALUE 0x84fe7e _REC_VAL_20_s2 2. _CNV_A_R_LINEAR_____15_CM -1. 1. DISPLAY_IDENTIFIER C_NUM_FIL_VALUE_T_IV_CLOSE_MMV_6_ FORMAT "%6.5" /end CHARACTERISTIC
/begin CHARACTERISTIC c_num_fil_value_t_iv_close_mmv[7] "MMV of T_IV_CLOSE - FIR filter numerator coefficient vector" VALUE 0x84fe80 _REC_VAL_20_s2 2. _CNV_A_R_LINEAR_____15_CM -1. 1. DISPLAY_IDENTIFIER C_NUM_FIL_VALUE_T_IV_CLOSE_MMV_7_ FORMAT "%6.5" /end CHARACTERISTIC
/begin CHARACTERISTIC c_num_fil_value_t_iv_close_mmv[8] "MMV of T_IV_CLOSE - FIR filter numerator coefficient vector" VALUE 0x84fe82 _REC_VAL_20_s2 2. _CNV_A_R_LINEAR_____15_CM -1. 1. DISPLAY_IDENTIFIER C_NUM_FIL_VALUE_T_IV_CLOSE_MMV_8_ FORMAT "%6.5" /end CHARACTERISTIC
/begin CHARACTERISTIC c_num_fil_value_t_iv_close_mmv[9] "MMV of T_IV_CLOSE - FIR filter numerator coefficient vector" VALUE 0x84fe84 _REC_VAL_20_s2 2. _CNV_A_R_LINEAR_____15_CM -1. 1. DISPLAY_IDENTIFIER C_NUM_FIL_VALUE_T_IV_CLOSE_MMV_9_ FORMAT "%6.5" /end CHARACTERISTIC
/begin CHARACTERISTIC c_t_iv_close_max "maximum value of acceptable injection valve closing time" VALUE 0x84ffa0 _REC_VAL_20_u2 0.512 _CNV_A_R_LINEAR_____540_CM 0. 0.512 DISPLAY_IDENTIFIER C_T_IV_CLOSE_MAX FORMAT "%4.3" /end CHARACTERISTIC
/begin CHARACTERISTIC c_t_iv_close_min "minimum value of acceptable injection valve closing time" VALUE 0x84ffa2 _REC_VAL_20_u2 0.512 _CNV_A_R_LINEAR_____540_CM 0. 0.512 DISPLAY_IDENTIFIER C_T_IV_CLOSE_MIN FORMAT "%4.3" /end CHARACTERISTIC
/begin CHARACTERISTIC c_t_iv_close_mmv_fil_ini "initialisation value for MMF state variables of T_IV_CLOSE" VALUE 0x84ffa4 _REC_VAL_20_u2 0.512 _CNV_A_R_LINEAR_____540_CM 0. 0.512 DISPLAY_IDENTIFIER C_T_IV_CLOSE_MMV_FIL_INI FORMAT "%4.3" /end CHARACTERISTIC
/begin CHARACTERISTIC c_t_iv_close_mmv_inp_max_lim "maximum input value for MMF of T_IV_CLOSE" VALUE 0x84ffa6 _REC_VAL_20_u2 0.512 _CNV_A_R_LINEAR_____540_CM 0. 0.512 DISPLAY_IDENTIFIER C_T_IV_CLOSE_MMV_INP_MAX_LIM FORMAT "%4.3" /end CHARACTERISTIC
/begin CHARACTERISTIC c_t_iv_close_mmv_inp_min_lim "minimum input value for MMF of T_IV_CLOSE" VALUE 0x84ffa8 _REC_VAL_20_u2 0.512 _CNV_A_R_LINEAR_____540_CM 0. 0.512 DISPLAY_IDENTIFIER C_T_IV_CLOSE_MMV_INP_MIN_LIM FORMAT "%4.3" /end CHARACTERISTIC
/begin CHARACTERISTIC c_t_iv_close_mmv_out_max_lim "maximum output value of MMF of T_IV_CLOSE" VALUE 0x84ffaa _REC_VAL_20_u2 0.512 _CNV_A_R_LINEAR_____540_CM 0. 0.512 DISPLAY_IDENTIFIER C_T_IV_CLOSE_MMV_OUT_MAX_LIM FORMAT "%4.3" /end CHARACTERISTIC
/begin CHARACTERISTIC c_t_iv_close_mmv_out_min_lim "minimum output value of MMF of T_IV_CLOSE" VALUE 0x84ffac _REC_VAL_20_u2 0.512 _CNV_A_R_LINEAR_____540_CM 0. 0.512 DISPLAY_IDENTIFIER C_T_IV_CLOSE_MMV_OUT_MIN_LIM FORMAT "%4.3" /end CHARACTERISTIC
/begin CHARACTERISTIC lc_iv_foc_iv_close_ctl_sel "select IV control (1: IV_FOC_CTL and SOI_CTL, 0: only IV_CLOSE_CTL)" VALUE 0x85014d _REC_VAL_20_u1 1. _CNV_A_R_LINEAR_____0_CM 0. 1. DISPLAY_IDENTIFIER LC_IV_FOC_IV_CLOSE_CTL_SEL FORMAT "%1.0" /end CHARACTERISTIC
/begin CHARACTERISTIC lc_soi_ctl_on "switch on SOI control" VALUE 0x850162 _REC_VAL_20_u1 1. _CNV_A_R_LINEAR_____0_CM 0. 1. DISPLAY_IDENTIFIER LC_SOI_CTL_ON FORMAT "%1.0" /end CHARACTERISTIC
/begin CHARACTERISTIC lc_t_iv_close_ctl_on "switch injection valve closing time controller on" VALUE 0x850167 _REC_VAL_20_u1 1. _CNV_A_R_LINEAR_____0_CM 0. 1. DISPLAY_IDENTIFIER LC_T_IV_CLOSE_CTL_ON FORMAT "%1.0" /end CHARACTERISTIC
/begin CHARACTERISTIC ip_egy_sp_ofs_t_ctl__tco "PECO_CLCO: T_IV_CLOSE_CTL energy set point offset depending on TCO" CURVE 0x847e98 _REC_CUR_20_u2_u1 522.7750630000001 _CNV_A_R_LINEAR_____555_CM -261.3875315 261.3875315 DISPLAY_IDENTIFIER IP_EGY_SP_OFS_T_CTL__TCO
 /begin AXIS_DESCR COM_AXIS tco _CNV_A_R_LINEAR_____18_CM 5 -50. 205. FORMAT "%3.0" AXIS_PTS_REF ldpm_tco_ip_egy_sp_close_ctl /end AXIS_DESCR
/end CHARACTERISTIC
/begin AXIS_PTS ldpm_tco_ip_egy_sp_close_ctl "" 0x8437a3 tco _REC_AXS_20_u1 255. _CNV_A_R_LINEAR_____18_CM 5 -50. 205. FORMAT "%3.0" /end AXIS_PTS
/begin CHARACTERISTIC ip_tn_pi_neg_soi_ctl__n "PECO_CLCO: SOI_CTL error integral time at negative deviation" CURVE 0x84f606 _REC_CUR_20_u2_u2 3276.7 _CNV_A_R_LINEAR_____548_CM 0. 3276.7 DISPLAY_IDENTIFIER IP_TN_PI_NEG_SOI_CTL__N FORMAT "%5.1"
 /begin AXIS_DESCR COM_AXIS n _CNV_A_R_LINEAR_____5_CM 10 0. 6375. FORMAT "%4.0" AXIS_PTS_REF ldpm_n_ip_tn_pi_iv_close_ctl /end AXIS_DESCR
/end CHARACTERISTIC
/begin AXIS_PTS ldpm_n_ip_tn_pi_iv_close_ctl "" 0x843576 n _REC_AXS_20_u2 6375. _CNV_A_R_LINEAR_____5_CM 10 0. 6375. FORMAT "%4.0" /end AXIS_PTS
/begin CHARACTERISTIC ip_tn_pi_neg_t_iv_close_ctl__n "PECO_CLCO: T_IV_CLOSE_CTL error integral time at negative deviation" CURVE 0x84f61a _REC_CUR_20_u2_u2 3276.7 _CNV_A_R_LINEAR_____548_CM 0. 3276.7 DISPLAY_IDENTIFIER IP_TN_PI_NEG_T_IV_CLOSE_CTL__N FORMAT "%5.1"
 /begin AXIS_DESCR COM_AXIS n _CNV_A_R_LINEAR_____5_CM 10 0. 6375. FORMAT "%4.0" AXIS_PTS_REF ldpm_n_ip_tn_pi_iv_close_ctl /end AXIS_DESCR
/end CHARACTERISTIC
/begin CHARACTERISTIC ip_tn_pi_pos_soi_ctl__n "PECO_CLCO: SOI_CTL error integral time at positive deviation" CURVE 0x84f656 _REC_CUR_20_u2_u2 3276.7 _CNV_A_R_LINEAR_____548_CM 0. 3276.7 DISPLAY_IDENTIFIER IP_TN_PI_POS_SOI_CTL__N FORMAT "%5.1"
 /begin AXIS_DESCR COM_AXIS n _CNV_A_R_LINEAR_____5_CM 10 0. 6375. FORMAT "%4.0" AXIS_PTS_REF ldpm_n_ip_tn_pi_iv_close_ctl /end AXIS_DESCR
/end CHARACTERISTIC
/begin CHARACTERISTIC ip_tn_pi_pos_t_iv_close_ctl__n "PECO_CLCO: T_IV_CLOSE_CTL error integral time at positive deviation" CURVE 0x84f66a _REC_CUR_20_u2_u2 3276.7 _CNV_A_R_LINEAR_____548_CM 0. 3276.7 DISPLAY_IDENTIFIER IP_TN_PI_POS_T_IV_CLOSE_CTL__N FORMAT "%5.1"
 /begin AXIS_DESCR COM_AXIS n _CNV_A_R_LINEAR_____5_CM 10 0. 6375. FORMAT "%4.0" AXIS_PTS_REF ldpm_n_ip_tn_pi_iv_close_ctl /end AXIS_DESCR
/end CHARACTERISTIC
/begin CHARACTERISTIC ip_egy_sp_t_close_ctl__n__doi "PECO_CLCO: T_IV_CLOSE_CTL energy set point depending on N and DOI" MAP 0x847ea2 _REC_MAP_20_u2_u2_u2 522.7750632 _CNV_A_R_LINEAR_____541_CM 0. 522.7750632 DISPLAY_IDENTIFIER IP_EGY_SP_T_CLOSE_CTL__N__DOI
 /begin AXIS_DESCR COM_AXIS n _CNV_A_R_LINEAR_____5_CM 5 0. 6375. FORMAT "%4.0" AXIS_PTS_REF ldpm_n_ip_egy_sp_close_ctl /end AXIS_DESCR
 /begin AXIS_DESCR COM_AXIS dummy_peco _CNV_A_R_LINEAR_____119_CM 5 0. 360. FORMAT "%5.2" AXIS_PTS_REF ldp_doi_ip_egy_sp_close_ctl /end AXIS_DESCR
/end CHARACTERISTIC
/begin AXIS_PTS ldpm_n_ip_egy_sp_close_ctl "" 0x843066 n _REC_AXS_20_u2 6375. _CNV_A_R_LINEAR_____5_CM 5 0. 6375. FORMAT "%4.0" /end AXIS_PTS
/begin AXIS_PTS ldp_doi_ip_egy_sp_close_ctl "" 0x8415da dummy_peco _REC_AXS_20_u2 360. _CNV_A_R_LINEAR_____119_CM 5 0. 360. FORMAT "%5.2" /end AXIS_PTS
/begin CHARACTERISTIC ip_egy_sp_t_close_ctl__n__soi "PECO_CLCO: T_IV_CLOSE_CTL energy set point depending on N and SOI" MAP 0x847ed4 _REC_MAP_20_u2_u2_u2 522.7750632 _CNV_A_R_LINEAR_____541_CM 0. 522.7750632 DISPLAY_IDENTIFIER IP_EGY_SP_T_CLOSE_CTL__N__SOI
 /begin AXIS_DESCR COM_AXIS n _CNV_A_R_LINEAR_____5_CM 5 0. 6375. FORMAT "%4.0" AXIS_PTS_REF ldpm_n_ip_egy_sp_close_ctl /end AXIS_DESCR
 /begin AXIS_DESCR COM_AXIS soi_main1_pwr_on_tu _CNV_A_R_LINEAR_____118_CM 5 -120. 240. FORMAT "%5.2" AXIS_PTS_REF ldp_soi_ip_egy_sp_close_ctl /end AXIS_DESCR
/end CHARACTERISTIC
/begin AXIS_PTS ldp_soi_ip_egy_sp_close_ctl "" 0x84215a soi_main1_pwr_on_tu _REC_AXS_20_u2 360. _CNV_A_R_LINEAR_____118_CM 5 -120. 240. FORMAT "%5.2" /end AXIS_PTS
/begin CHARACTERISTIC ip_fac_egy_sp_t_ctl__tco__capa "PECO_CLCO: T_IV_CLOSE_CTL energy set point tuning depending on TCO and CAPA representing the piezo temperature" MAP 0x8480bc _REC_MAP_20_u2_u1_u1 1.9999696 _CNV_A_R_LINEAR_____48_CM 0. 1.9999696 DISPLAY_IDENTIFIER IP_FAC_EGY_SP_T_CTL__TCO__CAPA FORMAT "%6.5"
 /begin AXIS_DESCR COM_AXIS tco _CNV_A_R_LINEAR_____18_CM 5 -50. 205. FORMAT "%3.0" AXIS_PTS_REF ldpm_tco_ip_egy_sp_close_ctl /end AXIS_DESCR
 /begin AXIS_DESCR COM_AXIS dummy_peco _CNV_A_R_LINEAR_____120_CM 5 0. 31.96875 FORMAT "%3.1" AXIS_PTS_REF ldp_capa_ip_egy_sp_close_ctl /end AXIS_DESCR
/end CHARACTERISTIC
/begin AXIS_PTS ldp_capa_ip_egy_sp_close_ctl "" 0x841466 dummy_peco _REC_AXS_20_u1 31.96875 _CNV_A_R_LINEAR_____120_CM 5 0. 31.96875 FORMAT "%3.1" /end AXIS_PTS
/begin CHARACTERISTIC ip_t_iv_close_sp__n__doi "PECO_CLCO: valve needle closing time set point depending on N and DOI" MAP 0x84ee7a _REC_MAP_20_u2_u2_u2 0.512 _CNV_A_R_LINEAR_____540_CM 0. 0.512 DISPLAY_IDENTIFIER IP_T_IV_CLOSE_SP__N__DOI FORMAT "%4.3"
 /begin AXIS_DESCR COM_AXIS n _CNV_A_R_LINEAR_____5_CM 5 0. 6375. FORMAT "%4.0" AXIS_PTS_REF ldpm_n_ip_t_iv_close_sp /end AXIS_DESCR
 /begin AXIS_DESCR COM_AXIS dummy_peco _CNV_A_R_LINEAR_____119_CM 5 0. 360. FORMAT "%5.2" AXIS_PTS_REF ldp_doi_ip_t_iv_close_sp /end AXIS_DESCR
/end CHARACTERISTIC
/begin AXIS_PTS ldpm_n_ip_t_iv_close_sp "" 0x843532 n _REC_AXS_20_u2 6375. _CNV_A_R_LINEAR_____5_CM 5 0. 6375. FORMAT "%4.0" /end AXIS_PTS
/begin AXIS_PTS ldp_doi_ip_t_iv_close_sp "" 0x8415f2 dummy_peco _REC_AXS_20_u2 360. _CNV_A_R_LINEAR_____119_CM 5 0. 360. FORMAT "%5.2" /end AXIS_PTS
/begin CHARACTERISTIC ip_t_iv_close_sp__n__soi "PECO_CLCO: valve needle closing time set point depending on N and SOI" MAP 0x84eeac _REC_MAP_20_u2_u2_u2 0.512 _CNV_A_R_LINEAR_____540_CM 0. 0.512 DISPLAY_IDENTIFIER IP_T_IV_CLOSE_SP__N__SOI FORMAT "%4.3"
 /begin AXIS_DESCR COM_AXIS n _CNV_A_R_LINEAR_____5_CM 5 0. 6375. FORMAT "%4.0" AXIS_PTS_REF ldpm_n_ip_t_iv_close_sp /end AXIS_DESCR
 /begin AXIS_DESCR COM_AXIS soi_main1_pwr_on_tu _CNV_A_R_LINEAR_____118_CM 5 -120. 240. FORMAT "%5.2" AXIS_PTS_REF ldp_soi_ip_t_iv_close_sp /end AXIS_DESCR
/end CHARACTERISTIC
/begin AXIS_PTS ldp_soi_ip_t_iv_close_sp "" 0x842172 soi_main1_pwr_on_tu _REC_AXS_20_u2 360. _CNV_A_R_LINEAR_____118_CM 5 -120. 240. FORMAT "%5.2" /end AXIS_PTS
/begin CHARACTERISTIC ip_t_iv_close_sp__tco__capa "PECO_CLCO: valve needle closing time set point depending on TCO and CAPA_INJ representing piezo temperature" MAP 0x84eede _REC_MAP_20_u2_u1_u1 0.512 _CNV_A_R_LINEAR_____540_CM 0. 0.512 DISPLAY_IDENTIFIER IP_T_IV_CLOSE_SP__TCO__CAPA FORMAT "%4.3"
 /begin AXIS_DESCR COM_AXIS tco _CNV_A_R_LINEAR_____18_CM 5 -50. 205. FORMAT "%3.0" AXIS_PTS_REF ldp_tco_ip_t_iv_close_sp /end AXIS_DESCR
 /begin AXIS_DESCR COM_AXIS dummy_peco _CNV_A_R_LINEAR_____120_CM 5 0. 31.96875 FORMAT "%3.1" AXIS_PTS_REF ldp_capa_ip_t_iv_close_sp /end AXIS_DESCR
/end CHARACTERISTIC
/begin AXIS_PTS ldp_tco_ip_t_iv_close_sp "" 0x8423df tco _REC_AXS_20_u1 255. _CNV_A_R_LINEAR_____18_CM 5 -50. 205. FORMAT "%3.0" /end AXIS_PTS
/begin AXIS_PTS ldp_capa_ip_t_iv_close_sp "" 0x841472 dummy_peco _REC_AXS_20_u1 31.96875 _CNV_A_R_LINEAR_____120_CM 5 0. 31.96875 FORMAT "%3.1" /end AXIS_PTS
/begin CHARACTERISTIC lc_t_iv_close_sel "select t_iv_close (1: t_iv_close_stat_mean_, 0: t_iv_close_)" VALUE 0x850168 _REC_VAL_20_u1 255. _CNV_A_R_LINEAR_____0_CM 0. 255. DISPLAY_IDENTIFIER LC_T_IV_CLOSE_SEL FORMAT "%1.0" /end CHARACTERISTIC
/begin MEASUREMENT t_soi_ofs_ctl_bas_[0] "cylinder individual SOI correction basic value for all injections" SWORD _CNV_A_R_LINEAR_____540_CM 1 0. -32.768 32.767 DISPLAY_IDENTIFIER T_SOI_OFS_CTL_BAS__0_ ECU_ADDRESS 0x7f9fbe BYTE_ORDER MSB_LAST FORMAT "%5.3" /end MEASUREMENT
/begin MEASUREMENT t_soi_ofs_ctl_bas_[1] "cylinder individual SOI correction basic value for all injections" SWORD _CNV_A_R_LINEAR_____540_CM 1 0. -32.768 32.767 DISPLAY_IDENTIFIER T_SOI_OFS_CTL_BAS__1_ ECU_ADDRESS 0x7f9fc0 BYTE_ORDER MSB_LAST FORMAT "%5.3" /end MEASUREMENT
/begin MEASUREMENT t_soi_ofs_ctl_bas_[2] "cylinder individual SOI correction basic value for all injections" SWORD _CNV_A_R_LINEAR_____540_CM 1 0. -32.768 32.767 DISPLAY_IDENTIFIER T_SOI_OFS_CTL_BAS__2_ ECU_ADDRESS 0x7f9fc2 BYTE_ORDER MSB_LAST FORMAT "%5.3" /end MEASUREMENT
/begin MEASUREMENT t_soi_ofs_ctl_bas_[3] "cylinder individual SOI correction basic value for all injections" SWORD _CNV_A_R_LINEAR_____540_CM 1 0. -32.768 32.767 DISPLAY_IDENTIFIER T_SOI_OFS_CTL_BAS__3_ ECU_ADDRESS 0x7f9fc4 BYTE_ORDER MSB_LAST FORMAT "%5.3" /end MEASUREMENT
/begin MEASUREMENT t_soi_ofs_ctl_fil_[0] "cylinder individual SOI correction filtered value for all injections" SWORD _CNV_A_R_LINEAR_____540_CM 1 0. -32.768 32.767 DISPLAY_IDENTIFIER T_SOI_OFS_CTL_FIL__0_ ECU_ADDRESS 0x7f9fc6 BYTE_ORDER MSB_LAST FORMAT "%5.3" /end MEASUREMENT
/begin MEASUREMENT t_soi_ofs_ctl_fil_[1] "cylinder individual SOI correction filtered value for all injections" SWORD _CNV_A_R_LINEAR_____540_CM 1 0. -32.768 32.767 DISPLAY_IDENTIFIER T_SOI_OFS_CTL_FIL__1_ ECU_ADDRESS 0x7f9fc8 BYTE_ORDER MSB_LAST FORMAT "%5.3" /end MEASUREMENT
/begin MEASUREMENT t_soi_ofs_ctl_fil_[2] "cylinder individual SOI correction filtered value for all injections" SWORD _CNV_A_R_LINEAR_____540_CM 1 0. -32.768 32.767 DISPLAY_IDENTIFIER T_SOI_OFS_CTL_FIL__2_ ECU_ADDRESS 0x7f9fca BYTE_ORDER MSB_LAST FORMAT "%5.3" /end MEASUREMENT
/begin MEASUREMENT t_soi_ofs_ctl_fil_[3] "cylinder individual SOI correction filtered value for all injections" SWORD _CNV_A_R_LINEAR_____540_CM 1 0. -32.768 32.767 DISPLAY_IDENTIFIER T_SOI_OFS_CTL_FIL__3_ ECU_ADDRESS 0x7f9fcc BYTE_ORDER MSB_LAST FORMAT "%5.3" /end MEASUREMENT
/begin CHARACTERISTIC lc_t_soi_ctl_sel "select soi control (1: t_soi_ofs_ctl_fil_, 0: t_soi_ofs_ctl_bas_)" VALUE 0x85016b _REC_VAL_20_u1 1. _CNV_A_R_LINEAR_____0_CM 0. 1. DISPLAY_IDENTIFIER LC_T_SOI_CTL_SEL FORMAT "%1.0" /end CHARACTERISTIC
/begin CHARACTERISTIC c_dnom_fil_value_t_soi_ctl_mmv[0] "MMV of T_SOI_CTL - FIR filter denominator coefficient vector" VALUE 0x84fc56 _REC_VAL_20_s2 2. _CNV_A_R_LINEAR_____15_CM -1. 1. DISPLAY_IDENTIFIER C_DNOM_FIL_VALUE_T_SOI_CTL_MMV_0_ FORMAT "%6.5" /end CHARACTERISTIC
/begin CHARACTERISTIC c_dnom_fil_value_t_soi_ctl_mmv[1] "MMV of T_SOI_CTL - FIR filter denominator coefficient vector" VALUE 0x84fc58 _REC_VAL_20_s2 2. _CNV_A_R_LINEAR_____15_CM -1. 1. DISPLAY_IDENTIFIER C_DNOM_FIL_VALUE_T_SOI_CTL_MMV_1_ FORMAT "%6.5" /end CHARACTERISTIC
/begin CHARACTERISTIC c_dnom_fil_value_t_soi_ctl_mmv[2] "MMV of T_SOI_CTL - FIR filter denominator coefficient vector" VALUE 0x84fc5a _REC_VAL_20_s2 2. _CNV_A_R_LINEAR_____15_CM -1. 1. DISPLAY_IDENTIFIER C_DNOM_FIL_VALUE_T_SOI_CTL_MMV_2_ FORMAT "%6.5" /end CHARACTERISTIC
/begin CHARACTERISTIC c_dnom_fil_value_t_soi_ctl_mmv[3] "MMV of T_SOI_CTL - FIR filter denominator coefficient vector" VALUE 0x84fc5c _REC_VAL_20_s2 2. _CNV_A_R_LINEAR_____15_CM -1. 1. DISPLAY_IDENTIFIER C_DNOM_FIL_VALUE_T_SOI_CTL_MMV_3_ FORMAT "%6.5" /end CHARACTERISTIC
/begin CHARACTERISTIC c_dnom_fil_value_t_soi_ctl_mmv[4] "MMV of T_SOI_CTL - FIR filter denominator coefficient vector" VALUE 0x84fc5e _REC_VAL_20_s2 2. _CNV_A_R_LINEAR_____15_CM -1. 1. DISPLAY_IDENTIFIER C_DNOM_FIL_VALUE_T_SOI_CTL_MMV_4_ FORMAT "%6.5" /end CHARACTERISTIC
/begin CHARACTERISTIC c_dnom_fil_value_t_soi_ctl_mmv[5] "MMV of T_SOI_CTL - FIR filter denominator coefficient vector" VALUE 0x84fc60 _REC_VAL_20_s2 2. _CNV_A_R_LINEAR_____15_CM -1. 1. DISPLAY_IDENTIFIER C_DNOM_FIL_VALUE_T_SOI_CTL_MMV_5_ FORMAT "%6.5" /end CHARACTERISTIC
/begin CHARACTERISTIC c_dnom_fil_value_t_soi_ctl_mmv[6] "MMV of T_SOI_CTL - FIR filter denominator coefficient vector" VALUE 0x84fc62 _REC_VAL_20_s2 2. _CNV_A_R_LINEAR_____15_CM -1. 1. DISPLAY_IDENTIFIER C_DNOM_FIL_VALUE_T_SOI_CTL_MMV_6_ FORMAT "%6.5" /end CHARACTERISTIC
/begin CHARACTERISTIC c_dnom_fil_value_t_soi_ctl_mmv[7] "MMV of T_SOI_CTL - FIR filter denominator coefficient vector" VALUE 0x84fc64 _REC_VAL_20_s2 2. _CNV_A_R_LINEAR_____15_CM -1. 1. DISPLAY_IDENTIFIER C_DNOM_FIL_VALUE_T_SOI_CTL_MMV_7_ FORMAT "%6.5" /end CHARACTERISTIC
/begin CHARACTERISTIC c_dnom_fil_value_t_soi_ctl_mmv[8] "MMV of T_SOI_CTL - FIR filter denominator coefficient vector" VALUE 0x84fc66 _REC_VAL_20_s2 2. _CNV_A_R_LINEAR_____15_CM -1. 1. DISPLAY_IDENTIFIER C_DNOM_FIL_VALUE_T_SOI_CTL_MMV_8_ FORMAT "%6.5" /end CHARACTERISTIC
/begin CHARACTERISTIC c_dnom_fil_value_t_soi_ctl_mmv[9] "MMV of T_SOI_CTL - FIR filter denominator coefficient vector" VALUE 0x84fc68 _REC_VAL_20_s2 2. _CNV_A_R_LINEAR_____15_CM -1. 1. DISPLAY_IDENTIFIER C_DNOM_FIL_VALUE_T_SOI_CTL_MMV_9_ FORMAT "%6.5" /end CHARACTERISTIC
/begin CHARACTERISTIC c_num_fil_value_t_soi_ctl_mmv[0] "MMV of T_SOI_CTL - FIR filter numerator coefficient vector" VALUE 0x84fe86 _REC_VAL_20_s2 2. _CNV_A_R_LINEAR_____15_CM -1. 1. DISPLAY_IDENTIFIER C_NUM_FIL_VALUE_T_SOI_CTL_MMV_0_ FORMAT "%6.5" /end CHARACTERISTIC
/begin CHARACTERISTIC c_num_fil_value_t_soi_ctl_mmv[1] "MMV of T_SOI_CTL - FIR filter numerator coefficient vector" VALUE 0x84fe88 _REC_VAL_20_s2 2. _CNV_A_R_LINEAR_____15_CM -1. 1. DISPLAY_IDENTIFIER C_NUM_FIL_VALUE_T_SOI_CTL_MMV_1_ FORMAT "%6.5" /end CHARACTERISTIC
/begin CHARACTERISTIC c_num_fil_value_t_soi_ctl_mmv[2] "MMV of T_SOI_CTL - FIR filter numerator coefficient vector" VALUE 0x84fe8a _REC_VAL_20_s2 2. _CNV_A_R_LINEAR_____15_CM -1. 1. DISPLAY_IDENTIFIER C_NUM_FIL_VALUE_T_SOI_CTL_MMV_2_ FORMAT "%6.5" /end CHARACTERISTIC
/begin CHARACTERISTIC c_num_fil_value_t_soi_ctl_mmv[3] "MMV of T_SOI_CTL - FIR filter numerator coefficient vector" VALUE 0x84fe8c _REC_VAL_20_s2 2. _CNV_A_R_LINEAR_____15_CM -1. 1. DISPLAY_IDENTIFIER C_NUM_FIL_VALUE_T_SOI_CTL_MMV_3_ FORMAT "%6.5" /end CHARACTERISTIC
/begin CHARACTERISTIC c_num_fil_value_t_soi_ctl_mmv[4] "MMV of T_SOI_CTL - FIR filter numerator coefficient vector" VALUE 0x84fe8e _REC_VAL_20_s2 2. _CNV_A_R_LINEAR_____15_CM -1. 1. DISPLAY_IDENTIFIER C_NUM_FIL_VALUE_T_SOI_CTL_MMV_4_ FORMAT "%6.5" /end CHARACTERISTIC
/begin CHARACTERISTIC c_num_fil_value_t_soi_ctl_mmv[5] "MMV of T_SOI_CTL - FIR filter numerator coefficient vector" VALUE 0x84fe90 _REC_VAL_20_s2 2. _CNV_A_R_LINEAR_____15_CM -1. 1. DISPLAY_IDENTIFIER C_NUM_FIL_VALUE_T_SOI_CTL_MMV_5_ FORMAT "%6.5" /end CHARACTERISTIC
/begin CHARACTERISTIC c_num_fil_value_t_soi_ctl_mmv[6] "MMV of T_SOI_CTL - FIR filter numerator coefficient vector" VALUE 0x84fe92 _REC_VAL_20_s2 2. _CNV_A_R_LINEAR_____15_CM -1. 1. DISPLAY_IDENTIFIER C_NUM_FIL_VALUE_T_SOI_CTL_MMV_6_ FORMAT "%6.5" /end CHARACTERISTIC
/begin CHARACTERISTIC c_num_fil_value_t_soi_ctl_mmv[7] "MMV of T_SOI_CTL - FIR filter numerator coefficient vector" VALUE 0x84fe94 _REC_VAL_20_s2 2. _CNV_A_R_LINEAR_____15_CM -1. 1. DISPLAY_IDENTIFIER C_NUM_FIL_VALUE_T_SOI_CTL_MMV_7_ FORMAT "%6.5" /end CHARACTERISTIC
/begin CHARACTERISTIC c_num_fil_value_t_soi_ctl_mmv[8] "MMV of T_SOI_CTL - FIR filter numerator coefficient vector" VALUE 0x84fe96 _REC_VAL_20_s2 2. _CNV_A_R_LINEAR_____15_CM -1. 1. DISPLAY_IDENTIFIER C_NUM_FIL_VALUE_T_SOI_CTL_MMV_8_ FORMAT "%6.5" /end CHARACTERISTIC
/begin CHARACTERISTIC c_num_fil_value_t_soi_ctl_mmv[9] "MMV of T_SOI_CTL - FIR filter numerator coefficient vector" VALUE 0x84fe98 _REC_VAL_20_s2 2. _CNV_A_R_LINEAR_____15_CM -1. 1. DISPLAY_IDENTIFIER C_NUM_FIL_VALUE_T_SOI_CTL_MMV_9_ FORMAT "%6.5" /end CHARACTERISTIC
/begin COMPU_METHOD _CNV_A_R_LINEAR_____0_CM "" RAT_FUNC "%6.3" "[-]" COEFFS 0 1. 0. 0 0 1 /end COMPU_METHOD
/begin COMPU_METHOD _CNV_A_R_LINEAR_____1_CM "" RAT_FUNC "%6.3" "-" COEFFS 0 1. 0. 0 0 1 /end COMPU_METHOD
/begin COMPU_METHOD _CNV_A_R_LINEAR_____5_CM "" RAT_FUNC "%6.3" "[rpm]" COEFFS 0 1. 0. 0 0 1 /end COMPU_METHOD
/begin COMPU_METHOD _CNV_A_R_LINEAR_____7_CM "" RAT_FUNC "%6.3" "[cm^2]" COEFFS 0 839.3314549180328 0. 0 0 1 /end COMPU_METHOD
/begin COMPU_METHOD _CNV_S_2_RANGE______11_CM "" TAB_VERB "%6.3" "[-]" COMPU_TAB_REF _CNV_S_2_RANGE______11 /end COMPU_METHOD
/begin COMPU_VTAB _CNV_S_2_RANGE______11 "" TAB_VERB 2 0 "0" 1 "1" /end COMPU_VTAB
/begin COMPU_METHOD _CNV_A_R_LINEAR_____12_CM "" RAT_FUNC "%6.3" "[%]" COEFFS 0 327.6800000003072 3.071909304708242e-008 0 0 1 /end COMPU_METHOD
/begin COMPU_METHOD _CNV_A_R_LINEAR_____14_CM "" RAT_FUNC "%6.3" "[-]" COEFFS 0 65535.99999999996 0. 0 0 1 /end COMPU_METHOD
/begin COMPU_METHOD _CNV_A_R_LINEAR_____15_CM "" RAT_FUNC "%6.3" "[-]" COEFFS 0 16384. 0. 0 0 1 /end COMPU_METHOD
/begin COMPU_METHOD _CNV_A_R_LINEAR_____18_CM "" RAT_FUNC "%6.3" "[°C]" COEFFS 0 1. 50. 0 0 1 /end COMPU_METHOD
/begin COMPU_METHOD _CNV_A_R_LINEAR_____20_CM "" RAT_FUNC "%6.3" "[°C]" COEFFS 0 1. 0. 0 0 1 /end COMPU_METHOD
/begin COMPU_METHOD _CNV_S_180_CONV_DIAG__21_CM "" TAB_VERB "%6.3" "[-]" COMPU_TAB_REF _CNV_S_180_CONV_DIAG__21 /end COMPU_METHOD
/begin COMPU_VTAB _CNV_S_180_CONV_DIAG__21 "" TAB_VERB 180 0 "NO_ERROR" 1 "IMOB" 2 "ECU_4" 3 "ECU_2" 4 "V_DCDC_RNG" 5 "PVS_L_1" 6 "PVS_L_2" 7 "PVS_H_1" 8 "PVS_H_2" 9 "PVS_RATIO" 10 "PVS_MOVE" 11 "PVS_BLS_BTS" 12 "VCC_1" 13 "VCC_2" 14 "V_DIP_PF_RNG" 15 "DIP_PF_MES_GRD" 16 "DIP_PF_MES_ES" 17 "V_TCO_1_RNG" 18 "V_TCO_2_RNG" 19 "TCO_1_MES_GRD" 20 "TCO_2_MES_GRD" 21 "TCO_MES_PLAUS" 22 "EGR_CTL_MIN" 23 "EGR_CTL_MAX" 24 "V_AMP_RNG" 25 "AMP_MES_GRD" 26 "V_TFU_RNG" 27 "TFU_MES_GRD" 28 "TFU_MES_PLAUS" 29 "V_MAP_RNG" 30 "MAP_AMP_OFS" 31 "MAP_IS_OFS" 32 "MAP_MES_GRD" 33 "MAF_KGH_PLAUS" 34 "MAF_0_RNG" 35 "V_TPC_RNG" 36 "TPC_MES_PLAUS" 37 "V_TAC_RNG" 38 "TAC_MES_GRD" 39 "MF_IS_OBD" 40 "CYL_BAL_0" 41 "CYL_BAL_1" 42 "CYL_BAL_2" 43 "CYL_BAL_3" 44 "EGRV_0_CTL" 45 "V_EGRV_0_BOL_AD" 46 "THR_0_CTL" 47 "V_THR_0_BOL_AD" 48 "BPA_0_CTL" 49 "V_BPA_0_BOL_AD" 50 "BYP_0_CTL" 51 "V_BYP_0_BOL_AD" 52 "MAP_CTL_MIN" 53 "MAP_CTL_MAX" 54 "EGR_IS_SLOW_OBD" 55 "MAF_EGR_THR_OBD" 56 "MAF_DIF_EGR_THR_OBD" 57 "MAP_DIF_EGR_THR_OBD" 58 "VS" 59 "CS" 60 "BLS" 61 "BLS_BTS_DECE" 62 "BLS_BTS_PLAUS" 63 "CAN_TCS" 64 "CAN_TCU" 65 "CAN_ACU" 66 "CAN_CCU" 67 "CAN_ICL" 68 "CAN_VECU" 69 "CAN_SMLS" 70 "CAN_BOFF" 71 "CAN_IF_CFT" 72 "CAN_EILU" 73 "CAN_DCC" 74 "CAN_WHL" 75 "CAN_SYS_INFO" 76 "CAN_NOM_SYS" 77 "CAN_TOT" 78 "VARCOD" 79 "ACP_MES_RNG" 80 "ACP_MES_GRD" 81 "V_TBA_RNG" 82 "TBA_MES_GRD" 83 "DUCY_ALTER_PWM_RNG" 84 "DUCY_ALTER_PWM_GRD" 85 "V_EGRV_0_RNG" 86 "V_EGRV_1_RNG" 87 "V_EGRV_0_GRD" 88 "V_EGRV_1_GRD" 89 "GES_MAF_0_MAX" 90 "TCO_1_2_PLAUS" 91 "EFP_RLY_DPS" 92 "EFP_RLY_PLAUS_1" 93 "EFP_RLY_PLAUS_2" 94 "SPI_MPS" 95 "SPI_OCT" 96 "SPI_QPS" 97 "EGR_BYP_DPS" 98 "EGRV_0" 99 "PPS_INI_0" 100 "PPS_INI_TOUT_0" 101 "PPS_PLAUS_0" 102 "PPS_CAL_0" 103 "PPS_V_INJ_0" 104 "PPS_WDT_0" 105 "PPS_FSM_0" 106 "PPS_OC_0" 107 "PPS_OC_1" 108 "PPS_OC_2" 109 "PPS_OC_3" 110 "PPS_SC_H_L_0" 111 "PPS_SC_H_L_1" 112 "PPS_SC_H_L_2" 113 "PPS_SC_H_L_3" 114 "PPS_SC_H_0" 115 "PPS_SC_L_0" 116 "V_TEG_TUR_UP_RNG" 117 "TEG_TUR_UP_MES_GRD" 118 "BPA" 119 "EGRV" 120 "FSD_1" 121 "GL_RLY_DPS" 122 "MIS_A" 123 "MIS_B1" 124 "MIS_B4" 125 "PCV_1" 126 "PCV_2" 127 "PCV_3" 128 "RLY_MAIN" 129 "RLY_POWER" 130 "THR" 131 "VAR_COD" 132 "VB" 133 "VCV_1" 134 "VCV_2" 135 "VCV_3" 136 "CONV_MON_1" 137 "N_32_MON_1" 138 "PVS_MON_1" 139 "FCUT_MON_1" 140 "TQI_N_MAX_MON_1" 141 "SERV_MON_1" 142 "POST_INH_MON" 143 "CRU_INH_MON" 144 "CAN_INH_MON" 145 "MON_3" 146 "PER_CAM_IN_1" 147 "SYN_CAM_IN_1" 148 "REF_CRK_CAM_IN_1" 149 "CRK_TOOTH" 150 "CRK_TOOTH_PER" 151 "CRK_SYN" 152 "CRK_PLAUS" 153 "PLAUS_CAM_IN_1" 154 "SYN_CRK_CAM_IN_1" 155 "LSH_UP_1" 156 "LSH_DOWN_1" 157 "SCG_LS_DOWN_1" 158 "SCP_LS_DOWN_1" 159 "OC_LS_DOWN_1" 160 "OBD_LSH_DOWN_1" 161 "LAM_ADJ_1" 162 "CHK_LS_DOWN_1" 163 "PUC_LS_DOWN_1" 164 "FL_LS_DOWN_1" 165 "EL_LSL_UP_1" 166 "OC_LSL_UP_1" 167 "LSL_UP_IF_1" 168 "AIR_LSL_UP_1" 169 "TTIP_OBD_LS_UP_1" 170 "DYN_VLD_LS_UP_1" 171 "PUC_VLD_LS_UP_1" 172 "OBD_VLD_LSH_UP_1" 173 "SHIFT_AFL_LSL_UP_1" 174 "SHIFT_AFR_LSL_UP_1" 175 "LSH_LSL_UP_1" 176 "SWT_LS_DOWN_1" 177 "PUE_LS_DOWN_1" 178 "CHG_LS_UP" 179 "CHG_LS_DOWN" /end COMPU_VTAB
/begin COMPU_METHOD _CNV_A_R_LINEAR_____28_CM "" RAT_FUNC "%6.3" "[V]" COEFFS 0 204.8 0. 0 0 1 /end COMPU_METHOD
/begin COMPU_METHOD _CNV_A_R_LINEAR_____30_CM "" RAT_FUNC "%6.3" "[1/min]" COEFFS 0 3.125e-002 0. 0 0 1 /end COMPU_METHOD
/begin COMPU_METHOD _CNV_A_R_LINEAR_____43_CM "" RAT_FUNC "%6.3" "[V]" COEFFS 0 8.854166666666666 0. 0 0 1 /end COMPU_METHOD
/begin COMPU_METHOD _CNV_A_R_LINEAR_____45_CM "" RAT_FUNC "%6.3" "[hPa]" COEFFS 0 12.06017666543982 0. 0 0 1 /end COMPU_METHOD
/begin COMPU_METHOD _CNV_A_R_LINEAR_____48_CM "" RAT_FUNC "%6.3" "[-]" COEFFS 0 32767.99807357072 0. 0 0 1 /end COMPU_METHOD
/begin COMPU_METHOD _CNV_A_R_LINEAR_____52_CM "" RAT_FUNC "%6.3" "[Nm]" COEFFS 0 32. 0. 0 0 1 /end COMPU_METHOD
/begin COMPU_METHOD _CNV_A_R_LINEAR_____55_CM "" RAT_FUNC "%6.3" "[rpm]" COEFFS 0 3.125e-002 0. 0 0 1 /end COMPU_METHOD
/begin COMPU_METHOD _CNV_A_R_LINEAR_____59_CM "" RAT_FUNC "%6.3" "[-]" COEFFS 0 16383.81262712377 0. 0 0 1 /end COMPU_METHOD
/begin COMPU_METHOD _CNV_A_R_LINEAR_____60_CM "" RAT_FUNC "%6.3" "[mg/stk]" COEFFS 0 47.18142548596112 0. 0 0 1 /end COMPU_METHOD
/begin COMPU_METHOD _CNV_P_8_TABLE_______68_CM "" TAB_NOINTP "%6.3" "[-]" COMPU_TAB_REF _CNV_P_8_TABLE_______68 /end COMPU_METHOD
/begin COMPU_TAB _CNV_P_8_TABLE_______68 "" TAB_NOINTP 8 0 0. 1 1. 2 2. 3 3. 4 4. 5 5. 6 6. 15 15. /end COMPU_TAB
/begin COMPU_METHOD _CNV_A_R_LINEAR_____70_CM "" RAT_FUNC "%6.3" "[(km/h)/rpm]" COEFFS 0 655350. 0. 0 0 1 /end COMPU_METHOD
/begin COMPU_METHOD _CNV_A_R_LINEAR_____71_CM "" RAT_FUNC "%6.3" "[km/h]" COEFFS 0 100. 0. 0 0 1 /end COMPU_METHOD
/begin COMPU_METHOD _CNV_A_R_LINEAR_____73_CM "" RAT_FUNC "%6.3" "[s]" COEFFS 0 1000. 0. 0 0 1 /end COMPU_METHOD
/begin COMPU_METHOD _CNV_A_R_LINEAR_____80_CM "" RAT_FUNC "%6.3" "[Nm]" COEFFS 0 31.99984374837874 32767.83999833983 0 0 1 /end COMPU_METHOD
/begin COMPU_METHOD _CNV_A_R_LINEAR_____81_CM "" RAT_FUNC "%6.3" "rpm" COEFFS 0 3.125e-002 0. 0 0 1 /end COMPU_METHOD
/begin COMPU_METHOD _CNV_S_2_RANGE__0___85_CM "" TAB_VERB "%6.3" "-" COMPU_TAB_REF _CNV_S_2_RANGE__0___85 /end COMPU_METHOD
/begin COMPU_VTAB _CNV_S_2_RANGE__0___85 "" TAB_VERB 2 0 "0" 1 "1" /end COMPU_VTAB
/begin COMPU_METHOD _CNV_A_R_LINEAR_____101_CM "" RAT_FUNC "%6.3" "[-]" COEFFS 0 128. 0. 0 0 1 /end COMPU_METHOD
/begin COMPU_METHOD _CNV_A_R_LINEAR_____118_CM "" RAT_FUNC "%6.3" "[°CRK]" COEFFS 0 42.66666666666666 5120. 0 0 1 /end COMPU_METHOD
/begin COMPU_METHOD _CNV_A_R_LINEAR_____119_CM "" RAT_FUNC "%6.3" "[°CRK]" COEFFS 0 42.66666666666666 0. 0 0 1 /end COMPU_METHOD
/begin COMPU_METHOD _CNV_A_R_LINEAR_____120_CM "" RAT_FUNC "%6.3" "[uF]" COEFFS 0 7.976539589442815 0. 0 0 1 /end COMPU_METHOD
/begin COMPU_METHOD _CNV_A_R_LINEAR_____136_CM "" RAT_FUNC "%6.3" "[%]" COEFFS 0 327.68 0. 0 0 1 /end COMPU_METHOD
/begin COMPU_METHOD _CNV_A_R_LINEAR_____137_CM "" RAT_FUNC "%6.3" "-" COEFFS 0 65535.99999999996 0. 0 0 1 /end COMPU_METHOD
/begin COMPU_METHOD _CNV_A_R_LINEAR_____154_CM "" RAT_FUNC "%6.3" "rpm" COEFFS 0 1. 0. 0 0 1 /end COMPU_METHOD
/begin COMPU_METHOD _CNV_A_R_LINEAR_____162_CM "" RAT_FUNC "%6.3" "[-]" COEFFS 0 1000. 0. 0 0 1 /end COMPU_METHOD
/begin COMPU_METHOD _CNV_A_R_LINEAR_____211_CM "" RAT_FUNC "%6.3" "[ms]" COEFFS 0 999.9999999999999 0. 0 0 1 /end COMPU_METHOD
/begin COMPU_METHOD _CNV_A_R_LINEAR_____223_CM "" RAT_FUNC "%6.3" "[ms]" COEFFS 0 100. 0. 0 0 1 /end COMPU_METHOD
/begin COMPU_METHOD _CNV_A_R_LINEAR_____235_CM "" RAT_FUNC "%6.3" "[°TPS]" COEFFS 0 137.0962343096234 0. 0 0 1 /end COMPU_METHOD
/begin COMPU_METHOD _CNV_A_R_LINEAR_____236_CM "" RAT_FUNC "%6.3" "-" COEFFS 0 4.015748031496063e-002 0. 0 0 1 /end COMPU_METHOD
/begin COMPU_METHOD _CNV_A_R_LINEAR_____240_CM "" RAT_FUNC "%6.3" "s" COEFFS 0 10. 0. 0 0 1 /end COMPU_METHOD
/begin COMPU_METHOD _CNV_A_R_LINEAR_____241_CM "" RAT_FUNC "%6.3" "[\260C]" COEFFS 0 1.333333333333333 64. 0 0 1 /end COMPU_METHOD
/begin COMPU_METHOD _CNV_A_R_LINEAR_____255_CM "" RAT_FUNC "%6.3" "ml/s" COEFFS 0 4000. 0. 0 0 1 /end COMPU_METHOD
/begin COMPU_METHOD _CNV_A_R_LINEAR_____266_CM "" RAT_FUNC "%6.3" "[%]" COEFFS 0 10.24024024024024 0. 0 0 1 /end COMPU_METHOD
/begin COMPU_METHOD _CNV_A_R_LINEAR_____300_CM "" RAT_FUNC "%6.3" "°C" COEFFS 0 1. 60. 0 0 1 /end COMPU_METHOD
/begin COMPU_METHOD _CNV_A_R_LINEAR_____318_CM "" RAT_FUNC "%6.3" "-" COEFFS 0 32768.00790412251 0. 0 0 1 /end COMPU_METHOD
/begin COMPU_METHOD _CNV_S_4_Engine_Sta_342_CM "" TAB_VERB "%6.3" "[-]" COMPU_TAB_REF _CNV_S_4_Engine_Sta_342 /end COMPU_METHOD
/begin COMPU_VTAB _CNV_S_4_Engine_Sta_342 "" TAB_VERB 4 1 "ES" 2 "ST" 4 "IS" 8 "PL" /end COMPU_VTAB
/begin COMPU_METHOD _CNV_A_R_LINEAR_____375_CM "" RAT_FUNC "%6.3" "[-]" COEFFS 0 65535. 0. 0 0 1 /end COMPU_METHOD
/begin COMPU_METHOD _CNV_S_2_RANGE______395_CM "" TAB_VERB "%6.3" "[-]" COMPU_TAB_REF _CNV_S_2_RANGE______395 /end COMPU_METHOD
/begin COMPU_VTAB _CNV_S_2_RANGE______395 "" TAB_VERB 256 0 "0" 1 "1" 2 "1" 3 "1" 4 "1" 5 "1" 6 "1" 7 "1" 8 "1" 9 "1" 10 "1" 11 "1" 12 "1" 13 "1" 14 "1" 15 "1" 16 "1" 17 "1" 18 "1" 19 "1" 20 "1" 21 "1" 22 "1" 23 "1" 24 "1" 25 "1" 26 "1" 27 "1" 28 "1" 29 "1" 30 "1" 31 "1" 32 "1" 33 "1" 34 "1" 35 "1" 36 "1" 37 "1" 38 "1" 39 "1" 40 "1" 41 "1" 42 "1" 43 "1" 44 "1" 45 "1" 46 "1" 47 "1" 48 "1" 49 "1" 50 "1" 51 "1" 52 "1" 53 "1" 54 "1" 55 "1" 56 "1" 57 "1" 58 "1" 59 "1" 60 "1" 61 "1" 62 "1" 63 "1" 64 "1" 65 "1" 66 "1" 67 "1" 68 "1" 69 "1" 70 "1" 71 "1" 72 "1" 73 "1" 74 "1" 75 "1" 76 "1" 77 "1" 78 "1" 79 "1" 80 "1" 81 "1" 82 "1" 83 "1" 84 "1" 85 "1" 86 "1" 87 "1" 88 "1" 89 "1" 90 "1" 91 "1" 92 "1" 93 "1" 94 "1" 95 "1" 96 "1" 97 "1" 98 "1" 99 "1" 100 "1" 101 "1" 102 "1" 103 "1" 104 "1" 105 "1" 106 "1" 107 "1" 108 "1" 109 "1" 110 "1" 111 "1" 112 "1" 113 "1" 114 "1" 115 "1" 116 "1" 117 "1" 118 "1" 119 "1" 120 "1" 121 "1" 122 "1" 123 "1" 124 "1" 125 "1" 126 "1" 127 "1" 128 "1" 129 "1" 130 "1" 131 "1" 132 "1" 133 "1" 134 "1" 135 "1" 136 "1" 137 "1" 138 "1" 139 "1" 140 "1" 141 "1" 142 "1" 143 "1" 144 "1" 145 "1" 146 "1" 147 "1" 148 "1" 149 "1" 150 "1" 151 "1" 152 "1" 153 "1" 154 "1" 155 "1" 156 "1" 157 "1" 158 "1" 159 "1" 160 "1" 161 "1" 162 "1" 163 "1" 164 "1" 165 "1" 166 "1" 167 "1" 168 "1" 169 "1" 170 "1" 171 "1" 172 "1" 173 "1" 174 "1" 175 "1" 176 "1" 177 "1" 178 "1" 179 "1" 180 "1" 181 "1" 182 "1" 183 "1" 184 "1" 185 "1" 186 "1" 187 "1" 188 "1" 189 "1" 190 "1" 191 "1" 192 "1" 193 "1" 194 "1" 195 "1" 196 "1" 197 "1" 198 "1" 199 "1" 200 "1" 201 "1" 202 "1" 203 "1" 204 "1" 205 "1" 206 "1" 207 "1" 208 "1" 209 "1" 210 "1" 211 "1" 212 "1" 213 "1" 214 "1" 215 "1" 216 "1" 217 "1" 218 "1" 219 "1" 220 "1" 221 "1" 222 "1" 223 "1" 224 "1" 225 "1" 226 "1" 227 "1" 228 "1" 229 "1" 230 "1" 231 "1" 232 "1" 233 "1" 234 "1" 235 "1" 236 "1" 237 "1" 238 "1" 239 "1" 240 "1" 241 "1" 242 "1" 243 "1" 244 "1" 245 "1" 246 "1" 247 "1" 248 "1" 249 "1" 250 "1" 251 "1" 252 "1" 253 "1" 254 "1" 255 "1" /end COMPU_VTAB
/begin COMPU_METHOD _CNV_S_6_STATE_C_MA_538_CM "" TAB_VERB "%6.3" "[-]" COMPU_TAB_REF _CNV_S_6_STATE_C_MA_538 /end COMPU_METHOD
/begin COMPU_VTAB _CNV_S_6_STATE_C_MA_538 "" TAB_VERB 6 1 "VW" 2 "Lamborghini" 3 "Audi" 4 "Bentley" 5 "Seat" 6 "Skoda" /end COMPU_VTAB
/begin COMPU_METHOD _CNV_A_R_LINEAR_____539_CM "" RAT_FUNC "%6.3" "[V]" COEFFS 0 257. 0. 0 0 1 /end COMPU_METHOD
/begin COMPU_METHOD _CNV_A_R_LINEAR_____540_CM "" RAT_FUNC "%6.3" "[ms]" COEFFS 0 1000. 0. 0 0 1 /end COMPU_METHOD
/begin COMPU_METHOD _CNV_A_R_LINEAR_____541_CM "" RAT_FUNC "%6.3" "[mJ]" COEFFS 0 125.3598432925406 0. 0 0 1 /end COMPU_METHOD
/begin COMPU_METHOD _CNV_A_R_LINEAR_____543_CM "" RAT_FUNC "%6.3" "[mJ]" COEFFS 0 125.3598433405 -0.5 0 0 1 /end COMPU_METHOD
/begin COMPU_METHOD _CNV_A_R_LINEAR_____548_CM "" RAT_FUNC "%6.3" "[ms]" COEFFS 0 10. 0. 0 0 1 /end COMPU_METHOD
/begin COMPU_METHOD _CNV_A_R_LINEAR_____551_CM "" RAT_FUNC "%6.3" "[V]" COEFFS 0 255.9999999499993 -6.400096026482061e-006 0 0 1 /end COMPU_METHOD
/begin COMPU_METHOD _CNV_A_R_LINEAR_____552_CM "" RAT_FUNC "%6.3" "[mJ/V]" COEFFS 0 327.6800000003072 3.071909304708242e-008 0 0 1 /end COMPU_METHOD
/begin COMPU_METHOD _CNV_A_R_LINEAR_____553_CM "" RAT_FUNC "%6.3" "[mJ]" COEFFS 0 125.3579304719055 0. 0 0 1 /end COMPU_METHOD
/begin COMPU_METHOD _CNV_A_R_LINEAR_____554_CM "" RAT_FUNC "%6.3" "[mJ]" COEFFS 0 125.3617562090945 0. 0 0 1 /end COMPU_METHOD
/begin COMPU_METHOD _CNV_A_R_LINEAR_____555_CM "" RAT_FUNC "%6.3" "[mJ]" COEFFS 0 125.3598433405 32767.5 0 0 1 /end COMPU_METHOD
/begin COMPU_METHOD _CNV_A_R_LINEAR_____556_CM "" RAT_FUNC "%6.3" "[-]" COEFFS 0 32.76800003968061 3.96806062781252e-005 0 0 1 /end COMPU_METHOD
/begin COMPU_METHOD _CNV_A_R_LINEAR_____557_CM "" RAT_FUNC "%6.3" "[mJ/ms]" COEFFS 0 32.76800003968061 3.96806062781252e-005 0 0 1 /end COMPU_METHOD
/begin RECORD_LAYOUT _REC_VAL_20_u1 FNC_VALUES 1 UBYTE COLUMN_DIR DIRECT /end RECORD_LAYOUT
/begin RECORD_LAYOUT _REC_AXS_20_u2 NO_AXIS_PTS_X 1 UWORD AXIS_PTS_X 2 UWORD INDEX_INCR DIRECT /end RECORD_LAYOUT
/begin RECORD_LAYOUT _REC_MAP_20_u2_u2_u2 FNC_VALUES 1 UWORD COLUMN_DIR DIRECT /end RECORD_LAYOUT
/begin RECORD_LAYOUT _REC_VAL_20_u2 FNC_VALUES 1 UWORD COLUMN_DIR DIRECT /end RECORD_LAYOUT
/begin RECORD_LAYOUT _REC_VAL_20_s2 FNC_VALUES 1 SWORD COLUMN_DIR DIRECT /end RECORD_LAYOUT
/begin RECORD_LAYOUT _REC_AXS_20_u1 NO_AXIS_PTS_X 1 UBYTE AXIS_PTS_X 2 UBYTE INDEX_INCR DIRECT /end RECORD_LAYOUT
/begin RECORD_LAYOUT _REC_CUR_20_u2_u2 FNC_VALUES 1 UWORD COLUMN_DIR DIRECT /end RECORD_LAYOUT
/begin RECORD_LAYOUT _REC_CUR_20_u2_u1 FNC_VALUES 1 UWORD COLUMN_DIR DIRECT /end RECORD_LAYOUT
/begin RECORD_LAYOUT _REC_MAP_20_u1_u2_u2 FNC_VALUES 1 UBYTE COLUMN_DIR DIRECT /end RECORD_LAYOUT
/begin RECORD_LAYOUT _REC_MAP_20_u2_u1_u1 FNC_VALUES 1 UWORD COLUMN_DIR DIRECT /end RECORD_LAYOUT
/begin RECORD_LAYOUT _REC_CUR_20_u1_u1 FNC_VALUES 1 UBYTE COLUMN_DIR DIRECT /end RECORD_LAYOUT
/begin RECORD_LAYOUT _REC_MAP_20_u1_u1_u2 FNC_VALUES 1 UBYTE COLUMN_DIR DIRECT /end RECORD_LAYOUT
/begin RECORD_LAYOUT _REC_MAP_20_u1_u2_u1 FNC_VALUES 1 UBYTE COLUMN_DIR DIRECT /end RECORD_LAYOUT
/begin FUNCTION PECO_CLCO ""
 /begin DEF_CHARACTERISTIC lc_v_delta_iv_foc_sel lc_v_delta_iv_foc_ast_sel c_dnom_fil_value_t_iv_close_mmv[0] c_dnom_fil_value_t_iv_close_mmv[1] c_dnom_fil_value_t_iv_close_mmv[2] c_dnom_fil_value_t_iv_close_mmv[3] c_dnom_fil_value_t_iv_close_mmv[4] c_dnom_fil_value_t_iv_close_mmv[5] c_dnom_fil_value_t_iv_close_mmv[6] c_dnom_fil_value_t_iv_close_mmv[7] c_dnom_fil_value_t_iv_close_mmv[8] c_dnom_fil_value_t_iv_close_mmv[9] c_kr_pi_soi_ctl c_kr_pi_t_iv_close_ctl c_lim_egy_sp_err_t_iv_ctl_max c_lim_egy_sp_err_t_iv_ctl_min c_lim_pi_t_iv_close_ctl_max c_lim_pi_t_iv_close_ctl_min c_lim_t_pi_soi_ctl_max c_lim_t_pi_soi_ctl_min c_lim_t_soi_ofs_soi_ctl_max c_lim_t_soi_ofs_soi_ctl_min c_num_fil_value_t_iv_close_mmv[0] c_num_fil_value_t_iv_close_mmv[1] c_num_fil_value_t_iv_close_mmv[2] c_num_fil_value_t_iv_close_mmv[3] c_num_fil_value_t_iv_close_mmv[4] c_num_fil_value_t_iv_close_mmv[5] c_num_fil_value_t_iv_close_mmv[6] c_num_fil_value_t_iv_close_mmv[7] c_num_fil_value_t_iv_close_mmv[8] c_num_fil_value_t_iv_close_mmv[9] c_t_iv_close_max c_t_iv_close_min c_t_iv_close_mmv_fil_ini c_t_iv_close_mmv_inp_max_lim c_t_iv_close_mmv_inp_min_lim c_t_iv_close_mmv_out_max_lim c_t_iv_close_mmv_out_min_lim lc_iv_foc_iv_close_ctl_sel lc_soi_ctl_on lc_t_iv_close_ctl_on ip_egy_sp_ofs_t_ctl__tco ldpm_tco_ip_egy_sp_close_ctl ip_tn_pi_neg_soi_ctl__n ldpm_n_ip_tn_pi_iv_close_ctl ip_tn_pi_neg_t_iv_close_ctl__n ip_tn_pi_pos_soi_ctl__n ip_tn_pi_pos_t_iv_close_ctl__n ip_egy_sp_t_close_ctl__n__doi ldpm_n_ip_egy_sp_close_ctl ldp_doi_ip_egy_sp_close_ctl ip_egy_sp_t_close_ctl__n__soi ldp_soi_ip_egy_sp_close_ctl ip_fac_egy_sp_t_ctl__tco__capa ldp_capa_ip_egy_sp_close_ctl ip_t_iv_close_sp__n__doi ldpm_n_ip_t_iv_close_sp ldp_doi_ip_t_iv_close_sp ip_t_iv_close_sp__n__soi ldp_soi_ip_t_iv_close_sp ip_t_iv_close_sp__tco__capa ldp_tco_ip_t_iv_close_sp ldp_capa_ip_t_iv_close_sp lc_t_iv_close_sel lc_t_soi_ctl_sel c_dnom_fil_value_t_soi_ctl_mmv[0] c_dnom_fil_value_t_soi_ctl_mmv[1] c_dnom_fil_value_t_soi_ctl_mmv[2] c_dnom_fil_value_t_soi_ctl_mmv[3] c_dnom_fil_value_t_soi_ctl_mmv[4] c_dnom_fil_value_t_soi_ctl_mmv[5] c_dnom_fil_value_t_soi_ctl_mmv[6] c_dnom_fil_value_t_soi_ctl_mmv[7] c_dnom_fil_value_t_soi_ctl_mmv[8] c_dnom_fil_value_t_soi_ctl_mmv[9] c_num_fil_value_t_soi_ctl_mmv[0] c_num_fil_value_t_soi_ctl_mmv[1] c_num_fil_value_t_soi_ctl_mmv[2] c_num_fil_value_t_soi_ctl_mmv[3] c_num_fil_value_t_soi_ctl_mmv[4] c_num_fil_value_t_soi_ctl_mmv[5] c_num_fil_value_t_soi_ctl_mmv[6] c_num_fil_value_t_soi_ctl_mmv[7] c_num_fil_value_t_soi_ctl_mmv[8] c_num_fil_value_t_soi_ctl_mmv[9] /end DEF_CHARACTERISTIC
 /begin OUT_MEASUREMENT t_soi_ofs_ctl_[0] t_soi_ofs_ctl_[1] t_soi_ofs_ctl_[2] t_soi_ofs_ctl_[3] lv_iv_foc_iv_close_ctl_sel egy_sp_bas_iv_close_ctl_[0] egy_sp_bas_iv_close_ctl_[1] egy_sp_bas_iv_close_ctl_[2] egy_sp_bas_iv_close_ctl_[3] sf_egy_sp_man_iv_close_ctl t_iv_close_mv_[0] t_iv_close_mv_[1] t_iv_close_mv_[2] t_iv_close_mv_[3] sf_mes_iv_close_vld egy_sp_err_t_iv_close_ctl_[0] egy_sp_err_t_iv_close_ctl_[1] egy_sp_err_t_iv_close_ctl_[2] egy_sp_err_t_iv_close_ctl_[3] i_ctl_iv_close_[0] i_ctl_iv_close_[1] i_ctl_iv_close_[2] i_ctl_iv_close_[3] i_ctl_soi_[0] i_ctl_soi_[1] i_ctl_soi_[2] i_ctl_soi_[3] p_ctl_iv_close_[0] p_ctl_iv_close_[1] p_ctl_iv_close_[2] p_ctl_iv_close_[3] p_ctl_soi_[0] p_ctl_soi_[1] p_ctl_soi_[2] p_ctl_soi_[3] seg_nr_t_iv_close_ctl sf_iv_close_ctl_act sf_pi_ctl_iv_close_max sf_pi_ctl_iv_close_min sf_pi_ctl_soi_max sf_pi_ctl_soi_min sf_soi_ctl_act t_iv_close_dif_[0] t_iv_close_dif_[1] t_iv_close_dif_[2] t_iv_close_dif_[3] t_iv_close_soi_ctl_dif_[0] t_iv_close_soi_ctl_dif_[1] t_iv_close_soi_ctl_dif_[2] t_iv_close_soi_ctl_dif_[3] t_iv_close_sp_mv_[0] t_iv_close_sp_mv_[1] t_iv_close_sp_mv_[2] t_iv_close_sp_mv_[3] t_soi_ofs_ctl_bas_[0] t_soi_ofs_ctl_bas_[1] t_soi_ofs_ctl_bas_[2] t_soi_ofs_ctl_bas_[3] t_soi_ofs_ctl_fil_[0] t_soi_ofs_ctl_fil_[1] t_soi_ofs_ctl_fil_[2] t_soi_ofs_ctl_fil_[3] /end OUT_MEASUREMENT
/end FUNCTION
/begin FUNCTION PECO_FOCO ""
 /begin DEF_CHARACTERISTIC c_dnom_fil_value_v_delta_mmv[0] c_dnom_fil_value_v_delta_mmv[1] c_dnom_fil_value_v_delta_mmv[2] c_dnom_fil_value_v_delta_mmv[3] c_dnom_fil_value_v_delta_mmv[4] c_dnom_fil_value_v_delta_mmv[5] c_dnom_fil_value_v_delta_mmv[6] c_dnom_fil_value_v_delta_mmv[7] c_dnom_fil_value_v_delta_mmv[8] c_dnom_fil_value_v_delta_mmv[9] c_kr_pi_iv_foc_ctl c_lim_egy_sp_err_iv_foc_ctl_max c_lim_egy_sp_err_iv_foc_ctl_min c_lim_pi_iv_foc_ctl_max c_lim_pi_iv_foc_ctl_min c_num_fil_value_v_delta_mmv[0] c_num_fil_value_v_delta_mmv[1] c_num_fil_value_v_delta_mmv[2] c_num_fil_value_v_delta_mmv[3] c_num_fil_value_v_delta_mmv[4] c_num_fil_value_v_delta_mmv[5] c_num_fil_value_v_delta_mmv[6] c_num_fil_value_v_delta_mmv[7] c_num_fil_value_v_delta_mmv[8] c_num_fil_value_v_delta_mmv[9] c_v_delta_max c_v_delta_min c_v_delta_mmv_fil_ini c_v_delta_mmv_inp_max_lim c_v_delta_mmv_inp_min_lim c_v_delta_mmv_out_max_lim c_v_delta_mmv_out_min_lim lc_iv_foc_ctl_on lc_v_delta_rel_iv_foc_ctl_on ip_egy_sp_ofs_foc_ctl__tco ldpm_tco_ip_egy_sp_foc_ctl ip_tn_pi_neg_iv_foc_ctl__n ldpm_n_ip_tn_pi_iv_foc_ctl ip_tn_pi_pos_iv_foc_ctl__n ip_egy_sp_foc_ctl__n__doi ldpm_n_ip_egy_sp_foc_ctl ldp_doi_ip_egy_sp_foc_ctl ip_egy_sp_foc_ctl__n__soi ldp_soi_ip_egy_sp_foc_ctl ip_fac_egy_sp_foc__tco__capa ldp_capa_ip_egy_sp_foc_ctl ip_v_delta_sp__n__doi ldpm_n_ip_v_delta_sp ldp_doi_ip_v_delta_sp ip_v_delta_sp__n__soi ldp_soi_ip_v_delta_sp ip_v_delta_sp__tco__capa ldp_tco_ip_v_delta_sp ldp_capa_ip_v_delta_sp /end DEF_CHARACTERISTIC
 /begin OUT_MEASUREMENT dummy_peco egy_sp_bas_iv_foc_ctl_[0] egy_sp_bas_iv_foc_ctl_[1] egy_sp_bas_iv_foc_ctl_[2] egy_sp_bas_iv_foc_ctl_[3] sf_egy_sp_man_iv_foc_ctl egy_sp_err_iv_foc_ctl_[0] egy_sp_err_iv_foc_ctl_[1] egy_sp_err_iv_foc_ctl_[2] egy_sp_err_iv_foc_ctl_[3] i_ctl_iv_foc_[0] i_ctl_iv_foc_[1] i_ctl_iv_foc_[2] i_ctl_iv_foc_[3] p_ctl_iv_foc_[0] p_ctl_iv_foc_[1] p_ctl_iv_foc_[2] p_ctl_iv_foc_[3] seg_nr_iv_foc_ctl sf_iv_foc_ctl_act sf_mes_iv_foc_vld sf_pi_ctl_iv_foc_max sf_pi_ctl_iv_foc_min v_delta_dif_[0] v_delta_dif_[1] v_delta_dif_[2] v_delta_dif_[3] v_delta_mv_[0] v_delta_mv_[1] v_delta_mv_[2] v_delta_mv_[3] v_delta_sp_mv_[0] v_delta_sp_mv_[1] v_delta_sp_mv_[2] v_delta_sp_mv_[3] /end OUT_MEASUREMENT
/end FUNCTION
/begin FUNCTION PECO_TEPL "" /begin DEF_CHARACTERISTIC ldpm_n_ip_t_burst_dly /end DEF_CHARACTERISTIC
 /begin OUT_MEASUREMENT t_dcha_test_pls t_cha_test_pls sf_test_pls_act lv_test_pls_act t_soi_burst_mes_dly t_eoi_burst_mes_dly seg_nr_test_pls test_pls_act_ctr test_pls_wait_ctr lv_test_pls_vld /end OUT_MEASUREMENT
/end FUNCTION
/begin FUNCTION PECO_STCO ""
 /begin DEF_CHARACTERISTIC c_num_fil_value_stk_ma[0] c_num_fil_value_stk_ma[1] c_num_fil_value_stk_ma[2] c_num_fil_value_stk_ma[3] c_dnom_fil_value_stk_ma[0] c_dnom_fil_value_stk_ma[1] c_dnom_fil_value_stk_ma[2] c_dnom_fil_value_stk_ma[3] c_fac_pwm_dcha_man c_fac_t_per_t_hld_frze c_fac_t_per_t_hld_toze c_step_nr_cha_frze_main1_man c_step_nr_cha_frze_post1_man c_step_nr_cha_frze_prev1_man c_step_nr_dcha_main1_man c_step_nr_dcha_post1_man c_step_nr_dcha_prev1_man c_stk_ma_fil_ini c_t_hld_frze_main1_stk_man c_t_hld_frze_post1_stk_man c_t_hld_frze_prev1_stk_man c_t_hld_toze_main1_stk_man c_t_hld_toze_post1_stk_man c_t_hld_toze_prev1_stk_man lc_tun_stk_ctl_man ip_fac_t_iv_opg_min_cor__tfu ldp_tfu_ip_fac_t_iv_opg_min_cor ip_fac_step_nr_cha_frze__n__tfu ldp_n_ip_fac_step_nr_cha_frze ldp_tfu_ip_fac_step_nr_cha_frze ip_t_iv_opg_min__n__soi ldp_n_ip_t_iv_opg_min ldp_soi_ip_t_iv_opg_min c_n_stk_ctl_act_max ip_fac_t_iv_opg_min_cor__n ldp_n_ip_fac_t_iv_opg_min_cor c_pv_av_stk_ctl_act_max /end DEF_CHARACTERISTIC
 /begin OUT_MEASUREMENT fac_pwm_dcha_[0] fac_pwm_dcha_[1] fac_pwm_dcha_[2] fac_pwm_dcha_[3] step_nr_cha_frze_prev1_ctl_[0] step_nr_cha_frze_prev1_ctl_[1] step_nr_cha_frze_prev1_ctl_[2] step_nr_cha_frze_prev1_ctl_[3] step_nr_cha_frze_main1_ctl_[0] step_nr_cha_frze_main1_ctl_[1] step_nr_cha_frze_main1_ctl_[2] step_nr_cha_frze_main1_ctl_[3] step_nr_cha_frze_post1_ctl_[0] step_nr_cha_frze_post1_ctl_[1] step_nr_cha_frze_post1_ctl_[2] step_nr_cha_frze_post1_ctl_[3] t_hld_frze_prev1_ctl_[0] t_hld_frze_prev1_ctl_[1] t_hld_frze_prev1_ctl_[2] t_hld_frze_prev1_ctl_[3] t_hld_frze_main1_ctl_[0] t_hld_frze_main1_ctl_[1] t_hld_frze_main1_ctl_[2] t_hld_frze_main1_ctl_[3] t_hld_frze_post1_ctl_[0] t_hld_frze_post1_ctl_[1] t_hld_frze_post1_ctl_[2] t_hld_frze_post1_ctl_[3] step_nr_dcha_prev1_ctl_[0] step_nr_dcha_prev1_ctl_[1] step_nr_dcha_prev1_ctl_[2] step_nr_dcha_prev1_ctl_[3] step_nr_dcha_main1_ctl_[0] step_nr_dcha_main1_ctl_[1] step_nr_dcha_main1_ctl_[2] step_nr_dcha_main1_ctl_[3] step_nr_dcha_post1_ctl_[0] step_nr_dcha_post1_ctl_[1] step_nr_dcha_post1_ctl_[2] step_nr_dcha_post1_ctl_[3] t_hld_toze_prev1_ctl_[0] t_hld_toze_prev1_ctl_[1] t_hld_toze_prev1_ctl_[2] t_hld_toze_prev1_ctl_[3] t_hld_toze_main1_ctl_[0] t_hld_toze_main1_ctl_[1] t_hld_toze_main1_ctl_[2] t_hld_toze_main1_ctl_[3] t_hld_toze_post1_ctl_[0] t_hld_toze_post1_ctl_[1] t_hld_toze_post1_ctl_[2] t_hld_toze_post1_ctl_[3] seg_nr_stk_mes t_hld_frze_mv t_hld_toze_mv seg_nr_stk_ctl t_per_stk_dcha v_ampl_stk_dcha step_nr_cha_frze_ctl_bas step_nr_dcha_ctl_bas t_iv_opg_min t_iv_close_mv_mv /end OUT_MEASUREMENT
/end FUNCTION
/begin FUNCTION PECO_CORD "" /begin DEF_CHARACTERISTIC c_num_stk_ast /end DEF_CHARACTERISTIC
 /begin OUT_MEASUREMENT burst_mes_mode burst_mes_mode_[0] burst_mes_mode_[1] burst_mes_mode_[2] burst_mes_mode_[3] sf_t_iv_close_ctl_sel sf_iv_foc_ctl_sel sf_pui_acq_sel sf_egy_ctl_sel sf_egy_mes_sel sf_stk_ctl_sel seg_nr_peco_cord sf_eng_state_[0] sf_eng_state_[1] sf_eng_state_[2] sf_eng_state_[3] lv_num_stk_ast_act /end OUT_MEASUREMENT
/end FUNCTION
/begin FUNCTION __DDS_EXPA2_DEFAULT_FUNC__ "__DDS_EXPA2_DEFAULT_FUNC__"
 /begin DEF_CHARACTERISTIC ldp_1_id_err_dtc_mis ldp_2_id_err_dtc_mis lc_test_hbr[0] lc_test_hbr[1] lc_dir_chg_hbr[0] lc_dir_chg_hbr[1] c_test_hbr[0] c_test_hbr[1] c_crlc_cor_hbr[0] c_crlc_cor_hbr[1] lc_err_det_upd lc_clr_err_intm ldp_dri_id_fac_pl_is ldp_tco_ip_fac_fil_pl_is ldp_tco_ip_fac_fil_st_is ldp_vs_n_id_dri ldpm_dri_aj ldpm_vb_fil_ip_n_inh ldp_quo_mfw_ip_fac_temp_egr ip_tco_warn ldp_tco_ip_tco_warn ldp_fco_t_ip_tco_warn c_tqi_sp_max_toil_mdl c_tqi_sp_min_toil_mdl c_n_max_toil_mdl c_n_min_toil_mdl ip_toil_mdl ldp_tqi_sp c_fac_toil_mdl c_toil_mdl_sub ldpm_n_32__drv2_er ldpm_clas_a_id_clas_fmy ldp_clas_b_id_clas_fmy ldp_n_32_n_grd_thd ldpm_gear ldp_v_maf_id_maf_x ldp_v_maf_id_maf_y ldp_tco_2_inj_x ldp_tco_3_inj_x ldp_t_ad_bpa_tol__ip_ad_bpa ldp_t_ad_bpa_bol__ip_ad_bpa ldp_t_ad_egrv_tol__ip_ad_egrv ldp_t_ad_egrv_bol__ip_ad_egrv ldp_n_ip_egrvpwm ldp_mafpwm_ip_egrvpwm ldp_ar_egrv_ip_egrvpwm c_can_imob_data_req_max c_imob4_max_req_time lc_ena_dwnld c_marken_id c_p_klasse lc_ena_retrain_ecu lc_ena_retrain_ims /end DEF_CHARACTERISTIC
 /begin OUT_MEASUREMENT err_intm_diag_inst[0] err_intm_diag_inst[1] err_intm_diag_inst[2] err_intm_diag_inst[3] err_intm_diag_inst[4] err_intm_diag_inst[5] err_intm_diag_inst[6] err_intm_diag_inst[7] err_intm_diag_inst[8] err_intm_diag_inst[9] err_intm_ctr_frc[0] err_intm_ctr_frc[1] err_intm_ctr_frc[2] err_intm_ctr_frc[3] err_intm_ctr_frc[4] err_intm_ctr_frc[5] err_intm_ctr_frc[6] err_intm_ctr_frc[7] err_intm_ctr_frc[8] err_intm_ctr_frc[9] ctr_err_intm_nr lv_vs_n_con_diag tq_req_clu_cor lv_tcs_hold tqi_av tqi_ems tqi_ref_max eff_iga_bas_cor tqi_ref_iga_min_lamb vs_high_res tps_av tqi_bas amp_ad lv_ct lv_ac_cru_sp_ena lv_acc_red_cmd lv_temp_pwal gen_load_resp_ems1 alter_inh lv_alter_act lv_heat_inh lv_vs_lim_act lv_tqi_stnd lv_err_amp lv_n_max_req_tcu n_max_req_tcu tco_stop tco_warn t_ast_stop v_hvr tqi_req_slow tqi_req_tra lv_accin_on toil_mdl mff_sp_mv eff_scc_av vs_used fac_cyl_bal_fdout_mf lv_vb_jump lv_vs_whl_lim_can lv_whl_can_vld lv_tcu_conf_can lv_clima_conf_can lv_nom_sys_can_vld lv_conf_info_vld lv_sys_info_can_vld lv_err_imob lv_imob_inj_off lv_imob_igc_off /end OUT_MEASUREMENT
/end FUNCTION
/end MODULE
/end PROJECT
