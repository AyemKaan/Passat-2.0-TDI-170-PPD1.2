ASAP2_VERSION 1 41
/begin PROJECT SN0 "SIMOS PPD"
/begin HEADER "_default_HeaderComment" PROJECT_NO PRJ_NUM /end HEADER
/begin MODULE _default_ModuleName "_default_ModuleLongIdentifier"
/begin MOD_COMMON "_default_ModCommonComment" DEPOSIT ABSOLUTE BYTE_ORDER MSB_FIRST ALIGNMENT_BYTE 1 ALIGNMENT_WORD 2 ALIGNMENT_LONG 4 ALIGNMENT_FLOAT32_IEEE 4 ALIGNMENT_FLOAT64_IEEE 8 /end MOD_COMMON
/begin AXIS_PTS ldpm_fup_tra_dif_1_inj "" 0x842b92 fup_tra_dif _REC_AXS_20_u2 199.9969482 _CNV_A_R_LINEAR_____117_CM 8 -100. 99.99694820000001 FORMAT "%7.3" /end AXIS_PTS
/begin MEASUREMENT soi_post1 "" UWORD _CNV_A_R_LINEAR_____118_CM 1 0. -120. 240. DISPLAY_IDENTIFIER SOI_POST1 ECU_ADDRESS 0x7fa038 BYTE_ORDER MSB_LAST FORMAT "%6.2" /end MEASUREMENT
/begin MEASUREMENT soi_post1_dif "" UWORD _CNV_A_R_LINEAR_____119_CM 1 0. 0. 360. DISPLAY_IDENTIFIER SOI_POST1_DIF ECU_ADDRESS 0x7fa02e BYTE_ORDER MSB_LAST FORMAT "%5.2" /end MEASUREMENT
/begin MEASUREMENT soi_post1_bas "" UWORD _CNV_A_R_LINEAR_____118_CM 1 0. -120. 240. DISPLAY_IDENTIFIER SOI_POST1_BAS ECU_ADDRESS 0x7fa044 BYTE_ORDER MSB_LAST FORMAT "%6.2" /end MEASUREMENT
/begin MEASUREMENT soi_main2 "" UWORD _CNV_A_R_LINEAR_____118_CM 1 0. -120. 240. DISPLAY_IDENTIFIER SOI_MAIN2 ECU_ADDRESS 0x7fa034 BYTE_ORDER MSB_LAST FORMAT "%6.2" /end MEASUREMENT
/begin MEASUREMENT soi_prev1 "" UWORD _CNV_A_R_LINEAR_____118_CM 1 0. -120. 240. DISPLAY_IDENTIFIER SOI_PREV1 ECU_ADDRESS 0x7fa030 BYTE_ORDER MSB_LAST FORMAT "%6.2" /end MEASUREMENT
/begin MEASUREMENT soi_prev2 "" UWORD _CNV_A_R_LINEAR_____118_CM 1 0. -120. 240. DISPLAY_IDENTIFIER SOI_PREV2 ECU_ADDRESS 0x7fa032 BYTE_ORDER MSB_LAST FORMAT "%6.2" /end MEASUREMENT
/begin MEASUREMENT soi_post2 "" UWORD _CNV_A_R_LINEAR_____118_CM 1 0. -120. 240. DISPLAY_IDENTIFIER SOI_POST2 ECU_ADDRESS 0x7fa03a BYTE_ORDER MSB_LAST FORMAT "%6.2" /end MEASUREMENT
/begin MEASUREMENT soi_prev1_dif "" UWORD _CNV_A_R_LINEAR_____119_CM 1 0. 0. 360. DISPLAY_IDENTIFIER SOI_PREV1_DIF ECU_ADDRESS 0x7fa028 BYTE_ORDER MSB_LAST FORMAT "%5.2" /end MEASUREMENT
/begin MEASUREMENT soi_prev2_dif "" UWORD _CNV_A_R_LINEAR_____119_CM 1 0. 0. 360. DISPLAY_IDENTIFIER SOI_PREV2_DIF ECU_ADDRESS 0x7fa02a BYTE_ORDER MSB_LAST FORMAT "%5.2" /end MEASUREMENT
/begin MEASUREMENT soi_main1 "" UWORD _CNV_A_R_LINEAR_____118_CM 1 0. -120. 240. DISPLAY_IDENTIFIER SOI_MAIN1 ECU_ADDRESS 0x7fa036 BYTE_ORDER MSB_LAST FORMAT "%6.2" /end MEASUREMENT
/begin MEASUREMENT soi_main2_dif "" UWORD _CNV_A_R_LINEAR_____119_CM 1 0. 0. 360. DISPLAY_IDENTIFIER SOI_MAIN2_DIF ECU_ADDRESS 0x7fa02c BYTE_ORDER MSB_LAST FORMAT "%5.2" /end MEASUREMENT
/begin MEASUREMENT soi_main1_bas "" UWORD _CNV_A_R_LINEAR_____118_CM 1 0. -120. 240. DISPLAY_IDENTIFIER SOI_MAIN1_BAS ECU_ADDRESS 0x7fa03c BYTE_ORDER MSB_LAST FORMAT "%6.2" /end MEASUREMENT
/begin MEASUREMENT soi_main2_bas "" UWORD _CNV_A_R_LINEAR_____118_CM 1 0. -120. 240. DISPLAY_IDENTIFIER SOI_MAIN2_BAS ECU_ADDRESS 0x7fa03e BYTE_ORDER MSB_LAST FORMAT "%6.2" /end MEASUREMENT
/begin MEASUREMENT soi_post2_bas "" UWORD _CNV_A_R_LINEAR_____118_CM 1 0. -120. 240. DISPLAY_IDENTIFIER SOI_POST2_BAS ECU_ADDRESS 0x7fa046 BYTE_ORDER MSB_LAST FORMAT "%6.2" /end MEASUREMENT
/begin MEASUREMENT soi_prev2_bas "" UWORD _CNV_A_R_LINEAR_____118_CM 1 0. -120. 240. DISPLAY_IDENTIFIER SOI_PREV2_BAS ECU_ADDRESS 0x7fa042 BYTE_ORDER MSB_LAST FORMAT "%4.1" /end MEASUREMENT
/begin MEASUREMENT soi_prev1_bas "" UWORD _CNV_A_R_LINEAR_____118_CM 1 0. -120. 240. DISPLAY_IDENTIFIER SOI_PREV1_BAS ECU_ADDRESS 0x7fa040 BYTE_ORDER MSB_LAST FORMAT "%4.1" /end MEASUREMENT
/begin AXIS_PTS ldpm_amp_2_inj "fuel mass AMP-correction factor of PREV1, PREV2, MAIN2 & POST1 at ST" 0x842b06 amp _REC_AXS_20_u2 5434. _CNV_A_R_LINEAR_____45_CM 4 0. 5434. FORMAT "%6.2" /end AXIS_PTS
/begin AXIS_PTS ldpm_n_3_inj "start fuel mass of injection PREV1, PREV2, MAIN2 & POST1" 0x842ec6 n _REC_AXS_20_u2 6375. _CNV_A_R_LINEAR_____5_CM 7 0. 6375. FORMAT "%4.0" /end AXIS_PTS
/begin AXIS_PTS ldpm_tco_2_inj "start fuel mass of injection PREV1, PREV2, MAIN2 & POST1" 0x84378f tco _REC_AXS_20_u1 255. _CNV_A_R_LINEAR_____18_CM 12 -50. 205. FORMAT "%3.0" /end AXIS_PTS
/begin AXIS_PTS ldpm_n_4_inj "amp correction of fuel mass of injection PREV1, PREV2, MAIN2 & POST1 at ST" 0x842ed6 n _REC_AXS_20_u2 6375. _CNV_A_R_LINEAR_____5_CM 4 0. 6375. FORMAT "%4.0" /end AXIS_PTS
/begin AXIS_PTS ldpm_tco_3_inj "amp correction of fuel mass of injection PREV1, PREV2, MAIN2 & POST1 at ST" 0x84379c tco _REC_AXS_20_u1 255. _CNV_A_R_LINEAR_____18_CM 6 -50. 205. FORMAT "%3.0" /end AXIS_PTS
/begin MEASUREMENT lv_byp_on "" UBYTE _CNV_S_2_RANGE__0___85_CM 1 0. 0. 1. DISPLAY_IDENTIFIER LV_BYP_ON ECU_ADDRESS 0x7fd3c7 /end MEASUREMENT
/begin CHARACTERISTIC c_byp_lih_cnt_max_A "" VALUE 0x84fbd4 _REC_VAL_20_u1 255. _CNV_A_R_LINEAR_____1_CM 0. 255. DISPLAY_IDENTIFIER C_BYP_LIH_CNT_MAX_A FORMAT "%3.0" /end CHARACTERISTIC
/begin CHARACTERISTIC c_byp_lih_cnt_max_B "" VALUE 0x84fbd5 _REC_VAL_20_u1 255. _CNV_A_R_LINEAR_____1_CM 0. 255. DISPLAY_IDENTIFIER C_BYP_LIH_CNT_MAX_B FORMAT "%3.0" /end CHARACTERISTIC
/begin CHARACTERISTIC c_byp_on "" VALUE 0x84fbd6 _REC_VAL_20_u1 255. _CNV_A_R_LINEAR_____1_CM 0. 255. DISPLAY_IDENTIFIER C_BYP_ON FORMAT "%3.0" /end CHARACTERISTIC
/begin MEASUREMENT byp_cnt_A "" UBYTE _CNV_A_R_LINEAR_____1_CM 1 0. 0. 255. DISPLAY_IDENTIFIER BYP_CNT_A ECU_ADDRESS 0x7fd3c4 FORMAT "%3.0" /end MEASUREMENT
/begin MEASUREMENT byp_cnt_B "" UBYTE _CNV_A_R_LINEAR_____1_CM 1 0. 0. 255. DISPLAY_IDENTIFIER BYP_CNT_B ECU_ADDRESS 0x7fd3c5 FORMAT "%3.0" /end MEASUREMENT
/begin MEASUREMENT byp_error "" UBYTE _CNV_A_R_LINEAR_____1_CM 1 0. 0. 255. DISPLAY_IDENTIFIER BYP_ERROR ECU_ADDRESS 0x7fd3c6 FORMAT "%3.0" /end MEASUREMENT
/begin CHARACTERISTIC c_byp_func_A "" VALUE 0x84fbce _REC_VAL_20_u2 65535. _CNV_A_R_LINEAR_____1_CM 0. 65535. DISPLAY_IDENTIFIER C_BYP_FUNC_A FORMAT "%5.0" /end CHARACTERISTIC
/begin CHARACTERISTIC c_byp_func_B "" VALUE 0x84fbd0 _REC_VAL_20_u4 4294967295. _CNV_A_R_LINEAR_____1_CM 0. 4294967295. DISPLAY_IDENTIFIER C_BYP_FUNC_B FORMAT "%10.0" /end CHARACTERISTIC
/begin CHARACTERISTIC c_byp_A_ofs_ch1 "" VALUE 0x84fb9f _REC_VAL_20_u1 255. _CNV_A_R_LINEAR_____1_CM 0. 255. DISPLAY_IDENTIFIER C_BYP_A_OFS_CH1 FORMAT "%3.0" /end CHARACTERISTIC
/begin CHARACTERISTIC c_byp_A_ofs_ch2 "" VALUE 0x84fba6 _REC_VAL_20_u1 255. _CNV_A_R_LINEAR_____1_CM 0. 255. DISPLAY_IDENTIFIER C_BYP_A_OFS_CH2 FORMAT "%3.0" /end CHARACTERISTIC
/begin CHARACTERISTIC c_byp_A_ofs_ch3 "" VALUE 0x84fba7 _REC_VAL_20_u1 255. _CNV_A_R_LINEAR_____1_CM 0. 255. DISPLAY_IDENTIFIER C_BYP_A_OFS_CH3 FORMAT "%3.0" /end CHARACTERISTIC
/begin CHARACTERISTIC c_byp_A_ofs_ch4 "" VALUE 0x84fba8 _REC_VAL_20_u1 255. _CNV_A_R_LINEAR_____1_CM 0. 255. DISPLAY_IDENTIFIER C_BYP_A_OFS_CH4 FORMAT "%3.0" /end CHARACTERISTIC
/begin CHARACTERISTIC c_byp_A_ofs_ch5 "" VALUE 0x84fba9 _REC_VAL_20_u1 255. _CNV_A_R_LINEAR_____1_CM 0. 255. DISPLAY_IDENTIFIER C_BYP_A_OFS_CH5 FORMAT "%3.0" /end CHARACTERISTIC
/begin CHARACTERISTIC c_byp_A_ofs_ch6 "" VALUE 0x84fbaa _REC_VAL_20_u1 255. _CNV_A_R_LINEAR_____1_CM 0. 255. DISPLAY_IDENTIFIER C_BYP_A_OFS_CH6 FORMAT "%3.0" /end CHARACTERISTIC
/begin CHARACTERISTIC c_byp_A_ofs_ch7 "" VALUE 0x84fbab _REC_VAL_20_u1 255. _CNV_A_R_LINEAR_____1_CM 0. 255. DISPLAY_IDENTIFIER C_BYP_A_OFS_CH7 FORMAT "%3.0" /end CHARACTERISTIC
/begin CHARACTERISTIC c_byp_A_ofs_ch8 "" VALUE 0x84fbac _REC_VAL_20_u1 255. _CNV_A_R_LINEAR_____1_CM 0. 255. DISPLAY_IDENTIFIER C_BYP_A_OFS_CH8 FORMAT "%3.0" /end CHARACTERISTIC
/begin CHARACTERISTIC c_byp_A_ofs_ch9 "" VALUE 0x84fbad _REC_VAL_20_u1 255. _CNV_A_R_LINEAR_____1_CM 0. 255. DISPLAY_IDENTIFIER C_BYP_A_OFS_CH9 FORMAT "%3.0" /end CHARACTERISTIC
/begin CHARACTERISTIC c_byp_A_ofs_ch10 "" VALUE 0x84fba0 _REC_VAL_20_u1 255. _CNV_A_R_LINEAR_____1_CM 0. 255. DISPLAY_IDENTIFIER C_BYP_A_OFS_CH10 FORMAT "%3.0" /end CHARACTERISTIC
/begin CHARACTERISTIC c_byp_A_ofs_ch11 "" VALUE 0x84fba1 _REC_VAL_20_u1 255. _CNV_A_R_LINEAR_____1_CM 0. 255. DISPLAY_IDENTIFIER C_BYP_A_OFS_CH11 FORMAT "%3.0" /end CHARACTERISTIC
/begin CHARACTERISTIC c_byp_A_ofs_ch12 "" VALUE 0x84fba2 _REC_VAL_20_u1 255. _CNV_A_R_LINEAR_____1_CM 0. 255. DISPLAY_IDENTIFIER C_BYP_A_OFS_CH12 FORMAT "%3.0" /end CHARACTERISTIC
/begin CHARACTERISTIC c_byp_A_ofs_ch13 "" VALUE 0x84fba3 _REC_VAL_20_u1 255. _CNV_A_R_LINEAR_____1_CM 0. 255. DISPLAY_IDENTIFIER C_BYP_A_OFS_CH13 FORMAT "%3.0" /end CHARACTERISTIC
/begin CHARACTERISTIC c_byp_A_ofs_ch14 "" VALUE 0x84fba4 _REC_VAL_20_u1 255. _CNV_A_R_LINEAR_____1_CM 0. 255. DISPLAY_IDENTIFIER C_BYP_A_OFS_CH14 FORMAT "%3.0" /end CHARACTERISTIC
/begin CHARACTERISTIC c_byp_A_ofs_ch15 "" VALUE 0x84fba5 _REC_VAL_20_u1 255. _CNV_A_R_LINEAR_____1_CM 0. 255. DISPLAY_IDENTIFIER C_BYP_A_OFS_CH15 FORMAT "%3.0" /end CHARACTERISTIC
/begin CHARACTERISTIC c_byp_A_ofs_ch0 "" VALUE 0x84fb9e _REC_VAL_20_u1 255. _CNV_A_R_LINEAR_____1_CM 0. 255. DISPLAY_IDENTIFIER C_BYP_A_OFS_CH0 FORMAT "%3.0" /end CHARACTERISTIC
/begin CHARACTERISTIC c_byp_B_ofs_ch0 "" VALUE 0x84fbae _REC_VAL_20_u1 255. _CNV_A_R_LINEAR_____1_CM 0. 255. DISPLAY_IDENTIFIER C_BYP_B_OFS_CH0 FORMAT "%3.0" /end CHARACTERISTIC
/begin CHARACTERISTIC c_byp_B_ofs_ch1 "" VALUE 0x84fbaf _REC_VAL_20_u1 255. _CNV_A_R_LINEAR_____1_CM 0. 255. DISPLAY_IDENTIFIER C_BYP_B_OFS_CH1 FORMAT "%3.0" /end CHARACTERISTIC
/begin CHARACTERISTIC c_byp_B_ofs_ch2 "" VALUE 0x84fbba _REC_VAL_20_u1 255. _CNV_A_R_LINEAR_____1_CM 0. 255. DISPLAY_IDENTIFIER C_BYP_B_OFS_CH2 FORMAT "%3.0" /end CHARACTERISTIC
/begin CHARACTERISTIC c_byp_B_ofs_ch3 "" VALUE 0x84fbc5 _REC_VAL_20_u1 255. _CNV_A_R_LINEAR_____1_CM 0. 255. DISPLAY_IDENTIFIER C_BYP_B_OFS_CH3 FORMAT "%3.0" /end CHARACTERISTIC
/begin CHARACTERISTIC c_byp_B_ofs_ch4 "" VALUE 0x84fbc8 _REC_VAL_20_u1 255. _CNV_A_R_LINEAR_____1_CM 0. 255. DISPLAY_IDENTIFIER C_BYP_B_OFS_CH4 FORMAT "%3.0" /end CHARACTERISTIC
/begin CHARACTERISTIC c_byp_B_ofs_ch5 "" VALUE 0x84fbc9 _REC_VAL_20_u1 255. _CNV_A_R_LINEAR_____1_CM 0. 255. DISPLAY_IDENTIFIER C_BYP_B_OFS_CH5 FORMAT "%3.0" /end CHARACTERISTIC
/begin CHARACTERISTIC c_byp_B_ofs_ch6 "" VALUE 0x84fbca _REC_VAL_20_u1 255. _CNV_A_R_LINEAR_____1_CM 0. 255. DISPLAY_IDENTIFIER C_BYP_B_OFS_CH6 FORMAT "%3.0" /end CHARACTERISTIC
/begin CHARACTERISTIC c_byp_B_ofs_ch7 "" VALUE 0x84fbcb _REC_VAL_20_u1 255. _CNV_A_R_LINEAR_____1_CM 0. 255. DISPLAY_IDENTIFIER C_BYP_B_OFS_CH7 FORMAT "%3.0" /end CHARACTERISTIC
/begin CHARACTERISTIC c_byp_B_ofs_ch8 "" VALUE 0x84fbcc _REC_VAL_20_u1 255. _CNV_A_R_LINEAR_____1_CM 0. 255. DISPLAY_IDENTIFIER C_BYP_B_OFS_CH8 FORMAT "%3.0" /end CHARACTERISTIC
/begin CHARACTERISTIC c_byp_B_ofs_ch9 "" VALUE 0x84fbcd _REC_VAL_20_u1 255. _CNV_A_R_LINEAR_____1_CM 0. 255. DISPLAY_IDENTIFIER C_BYP_B_OFS_CH9 FORMAT "%3.0" /end CHARACTERISTIC
/begin CHARACTERISTIC c_byp_B_ofs_ch10 "" VALUE 0x84fbb0 _REC_VAL_20_u1 255. _CNV_A_R_LINEAR_____1_CM 0. 255. DISPLAY_IDENTIFIER C_BYP_B_OFS_CH10 FORMAT "%3.0" /end CHARACTERISTIC
/begin CHARACTERISTIC c_byp_B_ofs_ch11 "" VALUE 0x84fbb1 _REC_VAL_20_u1 255. _CNV_A_R_LINEAR_____1_CM 0. 255. DISPLAY_IDENTIFIER C_BYP_B_OFS_CH11 FORMAT "%3.0" /end CHARACTERISTIC
/begin CHARACTERISTIC c_byp_B_ofs_ch12 "" VALUE 0x84fbb2 _REC_VAL_20_u1 255. _CNV_A_R_LINEAR_____1_CM 0. 255. DISPLAY_IDENTIFIER C_BYP_B_OFS_CH12 FORMAT "%3.0" /end CHARACTERISTIC
/begin CHARACTERISTIC c_byp_B_ofs_ch13 "" VALUE 0x84fbb3 _REC_VAL_20_u1 255. _CNV_A_R_LINEAR_____1_CM 0. 255. DISPLAY_IDENTIFIER C_BYP_B_OFS_CH13 FORMAT "%3.0" /end CHARACTERISTIC
/begin CHARACTERISTIC c_byp_B_ofs_ch14 "" VALUE 0x84fbb4 _REC_VAL_20_u1 255. _CNV_A_R_LINEAR_____1_CM 0. 255. DISPLAY_IDENTIFIER C_BYP_B_OFS_CH14 FORMAT "%3.0" /end CHARACTERISTIC
/begin CHARACTERISTIC c_byp_B_ofs_ch15 "" VALUE 0x84fbb5 _REC_VAL_20_u1 255. _CNV_A_R_LINEAR_____1_CM 0. 255. DISPLAY_IDENTIFIER C_BYP_B_OFS_CH15 FORMAT "%3.0" /end CHARACTERISTIC
/begin CHARACTERISTIC c_byp_B_ofs_ch16 "" VALUE 0x84fbb6 _REC_VAL_20_u1 255. _CNV_A_R_LINEAR_____1_CM 0. 255. DISPLAY_IDENTIFIER C_BYP_B_OFS_CH16 FORMAT "%3.0" /end CHARACTERISTIC
/begin CHARACTERISTIC c_byp_B_ofs_ch17 "" VALUE 0x84fbb7 _REC_VAL_20_u1 255. _CNV_A_R_LINEAR_____1_CM 0. 255. DISPLAY_IDENTIFIER C_BYP_B_OFS_CH17 FORMAT "%3.0" /end CHARACTERISTIC
/begin CHARACTERISTIC c_byp_B_ofs_ch18 "" VALUE 0x84fbb8 _REC_VAL_20_u1 255. _CNV_A_R_LINEAR_____1_CM 0. 255. DISPLAY_IDENTIFIER C_BYP_B_OFS_CH18 FORMAT "%3.0" /end CHARACTERISTIC
/begin CHARACTERISTIC c_byp_B_ofs_ch19 "" VALUE 0x84fbb9 _REC_VAL_20_u1 255. _CNV_A_R_LINEAR_____1_CM 0. 255. DISPLAY_IDENTIFIER C_BYP_B_OFS_CH19 FORMAT "%3.0" /end CHARACTERISTIC
/begin CHARACTERISTIC c_byp_B_ofs_ch20 "" VALUE 0x84fbbb _REC_VAL_20_u1 255. _CNV_A_R_LINEAR_____1_CM 0. 255. DISPLAY_IDENTIFIER C_BYP_B_OFS_CH20 FORMAT "%3.0" /end CHARACTERISTIC
/begin CHARACTERISTIC c_byp_B_ofs_ch21 "" VALUE 0x84fbbc _REC_VAL_20_u1 255. _CNV_A_R_LINEAR_____1_CM 0. 255. DISPLAY_IDENTIFIER C_BYP_B_OFS_CH21 FORMAT "%3.0" /end CHARACTERISTIC
/begin CHARACTERISTIC c_byp_B_ofs_ch22 "" VALUE 0x84fbbd _REC_VAL_20_u1 255. _CNV_A_R_LINEAR_____1_CM 0. 255. DISPLAY_IDENTIFIER C_BYP_B_OFS_CH22 FORMAT "%3.0" /end CHARACTERISTIC
/begin CHARACTERISTIC c_byp_B_ofs_ch23 "" VALUE 0x84fbbe _REC_VAL_20_u1 255. _CNV_A_R_LINEAR_____1_CM 0. 255. DISPLAY_IDENTIFIER C_BYP_B_OFS_CH23 FORMAT "%3.0" /end CHARACTERISTIC
/begin CHARACTERISTIC c_byp_B_ofs_ch24 "" VALUE 0x84fbbf _REC_VAL_20_u1 255. _CNV_A_R_LINEAR_____1_CM 0. 255. DISPLAY_IDENTIFIER C_BYP_B_OFS_CH24 FORMAT "%3.0" /end CHARACTERISTIC
/begin CHARACTERISTIC c_byp_B_ofs_ch25 "" VALUE 0x84fbc0 _REC_VAL_20_u1 255. _CNV_A_R_LINEAR_____1_CM 0. 255. DISPLAY_IDENTIFIER C_BYP_B_OFS_CH25 FORMAT "%3.0" /end CHARACTERISTIC
/begin CHARACTERISTIC c_byp_B_ofs_ch26 "" VALUE 0x84fbc1 _REC_VAL_20_u1 255. _CNV_A_R_LINEAR_____1_CM 0. 255. DISPLAY_IDENTIFIER C_BYP_B_OFS_CH26 FORMAT "%3.0" /end CHARACTERISTIC
/begin CHARACTERISTIC c_byp_B_ofs_ch27 "" VALUE 0x84fbc2 _REC_VAL_20_u1 255. _CNV_A_R_LINEAR_____1_CM 0. 255. DISPLAY_IDENTIFIER C_BYP_B_OFS_CH27 FORMAT "%3.0" /end CHARACTERISTIC
/begin CHARACTERISTIC c_byp_B_ofs_ch28 "" VALUE 0x84fbc3 _REC_VAL_20_u1 255. _CNV_A_R_LINEAR_____1_CM 0. 255. DISPLAY_IDENTIFIER C_BYP_B_OFS_CH28 FORMAT "%3.0" /end CHARACTERISTIC
/begin CHARACTERISTIC c_byp_B_ofs_ch29 "" VALUE 0x84fbc4 _REC_VAL_20_u1 255. _CNV_A_R_LINEAR_____1_CM 0. 255. DISPLAY_IDENTIFIER C_BYP_B_OFS_CH29 FORMAT "%3.0" /end CHARACTERISTIC
/begin CHARACTERISTIC c_byp_B_ofs_ch30 "" VALUE 0x84fbc6 _REC_VAL_20_u1 255. _CNV_A_R_LINEAR_____1_CM 0. 255. DISPLAY_IDENTIFIER C_BYP_B_OFS_CH30 FORMAT "%3.0" /end CHARACTERISTIC
/begin CHARACTERISTIC c_byp_B_ofs_ch31 "" VALUE 0x84fbc7 _REC_VAL_20_u1 255. _CNV_A_R_LINEAR_____1_CM 0. 255. DISPLAY_IDENTIFIER C_BYP_B_OFS_CH31 FORMAT "%3.0" /end CHARACTERISTIC
/begin MEASUREMENT tqi_st_add "additive start torque" SWORD _CNV_A_R_LINEAR_____52_CM 1 0. -1024. 1023.96875 DISPLAY_IDENTIFIER TQI_ST_ADD ECU_ADDRESS 0x7f9cec BYTE_ORDER MSB_LAST FORMAT "%6.2" /end MEASUREMENT
/begin MEASUREMENT lv_req_is_ctl "request idle speed control active" UBYTE _CNV_S_2_RANGE______11_CM 1 0. 0. 1. DISPLAY_IDENTIFIER LV_REQ_IS_CTL ECU_ADDRESS 0x7fba26 /end MEASUREMENT
/begin MEASUREMENT t_ais_req "timer after idle speed request" UWORD _CNV_A_R_LINEAR_____19_CM 1 0. 0. 6553.5 DISPLAY_IDENTIFIER T_AIS_REQ ECU_ADDRESS 0x7f9cf4 BYTE_ORDER MSB_LAST FORMAT "%5.1" /end MEASUREMENT
/begin CHARACTERISTIC ip_n_is_add_tco "AIS_CTL: additive engine speed for activation idle speed standing car" CURVE 0x857e02 _REC_CUR_20_u2_u1 6375. _CNV_A_R_LINEAR_____5_CM 0. 6375. DISPLAY_IDENTIFIER IP_N_IS_ADD_TCO FORMAT "%4.0"
 /begin AXIS_DESCR COM_AXIS tco _CNV_A_R_LINEAR_____18_CM 8 -50. 205. FORMAT "%3.0" AXIS_PTS_REF ldp_tco_ip_n_is_add /end AXIS_DESCR
/end CHARACTERISTIC
/begin AXIS_PTS ldp_tco_ip_n_is_add "additive engine speed for activation idle speed standing car" 0x8423b4 tco _REC_AXS_20_u1 255. _CNV_A_R_LINEAR_____18_CM 8 -50. 205. FORMAT "%3.0" /end AXIS_PTS
/begin CHARACTERISTIC id_n_add_dri "AIS_CTL: additive engine speed for activation idle speed running car" CURVE 0x850742 _REC_CUR_20_u2_u1 6375. _CNV_A_R_LINEAR_____5_CM 0. 6375. DISPLAY_IDENTIFIER ID_N_ADD_DRI FORMAT "%4.0"
 /begin AXIS_DESCR COM_AXIS dri _CNV_A_R_LINEAR_____0_CM 7 0. 6. FORMAT "%1.0" AXIS_PTS_REF ldpm_dri_id_isc /end AXIS_DESCR
/end CHARACTERISTIC
/begin MEASUREMENT ki_pi_is "integral amplification of PI-controller" UWORD _CNV_A_R_LINEAR_____270_CM 1 0. 0. 1310.4 DISPLAY_IDENTIFIER KI_PI_IS ECU_ADDRESS 0x7f9cf8 BYTE_ORDER MSB_LAST FORMAT "%6.2" /end MEASUREMENT
/begin MEASUREMENT kp_pi_is "amplification PI-controller" UWORD _CNV_A_R_LINEAR_____271_CM 1 0. 0. 65.52 DISPLAY_IDENTIFIER KP_PI_IS ECU_ADDRESS 0x7f9cfa BYTE_ORDER MSB_LAST FORMAT "%5.3" /end MEASUREMENT
/begin CHARACTERISTIC c_gain_n_dif_pos_ki "gain for positive control difference" VALUE 0x84fd62 _REC_VAL_20_u2 16. _CNV_A_R_LINEAR_____272_CM 0. 16. DISPLAY_IDENTIFIER C_GAIN_N_DIF_POS_KI FORMAT "%4.2" /end CHARACTERISTIC
/begin CHARACTERISTIC c_gain_n_dif_neg_ki "gain for negative control difference" VALUE 0x84fd5e _REC_VAL_20_u2 16. _CNV_A_R_LINEAR_____272_CM 0. 16. DISPLAY_IDENTIFIER C_GAIN_N_DIF_NEG_KI FORMAT "%4.2" /end CHARACTERISTIC
/begin CHARACTERISTIC c_gain_n_dif_pos_kp "gain for positive control difference" VALUE 0x84fd64 _REC_VAL_20_u2 16. _CNV_A_R_LINEAR_____162_CM 0. 16. DISPLAY_IDENTIFIER C_GAIN_N_DIF_POS_KP FORMAT "%5.3" /end CHARACTERISTIC
/begin CHARACTERISTIC c_gain_n_dif_neg_kp "gain for negative control difference" VALUE 0x84fd60 _REC_VAL_20_u2 16. _CNV_A_R_LINEAR_____162_CM 0. 16. DISPLAY_IDENTIFIER C_GAIN_N_DIF_NEG_KP FORMAT "%5.3" /end CHARACTERISTIC
/begin CHARACTERISTIC c_n_dif_thd_pos_kp "center point of linear area for positive control difference" VALUE 0x84fde8 _REC_VAL_20_s2 1023. _CNV_A_R_LINEAR_____5_CM -512. 511. DISPLAY_IDENTIFIER C_N_DIF_THD_POS_KP FORMAT "%3.0" /end CHARACTERISTIC
/begin CHARACTERISTIC c_n_dif_thd_neg_kp "center point of linear area for negative control difference" VALUE 0x84fde4 _REC_VAL_20_s2 1023. _CNV_A_R_LINEAR_____5_CM -512. 511. DISPLAY_IDENTIFIER C_N_DIF_THD_NEG_KP FORMAT "%3.0" /end CHARACTERISTIC
/begin CHARACTERISTIC c_n_dif_thd_pos_ki "center point of linear area for positive control difference" VALUE 0x84fde6 _REC_VAL_20_s2 1023. _CNV_A_R_LINEAR_____5_CM -512. 511. DISPLAY_IDENTIFIER C_N_DIF_THD_POS_KI FORMAT "%3.0" /end CHARACTERISTIC
/begin CHARACTERISTIC c_n_dif_thd_neg_ki "center point of linear area for negative control difference" VALUE 0x84fde2 _REC_VAL_20_s2 1023. _CNV_A_R_LINEAR_____5_CM -512. 511. DISPLAY_IDENTIFIER C_N_DIF_THD_NEG_KI FORMAT "%3.0" /end CHARACTERISTIC
/begin CHARACTERISTIC c_n_dif_win_pos_ki "window width of linear area for positve control difference" VALUE 0x84fdee _REC_VAL_20_u2 8160. _CNV_A_R_LINEAR_____5_CM 0. 8160. DISPLAY_IDENTIFIER C_N_DIF_WIN_POS_KI FORMAT "%4.0" /end CHARACTERISTIC
/begin CHARACTERISTIC c_n_dif_win_neg_ki "window width of linear area for negative control difference" VALUE 0x84fdea _REC_VAL_20_u2 8160. _CNV_A_R_LINEAR_____5_CM 0. 8160. DISPLAY_IDENTIFIER C_N_DIF_WIN_NEG_KI FORMAT "%4.0" /end CHARACTERISTIC
/begin CHARACTERISTIC c_n_dif_win_pos_kp "window width of linear area for positve control difference" VALUE 0x84fdf0 _REC_VAL_20_u2 8160. _CNV_A_R_LINEAR_____5_CM 0. 8160. DISPLAY_IDENTIFIER C_N_DIF_WIN_POS_KP FORMAT "%4.0" /end CHARACTERISTIC
/begin CHARACTERISTIC c_n_dif_win_neg_kp "window width of linear area for negative control difference" VALUE 0x84fdec _REC_VAL_20_u2 8160. _CNV_A_R_LINEAR_____5_CM 0. 8160. DISPLAY_IDENTIFIER C_N_DIF_WIN_NEG_KP FORMAT "%4.0" /end CHARACTERISTIC
/begin CHARACTERISTIC lc_is_p_ctl_brake "p controller on brake" VALUE 0x85013e _REC_VAL_20_u1 1. _CNV_A_R_LINEAR_____0_CM 0. 1. DISPLAY_IDENTIFIER LC_IS_P_CTL_BRAKE FORMAT "%1.0" /end CHARACTERISTIC
/begin CHARACTERISTIC c_fac_kr_pi_is_brake "factor amplification PI-controller brake" VALUE 0x84fd2c _REC_VAL_20_u2 0.9999874 _CNV_A_R_LINEAR_____87_CM 0. 0.9999874 DISPLAY_IDENTIFIER C_FAC_KR_PI_IS_BRAKE FORMAT "%6.5" /end CHARACTERISTIC
/begin CHARACTERISTIC id_kr_pi_is__dri "IS_PI: amplification PI-controller" CURVE 0x844540 _REC_CUR_20_u2_u1 4.095 _CNV_A_R_LINEAR_____271_CM 0. 4.095 DISPLAY_IDENTIFIER ID_KR_PI_IS__DRI FORMAT "%4.3"
 /begin AXIS_DESCR COM_AXIS dri _CNV_A_R_LINEAR_____0_CM 7 0. 6. FORMAT "%1.0" AXIS_PTS_REF ldpm_dri_id_isc /end AXIS_DESCR
/end CHARACTERISTIC
/begin CHARACTERISTIC ip_ki_pi_neg_is_tco "IS_PI: integral gain PI-controller for negative control difference" CURVE 0x8484b4 _REC_CUR_20_u2_u1 81.90000000000001 _CNV_A_R_LINEAR_____270_CM 0. 81.90000000000001 DISPLAY_IDENTIFIER IP_KI_PI_NEG_IS_TCO FORMAT "%4.2"
 /begin AXIS_DESCR COM_AXIS tco _CNV_A_R_LINEAR_____18_CM 8 -50. 205. FORMAT "%3.0" AXIS_PTS_REF ldp_tco_ip_ki_pi_neg_is /end AXIS_DESCR
/end CHARACTERISTIC
/begin AXIS_PTS ldp_tco_ip_ki_pi_neg_is "" 0x842377 tco _REC_AXS_20_u1 255. _CNV_A_R_LINEAR_____18_CM 8 -50. 205. FORMAT "%3.0" /end AXIS_PTS
/begin CHARACTERISTIC ip_ki_pi_pos_is_tco "IS_PI: integral gain PI-controller for positive control difference" CURVE 0x8484c4 _REC_CUR_20_u2_u1 81.90000000000001 _CNV_A_R_LINEAR_____270_CM 0. 81.90000000000001 DISPLAY_IDENTIFIER IP_KI_PI_POS_IS_TCO FORMAT "%4.2"
 /begin AXIS_DESCR COM_AXIS tco _CNV_A_R_LINEAR_____18_CM 8 -50. 205. FORMAT "%3.0" AXIS_PTS_REF ldp_tco_ip_ki_pi_pos_is /end AXIS_DESCR
/end CHARACTERISTIC
/begin AXIS_PTS ldp_tco_ip_ki_pi_pos_is "" 0x842380 tco _REC_AXS_20_u1 255. _CNV_A_R_LINEAR_____18_CM 8 -50. 205. FORMAT "%3.0" /end AXIS_PTS
/begin CHARACTERISTIC ip_kr_pi_neg_is__tco "IS_PI: amplification PI-controller negative control difference" CURVE 0x848504 _REC_CUR_20_u2_u1 4.095 _CNV_A_R_LINEAR_____271_CM 0. 4.095 DISPLAY_IDENTIFIER IP_KR_PI_NEG_IS__TCO FORMAT "%4.3"
 /begin AXIS_DESCR COM_AXIS tco _CNV_A_R_LINEAR_____18_CM 8 -50. 205. FORMAT "%3.0" AXIS_PTS_REF ldp_tco_ip_kr_pi_neg_is /end AXIS_DESCR
/end CHARACTERISTIC
/begin AXIS_PTS ldp_tco_ip_kr_pi_neg_is "" 0x842389 tco _REC_AXS_20_u1 255. _CNV_A_R_LINEAR_____18_CM 8 -50. 205. FORMAT "%3.0" /end AXIS_PTS
/begin CHARACTERISTIC ip_kr_pi_pos_is__tco "IS_PI: amplification PI-controller positive control difference" CURVE 0x848514 _REC_CUR_20_u2_u1 4.095 _CNV_A_R_LINEAR_____271_CM 0. 4.095 DISPLAY_IDENTIFIER IP_KR_PI_POS_IS__TCO FORMAT "%4.3"
 /begin AXIS_DESCR COM_AXIS tco _CNV_A_R_LINEAR_____18_CM 8 -50. 205. FORMAT "%3.0" AXIS_PTS_REF ldp_tco_ip_kr_pi_pos_is /end AXIS_DESCR
/end CHARACTERISTIC
/begin AXIS_PTS ldp_tco_ip_kr_pi_pos_is "" 0x842392 tco _REC_AXS_20_u1 255. _CNV_A_R_LINEAR_____18_CM 8 -50. 205. FORMAT "%3.0" /end AXIS_PTS
/begin CHARACTERISTIC id_ki_pi_is_dri "IS_PI: integral gain of PI-controller" CURVE 0x844532 _REC_CUR_20_u2_u1 81.90000000000001 _CNV_A_R_LINEAR_____270_CM 0. 81.90000000000001 DISPLAY_IDENTIFIER ID_KI_PI_IS_DRI FORMAT "%4.2"
 /begin AXIS_DESCR COM_AXIS dri _CNV_A_R_LINEAR_____0_CM 7 0. 6. FORMAT "%1.0" AXIS_PTS_REF ldpm_dri_id_isc /end AXIS_DESCR
/end CHARACTERISTIC
/begin MEASUREMENT lv_tqi_is_min "additive torque start active" UBYTE _CNV_S_2_RANGE______11_CM 1 0. 0. 1. DISPLAY_IDENTIFIER LV_TQI_IS_MIN ECU_ADDRESS 0x7fba27 /end MEASUREMENT
/begin MEASUREMENT lv_tqi_is_max "additive torque start active" UBYTE _CNV_S_2_RANGE______11_CM 1 0. 0. 1. DISPLAY_IDENTIFIER LV_TQI_IS_MAX ECU_ADDRESS 0x7fba28 /end MEASUREMENT
/begin CHARACTERISTIC c_tqi_is_max "additive torque idle speed controller if air conditioning switched on" VALUE 0x85cd38 _REC_VAL_20_s2 2047.96875 _CNV_A_R_LINEAR_____52_CM -1024. 1023.96875 DISPLAY_IDENTIFIER C_TQI_IS_MAX FORMAT "%6.2" /end CHARACTERISTIC
/begin CHARACTERISTIC c_tqi_is_min "additive torque idle speed controller if air conditioning switched on" VALUE 0x85cd3a _REC_VAL_20_s2 2047.96875 _CNV_A_R_LINEAR_____52_CM -1024. 1023.96875 DISPLAY_IDENTIFIER C_TQI_IS_MIN FORMAT "%6.2" /end CHARACTERISTIC
/begin MEASUREMENT tqi_is_min "torque idle speed controller" SWORD _CNV_A_R_LINEAR_____52_CM 1 0. -1024. 1023.96875 DISPLAY_IDENTIFIER TQI_IS_MIN ECU_ADDRESS 0x7f9cfe BYTE_ORDER MSB_LAST FORMAT "%6.2" /end MEASUREMENT
/begin MEASUREMENT tqi_is_max "torque idle speed controller" SWORD _CNV_A_R_LINEAR_____52_CM 1 0. -1024. 1023.96875 DISPLAY_IDENTIFIER TQI_IS_MAX ECU_ADDRESS 0x7f9cfc BYTE_ORDER MSB_LAST FORMAT "%6.2" /end MEASUREMENT
/begin MEASUREMENT lv_is_ena_st "enable idle speed controller" UBYTE _CNV_S_2_RANGE______11_CM 1 0. 0. 1. DISPLAY_IDENTIFIER LV_IS_ENA_ST ECU_ADDRESS 0x7fba25 /end MEASUREMENT
/begin MEASUREMENT dly_ctr_tqi_st "delay counter for start torque" UWORD _CNV_A_R_LINEAR_____0_CM 1 0. 0. 65535. DISPLAY_IDENTIFIER DLY_CTR_TQI_ST ECU_ADDRESS 0x7fa9a8 BYTE_ORDER MSB_LAST FORMAT "%5.0" /end MEASUREMENT
/begin MEASUREMENT tqi_st "start torque" SWORD _CNV_A_R_LINEAR_____52_CM 1 0. -1024. 1023.96875 DISPLAY_IDENTIFIER TQI_ST ECU_ADDRESS 0x7f9cee BYTE_ORDER MSB_LAST FORMAT "%6.2" /end MEASUREMENT
/begin CHARACTERISTIC ip_dly_ctr_tqi_st "TQISTGEN: delay counter for start torque" CURVE 0x851de6 _REC_CUR_20_u2_u1 65535. _CNV_A_R_LINEAR_____0_CM 0. 65535. DISPLAY_IDENTIFIER IP_DLY_CTR_TQI_ST FORMAT "%5.0"
 /begin AXIS_DESCR COM_AXIS tco _CNV_A_R_LINEAR_____18_CM 8 -50. 205. FORMAT "%3.0" AXIS_PTS_REF ldp_tco_ip_dly_ctr_tq_st /end AXIS_DESCR
/end CHARACTERISTIC
/begin AXIS_PTS ldp_tco_ip_dly_ctr_tq_st "delay counter for start torque" 0x842291 tco _REC_AXS_20_u1 255. _CNV_A_R_LINEAR_____18_CM 8 -50. 205. FORMAT "%3.0" /end AXIS_PTS
/begin CHARACTERISTIC ip_tqi_st "TQISTGEN: start torque" MAP 0x85c2d4 _REC_MAP_20_u2_u2_u1 2047.96875 _CNV_A_R_LINEAR_____86_CM -1024. 1023.96875 DISPLAY_IDENTIFIER IP_TQI_ST FORMAT "%6.2"
 /begin AXIS_DESCR COM_AXIS n _CNV_A_R_LINEAR_____5_CM 12 0. 6375. FORMAT "%4.0" AXIS_PTS_REF ldp_n_ip_tqi_st /end AXIS_DESCR
 /begin AXIS_DESCR COM_AXIS tco _CNV_A_R_LINEAR_____18_CM 7 -50. 205. FORMAT "%3.0" AXIS_PTS_REF ldp_tco_ip_tqi_st /end AXIS_DESCR
/end CHARACTERISTIC
/begin AXIS_PTS ldp_n_ip_tqi_st "start torque" 0x841f5a n _REC_AXS_20_u2 6375. _CNV_A_R_LINEAR_____5_CM 12 0. 6375. FORMAT "%4.0" /end AXIS_PTS
/begin AXIS_PTS ldp_tco_ip_tqi_st "start torque" 0x842402 tco _REC_AXS_20_u1 255. _CNV_A_R_LINEAR_____18_CM 7 -50. 205. FORMAT "%3.0" /end AXIS_PTS
/begin MEASUREMENT n_dif_is "idle speed control difference" SWORD _CNV_A_R_LINEAR_____5_CM 1 0. -512. 511. DISPLAY_IDENTIFIER N_DIF_IS ECU_ADDRESS 0x7f9cf0 BYTE_ORDER MSB_LAST FORMAT "%3.0" /end MEASUREMENT
/begin MEASUREMENT tqi_is_ctl "torque idle speed controller" SWORD _CNV_A_R_LINEAR_____52_CM 1 0. -1024. 1023.96875 DISPLAY_IDENTIFIER TQI_IS_CTL ECU_ADDRESS 0x7f9cf2 BYTE_ORDER MSB_LAST FORMAT "%6.2" /end MEASUREMENT
/begin MEASUREMENT kr_dt1_is "amplification DT1-function idle speed control" UWORD _CNV_A_R_LINEAR_____273_CM 1 0. 0. 0.9999874 DISPLAY_IDENTIFIER KR_DT1_IS ECU_ADDRESS 0x7fa9c2 BYTE_ORDER MSB_LAST FORMAT "%6.5" /end MEASUREMENT
/begin MEASUREMENT tqi_p_is_ctl "idle speed controller p-part" SWORD _CNV_A_R_LINEAR_____52_CM 1 0. -1024. 1023.96875 DISPLAY_IDENTIFIER TQI_P_IS_CTL ECU_ADDRESS 0x7fa9c4 BYTE_ORDER MSB_LAST FORMAT "%6.2" /end MEASUREMENT
/begin MEASUREMENT tqi_is_dt1_acin "torque DT1-function idle speed control air condition" SWORD _CNV_A_R_LINEAR_____52_CM 1 0. -1024. 1023.96875 DISPLAY_IDENTIFIER TQI_IS_DT1_ACIN ECU_ADDRESS 0x7fa9c6 BYTE_ORDER MSB_LAST FORMAT "%6.2" /end MEASUREMENT
/begin MEASUREMENT tqi_is_dt1_n "control torque DT1-function" SWORD _CNV_A_R_LINEAR_____52_CM 1 0. -1024. 1023.96875 DISPLAY_IDENTIFIER TQI_IS_DT1_N ECU_ADDRESS 0x7fa9c8 BYTE_ORDER MSB_LAST FORMAT "%6.2" /end MEASUREMENT
/begin MEASUREMENT tqi_pi_is_ctl "torque idle speed PI-controller" SWORD _CNV_A_R_LINEAR_____52_CM 1 0. -1024. 1023.96875 DISPLAY_IDENTIFIER TQI_PI_IS_CTL ECU_ADDRESS 0x7fa9ca BYTE_ORDER MSB_LAST FORMAT "%6.2" /end MEASUREMENT
/begin MEASUREMENT tqi_i_is_ctl "idle speed controller i-part" SWORD _CNV_A_R_LINEAR_____52_CM 1 0. -1024. 1023.96875 DISPLAY_IDENTIFIER TQI_I_IS_CTL ECU_ADDRESS 0x7fa9cc BYTE_ORDER MSB_LAST FORMAT "%6.2" /end MEASUREMENT
/begin MEASUREMENT tqi_dt1_is_ctl "torque DT1-function" SWORD _CNV_A_R_LINEAR_____52_CM 1 0. -1024. 1023.96875 DISPLAY_IDENTIFIER TQI_DT1_IS_CTL ECU_ADDRESS 0x7fa9ce BYTE_ORDER MSB_LAST FORMAT "%6.2" /end MEASUREMENT
/begin MEASUREMENT n_dif "engine speed control difference" SWORD _CNV_A_R_LINEAR_____5_CM 1 0. -512. 511. DISPLAY_IDENTIFIER N_DIF ECU_ADDRESS 0x7fa9aa BYTE_ORDER MSB_LAST FORMAT "%3.0" /end MEASUREMENT
/begin MEASUREMENT t1_dt1_is "time constant DT1-function idle speed control" UWORD _CNV_A_R_LINEAR_____274_CM 1 0. 0. 8.38848 DISPLAY_IDENTIFIER T1_DT1_IS ECU_ADDRESS 0x7fa9d0 BYTE_ORDER MSB_LAST FORMAT "%5.4" /end MEASUREMENT
/begin MEASUREMENT lv_act_dt1_is "idle speed DT1-function active" UBYTE _CNV_S_2_RANGE______11_CM 1 0. 0. 1. DISPLAY_IDENTIFIER LV_ACT_DT1_IS ECU_ADDRESS 0x7fbec1 /end MEASUREMENT
/begin MEASUREMENT tqi_is_ini "initialisation torque of idle speed controller" SWORD _CNV_A_R_LINEAR_____52_CM 1 0. -1024. 1023.96875 DISPLAY_IDENTIFIER TQI_IS_INI ECU_ADDRESS 0x7fa9d2 BYTE_ORDER MSB_LAST FORMAT "%6.2" /end MEASUREMENT
/begin CHARACTERISTIC lc_is_n_pred "switch for engine speed input signal" VALUE 0x85013d _REC_VAL_20_u1 1. _CNV_A_R_LINEAR_____0_CM 0. 1. DISPLAY_IDENTIFIER LC_IS_N_PRED FORMAT "%1.0" /end CHARACTERISTIC
/begin CHARACTERISTIC c_t1_dt1_is_acin_off "time constant DT1-function air condition off" VALUE 0x84ff10 _REC_VAL_20_u2 8.38848 _CNV_A_R_LINEAR_____274_CM 0. 8.38848 DISPLAY_IDENTIFIER C_T1_DT1_IS_ACIN_OFF FORMAT "%5.4" /end CHARACTERISTIC
/begin CHARACTERISTIC c_t1_dt1_is_acin_on "time constant DT1-function air condition on" VALUE 0x84ff12 _REC_VAL_20_u2 8.38848 _CNV_A_R_LINEAR_____274_CM 0. 8.38848 DISPLAY_IDENTIFIER C_T1_DT1_IS_ACIN_ON FORMAT "%5.4" /end CHARACTERISTIC
/begin CHARACTERISTIC c_kr_dt1_is_acin_off "amplification DT1-function air condition off" VALUE 0x84fd74 _REC_VAL_20_u2 3.99998471 _CNV_A_R_LINEAR_____275_CM 0. 3.99998471 DISPLAY_IDENTIFIER C_KR_DT1_IS_ACIN_OFF FORMAT "%6.5" /end CHARACTERISTIC
/begin CHARACTERISTIC c_kr_dt1_is_acin_on "amplification DT1-function air condition on" VALUE 0x84fd76 _REC_VAL_20_u2 3.99998471 _CNV_A_R_LINEAR_____275_CM 0. 3.99998471 DISPLAY_IDENTIFIER C_KR_DT1_IS_ACIN_ON FORMAT "%1.0" /end CHARACTERISTIC
/begin CHARACTERISTIC c_tqi_dt1_is_min "minimum torque DT1-function" VALUE 0x85006a _REC_VAL_20_s2 2047.96875 _CNV_A_R_LINEAR_____52_CM -1024. 1023.96875 DISPLAY_IDENTIFIER C_TQI_DT1_IS_MIN FORMAT "%6.2" /end CHARACTERISTIC
/begin CHARACTERISTIC c_tqi_dt1_is_max "maximum torque DT1-function" VALUE 0x850068 _REC_VAL_20_s2 2047.96875 _CNV_A_R_LINEAR_____52_CM -1024. 1023.96875 DISPLAY_IDENTIFIER C_TQI_DT1_IS_MAX FORMAT "%6.2" /end CHARACTERISTIC
/begin CHARACTERISTIC c_t_dly_dt1_is "time for activation DT1-function" VALUE 0x84ff68 _REC_VAL_20_u2 6553.5 _CNV_A_R_LINEAR_____19_CM 0. 6553.5 DISPLAY_IDENTIFIER C_T_DLY_DT1_IS FORMAT "%5.1" /end CHARACTERISTIC
/begin CHARACTERISTIC c_tqi_dt1_is_thd "threshold torque DT1-function" VALUE 0x85006c _REC_VAL_20_s2 2047.96875 _CNV_A_R_LINEAR_____52_CM -1024. 1023.96875 DISPLAY_IDENTIFIER C_TQI_DT1_IS_THD FORMAT "%6.2" /end CHARACTERISTIC
/begin CHARACTERISTIC c_kr_dt1_is "amplification DT1-function" VALUE 0x84fd72 _REC_VAL_20_u2 3.99998471 _CNV_A_R_LINEAR_____275_CM 0. 3.99998471 DISPLAY_IDENTIFIER C_KR_DT1_IS FORMAT "%6.5" /end CHARACTERISTIC
/begin CHARACTERISTIC c_kr_dt1_is_vs_run "amplification DT1-function running car" VALUE 0x84fd78 _REC_VAL_20_u2 3.99998471 _CNV_A_R_LINEAR_____275_CM 0. 3.99998471 DISPLAY_IDENTIFIER C_KR_DT1_IS_VS_RUN FORMAT "%1.0" /end CHARACTERISTIC
/begin CHARACTERISTIC c_t1_dt1_is "time constant DT1-function" VALUE 0x84ff0e _REC_VAL_20_u2 8.38848 _CNV_A_R_LINEAR_____274_CM 0. 8.38848 DISPLAY_IDENTIFIER C_T1_DT1_IS FORMAT "%5.4" /end CHARACTERISTIC
/begin CHARACTERISTIC c_t1_dt1_is_vs_run "time constant DT1-function running car" VALUE 0x84ff14 _REC_VAL_20_u2 8.38848 _CNV_A_R_LINEAR_____274_CM 0. 8.38848 DISPLAY_IDENTIFIER C_T1_DT1_IS_VS_RUN FORMAT "%5.4" /end CHARACTERISTIC
/begin CHARACTERISTIC c_fac_is_tqi_ini_brake "low pass filter factor idle speed controller for torque initialization when braking" VALUE 0x84fd2a _REC_VAL_20_u2 0.9999874 _CNV_A_R_LINEAR_____87_CM 0. 0.9999874 DISPLAY_IDENTIFIER C_FAC_IS_TQI_INI_BRAKE FORMAT "%6.5" /end CHARACTERISTIC
/begin CHARACTERISTIC c_fac_is_tqi_ini "low pass filter factor idle speed controller torque initialization" VALUE 0x84fd28 _REC_VAL_20_u2 0.9999874 _CNV_A_R_LINEAR_____87_CM 0. 0.9999874 DISPLAY_IDENTIFIER C_FAC_IS_TQI_INI FORMAT "%6.5" /end CHARACTERISTIC
/begin CHARACTERISTIC c_tqi_ini_add_acin "additive torque idle speed controller if air conditioning switched on" VALUE 0x850070 _REC_VAL_20_s2 2047.96875 _CNV_A_R_LINEAR_____52_CM -1024. 1023.96875 DISPLAY_IDENTIFIER C_TQI_INI_ADD_ACIN FORMAT "%6.2" /end CHARACTERISTIC
/begin CHARACTERISTIC lc_is_ini_bls_on "initialization on brake" VALUE 0x85013c _REC_VAL_20_u1 1. _CNV_A_R_LINEAR_____0_CM 0. 1. DISPLAY_IDENTIFIER LC_IS_INI_BLS_ON FORMAT "%1.0" /end CHARACTERISTIC
/begin CHARACTERISTIC id_fac_n_dif_rng_is__dri "TQ_IS: factor gradient switch" CURVE 0x844525 _REC_CUR_20_u1_u1 0.99609375 _CNV_A_R_LINEAR_____29_CM 0. 0.99609375 DISPLAY_IDENTIFIER ID_FAC_N_DIF_RNG_IS__DRI FORMAT "%4.3"
 /begin AXIS_DESCR COM_AXIS dri _CNV_A_R_LINEAR_____0_CM 7 0. 6. FORMAT "%1.0" AXIS_PTS_REF ldpm_dri_id_isc /end AXIS_DESCR
/end CHARACTERISTIC
/begin AXIS_PTS ldpm_dri_id_isc "" 0x842b56 dri _REC_AXS_20_u1 6. _CNV_A_R_LINEAR_____0_CM 7 0. 6. FORMAT "%1.0" /end AXIS_PTS
/begin CHARACTERISTIC id_n_dif_rng_is__dri "TQ_IS: range for gradient switch" CURVE 0x844d4e _REC_CUR_20_u2_u1 511. _CNV_A_R_LINEAR_____5_CM 0. 511. DISPLAY_IDENTIFIER ID_N_DIF_RNG_IS__DRI FORMAT "%3.0"
 /begin AXIS_DESCR COM_AXIS dri _CNV_A_R_LINEAR_____0_CM 7 0. 6. FORMAT "%1.0" AXIS_PTS_REF ldpm_dri_id_isc /end AXIS_DESCR
/end CHARACTERISTIC
/begin CHARACTERISTIC id_tqi_ini__dri "TQ_IS: intialization torque output idle speed controller for running car" CURVE 0x844df2 _REC_CUR_20_u2_u1 2047.96875 _CNV_A_R_LINEAR_____86_CM -1024. 1023.96875 DISPLAY_IDENTIFIER ID_TQI_INI__DRI FORMAT "%6.2"
 /begin AXIS_DESCR COM_AXIS dri _CNV_A_R_LINEAR_____0_CM 7 0. 6. FORMAT "%1.0" AXIS_PTS_REF ldpm_dri_id_isc /end AXIS_DESCR
/end CHARACTERISTIC
/begin CHARACTERISTIC ip_n_dif_dt1_is__tco "TQ_IS: control difference for activation DT1-function" CURVE 0x84d2dc _REC_CUR_20_u2_u1 8160. _CNV_A_R_LINEAR_____5_CM 0. 8160. DISPLAY_IDENTIFIER IP_N_DIF_DT1_IS__TCO FORMAT "%4.0"
 /begin AXIS_DESCR COM_AXIS tco _CNV_A_R_LINEAR_____18_CM 8 -50. 205. FORMAT "%3.0" AXIS_PTS_REF ldp_tco_ip_n_dif_dt1_is /end AXIS_DESCR
/end CHARACTERISTIC
/begin AXIS_PTS ldp_tco_ip_n_dif_dt1_is "" 0x8423a4 tco _REC_AXS_20_u1 255. _CNV_A_R_LINEAR_____18_CM 8 -50. 205. FORMAT "%3.0" /end AXIS_PTS
/begin CHARACTERISTIC ip_tqi_ini__tco "TQ_IS: initialization ouput torque idle speed controller" CURVE 0x84f8ce _REC_CUR_20_u2_u1 2047.96875 _CNV_A_R_LINEAR_____86_CM -1024. 1023.96875 DISPLAY_IDENTIFIER IP_TQI_INI__TCO FORMAT "%6.2"
 /begin AXIS_DESCR COM_AXIS tco _CNV_A_R_LINEAR_____18_CM 8 -50. 205. FORMAT "%3.0" AXIS_PTS_REF ldp_tco_ip_tqi_ini /end AXIS_DESCR
/end CHARACTERISTIC
/begin AXIS_PTS ldp_tco_ip_tqi_ini "" 0x8423f9 tco _REC_AXS_20_u1 255. _CNV_A_R_LINEAR_____18_CM 8 -50. 205. FORMAT "%3.0" /end AXIS_PTS
/begin MEASUREMENT tqi_is_pre_ctl "Pre-controlled torque for idle speed control" SWORD _CNV_A_R_LINEAR_____52_CM 1 0. -1024. 1023.96875 DISPLAY_IDENTIFIER TQI_IS_PRE_CTL ECU_ADDRESS 0x7f9cea BYTE_ORDER MSB_LAST FORMAT "%7.3" /end MEASUREMENT
/begin AXIS_PTS ldpm_sf_conf_inj "Injection Region" 0x843764 act_inj_coded _REC_AXS_20_u1 15. _CNV_A_R_LINEAR_____0_CM 16 0. 15. FORMAT "%2.0" /end AXIS_PTS
/begin AXIS_PTS ldp_amp_2_inj_x "" 0x841082 amp _REC_AXS_20_u2 5434. _CNV_A_R_LINEAR_____45_CM 1 0. 5434. FORMAT "%7.3" /end AXIS_PTS
/begin AXIS_PTS ldp_n_3_inj_x "" 0x841924 n _REC_AXS_20_u2 6375. _CNV_A_R_LINEAR_____5_CM 1 0. 6375. FORMAT "%4.0" /end AXIS_PTS
/begin AXIS_PTS ldp_tco_2_inj_x "" 0x842272 tco _REC_AXS_20_u1 255. _CNV_A_R_LINEAR_____18_CM 1 -50. 205. FORMAT "%3.0" /end AXIS_PTS
/begin AXIS_PTS ldp_n_4_inj_x "" 0x841928 n _REC_AXS_20_u2 6375. _CNV_A_R_LINEAR_____5_CM 1 0. 6375. FORMAT "%4.0" /end AXIS_PTS
/begin AXIS_PTS ldp_tco_3_inj_x "" 0x842274 tco _REC_AXS_20_u1 255. _CNV_A_R_LINEAR_____18_CM 1 -50. 205. FORMAT "%3.0" /end AXIS_PTS
/begin CHARACTERISTIC ip_fac_soi_prev1_cor_amp "amp correction factor for SOI of minor injection PREV1" CURVE 0x8529ae _REC_CUR_20_u2_u2 0.9999847412109381 _CNV_A_R_LINEAR_____14_CM 0. 0.9999847412109381 DISPLAY_IDENTIFIER IP_FAC_SOI_PREV1_COR_AMP FORMAT "%6.5"
 /begin AXIS_DESCR COM_AXIS amp _CNV_A_R_LINEAR_____45_CM 8 0. 5434. FORMAT "%6.2" AXIS_PTS_REF ldp_amp_ip_fac_soi_prev1_cor /end AXIS_DESCR
/end CHARACTERISTIC
/begin AXIS_PTS ldp_amp_ip_fac_soi_prev1_cor "amp correction factor for SOI of prev1 injection" 0x8412ba amp _REC_AXS_20_u2 5434. _CNV_A_R_LINEAR_____45_CM 8 0. 5434. FORMAT "%6.2" /end AXIS_PTS
/begin CHARACTERISTIC ip_fac_soi_prev1_cor_tgas "TGAS correction factor for SOI PREV1" CURVE 0x8529ce _REC_CUR_20_u2_u1 0.9999847412109381 _CNV_A_R_LINEAR_____14_CM 0. 0.9999847412109381 DISPLAY_IDENTIFIER IP_FAC_SOI_PREV1_COR_TGAS FORMAT "%6.5"
 /begin AXIS_DESCR COM_AXIS tgas _CNV_A_R_LINEAR_____18_CM 8 -50. 205. FORMAT "%3.0" AXIS_PTS_REF ldp_tgas_ip_fac_soi_prev1_cor /end AXIS_DESCR
/end CHARACTERISTIC
/begin AXIS_PTS ldp_tgas_ip_fac_soi_prev1_cor "SOI correction dependent on TGAS for prev1 injection" 0x842545 tgas _REC_AXS_20_u1 255. _CNV_A_R_LINEAR_____18_CM 8 -50. 205. FORMAT "%3.0" /end AXIS_PTS
/begin CHARACTERISTIC ip_fac_soi_prev1_cor_tco "start of PREV1 injection interpolation dependent on TCO" CURVE 0x8529be _REC_CUR_20_u2_u1 1.9999696 _CNV_A_R_LINEAR_____48_CM 0. 1.9999696 DISPLAY_IDENTIFIER IP_FAC_SOI_PREV1_COR_TCO FORMAT "%6.5"
 /begin AXIS_DESCR COM_AXIS tco _CNV_A_R_LINEAR_____18_CM 8 -50. 205. FORMAT "%3.0" AXIS_PTS_REF ldp_tco_ip_fac_soi_prev1_cor /end AXIS_DESCR
/end CHARACTERISTIC
/begin AXIS_PTS ldp_tco_ip_fac_soi_prev1_cor "start of prev1 injection interpolation dependent on TCO" 0x84230c tco _REC_AXS_20_u1 255. _CNV_A_R_LINEAR_____18_CM 8 -50. 205. FORMAT "%3.0" /end AXIS_PTS
/begin AXIS_PTS ldpm_n_1_ip_soi_prev1_dif "basic SOI of prev1 injection at warm conditions" 0x842e9a n _REC_AXS_20_u2 6375. _CNV_A_R_LINEAR_____5_CM 16 0. 6375. FORMAT "%4.0" /end AXIS_PTS
/begin AXIS_PTS ldpm_tqi_sp_1_ip_soi_prev1_dif "basic SOI of prev1 injection at warm conditions" 0x843c8a tqi_sp _REC_AXS_20_u2 2047.96875 _CNV_A_R_LINEAR_____86_CM 16 -1024. 1023.96875 FORMAT "%6.2" /end AXIS_PTS
/begin CHARACTERISTIC ip_soi_prev1_dif_amp "AMP correction of SOI PREV1" MAP 0x85ad8c _REC_MAP_20_u2_u2_u2 720. _CNV_A_R_LINEAR_____400_CM -360. 360. DISPLAY_IDENTIFIER IP_SOI_PREV1_DIF_AMP FORMAT "%5.2"
 /begin AXIS_DESCR COM_AXIS n _CNV_A_R_LINEAR_____5_CM 8 0. 6375. FORMAT "%4.0" AXIS_PTS_REF ldp_n_ip_soi_prev1_dif_amp /end AXIS_DESCR
 /begin AXIS_DESCR COM_AXIS tqi_sp _CNV_A_R_LINEAR_____86_CM 8 -1024. 1023.96875 FORMAT "%6.2" AXIS_PTS_REF ldp_tqi_sp_ip_soi_prev1_dif_amp /end AXIS_DESCR
/end CHARACTERISTIC
/begin AXIS_PTS ldp_n_ip_soi_prev1_dif_amp "ambient pressure temperature correction of SOI for prev1 injection" 0x841de6 n _REC_AXS_20_u2 6375. _CNV_A_R_LINEAR_____5_CM 8 0. 6375. FORMAT "%4.0" /end AXIS_PTS
/begin AXIS_PTS ldp_tqi_sp_ip_soi_prev1_dif_amp "ambient pressure temperature correction of SOI for prev1 injection" 0x842946 tqi_sp _REC_AXS_20_u2 2047.96875 _CNV_A_R_LINEAR_____86_CM 8 -1024. 1023.96875 FORMAT "%6.2" /end AXIS_PTS
/begin CHARACTERISTIC ip_soi_prev1_dif_tgas "TGAS correction of SOI PREV1" MAP 0x85aee4 _REC_MAP_20_u2_u2_u2 720. _CNV_A_R_LINEAR_____400_CM -360. 360. DISPLAY_IDENTIFIER IP_SOI_PREV1_DIF_TGAS FORMAT "%5.2"
 /begin AXIS_DESCR COM_AXIS n _CNV_A_R_LINEAR_____5_CM 8 0. 6375. FORMAT "%4.0" AXIS_PTS_REF ldp_n_ip_soi_prev1_dif_tgas /end AXIS_DESCR
 /begin AXIS_DESCR COM_AXIS tqi_sp _CNV_A_R_LINEAR_____86_CM 8 -1024. 1023.96875 FORMAT "%6.2" AXIS_PTS_REF ldp_tqi_sp_ip_soi_prev1_dif_tgas /end AXIS_DESCR
/end CHARACTERISTIC
/begin AXIS_PTS ldp_n_ip_soi_prev1_dif_tgas "air temperature correction of SOI for prev1 injection" 0x841df8 n _REC_AXS_20_u2 6375. _CNV_A_R_LINEAR_____5_CM 8 0. 6375. FORMAT "%4.0" /end AXIS_PTS
/begin AXIS_PTS ldp_tqi_sp_ip_soi_prev1_dif_tgas "air temperature correction of SOI for prev1 injection" 0x842958 tqi_sp _REC_AXS_20_u2 2047.96875 _CNV_A_R_LINEAR_____86_CM 8 -1024. 1023.96875 FORMAT "%6.2" /end AXIS_PTS
/begin CHARACTERISTIC ip_fac_soi_prev2_cor_amp "amp correction factor for SOI of minor injection PREV2" CURVE 0x8529e6 _REC_CUR_20_u2_u2 0.9999847412109381 _CNV_A_R_LINEAR_____14_CM 0. 0.9999847412109381 DISPLAY_IDENTIFIER IP_FAC_SOI_PREV2_COR_AMP FORMAT "%6.5"
 /begin AXIS_DESCR COM_AXIS amp _CNV_A_R_LINEAR_____45_CM 1 0. 5434. FORMAT "%6.2" AXIS_PTS_REF ldp_amp_ip_fac_soi_prev2_cor /end AXIS_DESCR
/end CHARACTERISTIC
/begin AXIS_PTS ldp_amp_ip_fac_soi_prev2_cor "amp correction factor for SOI of prev2 injection" 0x8412d8 amp _REC_AXS_20_u2 5434. _CNV_A_R_LINEAR_____45_CM 1 0. 5434. FORMAT "%6.2" /end AXIS_PTS
/begin CHARACTERISTIC ip_fac_soi_prev2_cor_tgas "TGAS correction factor for SOI PREV2" CURVE 0x8529ea _REC_CUR_20_u2_u1 0.9999847412109381 _CNV_A_R_LINEAR_____14_CM 0. 0.9999847412109381 DISPLAY_IDENTIFIER IP_FAC_SOI_PREV2_COR_TGAS FORMAT "%6.5"
 /begin AXIS_DESCR COM_AXIS tgas _CNV_A_R_LINEAR_____18_CM 1 -50. 205. FORMAT "%3.0" AXIS_PTS_REF ldp_tgas_ip_fac_soi_prev2_cor /end AXIS_DESCR
/end CHARACTERISTIC
/begin AXIS_PTS ldp_tgas_ip_fac_soi_prev2_cor "SOI correction dependent on TGAS for prev2 injection" 0x84254e tgas _REC_AXS_20_u1 255. _CNV_A_R_LINEAR_____18_CM 1 -50. 205. FORMAT "%3.0" /end AXIS_PTS
/begin CHARACTERISTIC ip_fac_soi_prev2_cor_tco "start of PREV2 injection interpolation dependent on TCO" CURVE 0x8529e8 _REC_CUR_20_u2_u1 1.9999696 _CNV_A_R_LINEAR_____48_CM 0. 1.9999696 DISPLAY_IDENTIFIER IP_FAC_SOI_PREV2_COR_TCO FORMAT "%6.5"
 /begin AXIS_DESCR COM_AXIS tco _CNV_A_R_LINEAR_____18_CM 1 -50. 205. FORMAT "%3.0" AXIS_PTS_REF ldp_tco_ip_fac_soi_prev2_cor /end AXIS_DESCR
/end CHARACTERISTIC
/begin AXIS_PTS ldp_tco_ip_fac_soi_prev2_cor "start of injection prev2 interpolation dependent on TCO" 0x842315 tco _REC_AXS_20_u1 255. _CNV_A_R_LINEAR_____18_CM 1 -50. 205. FORMAT "%3.0" /end AXIS_PTS
/begin AXIS_PTS ldpm_n_1_ip_soi_prev2_dif "basic SOI of prev2 injection at warm conditions" 0x842ebc n _REC_AXS_20_u2 6375. _CNV_A_R_LINEAR_____5_CM 1 0. 6375. FORMAT "%4.0" /end AXIS_PTS
/begin AXIS_PTS ldpm_tqi_sp_1_ip_soi_prev2_dif "basic SOI of prev2 injection at warm conditions" 0x843cac tqi_sp _REC_AXS_20_u2 2047.96875 _CNV_A_R_LINEAR_____86_CM 1 -1024. 1023.96875 FORMAT "%6.2" /end AXIS_PTS
/begin CHARACTERISTIC ip_soi_prev2_dif_amp "AMP correction of SOI PREV2" MAP 0x85af6a _REC_MAP_20_u2_u2_u2 720. _CNV_A_R_LINEAR_____400_CM -360. 360. DISPLAY_IDENTIFIER IP_SOI_PREV2_DIF_AMP FORMAT "%5.2"
 /begin AXIS_DESCR COM_AXIS n _CNV_A_R_LINEAR_____5_CM 1 0. 6375. FORMAT "%4.0" AXIS_PTS_REF ldp_n_ip_soi_prev2_dif_amp /end AXIS_DESCR
 /begin AXIS_DESCR COM_AXIS tqi_sp _CNV_A_R_LINEAR_____86_CM 1 -1024. 1023.96875 FORMAT "%6.2" AXIS_PTS_REF ldp_tqi_sp_ip_soi_prev2_dif_amp /end AXIS_DESCR
/end CHARACTERISTIC
/begin AXIS_PTS ldp_n_ip_soi_prev2_dif_amp "ambient pressure temperature correction of SOI for prev2 injection" 0x841e0a n _REC_AXS_20_u2 6375. _CNV_A_R_LINEAR_____5_CM 1 0. 6375. FORMAT "%4.0" /end AXIS_PTS
/begin AXIS_PTS ldp_tqi_sp_ip_soi_prev2_dif_amp "ambient pressure temperature correction of SOI for prev2 injection" 0x84296a tqi_sp _REC_AXS_20_u2 2047.96875 _CNV_A_R_LINEAR_____86_CM 1 -1024. 1023.96875 FORMAT "%6.2" /end AXIS_PTS
/begin CHARACTERISTIC ip_soi_prev2_dif_tgas "TGAS correction of SOI PREV2" MAP 0x85af70 _REC_MAP_20_u2_u2_u2 720. _CNV_A_R_LINEAR_____400_CM -360. 360. DISPLAY_IDENTIFIER IP_SOI_PREV2_DIF_TGAS FORMAT "%5.2"
 /begin AXIS_DESCR COM_AXIS n _CNV_A_R_LINEAR_____5_CM 1 0. 6375. FORMAT "%4.0" AXIS_PTS_REF ldp_n_ip_soi_prev2_dif_tgas /end AXIS_DESCR
 /begin AXIS_DESCR COM_AXIS tqi_sp _CNV_A_R_LINEAR_____86_CM 1 -1024. 1023.96875 FORMAT "%6.2" AXIS_PTS_REF ldp_tqi_sp_ip_soi_prev2_dif_tgas /end AXIS_DESCR
/end CHARACTERISTIC
/begin AXIS_PTS ldp_n_ip_soi_prev2_dif_tgas "air temperature correction of SOI for prev2 injection" 0x841e0e n _REC_AXS_20_u2 6375. _CNV_A_R_LINEAR_____5_CM 1 0. 6375. FORMAT "%4.0" /end AXIS_PTS
/begin AXIS_PTS ldp_tqi_sp_ip_soi_prev2_dif_tgas "air temperature correction of SOI for prev2 injection" 0x84296e tqi_sp _REC_AXS_20_u2 2047.96875 _CNV_A_R_LINEAR_____86_CM 1 -1024. 1023.96875 FORMAT "%6.2" /end AXIS_PTS
/begin CHARACTERISTIC ip_fac_soi_main2_cor_amp "amp correction factor for SOI of minor injection MAIN2" CURVE 0x85296e _REC_CUR_20_u2_u2 0.9999847412109381 _CNV_A_R_LINEAR_____14_CM 0. 0.9999847412109381 DISPLAY_IDENTIFIER IP_FAC_SOI_MAIN2_COR_AMP FORMAT "%6.5"
 /begin AXIS_DESCR COM_AXIS amp _CNV_A_R_LINEAR_____45_CM 1 0. 5434. FORMAT "%6.2" AXIS_PTS_REF ldp_amp_ip_fac_soi_main2_cor /end AXIS_DESCR
/end CHARACTERISTIC
/begin AXIS_PTS ldp_amp_ip_fac_soi_main2_cor "amp correction factor for SOI of main2 injection" 0x84128c amp _REC_AXS_20_u2 5434. _CNV_A_R_LINEAR_____45_CM 1 0. 5434. FORMAT "%6.2" /end AXIS_PTS
/begin CHARACTERISTIC ip_fac_soi_main2_cor_tgas "TGAS correction factor for SOI MAIN2" CURVE 0x852972 _REC_CUR_20_u2_u1 0.9999847412109381 _CNV_A_R_LINEAR_____14_CM 0. 0.9999847412109381 DISPLAY_IDENTIFIER IP_FAC_SOI_MAIN2_COR_TGAS FORMAT "%6.5"
 /begin AXIS_DESCR COM_AXIS tgas _CNV_A_R_LINEAR_____18_CM 1 -50. 205. FORMAT "%3.0" AXIS_PTS_REF ldp_tgas_ip_fac_soi_main2_cor /end AXIS_DESCR
/end CHARACTERISTIC
/begin AXIS_PTS ldp_tgas_ip_fac_soi_main2_cor "SOI correction dependent on TGAS for main2 injection" 0x84253a tgas _REC_AXS_20_u1 255. _CNV_A_R_LINEAR_____18_CM 1 -50. 205. FORMAT "%3.0" /end AXIS_PTS
/begin CHARACTERISTIC ip_fac_soi_main2_cor_tco "start of MAIN2 injection interpolation dependent on TCO" CURVE 0x852970 _REC_CUR_20_u2_u1 1.9999696 _CNV_A_R_LINEAR_____48_CM 0. 1.9999696 DISPLAY_IDENTIFIER IP_FAC_SOI_MAIN2_COR_TCO FORMAT "%6.5"
 /begin AXIS_DESCR COM_AXIS tco _CNV_A_R_LINEAR_____18_CM 1 -50. 205. FORMAT "%3.0" AXIS_PTS_REF ldp_tco_ip_fac_soi_main2_cor /end AXIS_DESCR
/end CHARACTERISTIC
/begin AXIS_PTS ldp_tco_ip_fac_soi_main2_cor "start of injection main2 interpolation dependent on TCO" 0x842301 tco _REC_AXS_20_u1 255. _CNV_A_R_LINEAR_____18_CM 1 -50. 205. FORMAT "%3.0" /end AXIS_PTS
/begin AXIS_PTS ldpm_n_1_ip_soi_main2_dif "basic SOI of main2 injection at warm conditions" 0x842e74 n _REC_AXS_20_u2 6375. _CNV_A_R_LINEAR_____5_CM 1 0. 6375. FORMAT "%4.0" /end AXIS_PTS
/begin AXIS_PTS ldpm_tqi_sp_1_ip_soi_main2_dif "basic SOI of main2 injection at warm conditions" 0x843c64 tqi_sp _REC_AXS_20_u2 2047.96875 _CNV_A_R_LINEAR_____86_CM 1 -1024. 1023.96875 FORMAT "%6.2" /end AXIS_PTS
/begin CHARACTERISTIC ip_soi_main2_dif_amp "AMP correction of SOI MAIN2" MAP 0x859f80 _REC_MAP_20_u2_u2_u2 720. _CNV_A_R_LINEAR_____400_CM -360. 360. DISPLAY_IDENTIFIER IP_SOI_MAIN2_DIF_AMP FORMAT "%5.2"
 /begin AXIS_DESCR COM_AXIS n _CNV_A_R_LINEAR_____5_CM 1 0. 6375. FORMAT "%4.0" AXIS_PTS_REF ldp_n_ip_soi_main2_dif_amp /end AXIS_DESCR
 /begin AXIS_DESCR COM_AXIS tqi_sp _CNV_A_R_LINEAR_____86_CM 1 -1024. 1023.96875 FORMAT "%6.2" AXIS_PTS_REF ldp_tqi_sp_ip_soi_main2_dif_amp /end AXIS_DESCR
/end CHARACTERISTIC
/begin AXIS_PTS ldp_n_ip_soi_main2_dif_amp "ambient pressure temperature correction of SOI for main2 injection" 0x841d98 n _REC_AXS_20_u2 6375. _CNV_A_R_LINEAR_____5_CM 1 0. 6375. FORMAT "%4.0" /end AXIS_PTS
/begin AXIS_PTS ldp_tqi_sp_ip_soi_main2_dif_amp "ambient pressure temperature correction of SOI for main2 injection" 0x84291a tqi_sp _REC_AXS_20_u2 2047.96875 _CNV_A_R_LINEAR_____86_CM 1 -1024. 1023.96875 FORMAT "%6.2" /end AXIS_PTS
/begin CHARACTERISTIC ip_soi_main2_dif_tgas "TGAS correction of SOI MAIN2" MAP 0x859f86 _REC_MAP_20_u2_u2_u2 720. _CNV_A_R_LINEAR_____400_CM -360. 360. DISPLAY_IDENTIFIER IP_SOI_MAIN2_DIF_TGAS FORMAT "%5.2"
 /begin AXIS_DESCR COM_AXIS n _CNV_A_R_LINEAR_____5_CM 1 0. 6375. FORMAT "%4.0" AXIS_PTS_REF ldp_n_ip_soi_main2_dif_tgas /end AXIS_DESCR
 /begin AXIS_DESCR COM_AXIS tqi_sp _CNV_A_R_LINEAR_____86_CM 1 -1024. 1023.96875 FORMAT "%6.2" AXIS_PTS_REF ldp_tqi_sp_ip_soi_main2_dif_tgas /end AXIS_DESCR
/end CHARACTERISTIC
/begin AXIS_PTS ldp_n_ip_soi_main2_dif_tgas "air temperature correction of SOI for main2 injection" 0x841d9c n _REC_AXS_20_u2 6375. _CNV_A_R_LINEAR_____5_CM 1 0. 6375. FORMAT "%4.0" /end AXIS_PTS
/begin AXIS_PTS ldp_tqi_sp_ip_soi_main2_dif_tgas "air temperature correction of SOI for main2 injection" 0x84291e tqi_sp _REC_AXS_20_u2 2047.96875 _CNV_A_R_LINEAR_____86_CM 1 -1024. 1023.96875 FORMAT "%6.2" /end AXIS_PTS
/begin CHARACTERISTIC ip_fac_soi_post1_cor_amp "amp correction factor for SOI of minor injection POST1" CURVE 0x852976 _REC_CUR_20_u2_u2 0.9999847412109381 _CNV_A_R_LINEAR_____14_CM 0. 0.9999847412109381 DISPLAY_IDENTIFIER IP_FAC_SOI_POST1_COR_AMP FORMAT "%6.5"
 /begin AXIS_DESCR COM_AXIS amp _CNV_A_R_LINEAR_____45_CM 8 0. 5434. FORMAT "%6.2" AXIS_PTS_REF ldp_amp_ip_fac_soi_post1_cor /end AXIS_DESCR
/end CHARACTERISTIC
/begin AXIS_PTS ldp_amp_ip_fac_soi_post1_cor "amp correction factor for SOI of post1 injection" 0x84129c amp _REC_AXS_20_u2 5434. _CNV_A_R_LINEAR_____45_CM 8 0. 5434. FORMAT "%6.2" /end AXIS_PTS
/begin CHARACTERISTIC ip_fac_soi_post1_cor_tgas "TGAS correction factor for SOI POST1" CURVE 0x852996 _REC_CUR_20_u2_u1 0.9999847412109381 _CNV_A_R_LINEAR_____14_CM 0. 0.9999847412109381 DISPLAY_IDENTIFIER IP_FAC_SOI_POST1_COR_TGAS FORMAT "%6.5"
 /begin AXIS_DESCR COM_AXIS tgas _CNV_A_R_LINEAR_____18_CM 8 -50. 205. FORMAT "%3.0" AXIS_PTS_REF ldp_tgas_ip_fac_soi_post1_cor /end AXIS_DESCR
/end CHARACTERISTIC
/begin AXIS_PTS ldp_tgas_ip_fac_soi_post1_cor "SOI correction dependent on TGAS for post1 injection" 0x84253c tgas _REC_AXS_20_u1 255. _CNV_A_R_LINEAR_____18_CM 8 -50. 205. FORMAT "%3.0" /end AXIS_PTS
/begin CHARACTERISTIC ip_fac_soi_post1_cor_tco "start of POST1 injection interpolation dependent on TCO" CURVE 0x852986 _REC_CUR_20_u2_u1 1.9999696 _CNV_A_R_LINEAR_____48_CM 0. 1.9999696 DISPLAY_IDENTIFIER IP_FAC_SOI_POST1_COR_TCO FORMAT "%6.5"
 /begin AXIS_DESCR COM_AXIS tco _CNV_A_R_LINEAR_____18_CM 8 -50. 205. FORMAT "%3.0" AXIS_PTS_REF ldp_tco_ip_fac_soi_post1_cor /end AXIS_DESCR
/end CHARACTERISTIC
/begin AXIS_PTS ldp_tco_ip_fac_soi_post1_cor "start of injection post1 interpolation dependent on TCO" 0x842303 tco _REC_AXS_20_u1 255. _CNV_A_R_LINEAR_____18_CM 8 -50. 205. FORMAT "%3.0" /end AXIS_PTS
/begin AXIS_PTS ldpm_n_1_ip_soi_post1_dif "basic SOI of post1 injection at warm conditions" 0x842e78 n _REC_AXS_20_u2 6375. _CNV_A_R_LINEAR_____5_CM 16 0. 6375. FORMAT "%4.0" /end AXIS_PTS
/begin AXIS_PTS ldpm_tqi_sp_1_ip_soi_post1_dif "basic SOI of post1 injection at warm conditions" 0x843c68 tqi_sp _REC_AXS_20_u2 2047.96875 _CNV_A_R_LINEAR_____86_CM 16 -1024. 1023.96875 FORMAT "%6.2" /end AXIS_PTS
/begin CHARACTERISTIC ip_soi_post1_dif_amp "AMP correction of SOI POST1" MAP 0x85a5a8 _REC_MAP_20_u2_u2_u2 720. _CNV_A_R_LINEAR_____400_CM -360. 360. DISPLAY_IDENTIFIER IP_SOI_POST1_DIF_AMP FORMAT "%5.2"
 /begin AXIS_DESCR COM_AXIS n _CNV_A_R_LINEAR_____5_CM 8 0. 6375. FORMAT "%4.0" AXIS_PTS_REF ldp_n_ip_soi_post1_dif_amp /end AXIS_DESCR
 /begin AXIS_DESCR COM_AXIS tqi_sp _CNV_A_R_LINEAR_____86_CM 8 -1024. 1023.96875 FORMAT "%6.2" AXIS_PTS_REF ldp_tqi_sp_ip_soi_post1_dif_amp /end AXIS_DESCR
/end CHARACTERISTIC
/begin AXIS_PTS ldp_n_ip_soi_post1_dif_amp "ambient pressure temperature correction of SOI for post1 injection" 0x841dc2 n _REC_AXS_20_u2 6375. _CNV_A_R_LINEAR_____5_CM 8 0. 6375. FORMAT "%4.0" /end AXIS_PTS
/begin AXIS_PTS ldp_tqi_sp_ip_soi_post1_dif_amp "ambient pressure temperature correction of SOI for post1 injection" 0x842922 tqi_sp _REC_AXS_20_u2 2047.96875 _CNV_A_R_LINEAR_____86_CM 8 -1024. 1023.96875 FORMAT "%6.2" /end AXIS_PTS
/begin CHARACTERISTIC ip_soi_post1_dif_tgas "TGAS correction of SOI POST1" MAP 0x85a700 _REC_MAP_20_u2_u2_u2 720. _CNV_A_R_LINEAR_____400_CM -360. 360. DISPLAY_IDENTIFIER IP_SOI_POST1_DIF_TGAS FORMAT "%5.2"
 /begin AXIS_DESCR COM_AXIS n _CNV_A_R_LINEAR_____5_CM 8 0. 6375. FORMAT "%4.0" AXIS_PTS_REF ldp_n_ip_soi_post1_dif_tgas /end AXIS_DESCR
 /begin AXIS_DESCR COM_AXIS tqi_sp _CNV_A_R_LINEAR_____86_CM 8 -1024. 1023.96875 FORMAT "%6.2" AXIS_PTS_REF ldp_tqi_sp_ip_soi_post1_dif_tgas /end AXIS_DESCR
/end CHARACTERISTIC
/begin AXIS_PTS ldp_n_ip_soi_post1_dif_tgas "air temperature correction of SOI for post1 injection" 0x841dd4 n _REC_AXS_20_u2 6375. _CNV_A_R_LINEAR_____5_CM 8 0. 6375. FORMAT "%4.0" /end AXIS_PTS
/begin AXIS_PTS ldp_tqi_sp_ip_soi_post1_dif_tgas "air temperature correction of SOI for post1 injection" 0x842934 tqi_sp _REC_AXS_20_u2 2047.96875 _CNV_A_R_LINEAR_____86_CM 8 -1024. 1023.96875 FORMAT "%6.2" /end AXIS_PTS
/begin MEASUREMENT soi_main2_dif_is_pl_rgl "distance between MAIN2 and MAIN1 at IS/PL and regular conditions" UWORD _CNV_A_R_LINEAR_____119_CM 1 0. 0. 360. DISPLAY_IDENTIFIER SOI_MAIN2_DIF_IS_PL_RGL ECU_ADDRESS 0x7fa04c BYTE_ORDER MSB_LAST FORMAT "%5.2" /end MEASUREMENT
/begin MEASUREMENT soi_prev2_dif_is_pl_rgl "distance between MAIN1 and PREV2 at IS/PL and regular conditions" UWORD _CNV_A_R_LINEAR_____119_CM 1 0. 0. 360. DISPLAY_IDENTIFIER SOI_PREV2_DIF_IS_PL_RGL ECU_ADDRESS 0x7fa04a BYTE_ORDER MSB_LAST FORMAT "%5.2" /end MEASUREMENT
/begin MEASUREMENT soi_prev1_dif_is_pl_rgl "distance between MAIN1 and PREV1 at IS/PL and regular conditions" UWORD _CNV_A_R_LINEAR_____119_CM 1 0. 0. 360. DISPLAY_IDENTIFIER SOI_PREV1_DIF_IS_PL_RGL ECU_ADDRESS 0x7fa048 BYTE_ORDER MSB_LAST FORMAT "%5.2" /end MEASUREMENT
/begin MEASUREMENT soi_post1_dif_is_pl_rgl "distance between POST1 and MAIN2 at IS/PL and regular conditions" UWORD _CNV_A_R_LINEAR_____119_CM 1 0. 0. 360. DISPLAY_IDENTIFIER SOI_POST1_DIF_IS_PL_RGL ECU_ADDRESS 0x7fa04e BYTE_ORDER MSB_LAST FORMAT "%5.2" /end MEASUREMENT
/begin MEASUREMENT soi_post1_dif_cor_rgl "sum of SOI corrections on the distance POST1-MAIN1 at IS/PL" UWORD _CNV_A_R_LINEAR_____118_CM 1 0. -120. 240. DISPLAY_IDENTIFIER SOI_POST1_DIF_COR_RGL ECU_ADDRESS 0x7fa056 BYTE_ORDER MSB_LAST FORMAT "%5.2" /end MEASUREMENT
/begin MEASUREMENT soi_prev1_dif_cor_rgl "sum of SOI corrections on the distance PREV1-MAIN1 at IS/PL" UWORD _CNV_A_R_LINEAR_____118_CM 1 0. -120. 240. DISPLAY_IDENTIFIER SOI_PREV1_DIF_COR_RGL ECU_ADDRESS 0x7fa050 BYTE_ORDER MSB_LAST FORMAT "%5.2" /end MEASUREMENT
/begin MEASUREMENT soi_prev2_dif_cor_rgl "sum of SOI corrections on the distance PREV2-MAIN1 at IS/PL" UWORD _CNV_A_R_LINEAR_____118_CM 1 0. -120. 240. DISPLAY_IDENTIFIER SOI_PREV2_DIF_COR_RGL ECU_ADDRESS 0x7fa052 BYTE_ORDER MSB_LAST FORMAT "%5.2" /end MEASUREMENT
/begin MEASUREMENT soi_main2_dif_cor_rgl "sum of SOI corrections on the distance MAIN2-MAIN1 at IS/PL" UWORD _CNV_A_R_LINEAR_____118_CM 1 0. -120. 240. DISPLAY_IDENTIFIER SOI_MAIN2_DIF_COR_RGL ECU_ADDRESS 0x7fa054 BYTE_ORDER MSB_LAST FORMAT "%5.2" /end MEASUREMENT
/begin CHARACTERISTIC ip_soi_main2_dif_0_0 "basic SOI of minor injection MAIN2 at temperature level 0" MAP 0x859f7a _REC_MAP_20_u2_u2_u2 360. _CNV_A_R_LINEAR_____119_CM 0. 360. DISPLAY_IDENTIFIER IP_SOI_MAIN2_DIF_0_0 FORMAT "%5.2"
 /begin AXIS_DESCR COM_AXIS n _CNV_A_R_LINEAR_____5_CM 1 0. 6375. FORMAT "%4.0" AXIS_PTS_REF ldpm_n_1_ip_soi_main2_dif /end AXIS_DESCR
 /begin AXIS_DESCR COM_AXIS tqi_sp _CNV_A_R_LINEAR_____86_CM 1 -1024. 1023.96875 FORMAT "%6.2" AXIS_PTS_REF ldpm_tqi_sp_1_ip_soi_main2_dif /end AXIS_DESCR
/end CHARACTERISTIC
/begin CHARACTERISTIC ip_soi_main2_dif_0_2 "basic SOI of minor injection MAIN2 at temperature level 2" MAP 0x859f7e _REC_MAP_20_u2_u2_u2 360. _CNV_A_R_LINEAR_____119_CM 0. 360. DISPLAY_IDENTIFIER IP_SOI_MAIN2_DIF_0_2 FORMAT "%5.2"
 /begin AXIS_DESCR COM_AXIS n _CNV_A_R_LINEAR_____5_CM 1 0. 6375. FORMAT "%4.0" AXIS_PTS_REF ldpm_n_1_ip_soi_main2_dif /end AXIS_DESCR
 /begin AXIS_DESCR COM_AXIS tqi_sp _CNV_A_R_LINEAR_____86_CM 1 -1024. 1023.96875 FORMAT "%6.2" AXIS_PTS_REF ldpm_tqi_sp_1_ip_soi_main2_dif /end AXIS_DESCR
/end CHARACTERISTIC
/begin CHARACTERISTIC ip_soi_main2_dif_0_1 "basic SOI of minor injection MAIN2 at temperature level 1" MAP 0x859f7c _REC_MAP_20_u2_u2_u2 360. _CNV_A_R_LINEAR_____119_CM 0. 360. DISPLAY_IDENTIFIER IP_SOI_MAIN2_DIF_0_1 FORMAT "%5.2"
 /begin AXIS_DESCR COM_AXIS n _CNV_A_R_LINEAR_____5_CM 1 0. 6375. FORMAT "%4.0" AXIS_PTS_REF ldpm_n_1_ip_soi_main2_dif /end AXIS_DESCR
 /begin AXIS_DESCR COM_AXIS tqi_sp _CNV_A_R_LINEAR_____86_CM 1 -1024. 1023.96875 FORMAT "%6.2" AXIS_PTS_REF ldpm_tqi_sp_1_ip_soi_main2_dif /end AXIS_DESCR
/end CHARACTERISTIC
/begin CHARACTERISTIC ip_soi_post1_dif_0_0 "basic SOI of minor injection POST1 at temperature level 0" MAP 0x859fa8 _REC_MAP_20_u2_u2_u2 360. _CNV_A_R_LINEAR_____119_CM 0. 360. DISPLAY_IDENTIFIER IP_SOI_POST1_DIF_0_0 FORMAT "%5.2"
 /begin AXIS_DESCR COM_AXIS n _CNV_A_R_LINEAR_____5_CM 16 0. 6375. FORMAT "%4.0" AXIS_PTS_REF ldpm_n_1_ip_soi_post1_dif /end AXIS_DESCR
 /begin AXIS_DESCR COM_AXIS tqi_sp _CNV_A_R_LINEAR_____86_CM 16 -1024. 1023.96875 FORMAT "%6.2" AXIS_PTS_REF ldpm_tqi_sp_1_ip_soi_post1_dif /end AXIS_DESCR
/end CHARACTERISTIC
/begin CHARACTERISTIC ip_soi_post1_dif_0_2 "basic SOI of minor injection POST1 at temperature level 2" MAP 0x85a3a8 _REC_MAP_20_u2_u2_u2 360. _CNV_A_R_LINEAR_____119_CM 0. 360. DISPLAY_IDENTIFIER IP_SOI_POST1_DIF_0_2 FORMAT "%5.2"
 /begin AXIS_DESCR COM_AXIS n _CNV_A_R_LINEAR_____5_CM 16 0. 6375. FORMAT "%4.0" AXIS_PTS_REF ldpm_n_1_ip_soi_post1_dif /end AXIS_DESCR
 /begin AXIS_DESCR COM_AXIS tqi_sp _CNV_A_R_LINEAR_____86_CM 16 -1024. 1023.96875 FORMAT "%6.2" AXIS_PTS_REF ldpm_tqi_sp_1_ip_soi_post1_dif /end AXIS_DESCR
/end CHARACTERISTIC
/begin CHARACTERISTIC ip_soi_post1_dif_0_1 "basic SOI of minor injection POST1 at temperature level 1" MAP 0x85a1a8 _REC_MAP_20_u2_u2_u2 360. _CNV_A_R_LINEAR_____119_CM 0. 360. DISPLAY_IDENTIFIER IP_SOI_POST1_DIF_0_1 FORMAT "%5.2"
 /begin AXIS_DESCR COM_AXIS n _CNV_A_R_LINEAR_____5_CM 16 0. 6375. FORMAT "%4.0" AXIS_PTS_REF ldpm_n_1_ip_soi_post1_dif /end AXIS_DESCR
 /begin AXIS_DESCR COM_AXIS tqi_sp _CNV_A_R_LINEAR_____86_CM 16 -1024. 1023.96875 FORMAT "%6.2" AXIS_PTS_REF ldpm_tqi_sp_1_ip_soi_post1_dif /end AXIS_DESCR
/end CHARACTERISTIC
/begin CHARACTERISTIC ip_soi_prev1_dif_0_2 "basic SOI of minor injection PREV1 at temperature level 2" MAP 0x85ab8c _REC_MAP_20_u2_u2_u2 360. _CNV_A_R_LINEAR_____119_CM 0. 360. DISPLAY_IDENTIFIER IP_SOI_PREV1_DIF_0_2 FORMAT "%5.2"
 /begin AXIS_DESCR COM_AXIS n _CNV_A_R_LINEAR_____5_CM 16 0. 6375. FORMAT "%4.0" AXIS_PTS_REF ldpm_n_1_ip_soi_prev1_dif /end AXIS_DESCR
 /begin AXIS_DESCR COM_AXIS tqi_sp _CNV_A_R_LINEAR_____86_CM 16 -1024. 1023.96875 FORMAT "%6.2" AXIS_PTS_REF ldpm_tqi_sp_1_ip_soi_prev1_dif /end AXIS_DESCR
/end CHARACTERISTIC
/begin CHARACTERISTIC ip_soi_prev1_dif_0_0 "basic SOI of minor injection PREV1 at temperature level 0" MAP 0x85a78c _REC_MAP_20_u2_u2_u2 360. _CNV_A_R_LINEAR_____119_CM 0. 360. DISPLAY_IDENTIFIER IP_SOI_PREV1_DIF_0_0 FORMAT "%5.2"
 /begin AXIS_DESCR COM_AXIS n _CNV_A_R_LINEAR_____5_CM 16 0. 6375. FORMAT "%4.0" AXIS_PTS_REF ldpm_n_1_ip_soi_prev1_dif /end AXIS_DESCR
 /begin AXIS_DESCR COM_AXIS tqi_sp _CNV_A_R_LINEAR_____86_CM 16 -1024. 1023.96875 FORMAT "%6.2" AXIS_PTS_REF ldpm_tqi_sp_1_ip_soi_prev1_dif /end AXIS_DESCR
/end CHARACTERISTIC
/begin CHARACTERISTIC ip_soi_prev1_dif_0_1 "basic SOI of minor injection PREV1 at temperature level 1" MAP 0x85a98c _REC_MAP_20_u2_u2_u2 360. _CNV_A_R_LINEAR_____119_CM 0. 360. DISPLAY_IDENTIFIER IP_SOI_PREV1_DIF_0_1 FORMAT "%5.2"
 /begin AXIS_DESCR COM_AXIS n _CNV_A_R_LINEAR_____5_CM 16 0. 6375. FORMAT "%4.0" AXIS_PTS_REF ldpm_n_1_ip_soi_prev1_dif /end AXIS_DESCR
 /begin AXIS_DESCR COM_AXIS tqi_sp _CNV_A_R_LINEAR_____86_CM 16 -1024. 1023.96875 FORMAT "%6.2" AXIS_PTS_REF ldpm_tqi_sp_1_ip_soi_prev1_dif /end AXIS_DESCR
/end CHARACTERISTIC
/begin CHARACTERISTIC ip_soi_prev2_dif_0_0 "basic SOI of minor injection PREV2 at temperature level 0" MAP 0x85af64 _REC_MAP_20_u2_u2_u2 360. _CNV_A_R_LINEAR_____119_CM 0. 360. DISPLAY_IDENTIFIER IP_SOI_PREV2_DIF_0_0 FORMAT "%5.2"
 /begin AXIS_DESCR COM_AXIS n _CNV_A_R_LINEAR_____5_CM 1 0. 6375. FORMAT "%4.0" AXIS_PTS_REF ldpm_n_1_ip_soi_prev2_dif /end AXIS_DESCR
 /begin AXIS_DESCR COM_AXIS tqi_sp _CNV_A_R_LINEAR_____86_CM 1 -1024. 1023.96875 FORMAT "%6.2" AXIS_PTS_REF ldpm_tqi_sp_1_ip_soi_prev2_dif /end AXIS_DESCR
/end CHARACTERISTIC
/begin CHARACTERISTIC ip_soi_prev2_dif_0_2 "basic SOI of minor injection PREV2 at temperature level 2" MAP 0x85af68 _REC_MAP_20_u2_u2_u2 360. _CNV_A_R_LINEAR_____119_CM 0. 360. DISPLAY_IDENTIFIER IP_SOI_PREV2_DIF_0_2 FORMAT "%5.2"
 /begin AXIS_DESCR COM_AXIS n _CNV_A_R_LINEAR_____5_CM 1 0. 6375. FORMAT "%4.0" AXIS_PTS_REF ldpm_n_1_ip_soi_prev2_dif /end AXIS_DESCR
 /begin AXIS_DESCR COM_AXIS tqi_sp _CNV_A_R_LINEAR_____86_CM 1 -1024. 1023.96875 FORMAT "%6.2" AXIS_PTS_REF ldpm_tqi_sp_1_ip_soi_prev2_dif /end AXIS_DESCR
/end CHARACTERISTIC
/begin CHARACTERISTIC ip_soi_prev2_dif_0_1 "basic SOI of minor injection PREV2 at temperature level 1" MAP 0x85af66 _REC_MAP_20_u2_u2_u2 360. _CNV_A_R_LINEAR_____119_CM 0. 360. DISPLAY_IDENTIFIER IP_SOI_PREV2_DIF_0_1 FORMAT "%5.2"
 /begin AXIS_DESCR COM_AXIS n _CNV_A_R_LINEAR_____5_CM 1 0. 6375. FORMAT "%4.0" AXIS_PTS_REF ldpm_n_1_ip_soi_prev2_dif /end AXIS_DESCR
 /begin AXIS_DESCR COM_AXIS tqi_sp _CNV_A_R_LINEAR_____86_CM 1 -1024. 1023.96875 FORMAT "%6.2" AXIS_PTS_REF ldpm_tqi_sp_1_ip_soi_prev2_dif /end AXIS_DESCR
/end CHARACTERISTIC
/begin MEASUREMENT lv_soi_prev1_act_st "activation of SOI PREV1 calculation at ST" UBYTE _CNV_A_R_LINEAR_____0_CM 1 0. 0. 1. DISPLAY_IDENTIFIER LV_SOI_PREV1_ACT_ST ECU_ADDRESS 0x7fbb0d FORMAT "%1.0" /end MEASUREMENT
/begin MEASUREMENT lv_soi_prev2_act_st "activation of SOI PREV2 calculation at ST" UBYTE _CNV_A_R_LINEAR_____0_CM 1 0. 0. 1. DISPLAY_IDENTIFIER LV_SOI_PREV2_ACT_ST ECU_ADDRESS 0x7fbb0e FORMAT "%1.0" /end MEASUREMENT
/begin MEASUREMENT lv_soi_main2_act_is_pl "activation of SOI MAIN2 calculation at IS/PL" UBYTE _CNV_A_R_LINEAR_____0_CM 1 0. 0. 1. DISPLAY_IDENTIFIER LV_SOI_MAIN2_ACT_IS_PL ECU_ADDRESS 0x7fbb11 FORMAT "%1.0" /end MEASUREMENT
/begin MEASUREMENT lv_soi_prev1_act_is_pl "activation of SOI PREV1 calculation at IS/PL" UBYTE _CNV_A_R_LINEAR_____0_CM 1 0. 0. 1. DISPLAY_IDENTIFIER LV_SOI_PREV1_ACT_IS_PL ECU_ADDRESS 0x7fbb12 FORMAT "%1.0" /end MEASUREMENT
/begin MEASUREMENT lv_soi_prev2_act_is_pl "activation of SOI PREV2 calculation at IS/PL" UBYTE _CNV_A_R_LINEAR_____0_CM 1 0. 0. 1. DISPLAY_IDENTIFIER LV_SOI_PREV2_ACT_IS_PL ECU_ADDRESS 0x7fbb13 FORMAT "%1.0" /end MEASUREMENT
/begin MEASUREMENT lv_soi_post1_act_is_pl "activation of SOI POST1 calculation at IS/PL" UBYTE _CNV_A_R_LINEAR_____0_CM 1 0. 0. 1. DISPLAY_IDENTIFIER LV_SOI_POST1_ACT_IS_PL ECU_ADDRESS 0x7fbb14 FORMAT "%1.0" /end MEASUREMENT
/begin MEASUREMENT lv_soi_post1_act_st "activation of SOI POST1 calculation at ST" UBYTE _CNV_A_R_LINEAR_____0_CM 1 0. 0. 1. DISPLAY_IDENTIFIER LV_SOI_POST1_ACT_ST ECU_ADDRESS 0x7fbb10 FORMAT "%1.0" /end MEASUREMENT
/begin MEASUREMENT lv_soi_main2_act_st "activation of SOI MAIN2 calculation at ST" UBYTE _CNV_A_R_LINEAR_____0_CM 1 0. 0. 1. DISPLAY_IDENTIFIER LV_SOI_MAIN2_ACT_ST ECU_ADDRESS 0x7fbb0f FORMAT "%1.0" /end MEASUREMENT
/begin MEASUREMENT lv_conf_inj_ges "flag indicating the injection configuration for the gas exchange system" UBYTE _CNV_A_R_LINEAR_____0_CM 1 0. 0. 1. DISPLAY_IDENTIFIER LV_CONF_INJ_GES ECU_ADDRESS 0x7fbb0c FORMAT "%1.0" /end MEASUREMENT
/begin MEASUREMENT sf_conf_inj_soi_rgl "injection configuration region at regular conditions" UBYTE _CNV_A_R_LINEAR_____0_CM 1 0. 0. 4. DISPLAY_IDENTIFIER SF_CONF_INJ_SOI_RGL ECU_ADDRESS 0x7fbb09 FORMAT "%1.0" /end MEASUREMENT
/begin MEASUREMENT sf_conf_inj_soi_rgn_1 "injection configuration region at rgn level 1" UBYTE _CNV_A_R_LINEAR_____0_CM 1 0. 0. 4. DISPLAY_IDENTIFIER SF_CONF_INJ_SOI_RGN_1 ECU_ADDRESS 0x7fbb0a FORMAT "%1.0" /end MEASUREMENT
/begin MEASUREMENT sf_conf_inj_soi_rgn_2 "injection configuration region at rgn level 2" UBYTE _CNV_A_R_LINEAR_____0_CM 1 0. 0. 4. DISPLAY_IDENTIFIER SF_CONF_INJ_SOI_RGN_2 ECU_ADDRESS 0x7fbb0b FORMAT "%1.0" /end MEASUREMENT
/begin CHARACTERISTIC id_conf_inj_ges "SOI: Injection Region for Gas Exchange System" CURVE 0x8502a6 _REC_CUR_20_u1_u1 1. _CNV_A_R_LINEAR_____0_CM 0. 1. DISPLAY_IDENTIFIER ID_CONF_INJ_GES FORMAT "%1.0"
 /begin AXIS_DESCR COM_AXIS act_inj_coded _CNV_A_R_LINEAR_____0_CM 16 0. 15. FORMAT "%2.0" AXIS_PTS_REF ldpm_sf_conf_inj /end AXIS_DESCR
/end CHARACTERISTIC
/begin MEASUREMENT soi_prev1_is_pl_rgn_1 "Start of injection PREV1 during IS/PL at rgn level 1" UWORD _CNV_A_R_LINEAR_____119_CM 1 0. 0. 360. DISPLAY_IDENTIFIER SOI_PREV1_IS_PL_RGN_1 ECU_ADDRESS 0x7fa068 BYTE_ORDER MSB_LAST FORMAT "%5.2" /end MEASUREMENT
/begin MEASUREMENT soi_main2_is_pl_rgn_1 "Start of injection MAIN2 during IS/PL at rgn level 1" UWORD _CNV_A_R_LINEAR_____119_CM 1 0. 0. 360. DISPLAY_IDENTIFIER SOI_MAIN2_IS_PL_RGN_1 ECU_ADDRESS 0x7fa06a BYTE_ORDER MSB_LAST FORMAT "%5.2" /end MEASUREMENT
/begin MEASUREMENT soi_post1_is_pl_rgn_1 "Start of injection POST1 during IS/PL at rgn level 1" UWORD _CNV_A_R_LINEAR_____119_CM 1 0. 0. 360. DISPLAY_IDENTIFIER SOI_POST1_IS_PL_RGN_1 ECU_ADDRESS 0x7fa06c BYTE_ORDER MSB_LAST FORMAT "%5.2" /end MEASUREMENT
/begin MEASUREMENT soi_prev2_is_pl_rgn_1 "Start of Injection PREV2 at IS/PL during rgn level 1" UWORD _CNV_A_R_LINEAR_____119_CM 1 0. 0. 360. DISPLAY_IDENTIFIER SOI_PREV2_IS_PL_RGN_1 ECU_ADDRESS 0x7fa06e BYTE_ORDER MSB_LAST FORMAT "%5.2" /end MEASUREMENT
/begin MEASUREMENT soi_prev2_is_pl_rgn_2 "Start of Injection PREV2 at IS/PL during rgn level 2" UWORD _CNV_A_R_LINEAR_____119_CM 1 0. 0. 360. DISPLAY_IDENTIFIER SOI_PREV2_IS_PL_RGN_2 ECU_ADDRESS 0x7fa070 BYTE_ORDER MSB_LAST FORMAT "%5.2" /end MEASUREMENT
/begin MEASUREMENT soi_main2_is_pl_rgn_2 "Start of Injection MAIN2 at IS/PL durin rgn level 2" UWORD _CNV_A_R_LINEAR_____119_CM 1 0. 0. 360. DISPLAY_IDENTIFIER SOI_MAIN2_IS_PL_RGN_2 ECU_ADDRESS 0x7fa072 BYTE_ORDER MSB_LAST FORMAT "%5.2" /end MEASUREMENT
/begin MEASUREMENT soi_post1_is_pl_rgn_2 "Start of Injection POST1 at IS/PL durin rgn level 2" UWORD _CNV_A_R_LINEAR_____119_CM 1 0. 0. 360. DISPLAY_IDENTIFIER SOI_POST1_IS_PL_RGN_2 ECU_ADDRESS 0x7fa074 BYTE_ORDER MSB_LAST FORMAT "%5.2" /end MEASUREMENT
/begin MEASUREMENT soi_prev1_is_pl_rgn_2 "Start of Injection PREV2 at IS/PL during rgn level 2" UWORD _CNV_A_R_LINEAR_____119_CM 1 0. 0. 360. DISPLAY_IDENTIFIER SOI_PREV1_IS_PL_RGN_2 ECU_ADDRESS 0x7fa076 BYTE_ORDER MSB_LAST FORMAT "%5.2" /end MEASUREMENT
/begin CHARACTERISTIC ip_fac_soi_prev1_cor_amp_rgn_1 "ASOI_MAIN_RGN: Amp correction factor for SOI prev1 minor injection during regeneration 1" CURVE 0x8483c0 _REC_CUR_20_u2_u2 0.9999874 _CNV_A_R_LINEAR_____87_CM 0. 0.9999874 DISPLAY_IDENTIFIER IP_FAC_SOI_PREV1_COR_AMP_RGN_1 FORMAT "%6.5"
 /begin AXIS_DESCR COM_AXIS amp _CNV_A_R_LINEAR_____45_CM 2 0. 5434. FORMAT "%6.2" AXIS_PTS_REF ldp_amp_ip_fac_soi_prev1_cor_rgn_1 /end AXIS_DESCR
/end CHARACTERISTIC
/begin CHARACTERISTIC ip_fac_soi_main2_cor_amp_rgn_1 "ASOI_MAIN_RGN: Amp correction factor for SOI main2 minor injection during regeneration 1" CURVE 0x8483b0 _REC_CUR_20_u2_u2 0.9999874 _CNV_A_R_LINEAR_____87_CM 0. 0.9999874 DISPLAY_IDENTIFIER IP_FAC_SOI_MAIN2_COR_AMP_RGN_1 FORMAT "%6.5"
 /begin AXIS_DESCR COM_AXIS amp _CNV_A_R_LINEAR_____45_CM 2 0. 5434. FORMAT "%6.2" AXIS_PTS_REF ldp_amp_ip_fac_soi_main2_cor_rgn_1 /end AXIS_DESCR
/end CHARACTERISTIC
/begin CHARACTERISTIC ip_fac_soi_post1_cor_amp_rgn_1 "ASOI_MAIN_RGN: Amp correction factor for SOI post1 minor injection during regeneration 1" CURVE 0x8483b8 _REC_CUR_20_u2_u2 0.9999874 _CNV_A_R_LINEAR_____87_CM 0. 0.9999874 DISPLAY_IDENTIFIER IP_FAC_SOI_POST1_COR_AMP_RGN_1 FORMAT "%6.5"
 /begin AXIS_DESCR COM_AXIS amp _CNV_A_R_LINEAR_____45_CM 2 0. 5434. FORMAT "%6.2" AXIS_PTS_REF ldp_amp_ip_fac_soi_post1_cor_rgn_1 /end AXIS_DESCR
/end CHARACTERISTIC
/begin CHARACTERISTIC ip_fac_soi_prev2_cor_amp_rgn_1 "ASOI_MAIN_RGN: Amp correction factor for SOI prev2 minor injection during regeneration 1" CURVE 0x8483c8 _REC_CUR_20_u2_u2 0.9999874 _CNV_A_R_LINEAR_____87_CM 0. 0.9999874 DISPLAY_IDENTIFIER IP_FAC_SOI_PREV2_COR_AMP_RGN_1 FORMAT "%6.5"
 /begin AXIS_DESCR COM_AXIS amp _CNV_A_R_LINEAR_____45_CM 2 0. 5434. FORMAT "%6.2" AXIS_PTS_REF ldp_amp_ip_fac_soi_prev2_cor_rgn_1 /end AXIS_DESCR
/end CHARACTERISTIC
/begin AXIS_PTS ldp_amp_ip_fac_soi_prev1_cor_rgn_1 "" 0x8412cc amp _REC_AXS_20_u2 5434. _CNV_A_R_LINEAR_____45_CM 2 0. 5434. FORMAT "%6.2" /end AXIS_PTS
/begin AXIS_PTS ldp_amp_ip_fac_soi_main2_cor_rgn_1 "" 0x841290 amp _REC_AXS_20_u2 5434. _CNV_A_R_LINEAR_____45_CM 2 0. 5434. FORMAT "%6.2" /end AXIS_PTS
/begin AXIS_PTS ldp_amp_ip_fac_soi_post1_cor_rgn_1 "" 0x8412ae amp _REC_AXS_20_u2 5434. _CNV_A_R_LINEAR_____45_CM 2 0. 5434. FORMAT "%6.2" /end AXIS_PTS
/begin AXIS_PTS ldp_amp_ip_fac_soi_prev2_cor_rgn_1 "" 0x8412dc amp _REC_AXS_20_u2 5434. _CNV_A_R_LINEAR_____45_CM 2 0. 5434. FORMAT "%6.2" /end AXIS_PTS
/begin CHARACTERISTIC ip_fac_soi_prev1_cor_amp_rgn_2 "ASOI_MAIN_RGN: Amp correction factor for SOI prev1 minor injection during regeneration 2" CURVE 0x8483c4 _REC_CUR_20_u2_u2 0.9999874 _CNV_A_R_LINEAR_____87_CM 0. 0.9999874 DISPLAY_IDENTIFIER IP_FAC_SOI_PREV1_COR_AMP_RGN_2 FORMAT "%6.5"
 /begin AXIS_DESCR COM_AXIS amp _CNV_A_R_LINEAR_____45_CM 2 0. 5434. FORMAT "%6.2" AXIS_PTS_REF ldp_amp_ip_fac_soi_prev1_cor_rgn_2 /end AXIS_DESCR
/end CHARACTERISTIC
/begin CHARACTERISTIC ip_fac_soi_main2_cor_amp_rgn_2 "ASOI_MAIN_RGN: Amp correction factor for SOI main2 minor injection during regeneration 2" CURVE 0x8483b4 _REC_CUR_20_u2_u2 0.9999874 _CNV_A_R_LINEAR_____87_CM 0. 0.9999874 DISPLAY_IDENTIFIER IP_FAC_SOI_MAIN2_COR_AMP_RGN_2 FORMAT "%6.5"
 /begin AXIS_DESCR COM_AXIS amp _CNV_A_R_LINEAR_____45_CM 2 0. 5434. FORMAT "%6.2" AXIS_PTS_REF ldp_amp_ip_fac_soi_main2_cor_rgn_2 /end AXIS_DESCR
/end CHARACTERISTIC
/begin CHARACTERISTIC ip_fac_soi_post1_cor_amp_rgn_2 "ASOI_MAIN_RGN: Amp correction factor for SOI post1 minor injection during regeneration 2" CURVE 0x8483bc _REC_CUR_20_u2_u2 0.9999874 _CNV_A_R_LINEAR_____87_CM 0. 0.9999874 DISPLAY_IDENTIFIER IP_FAC_SOI_POST1_COR_AMP_RGN_2 FORMAT "%6.5"
 /begin AXIS_DESCR COM_AXIS amp _CNV_A_R_LINEAR_____45_CM 2 0. 5434. FORMAT "%6.2" AXIS_PTS_REF ldp_amp_ip_fac_soi_post1_cor_rgn_2 /end AXIS_DESCR
/end CHARACTERISTIC
/begin CHARACTERISTIC ip_fac_soi_prev2_cor_amp_rgn_2 "ASOI_MAIN_RGN: Amp correction factor for SOI prev2 minor injection during regeneration 2" CURVE 0x8483cc _REC_CUR_20_u2_u2 0.9999874 _CNV_A_R_LINEAR_____87_CM 0. 0.9999874 DISPLAY_IDENTIFIER IP_FAC_SOI_PREV2_COR_AMP_RGN_2 FORMAT "%6.5"
 /begin AXIS_DESCR COM_AXIS amp _CNV_A_R_LINEAR_____45_CM 2 0. 5434. FORMAT "%6.2" AXIS_PTS_REF ldp_amp_ip_fac_soi_prev2_cor_rgn_2 /end AXIS_DESCR
/end CHARACTERISTIC
/begin AXIS_PTS ldp_amp_ip_fac_soi_prev1_cor_rgn_2 "" 0x8412d2 amp _REC_AXS_20_u2 5434. _CNV_A_R_LINEAR_____45_CM 2 0. 5434. FORMAT "%6.2" /end AXIS_PTS
/begin AXIS_PTS ldp_amp_ip_fac_soi_main2_cor_rgn_2 "" 0x841296 amp _REC_AXS_20_u2 5434. _CNV_A_R_LINEAR_____45_CM 2 0. 5434. FORMAT "%6.2" /end AXIS_PTS
/begin AXIS_PTS ldp_amp_ip_fac_soi_post1_cor_rgn_2 "" 0x8412b4 amp _REC_AXS_20_u2 5434. _CNV_A_R_LINEAR_____45_CM 2 0. 5434. FORMAT "%6.2" /end AXIS_PTS
/begin AXIS_PTS ldp_amp_ip_fac_soi_prev2_cor_rgn_2 "" 0x8412e2 amp _REC_AXS_20_u2 5434. _CNV_A_R_LINEAR_____45_CM 2 0. 5434. FORMAT "%6.2" /end AXIS_PTS
/begin CHARACTERISTIC ip_soi_prev1_amp_h_rgn_1 "ASOI_MAIN_RGN: AMP correction (=1) of soi_prev1 during regeneration 1" MAP 0x84e41c _REC_MAP_20_u2_u2_u2 360. _CNV_A_R_LINEAR_____119_CM 0. 360. DISPLAY_IDENTIFIER IP_SOI_PREV1_AMP_H_RGN_1 FORMAT "%5.2"
 /begin AXIS_DESCR COM_AXIS n _CNV_A_R_LINEAR_____5_CM 12 0. 8160. FORMAT "%4.0" AXIS_PTS_REF ldpm_n_ip_soi_prev1_amp_rgn_1 /end AXIS_DESCR
 /begin AXIS_DESCR COM_AXIS tqi_sp _CNV_A_R_LINEAR_____86_CM 12 -1024. 1023.96875 FORMAT "%6.2" AXIS_PTS_REF ldpm_tqi_sp_ip_soi_prev1_amp_rgn_1 /end AXIS_DESCR
/end CHARACTERISTIC
/begin CHARACTERISTIC ip_soi_main2_amp_h_rgn_1 "ASOI_MAIN_RGN: AMP correction (=1) of soi_main2 during regeneration 1" MAP 0x84db1c _REC_MAP_20_u2_u2_u2 360. _CNV_A_R_LINEAR_____119_CM 0. 360. DISPLAY_IDENTIFIER IP_SOI_MAIN2_AMP_H_RGN_1 FORMAT "%5.2"
 /begin AXIS_DESCR COM_AXIS n _CNV_A_R_LINEAR_____5_CM 12 0. 8160. FORMAT "%4.0" AXIS_PTS_REF ldpm_n_ip_soi_main2_amp_rgn_1 /end AXIS_DESCR
 /begin AXIS_DESCR COM_AXIS tqi_sp _CNV_A_R_LINEAR_____86_CM 12 -1024. 1023.96875 FORMAT "%6.2" AXIS_PTS_REF ldpm_tqi_sp_ip_soi_main2_amp_rgn_1 /end AXIS_DESCR
/end CHARACTERISTIC
/begin CHARACTERISTIC ip_soi_post1_amp_h_rgn_1 "ASOI_MAIN_RGN: AMP correction (=1) of soi_post1 during regeneration 1" MAP 0x84df9c _REC_MAP_20_u2_u2_u2 360. _CNV_A_R_LINEAR_____119_CM 0. 360. DISPLAY_IDENTIFIER IP_SOI_POST1_AMP_H_RGN_1 FORMAT "%5.2"
 /begin AXIS_DESCR COM_AXIS n _CNV_A_R_LINEAR_____5_CM 12 0. 8160. FORMAT "%4.0" AXIS_PTS_REF ldpm_n_ip_soi_post1_amp_rgn_1 /end AXIS_DESCR
 /begin AXIS_DESCR COM_AXIS tqi_sp _CNV_A_R_LINEAR_____86_CM 12 -1024. 1023.96875 FORMAT "%6.2" AXIS_PTS_REF ldpm_tqi_sp_ip_soi_post1_amp_rgn_1 /end AXIS_DESCR
/end CHARACTERISTIC
/begin CHARACTERISTIC ip_soi_prev2_amp_h_rgn_1 "ASOI_MAIN_RGN: AMP correction (=1) of soi_prev2 during regeneration 1" MAP 0x84e89c _REC_MAP_20_u2_u2_u2 360. _CNV_A_R_LINEAR_____119_CM 0. 360. DISPLAY_IDENTIFIER IP_SOI_PREV2_AMP_H_RGN_1 FORMAT "%5.2"
 /begin AXIS_DESCR COM_AXIS n _CNV_A_R_LINEAR_____5_CM 12 0. 8160. FORMAT "%4.0" AXIS_PTS_REF ldpm_n_ip_soi_prev2_amp_rgn_1 /end AXIS_DESCR
 /begin AXIS_DESCR COM_AXIS tqi_sp _CNV_A_R_LINEAR_____86_CM 12 -1024. 1023.96875 FORMAT "%6.2" AXIS_PTS_REF ldpm_tqi_sp_ip_soi_prev2_amp_rgn_1 /end AXIS_DESCR
/end CHARACTERISTIC
/begin AXIS_PTS ldpm_n_ip_soi_prev1_amp_rgn_1 "" 0x8434be n _REC_AXS_20_u2 8160. _CNV_A_R_LINEAR_____5_CM 12 0. 8160. FORMAT "%4.0" /end AXIS_PTS
/begin AXIS_PTS ldpm_n_ip_soi_main2_amp_rgn_1 "" 0x843456 n _REC_AXS_20_u2 8160. _CNV_A_R_LINEAR_____5_CM 12 0. 8160. FORMAT "%4.0" /end AXIS_PTS
/begin AXIS_PTS ldpm_n_ip_soi_post1_amp_rgn_1 "" 0x84348a n _REC_AXS_20_u2 8160. _CNV_A_R_LINEAR_____5_CM 12 0. 8160. FORMAT "%4.0" /end AXIS_PTS
/begin AXIS_PTS ldpm_n_ip_soi_prev2_amp_rgn_1 "" 0x8434f2 n _REC_AXS_20_u2 8160. _CNV_A_R_LINEAR_____5_CM 12 0. 8160. FORMAT "%4.0" /end AXIS_PTS
/begin AXIS_PTS ldpm_tqi_sp_ip_soi_prev1_amp_rgn_1 "" 0x843e86 tqi_sp _REC_AXS_20_u2 2047.96875 _CNV_A_R_LINEAR_____86_CM 12 -1024. 1023.96875 FORMAT "%6.2" /end AXIS_PTS
/begin AXIS_PTS ldpm_tqi_sp_ip_soi_main2_amp_rgn_1 "" 0x843e1e tqi_sp _REC_AXS_20_u2 2047.96875 _CNV_A_R_LINEAR_____86_CM 12 -1024. 1023.96875 FORMAT "%6.2" /end AXIS_PTS
/begin AXIS_PTS ldpm_tqi_sp_ip_soi_post1_amp_rgn_1 "" 0x843e52 tqi_sp _REC_AXS_20_u2 2047.96875 _CNV_A_R_LINEAR_____86_CM 12 -1024. 1023.96875 FORMAT "%6.2" /end AXIS_PTS
/begin AXIS_PTS ldpm_tqi_sp_ip_soi_prev2_amp_rgn_1 "" 0x843eba tqi_sp _REC_AXS_20_u2 2047.96875 _CNV_A_R_LINEAR_____86_CM 12 -1024. 1023.96875 FORMAT "%6.2" /end AXIS_PTS
/begin CHARACTERISTIC ip_soi_prev1_amp_l_rgn_1 "ASOI_MAIN_RGN: AMP correction (=0) of soi_prev1 during regeneration 1" MAP 0x84e65c _REC_MAP_20_u2_u2_u2 360. _CNV_A_R_LINEAR_____119_CM 0. 360. DISPLAY_IDENTIFIER IP_SOI_PREV1_AMP_L_RGN_1 FORMAT "%5.2"
 /begin AXIS_DESCR COM_AXIS n _CNV_A_R_LINEAR_____5_CM 12 0. 8160. FORMAT "%4.0" AXIS_PTS_REF ldpm_n_ip_soi_prev1_amp_rgn_1 /end AXIS_DESCR
 /begin AXIS_DESCR COM_AXIS tqi_sp _CNV_A_R_LINEAR_____86_CM 12 -1024. 1023.96875 FORMAT "%6.2" AXIS_PTS_REF ldpm_tqi_sp_ip_soi_prev1_amp_rgn_1 /end AXIS_DESCR
/end CHARACTERISTIC
/begin CHARACTERISTIC ip_soi_main2_amp_l_rgn_1 "ASOI_MAIN_RGN: AMP correction (=0) of soi_main2 during regeneration 1" MAP 0x84dd5c _REC_MAP_20_u2_u2_u2 360. _CNV_A_R_LINEAR_____119_CM 0. 360. DISPLAY_IDENTIFIER IP_SOI_MAIN2_AMP_L_RGN_1 FORMAT "%5.2"
 /begin AXIS_DESCR COM_AXIS n _CNV_A_R_LINEAR_____5_CM 12 0. 8160. FORMAT "%4.0" AXIS_PTS_REF ldpm_n_ip_soi_main2_amp_rgn_1 /end AXIS_DESCR
 /begin AXIS_DESCR COM_AXIS tqi_sp _CNV_A_R_LINEAR_____86_CM 12 -1024. 1023.96875 FORMAT "%6.2" AXIS_PTS_REF ldpm_tqi_sp_ip_soi_main2_amp_rgn_1 /end AXIS_DESCR
/end CHARACTERISTIC
/begin CHARACTERISTIC ip_soi_post1_amp_l_rgn_1 "ASOI_MAIN_RGN: AMP correction (=0) of soi_post1 during regeneration 1" MAP 0x84e1dc _REC_MAP_20_u2_u2_u2 360. _CNV_A_R_LINEAR_____119_CM 0. 360. DISPLAY_IDENTIFIER IP_SOI_POST1_AMP_L_RGN_1 FORMAT "%5.2"
 /begin AXIS_DESCR COM_AXIS n _CNV_A_R_LINEAR_____5_CM 12 0. 8160. FORMAT "%4.0" AXIS_PTS_REF ldpm_n_ip_soi_post1_amp_rgn_1 /end AXIS_DESCR
 /begin AXIS_DESCR COM_AXIS tqi_sp _CNV_A_R_LINEAR_____86_CM 12 -1024. 1023.96875 FORMAT "%6.2" AXIS_PTS_REF ldpm_tqi_sp_ip_soi_post1_amp_rgn_1 /end AXIS_DESCR
/end CHARACTERISTIC
/begin CHARACTERISTIC ip_soi_prev2_amp_l_rgn_1 "ASOI_MAIN_RGN: AMP correction (=0) of soi_prev2 during regeneration 1" MAP 0x84eadc _REC_MAP_20_u2_u2_u2 360. _CNV_A_R_LINEAR_____119_CM 0. 360. DISPLAY_IDENTIFIER IP_SOI_PREV2_AMP_L_RGN_1 FORMAT "%5.2"
 /begin AXIS_DESCR COM_AXIS n _CNV_A_R_LINEAR_____5_CM 12 0. 8160. FORMAT "%4.0" AXIS_PTS_REF ldpm_n_ip_soi_prev2_amp_rgn_1 /end AXIS_DESCR
 /begin AXIS_DESCR COM_AXIS tqi_sp _CNV_A_R_LINEAR_____86_CM 12 -1024. 1023.96875 FORMAT "%6.2" AXIS_PTS_REF ldpm_tqi_sp_ip_soi_prev2_amp_rgn_1 /end AXIS_DESCR
/end CHARACTERISTIC
/begin CHARACTERISTIC ip_soi_prev1_amp_h_rgn_2 "ASOI_MAIN_RGN: AMP correction(=1) of soi_prev1 during regeneration 2" MAP 0x84e53c _REC_MAP_20_u2_u2_u2 360. _CNV_A_R_LINEAR_____119_CM 0. 360. DISPLAY_IDENTIFIER IP_SOI_PREV1_AMP_H_RGN_2 FORMAT "%5.2"
 /begin AXIS_DESCR COM_AXIS n _CNV_A_R_LINEAR_____5_CM 12 0. 8160. FORMAT "%4.0" AXIS_PTS_REF ldpm_n_ip_soi_prev1_amp_rgn_2 /end AXIS_DESCR
 /begin AXIS_DESCR COM_AXIS tqi_sp _CNV_A_R_LINEAR_____86_CM 12 -1024. 1023.96875 FORMAT "%6.2" AXIS_PTS_REF ldpm_tqi_sp_ip_soi_prev1_amp_rgn_2 /end AXIS_DESCR
/end CHARACTERISTIC
/begin CHARACTERISTIC ip_soi_main2_amp_h_rgn_2 "ASOI_MAIN_RGN: AMP correction(=1) of soi_main2 during regeneration 2" MAP 0x84dc3c _REC_MAP_20_u2_u2_u2 360. _CNV_A_R_LINEAR_____119_CM 0. 360. DISPLAY_IDENTIFIER IP_SOI_MAIN2_AMP_H_RGN_2 FORMAT "%5.2"
 /begin AXIS_DESCR COM_AXIS n _CNV_A_R_LINEAR_____5_CM 12 0. 8160. FORMAT "%4.0" AXIS_PTS_REF ldpm_n_ip_soi_main2_amp_rgn_2 /end AXIS_DESCR
 /begin AXIS_DESCR COM_AXIS tqi_sp _CNV_A_R_LINEAR_____86_CM 12 -1024. 1023.96875 FORMAT "%6.2" AXIS_PTS_REF ldpm_tqi_sp_ip_soi_main2_amp_rgn_2 /end AXIS_DESCR
/end CHARACTERISTIC
/begin CHARACTERISTIC ip_soi_post1_amp_h_rgn_2 "ASOI_MAIN_RGN: AMP correction(=1) of soi_post1 during regeneration 2" MAP 0x84e0bc _REC_MAP_20_u2_u2_u2 360. _CNV_A_R_LINEAR_____119_CM 0. 360. DISPLAY_IDENTIFIER IP_SOI_POST1_AMP_H_RGN_2 FORMAT "%5.2"
 /begin AXIS_DESCR COM_AXIS n _CNV_A_R_LINEAR_____5_CM 12 0. 8160. FORMAT "%4.0" AXIS_PTS_REF ldpm_n_ip_soi_post1_amp_rgn_2 /end AXIS_DESCR
 /begin AXIS_DESCR COM_AXIS tqi_sp _CNV_A_R_LINEAR_____86_CM 12 -1024. 1023.96875 FORMAT "%6.2" AXIS_PTS_REF ldpm_tqi_sp_ip_soi_post1_amp_rgn_2 /end AXIS_DESCR
/end CHARACTERISTIC
/begin CHARACTERISTIC ip_soi_prev2_amp_h_rgn_2 "ASOI_MAIN_RGN: AMP correction(=1) of soi_prev2 during regeneration 2" MAP 0x84e9bc _REC_MAP_20_u2_u2_u2 360. _CNV_A_R_LINEAR_____119_CM 0. 360. DISPLAY_IDENTIFIER IP_SOI_PREV2_AMP_H_RGN_2 FORMAT "%5.2"
 /begin AXIS_DESCR COM_AXIS n _CNV_A_R_LINEAR_____5_CM 12 0. 8160. FORMAT "%4.0" AXIS_PTS_REF ldpm_n_ip_soi_prev2_amp_rgn_2 /end AXIS_DESCR
 /begin AXIS_DESCR COM_AXIS tqi_sp _CNV_A_R_LINEAR_____86_CM 12 -1024. 1023.96875 FORMAT "%6.2" AXIS_PTS_REF ldpm_tqi_sp_ip_soi_prev2_amp_rgn_2 /end AXIS_DESCR
/end CHARACTERISTIC
/begin AXIS_PTS ldpm_n_ip_soi_prev1_amp_rgn_2 "" 0x8434d8 n _REC_AXS_20_u2 8160. _CNV_A_R_LINEAR_____5_CM 12 0. 8160. FORMAT "%4.0" /end AXIS_PTS
/begin AXIS_PTS ldpm_n_ip_soi_main2_amp_rgn_2 "" 0x843470 n _REC_AXS_20_u2 8160. _CNV_A_R_LINEAR_____5_CM 12 0. 8160. FORMAT "%4.0" /end AXIS_PTS
/begin AXIS_PTS ldpm_n_ip_soi_post1_amp_rgn_2 "" 0x8434a4 n _REC_AXS_20_u2 8160. _CNV_A_R_LINEAR_____5_CM 12 0. 8160. FORMAT "%4.0" /end AXIS_PTS
/begin AXIS_PTS ldpm_n_ip_soi_prev2_amp_rgn_2 "" 0x84350c n _REC_AXS_20_u2 8160. _CNV_A_R_LINEAR_____5_CM 12 0. 8160. FORMAT "%4.0" /end AXIS_PTS
/begin AXIS_PTS ldpm_tqi_sp_ip_soi_prev1_amp_rgn_2 "" 0x843ea0 tqi_sp _REC_AXS_20_u2 2047.96875 _CNV_A_R_LINEAR_____86_CM 12 -1024. 1023.96875 FORMAT "%6.2" /end AXIS_PTS
/begin AXIS_PTS ldpm_tqi_sp_ip_soi_main2_amp_rgn_2 "" 0x843e38 tqi_sp _REC_AXS_20_u2 2047.96875 _CNV_A_R_LINEAR_____86_CM 12 -1024. 1023.96875 FORMAT "%6.2" /end AXIS_PTS
/begin AXIS_PTS ldpm_tqi_sp_ip_soi_post1_amp_rgn_2 "" 0x843e6c tqi_sp _REC_AXS_20_u2 2047.96875 _CNV_A_R_LINEAR_____86_CM 12 -1024. 1023.96875 FORMAT "%6.2" /end AXIS_PTS
/begin AXIS_PTS ldpm_tqi_sp_ip_soi_prev2_amp_rgn_2 "" 0x843ed4 tqi_sp _REC_AXS_20_u2 2047.96875 _CNV_A_R_LINEAR_____86_CM 12 -1024. 1023.96875 FORMAT "%6.2" /end AXIS_PTS
/begin CHARACTERISTIC ip_soi_prev1_amp_l_rgn_2 "ASOI_MAIN_RGN: AMP correction (= 0 ) of soi_prev1 during regeneration 2" MAP 0x84e77c _REC_MAP_20_u2_u2_u2 360. _CNV_A_R_LINEAR_____119_CM 0. 360. DISPLAY_IDENTIFIER IP_SOI_PREV1_AMP_L_RGN_2 FORMAT "%5.2"
 /begin AXIS_DESCR COM_AXIS n _CNV_A_R_LINEAR_____5_CM 12 0. 8160. FORMAT "%4.0" AXIS_PTS_REF ldpm_n_ip_soi_prev1_amp_rgn_2 /end AXIS_DESCR
 /begin AXIS_DESCR COM_AXIS tqi_sp _CNV_A_R_LINEAR_____86_CM 12 -1024. 1023.96875 FORMAT "%6.2" AXIS_PTS_REF ldpm_tqi_sp_ip_soi_prev1_amp_rgn_2 /end AXIS_DESCR
/end CHARACTERISTIC
/begin CHARACTERISTIC ip_soi_main2_amp_l_rgn_2 "ASOI_MAIN_RGN: AMP correction (= 0 ) of soi_main2 during regeneration 2" MAP 0x84de7c _REC_MAP_20_u2_u2_u2 360. _CNV_A_R_LINEAR_____119_CM 0. 360. DISPLAY_IDENTIFIER IP_SOI_MAIN2_AMP_L_RGN_2 FORMAT "%5.2"
 /begin AXIS_DESCR COM_AXIS n _CNV_A_R_LINEAR_____5_CM 12 0. 8160. FORMAT "%4.0" AXIS_PTS_REF ldpm_n_ip_soi_main2_amp_rgn_2 /end AXIS_DESCR
 /begin AXIS_DESCR COM_AXIS tqi_sp _CNV_A_R_LINEAR_____86_CM 12 -1024. 1023.96875 FORMAT "%6.2" AXIS_PTS_REF ldpm_tqi_sp_ip_soi_main2_amp_rgn_2 /end AXIS_DESCR
/end CHARACTERISTIC
/begin CHARACTERISTIC ip_soi_post1_amp_l_rgn_2 "ASOI_MAIN_RGN: AMP correction (= 0 ) of soi_post1 during regeneration 2" MAP 0x84e2fc _REC_MAP_20_u2_u2_u2 360. _CNV_A_R_LINEAR_____119_CM 0. 360. DISPLAY_IDENTIFIER IP_SOI_POST1_AMP_L_RGN_2 FORMAT "%5.2"
 /begin AXIS_DESCR COM_AXIS n _CNV_A_R_LINEAR_____5_CM 12 0. 8160. FORMAT "%4.0" AXIS_PTS_REF ldpm_n_ip_soi_post1_amp_rgn_2 /end AXIS_DESCR
 /begin AXIS_DESCR COM_AXIS tqi_sp _CNV_A_R_LINEAR_____86_CM 12 -1024. 1023.96875 FORMAT "%6.2" AXIS_PTS_REF ldpm_tqi_sp_ip_soi_post1_amp_rgn_2 /end AXIS_DESCR
/end CHARACTERISTIC
/begin CHARACTERISTIC ip_soi_prev2_amp_l_rgn_2 "ASOI_MAIN_RGN: AMP correction (= 0 ) of soi_prev2 during regeneration 2" MAP 0x84ebfc _REC_MAP_20_u2_u2_u2 360. _CNV_A_R_LINEAR_____119_CM 0. 360. DISPLAY_IDENTIFIER IP_SOI_PREV2_AMP_L_RGN_2 FORMAT "%5.2"
 /begin AXIS_DESCR COM_AXIS n _CNV_A_R_LINEAR_____5_CM 12 0. 8160. FORMAT "%4.0" AXIS_PTS_REF ldpm_n_ip_soi_prev2_amp_rgn_2 /end AXIS_DESCR
 /begin AXIS_DESCR COM_AXIS tqi_sp _CNV_A_R_LINEAR_____86_CM 12 -1024. 1023.96875 FORMAT "%6.2" AXIS_PTS_REF ldpm_tqi_sp_ip_soi_prev2_amp_rgn_2 /end AXIS_DESCR
/end CHARACTERISTIC
/begin MEASUREMENT soi_prev2_dif_st "distance between MAIN1 and PREV2 at start" UWORD _CNV_A_R_LINEAR_____119_CM 1 0. 0. 360. DISPLAY_IDENTIFIER SOI_PREV2_DIF_ST ECU_ADDRESS 0x7fa07a BYTE_ORDER MSB_LAST FORMAT "%5.2" /end MEASUREMENT
/begin MEASUREMENT soi_main2_dif_st "distance between MAIN2 and MAIN1 at start" UWORD _CNV_A_R_LINEAR_____119_CM 1 0. 0. 360. DISPLAY_IDENTIFIER SOI_MAIN2_DIF_ST ECU_ADDRESS 0x7fa07c BYTE_ORDER MSB_LAST FORMAT "%5.2" /end MEASUREMENT
/begin MEASUREMENT soi_prev1_dif_st "distance between MAIN1 and PREV1 at start" UWORD _CNV_A_R_LINEAR_____119_CM 1 0. 0. 360. DISPLAY_IDENTIFIER SOI_PREV1_DIF_ST ECU_ADDRESS 0x7fa078 BYTE_ORDER MSB_LAST FORMAT "%5.2" /end MEASUREMENT
/begin MEASUREMENT soi_post1_dif_st "distance between POST1 and MAIN1 at start" UWORD _CNV_A_R_LINEAR_____119_CM 1 0. 0. 360. DISPLAY_IDENTIFIER SOI_POST1_DIF_ST ECU_ADDRESS 0x7fa07e BYTE_ORDER MSB_LAST FORMAT "%5.2" /end MEASUREMENT
/begin CHARACTERISTIC ip_fac_soi_main2_dif_st_cor_amp "SOI: AMP correction factor for SOI MAIN2 at ST" CURVE 0x852974 _REC_CUR_20_u2_u2 3.99993896484375 _CNV_A_R_LINEAR_____15_CM 0. 3.99993896484375 DISPLAY_IDENTIFIER IP_FAC_SOI_MAIN2_DIF_ST_COR_AMP FORMAT "%6.5"
 /begin AXIS_DESCR COM_AXIS amp _CNV_A_R_LINEAR_____45_CM 1 0. 5434. FORMAT "%7.3" AXIS_PTS_REF ldp_amp_2_inj_x /end AXIS_DESCR
/end CHARACTERISTIC
/begin CHARACTERISTIC ip_fac_soi_post1_dif_st_cor_amp "SOI: AMP correction factor for SOI POST1 at ST" CURVE 0x8529a6 _REC_CUR_20_u2_u2 3.99993896484375 _CNV_A_R_LINEAR_____15_CM 0. 3.99993896484375 DISPLAY_IDENTIFIER IP_FAC_SOI_POST1_DIF_ST_COR_AMP FORMAT "%6.5"
 /begin AXIS_DESCR COM_AXIS amp _CNV_A_R_LINEAR_____45_CM 4 0. 5434. FORMAT "%6.2" AXIS_PTS_REF ldpm_amp_2_inj /end AXIS_DESCR
/end CHARACTERISTIC
/begin CHARACTERISTIC ip_fac_soi_prev1_dif_st_cor_amp "SOI: AMP correction factor for SOI PREV1 at ST" CURVE 0x8529de _REC_CUR_20_u2_u2 3.99993896484375 _CNV_A_R_LINEAR_____15_CM 0. 3.99993896484375 DISPLAY_IDENTIFIER IP_FAC_SOI_PREV1_DIF_ST_COR_AMP FORMAT "%6.5"
 /begin AXIS_DESCR COM_AXIS amp _CNV_A_R_LINEAR_____45_CM 4 0. 5434. FORMAT "%6.2" AXIS_PTS_REF ldpm_amp_2_inj /end AXIS_DESCR
/end CHARACTERISTIC
/begin CHARACTERISTIC ip_fac_soi_prev2_dif_st_cor_amp "SOI: AMP correction factor for SOI PREV2 at ST" CURVE 0x8529ec _REC_CUR_20_u2_u2 3.99993896484375 _CNV_A_R_LINEAR_____15_CM 0. 3.99993896484375 DISPLAY_IDENTIFIER IP_FAC_SOI_PREV2_DIF_ST_COR_AMP FORMAT "%6.5"
 /begin AXIS_DESCR COM_AXIS amp _CNV_A_R_LINEAR_____45_CM 1 0. 5434. FORMAT "%7.3" AXIS_PTS_REF ldp_amp_2_inj_x /end AXIS_DESCR
/end CHARACTERISTIC
/begin CHARACTERISTIC ip_soi_main2_dif_st "SOI: Distance between MAIN2 and MAIN1 at ST" MAP 0x859f82 _REC_MAP_20_u2_u2_u1 360. _CNV_A_R_LINEAR_____119_CM 0. 360. DISPLAY_IDENTIFIER IP_SOI_MAIN2_DIF_ST FORMAT "%6.5"
 /begin AXIS_DESCR COM_AXIS n _CNV_A_R_LINEAR_____5_CM 1 0. 6375. FORMAT "%4.0" AXIS_PTS_REF ldp_n_3_inj_x /end AXIS_DESCR
 /begin AXIS_DESCR COM_AXIS tco _CNV_A_R_LINEAR_____18_CM 1 -50. 205. FORMAT "%3.0" AXIS_PTS_REF ldp_tco_2_inj_x /end AXIS_DESCR
/end CHARACTERISTIC
/begin CHARACTERISTIC ip_soi_post1_dif_st "SOI: Distance between POST1 and MAIN1 at ST" MAP 0x85a628 _REC_MAP_20_u2_u2_u1 360. _CNV_A_R_LINEAR_____119_CM 0. 360. DISPLAY_IDENTIFIER IP_SOI_POST1_DIF_ST FORMAT "%6.5"
 /begin AXIS_DESCR COM_AXIS n _CNV_A_R_LINEAR_____5_CM 7 0. 6375. FORMAT "%4.0" AXIS_PTS_REF ldpm_n_3_inj /end AXIS_DESCR
 /begin AXIS_DESCR COM_AXIS tco _CNV_A_R_LINEAR_____18_CM 12 -50. 205. FORMAT "%3.0" AXIS_PTS_REF ldpm_tco_2_inj /end AXIS_DESCR
/end CHARACTERISTIC
/begin CHARACTERISTIC ip_soi_prev1_dif_st "SOI: Distance between PREV1 and MAIN1 at ST" MAP 0x85ae0c _REC_MAP_20_u2_u2_u1 360. _CNV_A_R_LINEAR_____119_CM 0. 360. DISPLAY_IDENTIFIER IP_SOI_PREV1_DIF_ST FORMAT "%6.5"
 /begin AXIS_DESCR COM_AXIS n _CNV_A_R_LINEAR_____5_CM 7 0. 6375. FORMAT "%4.0" AXIS_PTS_REF ldpm_n_3_inj /end AXIS_DESCR
 /begin AXIS_DESCR COM_AXIS tco _CNV_A_R_LINEAR_____18_CM 12 -50. 205. FORMAT "%3.0" AXIS_PTS_REF ldpm_tco_2_inj /end AXIS_DESCR
/end CHARACTERISTIC
/begin CHARACTERISTIC ip_soi_prev2_dif_st "SOI: Distance between PREV2 and MAIN1 at ST" MAP 0x85af6c _REC_MAP_20_u2_u2_u1 360. _CNV_A_R_LINEAR_____119_CM 0. 360. DISPLAY_IDENTIFIER IP_SOI_PREV2_DIF_ST FORMAT "%6.5"
 /begin AXIS_DESCR COM_AXIS n _CNV_A_R_LINEAR_____5_CM 1 0. 6375. FORMAT "%4.0" AXIS_PTS_REF ldp_n_3_inj_x /end AXIS_DESCR
 /begin AXIS_DESCR COM_AXIS tco _CNV_A_R_LINEAR_____18_CM 1 -50. 205. FORMAT "%3.0" AXIS_PTS_REF ldp_tco_2_inj_x /end AXIS_DESCR
/end CHARACTERISTIC
/begin CHARACTERISTIC ip_soi_main2_dif_st_cor_amp "SOI: AMP correction of distance between MAIN2 and MAIN1 at ST" MAP 0x859f84 _REC_MAP_20_u2_u2_u1 720. _CNV_A_R_LINEAR_____400_CM -360. 360. DISPLAY_IDENTIFIER IP_SOI_MAIN2_DIF_ST_COR_AMP FORMAT "%6.5"
 /begin AXIS_DESCR COM_AXIS n _CNV_A_R_LINEAR_____5_CM 1 0. 6375. FORMAT "%4.0" AXIS_PTS_REF ldp_n_4_inj_x /end AXIS_DESCR
 /begin AXIS_DESCR COM_AXIS tco _CNV_A_R_LINEAR_____18_CM 1 -50. 205. FORMAT "%3.0" AXIS_PTS_REF ldp_tco_3_inj_x /end AXIS_DESCR
/end CHARACTERISTIC
/begin CHARACTERISTIC ip_soi_post1_dif_st_cor_amp "SOI: AMP correction of distance between POST1 and MAIN1 at ST" MAP 0x85a6d0 _REC_MAP_20_u2_u2_u1 720. _CNV_A_R_LINEAR_____400_CM -360. 360. DISPLAY_IDENTIFIER IP_SOI_POST1_DIF_ST_COR_AMP FORMAT "%6.5"
 /begin AXIS_DESCR COM_AXIS n _CNV_A_R_LINEAR_____5_CM 4 0. 6375. FORMAT "%4.0" AXIS_PTS_REF ldpm_n_4_inj /end AXIS_DESCR
 /begin AXIS_DESCR COM_AXIS tco _CNV_A_R_LINEAR_____18_CM 6 -50. 205. FORMAT "%3.0" AXIS_PTS_REF ldpm_tco_3_inj /end AXIS_DESCR
/end CHARACTERISTIC
/begin CHARACTERISTIC ip_soi_prev1_dif_st_cor_amp "SOI: AMP correction of distance between PREV1 and MAIN1 at ST" MAP 0x85aeb4 _REC_MAP_20_u2_u2_u1 720. _CNV_A_R_LINEAR_____400_CM -360. 360. DISPLAY_IDENTIFIER IP_SOI_PREV1_DIF_ST_COR_AMP FORMAT "%6.5"
 /begin AXIS_DESCR COM_AXIS n _CNV_A_R_LINEAR_____5_CM 4 0. 6375. FORMAT "%4.0" AXIS_PTS_REF ldpm_n_4_inj /end AXIS_DESCR
 /begin AXIS_DESCR COM_AXIS tco _CNV_A_R_LINEAR_____18_CM 6 -50. 205. FORMAT "%3.0" AXIS_PTS_REF ldpm_tco_3_inj /end AXIS_DESCR
/end CHARACTERISTIC
/begin CHARACTERISTIC ip_soi_prev2_dif_st_cor_amp "SOI: AMP correction of distance between PREV2 and MAIN1 at ST" MAP 0x85af6e _REC_MAP_20_u2_u2_u1 720. _CNV_A_R_LINEAR_____400_CM -360. 360. DISPLAY_IDENTIFIER IP_SOI_PREV2_DIF_ST_COR_AMP FORMAT "%6.5"
 /begin AXIS_DESCR COM_AXIS n _CNV_A_R_LINEAR_____5_CM 1 0. 6375. FORMAT "%4.0" AXIS_PTS_REF ldp_n_4_inj_x /end AXIS_DESCR
 /begin AXIS_DESCR COM_AXIS tco _CNV_A_R_LINEAR_____18_CM 1 -50. 205. FORMAT "%3.0" AXIS_PTS_REF ldp_tco_3_inj_x /end AXIS_DESCR
/end CHARACTERISTIC
/begin MEASUREMENT soi_prev1_dif_bas_sel "distance between MAIN1 and PREV1 after temperature selection" UWORD _CNV_A_R_LINEAR_____119_CM 1 0. 0. 360. DISPLAY_IDENTIFIER SOI_PREV1_DIF_BAS_SEL ECU_ADDRESS 0x7fa058 BYTE_ORDER MSB_LAST FORMAT "%6.5" /end MEASUREMENT
/begin MEASUREMENT soi_main2_dif_bas_sel "distance between MAIN1 and MAIN2 after temperature selection" UWORD _CNV_A_R_LINEAR_____119_CM 1 0. 0. 360. DISPLAY_IDENTIFIER SOI_MAIN2_DIF_BAS_SEL ECU_ADDRESS 0x7fa05c BYTE_ORDER MSB_LAST FORMAT "%6.5" /end MEASUREMENT
/begin MEASUREMENT soi_prev2_dif_bas_sel "distance between MAIN1 and PREV2 after temperature selection" UWORD _CNV_A_R_LINEAR_____119_CM 1 0. 0. 360. DISPLAY_IDENTIFIER SOI_PREV2_DIF_BAS_SEL ECU_ADDRESS 0x7fa05a BYTE_ORDER MSB_LAST FORMAT "%6.5" /end MEASUREMENT
/begin MEASUREMENT soi_post1_dif_bas_sel "distance between MAIN1 and POST1 after temperature selection" UWORD _CNV_A_R_LINEAR_____119_CM 1 0. 0. 360. DISPLAY_IDENTIFIER SOI_POST1_DIF_BAS_SEL ECU_ADDRESS 0x7fa05e BYTE_ORDER MSB_LAST FORMAT "%6.5" /end MEASUREMENT
/begin CHARACTERISTIC c_t_rgn_trn_soi_post1 "time constant of rgn transition of soi j" VALUE 0x85cc92 _REC_VAL_20_u2 4.19424 _CNV_A_R_LINEAR_____64_CM 0. 4.19424 DISPLAY_IDENTIFIER C_T_RGN_TRN_SOI_POST1 FORMAT "%7.5" /end CHARACTERISTIC
/begin CHARACTERISTIC c_t_rgn_trn_soi_prev1 "time constant of rgn transition of soi j" VALUE 0x85cc94 _REC_VAL_20_u2 4.19424 _CNV_A_R_LINEAR_____64_CM 0. 4.19424 DISPLAY_IDENTIFIER C_T_RGN_TRN_SOI_PREV1 FORMAT "%7.5" /end CHARACTERISTIC
/begin CHARACTERISTIC c_t_rgn_trn_soi_main2 "time constant of rgn transition of soi j" VALUE 0x85cc90 _REC_VAL_20_u2 4.19424 _CNV_A_R_LINEAR_____64_CM 0. 4.19424 DISPLAY_IDENTIFIER C_T_RGN_TRN_SOI_MAIN2 FORMAT "%7.5" /end CHARACTERISTIC
/begin MEASUREMENT soi_prev1_dif_is_pl "" UWORD _CNV_A_R_LINEAR_____119_CM 1 0. 0. 360. DISPLAY_IDENTIFIER SOI_PREV1_DIF_IS_PL ECU_ADDRESS 0x7fa060 BYTE_ORDER MSB_LAST FORMAT "%5.2" /end MEASUREMENT
/begin MEASUREMENT soi_prev2_dif_is_pl "" UWORD _CNV_A_R_LINEAR_____119_CM 1 0. 0. 360. DISPLAY_IDENTIFIER SOI_PREV2_DIF_IS_PL ECU_ADDRESS 0x7fa062 BYTE_ORDER MSB_LAST FORMAT "%5.2" /end MEASUREMENT
/begin MEASUREMENT soi_main2_dif_is_pl "" UWORD _CNV_A_R_LINEAR_____119_CM 1 0. 0. 360. DISPLAY_IDENTIFIER SOI_MAIN2_DIF_IS_PL ECU_ADDRESS 0x7fa064 BYTE_ORDER MSB_LAST FORMAT "%5.2" /end MEASUREMENT
/begin MEASUREMENT soi_post1_dif_is_pl "" UWORD _CNV_A_R_LINEAR_____119_CM 1 0. 0. 360. DISPLAY_IDENTIFIER SOI_POST1_DIF_IS_PL ECU_ADDRESS 0x7fa066 BYTE_ORDER MSB_LAST FORMAT "%5.2" /end MEASUREMENT
/begin CHARACTERISTIC c_t_rgn_trn_soi_prev2 "" VALUE 0x85cc96 _REC_VAL_20_u2 4.19424 _CNV_A_R_LINEAR_____64_CM 0. 4.19424 DISPLAY_IDENTIFIER C_T_RGN_TRN_SOI_PREV2 FORMAT "%6.5" /end CHARACTERISTIC
/begin MEASUREMENT soi_prev1_cor "SOI correction of Injection PREV1" SWORD _CNV_A_R_LINEAR_____119_CM 1 0. -360. 360. DISPLAY_IDENTIFIER SOI_PREV1_COR ECU_ADDRESS 0x7fb426 BYTE_ORDER MSB_LAST FORMAT "%5.2" /end MEASUREMENT
/begin MEASUREMENT soi_prev2_cor "SOI correction of Injection PREV2" SWORD _CNV_A_R_LINEAR_____119_CM 1 0. -360. 360. DISPLAY_IDENTIFIER SOI_PREV2_COR ECU_ADDRESS 0x7fa082 BYTE_ORDER MSB_LAST FORMAT "%5.2" /end MEASUREMENT
/begin MEASUREMENT soi_main2_cor "SOI correction of Injection MAIN2" SWORD _CNV_A_R_LINEAR_____119_CM 1 0. -360. 360. DISPLAY_IDENTIFIER SOI_MAIN2_COR ECU_ADDRESS 0x7fa084 BYTE_ORDER MSB_LAST FORMAT "%5.2" /end MEASUREMENT
/begin MEASUREMENT soi_post1_cor "SOI correction of Injection POST1" SWORD _CNV_A_R_LINEAR_____119_CM 1 0. -360. 360. DISPLAY_IDENTIFIER SOI_POST1_COR ECU_ADDRESS 0x7fb45e BYTE_ORDER MSB_LAST FORMAT "%5.2" /end MEASUREMENT
/begin MEASUREMENT soi_main1_cor_conf_1 "SOI correction of Injection MAIN1, configuration 1" SWORD _CNV_A_R_LINEAR_____119_CM 1 0. -360. 360. DISPLAY_IDENTIFIER SOI_MAIN1_COR_CONF_1 ECU_ADDRESS 0x7fa088 BYTE_ORDER MSB_LAST FORMAT "%5.2" /end MEASUREMENT
/begin MEASUREMENT soi_main1_cor_conf_2 "SOI correction of Injection MAIN1, configuration 2" SWORD _CNV_A_R_LINEAR_____119_CM 1 0. -360. 360. DISPLAY_IDENTIFIER SOI_MAIN1_COR_CONF_2 ECU_ADDRESS 0x7fa08a BYTE_ORDER MSB_LAST FORMAT "%5.2" /end MEASUREMENT
/begin MEASUREMENT soi_main1_cor_conf_0 "SOI correction of Injection MAIN1, configuration 0" SWORD _CNV_A_R_LINEAR_____119_CM 1 0. -360. 360. DISPLAY_IDENTIFIER SOI_MAIN1_COR_CONF_0 ECU_ADDRESS 0x7fa08c BYTE_ORDER MSB_LAST FORMAT "%5.2" /end MEASUREMENT
/begin MEASUREMENT soi_main1_cor_conf_3 "SOI correction of Injection MAIN1, configuration 3" SWORD _CNV_A_R_LINEAR_____119_CM 1 0. -360. 360. DISPLAY_IDENTIFIER SOI_MAIN1_COR_CONF_3 ECU_ADDRESS 0x7fa08e BYTE_ORDER MSB_LAST FORMAT "%5.2" /end MEASUREMENT
/begin MEASUREMENT soi_main1_cor_conf_4 "SOI correction of Injection MAIN1, configuration 4" SWORD _CNV_A_R_LINEAR_____119_CM 1 0. -360. 360. DISPLAY_IDENTIFIER SOI_MAIN1_COR_CONF_4 ECU_ADDRESS 0x7fa090 BYTE_ORDER MSB_LAST FORMAT "%5.2" /end MEASUREMENT
/begin CHARACTERISTIC ip_soi_main1_cor_fup_tra_dif "SOI_COR: FUP_TRA_DIF correction for SOI_MAIN1" CURVE 0x859b7c _REC_CUR_20_u2_u2 720. _CNV_A_R_LINEAR_____400_CM -360. 360. DISPLAY_IDENTIFIER IP_SOI_MAIN1_COR_FUP_TRA_DIF FORMAT "%5.2"
 /begin AXIS_DESCR COM_AXIS fup_tra_dif _CNV_A_R_LINEAR_____117_CM 8 -100. 99.99694820000001 FORMAT "%7.3" AXIS_PTS_REF ldpm_fup_tra_dif_1_inj /end AXIS_DESCR
/end CHARACTERISTIC
/begin MEASUREMENT soi_prev1_dif_min "Minimal distance between MAIN1 and PREV1" UWORD _CNV_A_R_LINEAR_____119_CM 1 0. 0. 360. DISPLAY_IDENTIFIER SOI_PREV1_DIF_MIN ECU_ADDRESS 0x7fa092 BYTE_ORDER MSB_LAST FORMAT "%5.2" /end MEASUREMENT
/begin MEASUREMENT soi_prev2_dif_min "Minimal distance between MAIN1 and PREV2" UWORD _CNV_A_R_LINEAR_____119_CM 1 0. 0. 360. DISPLAY_IDENTIFIER SOI_PREV2_DIF_MIN ECU_ADDRESS 0x7fa094 BYTE_ORDER MSB_LAST FORMAT "%5.2" /end MEASUREMENT
/begin MEASUREMENT soi_main2_dif_min "Minimal distance between MAIN1 and MAIN2" UWORD _CNV_A_R_LINEAR_____119_CM 1 0. 0. 360. DISPLAY_IDENTIFIER SOI_MAIN2_DIF_MIN ECU_ADDRESS 0x7fa096 BYTE_ORDER MSB_LAST FORMAT "%5.2" /end MEASUREMENT
/begin MEASUREMENT soi_post1_dif_min "Minimal distance between MAIN1 and POST1" UWORD _CNV_A_R_LINEAR_____119_CM 1 0. 0. 360. DISPLAY_IDENTIFIER SOI_POST1_DIF_MIN ECU_ADDRESS 0x7fa098 BYTE_ORDER MSB_LAST FORMAT "%5.2" /end MEASUREMENT
/begin MEASUREMENT soi_prev1_dif_max "Maximal distance between MAIN1 and PREV1" UWORD _CNV_A_R_LINEAR_____119_CM 1 0. 0. 360. DISPLAY_IDENTIFIER SOI_PREV1_DIF_MAX ECU_ADDRESS 0x7fa09a BYTE_ORDER MSB_LAST FORMAT "%5.2" /end MEASUREMENT
/begin MEASUREMENT soi_prev2_dif_max "Maximal distance between MAIN1 and PREV2" UWORD _CNV_A_R_LINEAR_____119_CM 1 0. 0. 360. DISPLAY_IDENTIFIER SOI_PREV2_DIF_MAX ECU_ADDRESS 0x7fa09c BYTE_ORDER MSB_LAST FORMAT "%5.2" /end MEASUREMENT
/begin MEASUREMENT soi_main2_dif_max "Maximal distance between MAIN1 and MAIN2" UWORD _CNV_A_R_LINEAR_____119_CM 1 0. 0. 360. DISPLAY_IDENTIFIER SOI_MAIN2_DIF_MAX ECU_ADDRESS 0x7fa09e BYTE_ORDER MSB_LAST FORMAT "%5.2" /end MEASUREMENT
/begin MEASUREMENT soi_post1_dif_max "Maximal distance between MAIN1 and POST1" UWORD _CNV_A_R_LINEAR_____119_CM 1 0. 0. 360. DISPLAY_IDENTIFIER SOI_POST1_DIF_MAX ECU_ADDRESS 0x7fa0a0 BYTE_ORDER MSB_LAST FORMAT "%5.2" /end MEASUREMENT
/begin CHARACTERISTIC c_fac_soi_prev1_tu "" VALUE 0x85ca06 _REC_VAL_20_u2 1.9999696 _CNV_A_R_LINEAR_____48_CM 0. 1.9999696 DISPLAY_IDENTIFIER C_FAC_SOI_PREV1_TU FORMAT "%5.4" /end CHARACTERISTIC
/begin CHARACTERISTIC lc_soi_prev1_tu_on "" VALUE 0x85cea8 _REC_VAL_20_u1 1. _CNV_A_R_LINEAR_____0_CM 0. 1. DISPLAY_IDENTIFIER LC_SOI_PREV1_TU_ON FORMAT "%1.0" /end CHARACTERISTIC
/begin CHARACTERISTIC c_soi_prev1_add_tu "" VALUE 0x85cbcc _REC_VAL_20_s2 720. _CNV_A_R_LINEAR_____119_CM -360. 360. DISPLAY_IDENTIFIER C_SOI_PREV1_ADD_TU FORMAT "%6.2" /end CHARACTERISTIC
/begin CHARACTERISTIC c_soi_prev1_add_tu_cyl[0] "" VALUE 0x85cbce _REC_VAL_20_s2 720. _CNV_A_R_LINEAR_____119_CM -360. 360. DISPLAY_IDENTIFIER C_SOI_PREV1_ADD_TU_CYL_0_ FORMAT "%6.2" /end CHARACTERISTIC
/begin CHARACTERISTIC c_soi_prev1_add_tu_cyl[1] "" VALUE 0x85cbd0 _REC_VAL_20_s2 720. _CNV_A_R_LINEAR_____119_CM -360. 360. DISPLAY_IDENTIFIER C_SOI_PREV1_ADD_TU_CYL_1_ FORMAT "%6.2" /end CHARACTERISTIC
/begin CHARACTERISTIC c_soi_prev1_add_tu_cyl[2] "" VALUE 0x85cbd2 _REC_VAL_20_s2 720. _CNV_A_R_LINEAR_____119_CM -360. 360. DISPLAY_IDENTIFIER C_SOI_PREV1_ADD_TU_CYL_2_ FORMAT "%6.2" /end CHARACTERISTIC
/begin CHARACTERISTIC c_soi_prev1_add_tu_cyl[3] "" VALUE 0x85cbd4 _REC_VAL_20_s2 720. _CNV_A_R_LINEAR_____119_CM -360. 360. DISPLAY_IDENTIFIER C_SOI_PREV1_ADD_TU_CYL_3_ FORMAT "%6.2" /end CHARACTERISTIC
/begin CHARACTERISTIC c_fac_soi_prev2_tu "" VALUE 0x85ca08 _REC_VAL_20_u2 1.9999696 _CNV_A_R_LINEAR_____48_CM 0. 1.9999696 DISPLAY_IDENTIFIER C_FAC_SOI_PREV2_TU FORMAT "%5.4" /end CHARACTERISTIC
/begin CHARACTERISTIC lc_soi_prev2_tu_on "" VALUE 0x85cea9 _REC_VAL_20_u1 1. _CNV_A_R_LINEAR_____0_CM 0. 1. DISPLAY_IDENTIFIER LC_SOI_PREV2_TU_ON FORMAT "%1.0" /end CHARACTERISTIC
/begin CHARACTERISTIC c_soi_prev2_add_tu "" VALUE 0x85cbd6 _REC_VAL_20_s2 720. _CNV_A_R_LINEAR_____119_CM -360. 360. DISPLAY_IDENTIFIER C_SOI_PREV2_ADD_TU FORMAT "%6.2" /end CHARACTERISTIC
/begin CHARACTERISTIC c_soi_prev2_add_tu_cyl[0] "" VALUE 0x85cbd8 _REC_VAL_20_s2 720. _CNV_A_R_LINEAR_____119_CM -360. 360. DISPLAY_IDENTIFIER C_SOI_PREV2_ADD_TU_CYL_0_ FORMAT "%6.2" /end CHARACTERISTIC
/begin CHARACTERISTIC c_soi_prev2_add_tu_cyl[1] "" VALUE 0x85cbda _REC_VAL_20_s2 720. _CNV_A_R_LINEAR_____119_CM -360. 360. DISPLAY_IDENTIFIER C_SOI_PREV2_ADD_TU_CYL_1_ FORMAT "%6.2" /end CHARACTERISTIC
/begin CHARACTERISTIC c_soi_prev2_add_tu_cyl[2] "" VALUE 0x85cbdc _REC_VAL_20_s2 720. _CNV_A_R_LINEAR_____119_CM -360. 360. DISPLAY_IDENTIFIER C_SOI_PREV2_ADD_TU_CYL_2_ FORMAT "%6.2" /end CHARACTERISTIC
/begin CHARACTERISTIC c_soi_prev2_add_tu_cyl[3] "" VALUE 0x85cbde _REC_VAL_20_s2 720. _CNV_A_R_LINEAR_____119_CM -360. 360. DISPLAY_IDENTIFIER C_SOI_PREV2_ADD_TU_CYL_3_ FORMAT "%6.2" /end CHARACTERISTIC
/begin CHARACTERISTIC c_fac_soi_main1_tu "" VALUE 0x85c9fe _REC_VAL_20_u2 1.9999696 _CNV_A_R_LINEAR_____48_CM 0. 1.9999696 DISPLAY_IDENTIFIER C_FAC_SOI_MAIN1_TU FORMAT "%5.4" /end CHARACTERISTIC
/begin CHARACTERISTIC lc_soi_main1_tu_on "" VALUE 0x85cea4 _REC_VAL_20_u1 1. _CNV_A_R_LINEAR_____0_CM 0. 1. DISPLAY_IDENTIFIER LC_SOI_MAIN1_TU_ON FORMAT "%1.0" /end CHARACTERISTIC
/begin CHARACTERISTIC c_soi_main1_add_tu "" VALUE 0x85cba2 _REC_VAL_20_s2 720. _CNV_A_R_LINEAR_____119_CM -360. 360. DISPLAY_IDENTIFIER C_SOI_MAIN1_ADD_TU FORMAT "%6.2" /end CHARACTERISTIC
/begin CHARACTERISTIC c_soi_main1_add_tu_cyl[0] "" VALUE 0x85cba4 _REC_VAL_20_s2 720. _CNV_A_R_LINEAR_____119_CM -360. 360. DISPLAY_IDENTIFIER C_SOI_MAIN1_ADD_TU_CYL_0_ FORMAT "%6.2" /end CHARACTERISTIC
/begin CHARACTERISTIC c_soi_main1_add_tu_cyl[1] "" VALUE 0x85cba6 _REC_VAL_20_s2 720. _CNV_A_R_LINEAR_____119_CM -360. 360. DISPLAY_IDENTIFIER C_SOI_MAIN1_ADD_TU_CYL_1_ FORMAT "%6.2" /end CHARACTERISTIC
/begin CHARACTERISTIC c_soi_main1_add_tu_cyl[2] "" VALUE 0x85cba8 _REC_VAL_20_s2 720. _CNV_A_R_LINEAR_____119_CM -360. 360. DISPLAY_IDENTIFIER C_SOI_MAIN1_ADD_TU_CYL_2_ FORMAT "%6.2" /end CHARACTERISTIC
/begin CHARACTERISTIC c_soi_main1_add_tu_cyl[3] "" VALUE 0x85cbaa _REC_VAL_20_s2 720. _CNV_A_R_LINEAR_____119_CM -360. 360. DISPLAY_IDENTIFIER C_SOI_MAIN1_ADD_TU_CYL_3_ FORMAT "%6.2" /end CHARACTERISTIC
/begin CHARACTERISTIC c_fac_soi_main2_tu "" VALUE 0x85ca00 _REC_VAL_20_u2 1.9999696 _CNV_A_R_LINEAR_____48_CM 0. 1.9999696 DISPLAY_IDENTIFIER C_FAC_SOI_MAIN2_TU FORMAT "%5.4" /end CHARACTERISTIC
/begin CHARACTERISTIC lc_soi_main2_tu_on "" VALUE 0x85cea5 _REC_VAL_20_u1 1. _CNV_A_R_LINEAR_____0_CM 0. 1. DISPLAY_IDENTIFIER LC_SOI_MAIN2_TU_ON FORMAT "%1.0" /end CHARACTERISTIC
/begin CHARACTERISTIC c_soi_main2_add_tu "" VALUE 0x85cbac _REC_VAL_20_s2 720. _CNV_A_R_LINEAR_____119_CM -360. 360. DISPLAY_IDENTIFIER C_SOI_MAIN2_ADD_TU FORMAT "%6.2" /end CHARACTERISTIC
/begin CHARACTERISTIC c_soi_main2_add_tu_cyl[0] "" VALUE 0x85cbae _REC_VAL_20_s2 720. _CNV_A_R_LINEAR_____119_CM -360. 360. DISPLAY_IDENTIFIER C_SOI_MAIN2_ADD_TU_CYL_0_ FORMAT "%6.2" /end CHARACTERISTIC
/begin CHARACTERISTIC c_soi_main2_add_tu_cyl[1] "" VALUE 0x85cbb0 _REC_VAL_20_s2 720. _CNV_A_R_LINEAR_____119_CM -360. 360. DISPLAY_IDENTIFIER C_SOI_MAIN2_ADD_TU_CYL_1_ FORMAT "%6.2" /end CHARACTERISTIC
/begin CHARACTERISTIC c_soi_main2_add_tu_cyl[2] "" VALUE 0x85cbb2 _REC_VAL_20_s2 720. _CNV_A_R_LINEAR_____119_CM -360. 360. DISPLAY_IDENTIFIER C_SOI_MAIN2_ADD_TU_CYL_2_ FORMAT "%6.2" /end CHARACTERISTIC
/begin CHARACTERISTIC c_soi_main2_add_tu_cyl[3] "" VALUE 0x85cbb4 _REC_VAL_20_s2 720. _CNV_A_R_LINEAR_____119_CM -360. 360. DISPLAY_IDENTIFIER C_SOI_MAIN2_ADD_TU_CYL_3_ FORMAT "%6.2" /end CHARACTERISTIC
/begin CHARACTERISTIC c_soi_main1_test_add_tu[0] "" VALUE 0x8501a6 _REC_VAL_20_s2 720. _CNV_A_R_LINEAR_____119_CM -360. 360. DISPLAY_IDENTIFIER C_SOI_MAIN1_TEST_ADD_TU_0_ FORMAT "%6.2" /end CHARACTERISTIC
/begin CHARACTERISTIC c_soi_main1_test_add_tu[1] "" VALUE 0x8501a8 _REC_VAL_20_s2 720. _CNV_A_R_LINEAR_____119_CM -360. 360. DISPLAY_IDENTIFIER C_SOI_MAIN1_TEST_ADD_TU_1_ FORMAT "%6.2" /end CHARACTERISTIC
/begin CHARACTERISTIC c_soi_main1_test_add_tu[2] "" VALUE 0x8501aa _REC_VAL_20_s2 720. _CNV_A_R_LINEAR_____119_CM -360. 360. DISPLAY_IDENTIFIER C_SOI_MAIN1_TEST_ADD_TU_2_ FORMAT "%6.2" /end CHARACTERISTIC
/begin CHARACTERISTIC c_soi_main1_test_add_tu[3] "" VALUE 0x8501ac _REC_VAL_20_s2 720. _CNV_A_R_LINEAR_____119_CM -360. 360. DISPLAY_IDENTIFIER C_SOI_MAIN1_TEST_ADD_TU_3_ FORMAT "%6.2" /end CHARACTERISTIC
/begin CHARACTERISTIC c_soi_main2_test_add_tu[0] "" VALUE 0x850196 _REC_VAL_20_s2 720. _CNV_A_R_LINEAR_____119_CM -360. 360. DISPLAY_IDENTIFIER C_SOI_MAIN2_TEST_ADD_TU_0_ FORMAT "%6.2" /end CHARACTERISTIC
/begin CHARACTERISTIC c_soi_main2_test_add_tu[1] "" VALUE 0x850198 _REC_VAL_20_s2 720. _CNV_A_R_LINEAR_____119_CM -360. 360. DISPLAY_IDENTIFIER C_SOI_MAIN2_TEST_ADD_TU_1_ FORMAT "%6.2" /end CHARACTERISTIC
/begin CHARACTERISTIC c_soi_main2_test_add_tu[2] "" VALUE 0x85019a _REC_VAL_20_s2 720. _CNV_A_R_LINEAR_____119_CM -360. 360. DISPLAY_IDENTIFIER C_SOI_MAIN2_TEST_ADD_TU_2_ FORMAT "%6.2" /end CHARACTERISTIC
/begin CHARACTERISTIC c_soi_main2_test_add_tu[3] "" VALUE 0x85019c _REC_VAL_20_s2 720. _CNV_A_R_LINEAR_____119_CM -360. 360. DISPLAY_IDENTIFIER C_SOI_MAIN2_TEST_ADD_TU_3_ FORMAT "%6.2" /end CHARACTERISTIC
/begin CHARACTERISTIC c_soi_prev1_test_add_tu[0] "" VALUE 0x85019e _REC_VAL_20_s2 720. _CNV_A_R_LINEAR_____119_CM -360. 360. DISPLAY_IDENTIFIER C_SOI_PREV1_TEST_ADD_TU_0_ FORMAT "%6.2" /end CHARACTERISTIC
/begin CHARACTERISTIC c_soi_prev1_test_add_tu[1] "" VALUE 0x8501a0 _REC_VAL_20_s2 720. _CNV_A_R_LINEAR_____119_CM -360. 360. DISPLAY_IDENTIFIER C_SOI_PREV1_TEST_ADD_TU_1_ FORMAT "%6.2" /end CHARACTERISTIC
/begin CHARACTERISTIC c_soi_prev1_test_add_tu[2] "" VALUE 0x8501a2 _REC_VAL_20_s2 720. _CNV_A_R_LINEAR_____119_CM -360. 360. DISPLAY_IDENTIFIER C_SOI_PREV1_TEST_ADD_TU_2_ FORMAT "%6.2" /end CHARACTERISTIC
/begin CHARACTERISTIC c_soi_prev1_test_add_tu[3] "" VALUE 0x8501a4 _REC_VAL_20_s2 720. _CNV_A_R_LINEAR_____119_CM -360. 360. DISPLAY_IDENTIFIER C_SOI_PREV1_TEST_ADD_TU_3_ FORMAT "%6.2" /end CHARACTERISTIC
/begin CHARACTERISTIC c_soi_prev2_test_add_tu[0] "" VALUE 0x85018e _REC_VAL_20_s2 720. _CNV_A_R_LINEAR_____119_CM -360. 360. DISPLAY_IDENTIFIER C_SOI_PREV2_TEST_ADD_TU_0_ FORMAT "%6.2" /end CHARACTERISTIC
/begin CHARACTERISTIC c_soi_prev2_test_add_tu[1] "" VALUE 0x850190 _REC_VAL_20_s2 720. _CNV_A_R_LINEAR_____119_CM -360. 360. DISPLAY_IDENTIFIER C_SOI_PREV2_TEST_ADD_TU_1_ FORMAT "%6.2" /end CHARACTERISTIC
/begin CHARACTERISTIC c_soi_prev2_test_add_tu[2] "" VALUE 0x850192 _REC_VAL_20_s2 720. _CNV_A_R_LINEAR_____119_CM -360. 360. DISPLAY_IDENTIFIER C_SOI_PREV2_TEST_ADD_TU_2_ FORMAT "%6.2" /end CHARACTERISTIC
/begin CHARACTERISTIC c_soi_prev2_test_add_tu[3] "" VALUE 0x850194 _REC_VAL_20_s2 720. _CNV_A_R_LINEAR_____119_CM -360. 360. DISPLAY_IDENTIFIER C_SOI_PREV2_TEST_ADD_TU_3_ FORMAT "%6.2" /end CHARACTERISTIC
/begin MEASUREMENT soi_post1_tu "" UWORD _CNV_A_R_LINEAR_____118_CM 1 0. -120. 240. DISPLAY_IDENTIFIER SOI_POST1_TU ECU_ADDRESS 0x7fa0aa BYTE_ORDER MSB_LAST FORMAT "%6.2" /end MEASUREMENT
/begin MEASUREMENT soi_post2_tu "" UWORD _CNV_A_R_LINEAR_____118_CM 1 0. -120. 240. DISPLAY_IDENTIFIER SOI_POST2_TU ECU_ADDRESS 0x7fa0ac BYTE_ORDER MSB_LAST FORMAT "%6.2" /end MEASUREMENT
/begin MEASUREMENT soi_main1_tu "" UWORD _CNV_A_R_LINEAR_____118_CM 1 0. -120. 240. DISPLAY_IDENTIFIER SOI_MAIN1_TU ECU_ADDRESS 0x7fa0a2 BYTE_ORDER MSB_LAST FORMAT "%6.2" /end MEASUREMENT
/begin MEASUREMENT soi_main2_tu "" UWORD _CNV_A_R_LINEAR_____118_CM 1 0. -120. 240. DISPLAY_IDENTIFIER SOI_MAIN2_TU ECU_ADDRESS 0x7fa0a4 BYTE_ORDER MSB_LAST FORMAT "%6.2" /end MEASUREMENT
/begin MEASUREMENT soi_prev2_tu "" UWORD _CNV_A_R_LINEAR_____118_CM 1 0. -120. 240. DISPLAY_IDENTIFIER SOI_PREV2_TU ECU_ADDRESS 0x7fa0a8 BYTE_ORDER MSB_LAST FORMAT "%6.2" /end MEASUREMENT
/begin MEASUREMENT soi_prev1_tu "" UWORD _CNV_A_R_LINEAR_____118_CM 1 0. -120. 240. DISPLAY_IDENTIFIER SOI_PREV1_TU ECU_ADDRESS 0x7fa0a6 BYTE_ORDER MSB_LAST FORMAT "%6.2" /end MEASUREMENT
/begin CHARACTERISTIC lc_soi_post1_tu_on "" VALUE 0x85cea6 _REC_VAL_20_u1 1. _CNV_A_R_LINEAR_____0_CM 0. 1. DISPLAY_IDENTIFIER LC_SOI_POST1_TU_ON FORMAT "%1.0" /end CHARACTERISTIC
/begin CHARACTERISTIC lc_soi_post2_tu_on "" VALUE 0x85cea7 _REC_VAL_20_u1 1. _CNV_A_R_LINEAR_____0_CM 0. 1. DISPLAY_IDENTIFIER LC_SOI_POST2_TU_ON FORMAT "%1.0" /end CHARACTERISTIC
/begin CHARACTERISTIC c_fac_soi_post1_tu "" VALUE 0x85ca02 _REC_VAL_20_u2 1.9999696 _CNV_A_R_LINEAR_____48_CM 0. 1.9999696 DISPLAY_IDENTIFIER C_FAC_SOI_POST1_TU FORMAT "%5.4" /end CHARACTERISTIC
/begin CHARACTERISTIC c_fac_soi_post2_tu "" VALUE 0x85ca04 _REC_VAL_20_u2 1.9999696 _CNV_A_R_LINEAR_____48_CM 0. 1.9999696 DISPLAY_IDENTIFIER C_FAC_SOI_POST2_TU FORMAT "%5.4" /end CHARACTERISTIC
/begin CHARACTERISTIC c_soi_post1_add_tu "" VALUE 0x85cbb8 _REC_VAL_20_s2 720. _CNV_A_R_LINEAR_____119_CM -360. 360. DISPLAY_IDENTIFIER C_SOI_POST1_ADD_TU FORMAT "%6.2" /end CHARACTERISTIC
/begin CHARACTERISTIC c_soi_post2_add_tu "" VALUE 0x85cbc2 _REC_VAL_20_s2 720. _CNV_A_R_LINEAR_____119_CM -360. 360. DISPLAY_IDENTIFIER C_SOI_POST2_ADD_TU FORMAT "%6.2" /end CHARACTERISTIC
/begin CHARACTERISTIC c_soi_post1_add_tu_cyl[0] "" VALUE 0x85cbba _REC_VAL_20_s2 720. _CNV_A_R_LINEAR_____119_CM -360. 360. DISPLAY_IDENTIFIER C_SOI_POST1_ADD_TU_CYL_0_ FORMAT "%6.2" /end CHARACTERISTIC
/begin CHARACTERISTIC c_soi_post1_add_tu_cyl[1] "" VALUE 0x85cbbc _REC_VAL_20_s2 720. _CNV_A_R_LINEAR_____119_CM -360. 360. DISPLAY_IDENTIFIER C_SOI_POST1_ADD_TU_CYL_1_ FORMAT "%6.2" /end CHARACTERISTIC
/begin CHARACTERISTIC c_soi_post1_add_tu_cyl[2] "" VALUE 0x85cbbe _REC_VAL_20_s2 720. _CNV_A_R_LINEAR_____119_CM -360. 360. DISPLAY_IDENTIFIER C_SOI_POST1_ADD_TU_CYL_2_ FORMAT "%6.2" /end CHARACTERISTIC
/begin CHARACTERISTIC c_soi_post1_add_tu_cyl[3] "" VALUE 0x85cbc0 _REC_VAL_20_s2 720. _CNV_A_R_LINEAR_____119_CM -360. 360. DISPLAY_IDENTIFIER C_SOI_POST1_ADD_TU_CYL_3_ FORMAT "%6.2" /end CHARACTERISTIC
/begin CHARACTERISTIC c_soi_post2_add_tu_cyl[0] "" VALUE 0x85cbc4 _REC_VAL_20_s2 720. _CNV_A_R_LINEAR_____119_CM -360. 360. DISPLAY_IDENTIFIER C_SOI_POST2_ADD_TU_CYL_0_ FORMAT "%6.2" /end CHARACTERISTIC
/begin CHARACTERISTIC c_soi_post2_add_tu_cyl[1] "" VALUE 0x85cbc6 _REC_VAL_20_s2 720. _CNV_A_R_LINEAR_____119_CM -360. 360. DISPLAY_IDENTIFIER C_SOI_POST2_ADD_TU_CYL_1_ FORMAT "%6.2" /end CHARACTERISTIC
/begin CHARACTERISTIC c_soi_post2_add_tu_cyl[2] "" VALUE 0x85cbc8 _REC_VAL_20_s2 720. _CNV_A_R_LINEAR_____119_CM -360. 360. DISPLAY_IDENTIFIER C_SOI_POST2_ADD_TU_CYL_2_ FORMAT "%6.2" /end CHARACTERISTIC
/begin CHARACTERISTIC c_soi_post2_add_tu_cyl[3] "" VALUE 0x85cbca _REC_VAL_20_s2 720. _CNV_A_R_LINEAR_____119_CM -360. 360. DISPLAY_IDENTIFIER C_SOI_POST2_ADD_TU_CYL_3_ FORMAT "%6.2" /end CHARACTERISTIC
/begin CHARACTERISTIC c_soi_post1_test_add_tu[0] "" VALUE 0x85021e _REC_VAL_20_s2 720. _CNV_A_R_LINEAR_____119_CM -360. 360. DISPLAY_IDENTIFIER C_SOI_POST1_TEST_ADD_TU_0_ FORMAT "%6.2" /end CHARACTERISTIC
/begin CHARACTERISTIC c_soi_post1_test_add_tu[1] "" VALUE 0x850220 _REC_VAL_20_s2 720. _CNV_A_R_LINEAR_____119_CM -360. 360. DISPLAY_IDENTIFIER C_SOI_POST1_TEST_ADD_TU_1_ FORMAT "%6.2" /end CHARACTERISTIC
/begin CHARACTERISTIC c_soi_post1_test_add_tu[2] "" VALUE 0x850222 _REC_VAL_20_s2 720. _CNV_A_R_LINEAR_____119_CM -360. 360. DISPLAY_IDENTIFIER C_SOI_POST1_TEST_ADD_TU_2_ FORMAT "%6.2" /end CHARACTERISTIC
/begin CHARACTERISTIC c_soi_post1_test_add_tu[3] "" VALUE 0x850224 _REC_VAL_20_s2 720. _CNV_A_R_LINEAR_____119_CM -360. 360. DISPLAY_IDENTIFIER C_SOI_POST1_TEST_ADD_TU_3_ FORMAT "%6.2" /end CHARACTERISTIC
/begin CHARACTERISTIC c_soi_post2_test_add_tu[0] "" VALUE 0x85022e _REC_VAL_20_s2 720. _CNV_A_R_LINEAR_____119_CM -360. 360. DISPLAY_IDENTIFIER C_SOI_POST2_TEST_ADD_TU_0_ FORMAT "%6.2" /end CHARACTERISTIC
/begin CHARACTERISTIC c_soi_post2_test_add_tu[1] "" VALUE 0x850230 _REC_VAL_20_s2 720. _CNV_A_R_LINEAR_____119_CM -360. 360. DISPLAY_IDENTIFIER C_SOI_POST2_TEST_ADD_TU_1_ FORMAT "%6.2" /end CHARACTERISTIC
/begin CHARACTERISTIC c_soi_post2_test_add_tu[2] "" VALUE 0x850232 _REC_VAL_20_s2 720. _CNV_A_R_LINEAR_____119_CM -360. 360. DISPLAY_IDENTIFIER C_SOI_POST2_TEST_ADD_TU_2_ FORMAT "%6.2" /end CHARACTERISTIC
/begin CHARACTERISTIC c_soi_post2_test_add_tu[3] "" VALUE 0x850234 _REC_VAL_20_s2 720. _CNV_A_R_LINEAR_____119_CM -360. 360. DISPLAY_IDENTIFIER C_SOI_POST2_TEST_ADD_TU_3_ FORMAT "%6.2" /end CHARACTERISTIC
/begin AXIS_PTS ldp_n_ip_soi_min_tu_ad_2 "" 0x841da0 n _REC_AXS_20_u2 8160. _CNV_A_R_LINEAR_____5_CM 16 0. 8160. FORMAT "%4.0" /end AXIS_PTS
/begin CHARACTERISTIC ip_soi_min_tu_ad_2_n "SOI tuning of PREV2 if injection adaption is active" CURVE 0x859f88 _REC_CUR_20_u2_u2 360. _CNV_A_R_LINEAR_____118_CM -120. 240. DISPLAY_IDENTIFIER IP_SOI_MIN_TU_AD_2_N FORMAT "%6.2"
 /begin AXIS_DESCR COM_AXIS n _CNV_A_R_LINEAR_____5_CM 16 0. 8160. FORMAT "%4.0" AXIS_PTS_REF ldp_n_ip_soi_min_tu_ad_2 /end AXIS_DESCR
/end CHARACTERISTIC
/begin CHARACTERISTIC ip_soi_main1_inj_test_ad "SOI offset of main1 during adaptation procedure" MAP 0x859b8c _REC_MAP_20_u2_u2_u2 720. _CNV_A_R_LINEAR_____400_CM -360. 360. DISPLAY_IDENTIFIER IP_SOI_MAIN1_INJ_TEST_AD FORMAT "%5.2"
 /begin AXIS_DESCR COM_AXIS n _CNV_A_R_LINEAR_____5_CM 16 0. 6375. FORMAT "%4.0" AXIS_PTS_REF ldp_n_ip_soi_main1_inj_test_ad /end AXIS_DESCR
 /begin AXIS_DESCR COM_AXIS tqi_sp _CNV_A_R_LINEAR_____86_CM 16 -1024. 1023.96875 FORMAT "%6.2" AXIS_PTS_REF ldp_tqi_sp_ip_soi_main1_inj_test_ad /end AXIS_DESCR
/end CHARACTERISTIC
/begin AXIS_PTS ldp_n_ip_soi_main1_inj_test_ad "SOI offset of main1 during adaptation procedure" 0x841d3a n _REC_AXS_20_u2 6375. _CNV_A_R_LINEAR_____5_CM 16 0. 6375. FORMAT "%4.0" /end AXIS_PTS
/begin AXIS_PTS ldp_tqi_sp_ip_soi_main1_inj_test_ad "SOI offset of main1 during adaptation procedure" 0x8428ec tqi_sp _REC_AXS_20_u2 2047.96875 _CNV_A_R_LINEAR_____86_CM 16 -1024. 1023.96875 FORMAT "%6.2" /end AXIS_PTS
/begin MEASUREMENT soi_main1_st "start of injection MAIN1 at start" UWORD _CNV_A_R_LINEAR_____118_CM 1 0. -120. 240. DISPLAY_IDENTIFIER SOI_MAIN1_ST ECU_ADDRESS 0x7fa0ae BYTE_ORDER MSB_LAST FORMAT "%5.2" /end MEASUREMENT
/begin CHARACTERISTIC ip_fac_soi_main1_st_cor_amp "SOIST: AMP correction factor for SOI_MAIN1 at start" CURVE 0x85291a _REC_CUR_20_u2_u2 3.99998471 _CNV_A_R_LINEAR_____59_CM 0. 3.99998471 DISPLAY_IDENTIFIER IP_FAC_SOI_MAIN1_ST_COR_AMP FORMAT "%6.5"
 /begin AXIS_DESCR COM_AXIS amp _CNV_A_R_LINEAR_____45_CM 4 0. 5434. FORMAT "%6.2" AXIS_PTS_REF ldpm_amp_2_inj /end AXIS_DESCR
/end CHARACTERISTIC
/begin CHARACTERISTIC ip_soi_main1_st "SOIST: SOI of injection MAIN1 at start" MAP 0x859d9c _REC_MAP_20_u2_u2_u1 360. _CNV_A_R_LINEAR_____118_CM -120. 240. DISPLAY_IDENTIFIER IP_SOI_MAIN1_ST FORMAT "%5.2"
 /begin AXIS_DESCR COM_AXIS n _CNV_A_R_LINEAR_____5_CM 7 0. 6375. FORMAT "%4.0" AXIS_PTS_REF ldpm_n_3_inj /end AXIS_DESCR
 /begin AXIS_DESCR COM_AXIS tco _CNV_A_R_LINEAR_____18_CM 12 -50. 205. FORMAT "%3.0" AXIS_PTS_REF ldpm_tco_2_inj /end AXIS_DESCR
/end CHARACTERISTIC
/begin CHARACTERISTIC ip_soi_main1_st_cor_amp "SOIST: AMP correction for SOI of injection MAIN1 at start" MAP 0x859e44 _REC_MAP_20_u2_u2_u1 720. _CNV_A_R_LINEAR_____400_CM -360. 360. DISPLAY_IDENTIFIER IP_SOI_MAIN1_ST_COR_AMP FORMAT "%5.2"
 /begin AXIS_DESCR COM_AXIS n _CNV_A_R_LINEAR_____5_CM 4 0. 6375. FORMAT "%4.0" AXIS_PTS_REF ldpm_n_4_inj /end AXIS_DESCR
 /begin AXIS_DESCR COM_AXIS tco _CNV_A_R_LINEAR_____18_CM 6 -50. 205. FORMAT "%3.0" AXIS_PTS_REF ldpm_tco_3_inj /end AXIS_DESCR
/end CHARACTERISTIC
/begin MEASUREMENT soi_main1_is_pl_rgl "SOIST: start of injection MAIN1 at IS/PL" UWORD _CNV_A_R_LINEAR_____118_CM 1 0. -120. 240. DISPLAY_IDENTIFIER SOI_MAIN1_IS_PL_RGL ECU_ADDRESS 0x7fa0b0 BYTE_ORDER MSB_LAST FORMAT "%5.2" /end MEASUREMENT
/begin MEASUREMENT soi_main1_is_pl_cor_sum_rgl "SOIST: sum of corrections on SOI_MAIN1 at IS/P" UWORD _CNV_A_R_LINEAR_____118_CM 1 0. -120. 240. DISPLAY_IDENTIFIER SOI_MAIN1_IS_PL_COR_SUM_RGL ECU_ADDRESS 0x7fa0b2 BYTE_ORDER MSB_LAST FORMAT "%5.2" /end MEASUREMENT
/begin CHARACTERISTIC ip_fac_soi_main1_amp_0_0 "SOIST: amp correction factor for soi_main1 at inj conf 0" CURVE 0x8528f4 _REC_CUR_20_u2_u2 0.9999847412109381 _CNV_A_R_LINEAR_____14_CM 0. 0.9999847412109381 DISPLAY_IDENTIFIER IP_FAC_SOI_MAIN1_AMP_0_0 FORMAT "%6.5"
 /begin AXIS_DESCR COM_AXIS amp _CNV_A_R_LINEAR_____45_CM 8 0. 5434. FORMAT "%6.2" AXIS_PTS_REF ldp_amp_ip_fac_soi_main1_0_0 /end AXIS_DESCR
/end CHARACTERISTIC
/begin AXIS_PTS ldp_amp_ip_fac_soi_main1_0_0 "amp correction factor for soi_main1 at inj conf 0" 0x84125c amp _REC_AXS_20_u2 5434. _CNV_A_R_LINEAR_____45_CM 8 0. 5434. FORMAT "%6.2" /end AXIS_PTS
/begin CHARACTERISTIC ip_fac_soi_main1_amp_1_0 "SOIST: amp correction factor for soi_main1 at inj conf 1" CURVE 0x852904 _REC_CUR_20_u2_u2 0.9999847412109381 _CNV_A_R_LINEAR_____14_CM 0. 0.9999847412109381 DISPLAY_IDENTIFIER IP_FAC_SOI_MAIN1_AMP_1_0 FORMAT "%6.5"
 /begin AXIS_DESCR COM_AXIS amp _CNV_A_R_LINEAR_____45_CM 8 0. 5434. FORMAT "%6.2" AXIS_PTS_REF ldp_amp_ip_fac_soi_main1_1_0 /end AXIS_DESCR
/end CHARACTERISTIC
/begin AXIS_PTS ldp_amp_ip_fac_soi_main1_1_0 "amp correction factor for soi_main1 at inj conf 1" 0x84126e amp _REC_AXS_20_u2 5434. _CNV_A_R_LINEAR_____45_CM 8 0. 5434. FORMAT "%6.2" /end AXIS_PTS
/begin CHARACTERISTIC ip_fac_soi_main1_amp_2_0 "SOIST: amp correction factor for soi_main1 at inj conf 2" CURVE 0x852914 _REC_CUR_20_u2_u2 0.9999847412109381 _CNV_A_R_LINEAR_____14_CM 0. 0.9999847412109381 DISPLAY_IDENTIFIER IP_FAC_SOI_MAIN1_AMP_2_0 FORMAT "%6.5"
 /begin AXIS_DESCR COM_AXIS amp _CNV_A_R_LINEAR_____45_CM 1 0. 5434. FORMAT "%6.2" AXIS_PTS_REF ldp_amp_ip_fac_soi_main1_2_0 /end AXIS_DESCR
/end CHARACTERISTIC
/begin AXIS_PTS ldp_amp_ip_fac_soi_main1_2_0 "amp correction factor for soi_main1 at inj conf 2" 0x841280 amp _REC_AXS_20_u2 5434. _CNV_A_R_LINEAR_____45_CM 1 0. 5434. FORMAT "%6.2" /end AXIS_PTS
/begin CHARACTERISTIC ip_fac_soi_main1_amp_3_0 "SOIST: amp correction factor for soi_main1 at inj conf 3" CURVE 0x852916 _REC_CUR_20_u2_u2 0.9999847412109381 _CNV_A_R_LINEAR_____14_CM 0. 0.9999847412109381 DISPLAY_IDENTIFIER IP_FAC_SOI_MAIN1_AMP_3_0 FORMAT "%6.5"
 /begin AXIS_DESCR COM_AXIS amp _CNV_A_R_LINEAR_____45_CM 1 0. 5434. FORMAT "%6.2" AXIS_PTS_REF ldp_amp_ip_fac_soi_main1_3_0 /end AXIS_DESCR
/end CHARACTERISTIC
/begin AXIS_PTS ldp_amp_ip_fac_soi_main1_3_0 "amp correction factor for soi_main1 at inj conf 3" 0x841284 amp _REC_AXS_20_u2 5434. _CNV_A_R_LINEAR_____45_CM 1 0. 5434. FORMAT "%6.2" /end AXIS_PTS
/begin CHARACTERISTIC ip_fac_soi_main1_amp_4_0 "SOIST: amp correction factor for soi_main1 at inj conf 4" CURVE 0x852918 _REC_CUR_20_u2_u2 0.9999847412109381 _CNV_A_R_LINEAR_____14_CM 0. 0.9999847412109381 DISPLAY_IDENTIFIER IP_FAC_SOI_MAIN1_AMP_4_0 FORMAT "%6.5"
 /begin AXIS_DESCR COM_AXIS amp _CNV_A_R_LINEAR_____45_CM 1 0. 5434. FORMAT "%6.2" AXIS_PTS_REF ldp_amp_ip_fac_soi_main1_4_0 /end AXIS_DESCR
/end CHARACTERISTIC
/begin AXIS_PTS ldp_amp_ip_fac_soi_main1_4_0 "amp correction factor for soi_main1 at inj conf 4" 0x841288 amp _REC_AXS_20_u2 5434. _CNV_A_R_LINEAR_____45_CM 1 0. 5434. FORMAT "%6.2" /end AXIS_PTS
/begin CHARACTERISTIC ip_fac_soi_main1_tgas_0_0 "SOIST: SOI main1 correction dependent on TGAS at inj conf 0" CURVE 0x852948 _REC_CUR_20_u2_u1 0.9999847412109381 _CNV_A_R_LINEAR_____14_CM 0. 0.9999847412109381 DISPLAY_IDENTIFIER IP_FAC_SOI_MAIN1_TGAS_0_0 FORMAT "%6.5"
 /begin AXIS_DESCR COM_AXIS tgas _CNV_A_R_LINEAR_____18_CM 8 -50. 205. FORMAT "%3.0" AXIS_PTS_REF ldp_tgas_ip_fac_soi_main1_0_0 /end AXIS_DESCR
/end CHARACTERISTIC
/begin AXIS_PTS ldp_tgas_ip_fac_soi_main1_0_0 "SOI main1 correction dependent on TGAS at inj conf 0" 0x842522 tgas _REC_AXS_20_u1 255. _CNV_A_R_LINEAR_____18_CM 8 -50. 205. FORMAT "%3.0" /end AXIS_PTS
/begin CHARACTERISTIC ip_fac_soi_main1_tgas_1_0 "SOIST: SOI main1 correction dependent on TGAS at inj conf 1" CURVE 0x852958 _REC_CUR_20_u2_u1 0.9999847412109381 _CNV_A_R_LINEAR_____14_CM 0. 0.9999847412109381 DISPLAY_IDENTIFIER IP_FAC_SOI_MAIN1_TGAS_1_0 FORMAT "%6.5"
 /begin AXIS_DESCR COM_AXIS tgas _CNV_A_R_LINEAR_____18_CM 8 -50. 205. FORMAT "%3.0" AXIS_PTS_REF ldp_tgas_ip_fac_soi_main1_1_0 /end AXIS_DESCR
/end CHARACTERISTIC
/begin AXIS_PTS ldp_tgas_ip_fac_soi_main1_1_0 "SOI main1 correction dependent on TGAS at inj conf 1" 0x84252b tgas _REC_AXS_20_u1 255. _CNV_A_R_LINEAR_____18_CM 8 -50. 205. FORMAT "%3.0" /end AXIS_PTS
/begin CHARACTERISTIC ip_fac_soi_main1_tgas_2_0 "SOIST: SOI main1 correction dependent on TGAS at inj conf 2" CURVE 0x852968 _REC_CUR_20_u2_u1 0.9999847412109381 _CNV_A_R_LINEAR_____14_CM 0. 0.9999847412109381 DISPLAY_IDENTIFIER IP_FAC_SOI_MAIN1_TGAS_2_0 FORMAT "%6.5"
 /begin AXIS_DESCR COM_AXIS tgas _CNV_A_R_LINEAR_____18_CM 1 -50. 205. FORMAT "%3.0" AXIS_PTS_REF ldp_tgas_ip_fac_soi_main1_2_0 /end AXIS_DESCR
/end CHARACTERISTIC
/begin AXIS_PTS ldp_tgas_ip_fac_soi_main1_2_0 "SOI main1 correction dependent on TGAS at inj conf 2" 0x842534 tgas _REC_AXS_20_u1 255. _CNV_A_R_LINEAR_____18_CM 1 -50. 205. FORMAT "%3.0" /end AXIS_PTS
/begin CHARACTERISTIC ip_fac_soi_main1_tgas_3_0 "SOIST: SOI main1 correction dependent on TGAS at inj conf 3" CURVE 0x85296a _REC_CUR_20_u2_u1 0.9999847412109381 _CNV_A_R_LINEAR_____14_CM 0. 0.9999847412109381 DISPLAY_IDENTIFIER IP_FAC_SOI_MAIN1_TGAS_3_0 FORMAT "%6.5"
 /begin AXIS_DESCR COM_AXIS tgas _CNV_A_R_LINEAR_____18_CM 1 -50. 205. FORMAT "%3.0" AXIS_PTS_REF ldp_tgas_ip_fac_soi_main1_3_0 /end AXIS_DESCR
/end CHARACTERISTIC
/begin AXIS_PTS ldp_tgas_ip_fac_soi_main1_3_0 "SOI main1 correction dependent on TGAS at inj conf 3" 0x842536 tgas _REC_AXS_20_u1 255. _CNV_A_R_LINEAR_____18_CM 1 -50. 205. FORMAT "%3.0" /end AXIS_PTS
/begin CHARACTERISTIC ip_fac_soi_main1_tgas_4_0 "SOIST: SOI main1 correction dependent on TGAS at inj conf 4" CURVE 0x85296c _REC_CUR_20_u2_u1 0.9999847412109381 _CNV_A_R_LINEAR_____14_CM 0. 0.9999847412109381 DISPLAY_IDENTIFIER IP_FAC_SOI_MAIN1_TGAS_4_0 FORMAT "%6.5"
 /begin AXIS_DESCR COM_AXIS tgas _CNV_A_R_LINEAR_____18_CM 1 -50. 205. FORMAT "%3.0" AXIS_PTS_REF ldp_tgas_ip_fac_soi_main1_4_0 /end AXIS_DESCR
/end CHARACTERISTIC
/begin AXIS_PTS ldp_tgas_ip_fac_soi_main1_4_0 "SOI main1 correction dependent on TGAS at inj conf 4" 0x842538 tgas _REC_AXS_20_u1 255. _CNV_A_R_LINEAR_____18_CM 1 -50. 205. FORMAT "%3.0" /end AXIS_PTS
/begin CHARACTERISTIC ip_fac_soi_main1_tco_0_0 "SOIST: SOI interpolation dependent on TCO at inj conf 0" CURVE 0x852922 _REC_CUR_20_u2_u1 1.9999696 _CNV_A_R_LINEAR_____48_CM 0. 1.9999696 DISPLAY_IDENTIFIER IP_FAC_SOI_MAIN1_TCO_0_0 FORMAT "%6.5"
 /begin AXIS_DESCR COM_AXIS tco _CNV_A_R_LINEAR_____18_CM 8 -50. 205. FORMAT "%3.0" AXIS_PTS_REF ldp_tco_ip_fac_soi_main1_0_0 /end AXIS_DESCR
/end CHARACTERISTIC
/begin AXIS_PTS ldp_tco_ip_fac_soi_main1_0_0 "SOI interpolation dependent on TCO at inj conf 0" 0x8422e9 tco _REC_AXS_20_u1 255. _CNV_A_R_LINEAR_____18_CM 8 -50. 205. FORMAT "%3.0" /end AXIS_PTS
/begin CHARACTERISTIC ip_fac_soi_main1_tco_1_0 "SOIST: SOI interpolation dependent on TCO at inj conf 1" CURVE 0x852932 _REC_CUR_20_u2_u1 1.9999696 _CNV_A_R_LINEAR_____48_CM 0. 1.9999696 DISPLAY_IDENTIFIER IP_FAC_SOI_MAIN1_TCO_1_0 FORMAT "%6.5"
 /begin AXIS_DESCR COM_AXIS tco _CNV_A_R_LINEAR_____18_CM 8 -50. 205. FORMAT "%3.0" AXIS_PTS_REF ldp_tco_ip_fac_soi_main1_1_0 /end AXIS_DESCR
/end CHARACTERISTIC
/begin AXIS_PTS ldp_tco_ip_fac_soi_main1_1_0 "SOI interpolation dependent on TCO at inj conf 1" 0x8422f2 tco _REC_AXS_20_u1 255. _CNV_A_R_LINEAR_____18_CM 8 -50. 205. FORMAT "%3.0" /end AXIS_PTS
/begin CHARACTERISTIC ip_fac_soi_main1_tco_2_0 "SOIST: SOI interpolation dependent on TCO at inj conf 2" CURVE 0x852942 _REC_CUR_20_u2_u1 1.9999696 _CNV_A_R_LINEAR_____48_CM 0. 1.9999696 DISPLAY_IDENTIFIER IP_FAC_SOI_MAIN1_TCO_2_0 FORMAT "%6.5"
 /begin AXIS_DESCR COM_AXIS tco _CNV_A_R_LINEAR_____18_CM 1 -50. 205. FORMAT "%3.0" AXIS_PTS_REF ldp_tco_ip_fac_soi_main1_2_0 /end AXIS_DESCR
/end CHARACTERISTIC
/begin AXIS_PTS ldp_tco_ip_fac_soi_main1_2_0 "SOI interpolation dependent on TCO at inj conf 2" 0x8422fb tco _REC_AXS_20_u1 255. _CNV_A_R_LINEAR_____18_CM 1 -50. 205. FORMAT "%3.0" /end AXIS_PTS
/begin CHARACTERISTIC ip_fac_soi_main1_tco_3_0 "SOIST: SOI interpolation dependent on TCO at inj conf 3" CURVE 0x852944 _REC_CUR_20_u2_u1 1.9999696 _CNV_A_R_LINEAR_____48_CM 0. 1.9999696 DISPLAY_IDENTIFIER IP_FAC_SOI_MAIN1_TCO_3_0 FORMAT "%6.5"
 /begin AXIS_DESCR COM_AXIS tco _CNV_A_R_LINEAR_____18_CM 1 -50. 205. FORMAT "%3.0" AXIS_PTS_REF ldp_tco_ip_fac_soi_main1_3_0 /end AXIS_DESCR
/end CHARACTERISTIC
/begin AXIS_PTS ldp_tco_ip_fac_soi_main1_3_0 "SOI interpolation dependent on TCO at inj conf 3" 0x8422fd tco _REC_AXS_20_u1 255. _CNV_A_R_LINEAR_____18_CM 1 -50. 205. FORMAT "%3.0" /end AXIS_PTS
/begin CHARACTERISTIC ip_fac_soi_main1_tco_4_0 "SOIST: SOI interpolation dependent on TCO at inj conf 4" CURVE 0x852946 _REC_CUR_20_u2_u1 1.9999696 _CNV_A_R_LINEAR_____48_CM 0. 1.9999696 DISPLAY_IDENTIFIER IP_FAC_SOI_MAIN1_TCO_4_0 FORMAT "%6.5"
 /begin AXIS_DESCR COM_AXIS tco _CNV_A_R_LINEAR_____18_CM 1 -50. 205. FORMAT "%3.0" AXIS_PTS_REF ldp_tco_ip_fac_soi_main1_4_0 /end AXIS_DESCR
/end CHARACTERISTIC
/begin AXIS_PTS ldp_tco_ip_fac_soi_main1_4_0 "SOI interpolation dependent on TCO at inj conf 4" 0x8422ff tco _REC_AXS_20_u1 255. _CNV_A_R_LINEAR_____18_CM 1 -50. 205. FORMAT "%3.0" /end AXIS_PTS
/begin CHARACTERISTIC ip_soi_main1_0_0 "SOIST: SOI of main injection at inj conf 0 and temp level 0" MAP 0x858270 _REC_MAP_20_u2_u2_u2 360. _CNV_A_R_LINEAR_____118_CM -120. 240. DISPLAY_IDENTIFIER IP_SOI_MAIN1_0_0 FORMAT "%5.2"
 /begin AXIS_DESCR COM_AXIS n _CNV_A_R_LINEAR_____5_CM 16 0. 6375. FORMAT "%4.0" AXIS_PTS_REF ldpm_n_1_ip_soi_main1_0_0 /end AXIS_DESCR
 /begin AXIS_DESCR COM_AXIS tqi_sp _CNV_A_R_LINEAR_____86_CM 16 -1024. 1023.96875 FORMAT "%6.2" AXIS_PTS_REF ldpm_tqi_sp_1_ip_soi_0_0 /end AXIS_DESCR
/end CHARACTERISTIC
/begin AXIS_PTS ldpm_n_1_ip_soi_main1_0_0 "SOI of main injection at inj conf 0 and temp level 0" 0x842dca n _REC_AXS_20_u2 6375. _CNV_A_R_LINEAR_____5_CM 16 0. 6375. FORMAT "%4.0" /end AXIS_PTS
/begin AXIS_PTS ldpm_tqi_sp_1_ip_soi_0_0 "SOI of main injection at inj conf 0 and temp level 0" 0x843bba tqi_sp _REC_AXS_20_u2 2047.96875 _CNV_A_R_LINEAR_____86_CM 16 -1024. 1023.96875 FORMAT "%6.2" /end AXIS_PTS
/begin CHARACTERISTIC ip_soi_main1_0_1 "SOIST: SOI of main injection at inj conf 0 and temp level 1" MAP 0x858470 _REC_MAP_20_u2_u2_u2 360. _CNV_A_R_LINEAR_____118_CM -120. 240. DISPLAY_IDENTIFIER IP_SOI_MAIN1_0_1 FORMAT "%5.2"
 /begin AXIS_DESCR COM_AXIS n _CNV_A_R_LINEAR_____5_CM 16 0. 6375. FORMAT "%4.0" AXIS_PTS_REF ldpm_n_1_ip_soi_main1_0_0 /end AXIS_DESCR
 /begin AXIS_DESCR COM_AXIS tqi_sp _CNV_A_R_LINEAR_____86_CM 16 -1024. 1023.96875 FORMAT "%6.2" AXIS_PTS_REF ldpm_tqi_sp_1_ip_soi_0_0 /end AXIS_DESCR
/end CHARACTERISTIC
/begin CHARACTERISTIC ip_soi_main1_0_2 "SOIST: SOI of main injection at inj conf 0 and temp level 2" MAP 0x858670 _REC_MAP_20_u2_u2_u2 360. _CNV_A_R_LINEAR_____118_CM -120. 240. DISPLAY_IDENTIFIER IP_SOI_MAIN1_0_2 FORMAT "%5.2"
 /begin AXIS_DESCR COM_AXIS n _CNV_A_R_LINEAR_____5_CM 16 0. 6375. FORMAT "%4.0" AXIS_PTS_REF ldpm_n_1_ip_soi_main1_0_0 /end AXIS_DESCR
 /begin AXIS_DESCR COM_AXIS tqi_sp _CNV_A_R_LINEAR_____86_CM 16 -1024. 1023.96875 FORMAT "%6.2" AXIS_PTS_REF ldpm_tqi_sp_1_ip_soi_0_0 /end AXIS_DESCR
/end CHARACTERISTIC
/begin CHARACTERISTIC ip_soi_main1_1_0 "SOIST: SOI of main injection at inj conf 1 and temp level 0" MAP 0x858870 _REC_MAP_20_u2_u2_u2 360. _CNV_A_R_LINEAR_____118_CM -120. 240. DISPLAY_IDENTIFIER IP_SOI_MAIN1_1_0 FORMAT "%5.2"
 /begin AXIS_DESCR COM_AXIS n _CNV_A_R_LINEAR_____5_CM 16 0. 6375. FORMAT "%4.0" AXIS_PTS_REF ldpm_n_1_ip_soi_main1_1_0 /end AXIS_DESCR
 /begin AXIS_DESCR COM_AXIS tqi_sp _CNV_A_R_LINEAR_____86_CM 16 -1024. 1023.96875 FORMAT "%6.2" AXIS_PTS_REF ldpm_tqi_sp_1_ip_soi_1_0 /end AXIS_DESCR
/end CHARACTERISTIC
/begin AXIS_PTS ldpm_n_1_ip_soi_main1_1_0 "SOI of main injection at inj conf 1 and temp level 0" 0x842dec n _REC_AXS_20_u2 6375. _CNV_A_R_LINEAR_____5_CM 16 0. 6375. FORMAT "%4.0" /end AXIS_PTS
/begin AXIS_PTS ldpm_tqi_sp_1_ip_soi_1_0 "SOI of main injection at inj conf 1 and temp level 0" 0x843bdc tqi_sp _REC_AXS_20_u2 2047.96875 _CNV_A_R_LINEAR_____86_CM 16 -1024. 1023.96875 FORMAT "%6.2" /end AXIS_PTS
/begin CHARACTERISTIC ip_soi_main1_1_1 "SOIST: SOI of main injection at inj conf 1 and temp level 1" MAP 0x858a70 _REC_MAP_20_u2_u2_u2 360. _CNV_A_R_LINEAR_____118_CM -120. 240. DISPLAY_IDENTIFIER IP_SOI_MAIN1_1_1 FORMAT "%5.2"
 /begin AXIS_DESCR COM_AXIS n _CNV_A_R_LINEAR_____5_CM 16 0. 6375. FORMAT "%4.0" AXIS_PTS_REF ldpm_n_1_ip_soi_main1_1_0 /end AXIS_DESCR
 /begin AXIS_DESCR COM_AXIS tqi_sp _CNV_A_R_LINEAR_____86_CM 16 -1024. 1023.96875 FORMAT "%6.2" AXIS_PTS_REF ldpm_tqi_sp_1_ip_soi_1_0 /end AXIS_DESCR
/end CHARACTERISTIC
/begin CHARACTERISTIC ip_soi_main1_1_2 "SOIST: SOI of main injection at inj conf 1 and temp level 2" MAP 0x858c70 _REC_MAP_20_u2_u2_u2 360. _CNV_A_R_LINEAR_____118_CM -120. 240. DISPLAY_IDENTIFIER IP_SOI_MAIN1_1_2 FORMAT "%5.2"
 /begin AXIS_DESCR COM_AXIS n _CNV_A_R_LINEAR_____5_CM 16 0. 6375. FORMAT "%4.0" AXIS_PTS_REF ldpm_n_1_ip_soi_main1_1_0 /end AXIS_DESCR
 /begin AXIS_DESCR COM_AXIS tqi_sp _CNV_A_R_LINEAR_____86_CM 16 -1024. 1023.96875 FORMAT "%6.2" AXIS_PTS_REF ldpm_tqi_sp_1_ip_soi_1_0 /end AXIS_DESCR
/end CHARACTERISTIC
/begin CHARACTERISTIC ip_soi_main1_2_0 "SOIST: SOI of main injection at inj conf 2 and temp level 0" MAP 0x858e70 _REC_MAP_20_u2_u2_u2 360. _CNV_A_R_LINEAR_____118_CM -120. 240. DISPLAY_IDENTIFIER IP_SOI_MAIN1_2_0 FORMAT "%5.2"
 /begin AXIS_DESCR COM_AXIS n _CNV_A_R_LINEAR_____5_CM 16 0. 6375. FORMAT "%4.0" AXIS_PTS_REF ldpm_n_1_ip_soi_main1_2_0 /end AXIS_DESCR
 /begin AXIS_DESCR COM_AXIS tqi_sp _CNV_A_R_LINEAR_____86_CM 16 -1024. 1023.96875 FORMAT "%6.2" AXIS_PTS_REF ldpm_tqi_sp_1_ip_soi_2_0 /end AXIS_DESCR
/end CHARACTERISTIC
/begin AXIS_PTS ldpm_n_1_ip_soi_main1_2_0 "SOI of main injection at inj conf 2 and temp level 0" 0x842e0e n _REC_AXS_20_u2 6375. _CNV_A_R_LINEAR_____5_CM 16 0. 6375. FORMAT "%4.0" /end AXIS_PTS
/begin AXIS_PTS ldp_n_1_ip_soi_main1_2_0_x "SOI of main injection at inj conf 2 and temp level 0" 0x8418fc n _REC_AXS_20_u2 6375. _CNV_A_R_LINEAR_____5_CM 1 0. 6375. FORMAT "%4.0" /end AXIS_PTS
/begin AXIS_PTS ldpm_tqi_sp_1_ip_soi_2_0 "SOI of main injection at inj conf 2 and temp level 0" 0x843bfe tqi_sp _REC_AXS_20_u2 2047.96875 _CNV_A_R_LINEAR_____86_CM 16 -1024. 1023.96875 FORMAT "%6.2" /end AXIS_PTS
/begin AXIS_PTS ldp_tqi_sp_1_ip_soi_2_0_x "SOI of main injection at inj conf 2 and temp level 0" 0x8427a4 tqi_sp _REC_AXS_20_u2 2047.96875 _CNV_A_R_LINEAR_____86_CM 1 -1024. 1023.96875 FORMAT "%6.2" /end AXIS_PTS
/begin CHARACTERISTIC ip_soi_main1_2_1 "SOIST: SOI of main injection at inj conf 2 and temp level 1" MAP 0x859070 _REC_MAP_20_u2_u2_u2 360. _CNV_A_R_LINEAR_____118_CM -120. 240. DISPLAY_IDENTIFIER IP_SOI_MAIN1_2_1 FORMAT "%5.2"
 /begin AXIS_DESCR COM_AXIS n _CNV_A_R_LINEAR_____5_CM 16 0. 6375. FORMAT "%4.0" AXIS_PTS_REF ldpm_n_1_ip_soi_main1_2_0 /end AXIS_DESCR
 /begin AXIS_DESCR COM_AXIS tqi_sp _CNV_A_R_LINEAR_____86_CM 16 -1024. 1023.96875 FORMAT "%6.2" AXIS_PTS_REF ldpm_tqi_sp_1_ip_soi_2_0 /end AXIS_DESCR
/end CHARACTERISTIC
/begin CHARACTERISTIC ip_soi_main1_2_2 "SOIST: SOI of main injection at inj conf 2 and temp level 2" MAP 0x859270 _REC_MAP_20_u2_u2_u2 360. _CNV_A_R_LINEAR_____118_CM -120. 240. DISPLAY_IDENTIFIER IP_SOI_MAIN1_2_2 FORMAT "%5.2"
 /begin AXIS_DESCR COM_AXIS n _CNV_A_R_LINEAR_____5_CM 1 0. 6375. FORMAT "%4.0" AXIS_PTS_REF ldp_n_1_ip_soi_main1_2_0_x /end AXIS_DESCR
 /begin AXIS_DESCR COM_AXIS tqi_sp _CNV_A_R_LINEAR_____86_CM 1 -1024. 1023.96875 FORMAT "%6.2" AXIS_PTS_REF ldp_tqi_sp_1_ip_soi_2_0_x /end AXIS_DESCR
/end CHARACTERISTIC
/begin CHARACTERISTIC ip_soi_main1_3_0 "SOIST: SOI of main injection at inj conf 3 and temp level 0" MAP 0x859272 _REC_MAP_20_u2_u2_u2 360. _CNV_A_R_LINEAR_____118_CM -120. 240. DISPLAY_IDENTIFIER IP_SOI_MAIN1_3_0 FORMAT "%5.2"
 /begin AXIS_DESCR COM_AXIS n _CNV_A_R_LINEAR_____5_CM 16 0. 6375. FORMAT "%4.0" AXIS_PTS_REF ldpm_n_1_ip_soi_main1_3_0 /end AXIS_DESCR
 /begin AXIS_DESCR COM_AXIS tqi_sp _CNV_A_R_LINEAR_____86_CM 16 -1024. 1023.96875 FORMAT "%6.2" AXIS_PTS_REF ldpm_tqi_sp_1_ip_soi_3_0 /end AXIS_DESCR
/end CHARACTERISTIC
/begin AXIS_PTS ldpm_n_1_ip_soi_main1_3_0 "SOI of main injection at inj conf 3 and temp level 0" 0x842e30 n _REC_AXS_20_u2 6375. _CNV_A_R_LINEAR_____5_CM 16 0. 6375. FORMAT "%4.0" /end AXIS_PTS
/begin AXIS_PTS ldp_n_1_ip_soi_main1_3_0_x "SOI of main injection at inj conf 3 and temp level 0" 0x841900 n _REC_AXS_20_u2 6375. _CNV_A_R_LINEAR_____5_CM 1 0. 6375. FORMAT "%4.0" /end AXIS_PTS
/begin AXIS_PTS ldpm_tqi_sp_1_ip_soi_3_0 "SOI of main injection at inj conf 3 and temp level 0" 0x843c20 tqi_sp _REC_AXS_20_u2 2047.96875 _CNV_A_R_LINEAR_____86_CM 16 -1024. 1023.96875 FORMAT "%6.2" /end AXIS_PTS
/begin AXIS_PTS ldp_tqi_sp_1_ip_soi_3_0_x "SOI of main injection at inj conf 3 and temp level 0" 0x8427a8 tqi_sp _REC_AXS_20_u2 2047.96875 _CNV_A_R_LINEAR_____86_CM 1 -1024. 1023.96875 FORMAT "%6.2" /end AXIS_PTS
/begin CHARACTERISTIC ip_soi_main1_3_1 "SOIST: SOI of main injection at inj conf 3 and temp level 1" MAP 0x859472 _REC_MAP_20_u2_u2_u2 360. _CNV_A_R_LINEAR_____118_CM -120. 240. DISPLAY_IDENTIFIER IP_SOI_MAIN1_3_1 FORMAT "%5.2"
 /begin AXIS_DESCR COM_AXIS n _CNV_A_R_LINEAR_____5_CM 16 0. 6375. FORMAT "%4.0" AXIS_PTS_REF ldpm_n_1_ip_soi_main1_3_0 /end AXIS_DESCR
 /begin AXIS_DESCR COM_AXIS tqi_sp _CNV_A_R_LINEAR_____86_CM 16 -1024. 1023.96875 FORMAT "%6.2" AXIS_PTS_REF ldpm_tqi_sp_1_ip_soi_3_0 /end AXIS_DESCR
/end CHARACTERISTIC
/begin CHARACTERISTIC ip_soi_main1_3_2 "SOIST: SOI of main injection at inj conf 3 and temp level 2" MAP 0x859672 _REC_MAP_20_u2_u2_u2 360. _CNV_A_R_LINEAR_____118_CM -120. 240. DISPLAY_IDENTIFIER IP_SOI_MAIN1_3_2 FORMAT "%5.2"
 /begin AXIS_DESCR COM_AXIS n _CNV_A_R_LINEAR_____5_CM 1 0. 6375. FORMAT "%4.0" AXIS_PTS_REF ldp_n_1_ip_soi_main1_3_0_x /end AXIS_DESCR
 /begin AXIS_DESCR COM_AXIS tqi_sp _CNV_A_R_LINEAR_____86_CM 1 -1024. 1023.96875 FORMAT "%6.2" AXIS_PTS_REF ldp_tqi_sp_1_ip_soi_3_0_x /end AXIS_DESCR
/end CHARACTERISTIC
/begin CHARACTERISTIC ip_soi_main1_4_0 "SOIST: SOI of main injection at inj conf 4 and temp level 0" MAP 0x859674 _REC_MAP_20_u2_u2_u2 360. _CNV_A_R_LINEAR_____118_CM -120. 240. DISPLAY_IDENTIFIER IP_SOI_MAIN1_4_0 FORMAT "%5.2"
 /begin AXIS_DESCR COM_AXIS n _CNV_A_R_LINEAR_____5_CM 16 0. 6375. FORMAT "%4.0" AXIS_PTS_REF ldpm_n_1_ip_soi_main1_4_0 /end AXIS_DESCR
 /begin AXIS_DESCR COM_AXIS tqi_sp _CNV_A_R_LINEAR_____86_CM 16 -1024. 1023.96875 FORMAT "%6.2" AXIS_PTS_REF ldpm_tqi_sp_1_ip_soi_4_0 /end AXIS_DESCR
/end CHARACTERISTIC
/begin AXIS_PTS ldpm_n_1_ip_soi_main1_4_0 "SOI of main injection at inj conf 4 and temp level 0" 0x842e52 n _REC_AXS_20_u2 6375. _CNV_A_R_LINEAR_____5_CM 16 0. 6375. FORMAT "%4.0" /end AXIS_PTS
/begin AXIS_PTS ldp_n_1_ip_soi_main1_4_0_x "SOI of main injection at inj conf 4 and temp level 0" 0x841904 n _REC_AXS_20_u2 6375. _CNV_A_R_LINEAR_____5_CM 1 0. 6375. FORMAT "%4.0" /end AXIS_PTS
/begin AXIS_PTS ldpm_tqi_sp_1_ip_soi_4_0 "SOI of main injection at inj conf 4 and temp level 0" 0x843c42 tqi_sp _REC_AXS_20_u2 2047.96875 _CNV_A_R_LINEAR_____86_CM 16 -1024. 1023.96875 FORMAT "%6.2" /end AXIS_PTS
/begin AXIS_PTS ldp_tqi_sp_1_ip_soi_4_0_x "SOI of main injection at inj conf 4 and temp level 0" 0x8427ac tqi_sp _REC_AXS_20_u2 2047.96875 _CNV_A_R_LINEAR_____86_CM 1 -1024. 1023.96875 FORMAT "%6.2" /end AXIS_PTS
/begin CHARACTERISTIC ip_soi_main1_4_1 "SOIST: SOI of main injection at inj conf 4 and temp level 1" MAP 0x859874 _REC_MAP_20_u2_u2_u2 360. _CNV_A_R_LINEAR_____118_CM -120. 240. DISPLAY_IDENTIFIER IP_SOI_MAIN1_4_1 FORMAT "%5.2"
 /begin AXIS_DESCR COM_AXIS n _CNV_A_R_LINEAR_____5_CM 16 0. 6375. FORMAT "%4.0" AXIS_PTS_REF ldpm_n_1_ip_soi_main1_4_0 /end AXIS_DESCR
 /begin AXIS_DESCR COM_AXIS tqi_sp _CNV_A_R_LINEAR_____86_CM 16 -1024. 1023.96875 FORMAT "%6.2" AXIS_PTS_REF ldpm_tqi_sp_1_ip_soi_4_0 /end AXIS_DESCR
/end CHARACTERISTIC
/begin CHARACTERISTIC ip_soi_main1_4_2 "SOIST: SOI of main injection at inj conf 4 and temp level 2" MAP 0x859a74 _REC_MAP_20_u2_u2_u2 360. _CNV_A_R_LINEAR_____118_CM -120. 240. DISPLAY_IDENTIFIER IP_SOI_MAIN1_4_2 FORMAT "%5.2"
 /begin AXIS_DESCR COM_AXIS n _CNV_A_R_LINEAR_____5_CM 1 0. 6375. FORMAT "%4.0" AXIS_PTS_REF ldp_n_1_ip_soi_main1_4_0_x /end AXIS_DESCR
 /begin AXIS_DESCR COM_AXIS tqi_sp _CNV_A_R_LINEAR_____86_CM 1 -1024. 1023.96875 FORMAT "%6.2" AXIS_PTS_REF ldp_tqi_sp_1_ip_soi_4_0_x /end AXIS_DESCR
/end CHARACTERISTIC
/begin CHARACTERISTIC ip_soi_main1_amp_0_0 "SOIST: ambient pressure correction of SOI_MAIN1 at inj conf 0" MAP 0x859a76 _REC_MAP_20_u2_u2_u2 720. _CNV_A_R_LINEAR_____400_CM -360. 360. DISPLAY_IDENTIFIER IP_SOI_MAIN1_AMP_0_0 FORMAT "%5.2"
 /begin AXIS_DESCR COM_AXIS n _CNV_A_R_LINEAR_____5_CM 8 0. 6375. FORMAT "%4.0" AXIS_PTS_REF ldp_n_ip_soi_amp_0_0 /end AXIS_DESCR
 /begin AXIS_DESCR COM_AXIS tqi_sp _CNV_A_R_LINEAR_____86_CM 8 -1024. 1023.96875 FORMAT "%6.2" AXIS_PTS_REF ldp_tqi_sp_ip_soi_amp_0_0 /end AXIS_DESCR
/end CHARACTERISTIC
/begin AXIS_PTS ldp_n_ip_soi_amp_0_0 "ambient pressure correction of SOI_MAIN1 at inj conf 0" 0x841cf8 n _REC_AXS_20_u2 6375. _CNV_A_R_LINEAR_____5_CM 8 0. 6375. FORMAT "%4.0" /end AXIS_PTS
/begin AXIS_PTS ldp_tqi_sp_ip_soi_amp_0_0 "ambient pressure correction of SOI_MAIN1 at inj conf 0" 0x8428bc tqi_sp _REC_AXS_20_u2 2047.96875 _CNV_A_R_LINEAR_____86_CM 8 -1024. 1023.96875 FORMAT "%6.2" /end AXIS_PTS
/begin CHARACTERISTIC ip_soi_main1_amp_1_0 "SOIST: ambient pressure correction of SOI_MAIN1 at inj conf 1" MAP 0x859af6 _REC_MAP_20_u2_u2_u2 720. _CNV_A_R_LINEAR_____400_CM -360. 360. DISPLAY_IDENTIFIER IP_SOI_MAIN1_AMP_1_0 FORMAT "%5.2"
 /begin AXIS_DESCR COM_AXIS n _CNV_A_R_LINEAR_____5_CM 8 0. 6375. FORMAT "%4.0" AXIS_PTS_REF ldp_n_ip_soi_amp_1_0 /end AXIS_DESCR
 /begin AXIS_DESCR COM_AXIS tqi_sp _CNV_A_R_LINEAR_____86_CM 8 -1024. 1023.96875 FORMAT "%6.2" AXIS_PTS_REF ldp_tqi_sp_ip_soi_amp_1_0 /end AXIS_DESCR
/end CHARACTERISTIC
/begin AXIS_PTS ldp_n_ip_soi_amp_1_0 "ambient pressure correction of SOI_MAIN1 at inj conf 1" 0x841d0a n _REC_AXS_20_u2 6375. _CNV_A_R_LINEAR_____5_CM 8 0. 6375. FORMAT "%4.0" /end AXIS_PTS
/begin AXIS_PTS ldp_tqi_sp_ip_soi_amp_1_0 "ambient pressure correction of SOI_MAIN1 at inj conf 1" 0x8428ce tqi_sp _REC_AXS_20_u2 2047.96875 _CNV_A_R_LINEAR_____86_CM 8 -1024. 1023.96875 FORMAT "%6.2" /end AXIS_PTS
/begin CHARACTERISTIC ip_soi_main1_amp_2_0 "SOIST: ambient pressure correction of SOI_MAIN1 at inj conf 2" MAP 0x859b76 _REC_MAP_20_u2_u2_u2 720. _CNV_A_R_LINEAR_____400_CM -360. 360. DISPLAY_IDENTIFIER IP_SOI_MAIN1_AMP_2_0 FORMAT "%5.2"
 /begin AXIS_DESCR COM_AXIS n _CNV_A_R_LINEAR_____5_CM 1 0. 6375. FORMAT "%4.0" AXIS_PTS_REF ldp_n_ip_soi_amp_2_0 /end AXIS_DESCR
 /begin AXIS_DESCR COM_AXIS tqi_sp _CNV_A_R_LINEAR_____86_CM 1 -1024. 1023.96875 FORMAT "%6.2" AXIS_PTS_REF ldp_tqi_sp_ip_soi_amp_2_0 /end AXIS_DESCR
/end CHARACTERISTIC
/begin AXIS_PTS ldp_n_ip_soi_amp_2_0 "ambient pressure correction of SOI_MAIN1 at inj conf 2" 0x841d1c n _REC_AXS_20_u2 6375. _CNV_A_R_LINEAR_____5_CM 1 0. 6375. FORMAT "%4.0" /end AXIS_PTS
/begin AXIS_PTS ldp_tqi_sp_ip_soi_amp_2_0 "ambient pressure correction of SOI_MAIN1 at inj conf 2" 0x8428e0 tqi_sp _REC_AXS_20_u2 2047.96875 _CNV_A_R_LINEAR_____86_CM 1 -1024. 1023.96875 FORMAT "%6.2" /end AXIS_PTS
/begin CHARACTERISTIC ip_soi_main1_amp_3_0 "SOIST: ambient pressure correction of SOI_MAIN1 at inj conf 3" MAP 0x859b78 _REC_MAP_20_u2_u2_u2 720. _CNV_A_R_LINEAR_____400_CM -360. 360. DISPLAY_IDENTIFIER IP_SOI_MAIN1_AMP_3_0 FORMAT "%5.2"
 /begin AXIS_DESCR COM_AXIS n _CNV_A_R_LINEAR_____5_CM 1 0. 6375. FORMAT "%4.0" AXIS_PTS_REF ldp_n_ip_soi_amp_3_0 /end AXIS_DESCR
 /begin AXIS_DESCR COM_AXIS tqi_sp _CNV_A_R_LINEAR_____86_CM 1 -1024. 1023.96875 FORMAT "%6.2" AXIS_PTS_REF ldp_tqi_sp_ip_soi_amp_3_0 /end AXIS_DESCR
/end CHARACTERISTIC
/begin AXIS_PTS ldp_n_ip_soi_amp_3_0 "ambient pressure correction of SOI_MAIN1 at inj conf 3" 0x841d20 n _REC_AXS_20_u2 6375. _CNV_A_R_LINEAR_____5_CM 1 0. 6375. FORMAT "%4.0" /end AXIS_PTS
/begin AXIS_PTS ldp_tqi_sp_ip_soi_amp_3_0 "ambient pressure correction of SOI_MAIN1 at inj conf 3" 0x8428e4 tqi_sp _REC_AXS_20_u2 2047.96875 _CNV_A_R_LINEAR_____86_CM 1 -1024. 1023.96875 FORMAT "%6.2" /end AXIS_PTS
/begin CHARACTERISTIC ip_soi_main1_amp_4_0 "SOIST: ambient pressure correction of SOI_MAIN1 at inj conf 4" MAP 0x859b7a _REC_MAP_20_u2_u2_u2 720. _CNV_A_R_LINEAR_____400_CM -360. 360. DISPLAY_IDENTIFIER IP_SOI_MAIN1_AMP_4_0 FORMAT "%5.2"
 /begin AXIS_DESCR COM_AXIS n _CNV_A_R_LINEAR_____5_CM 1 0. 6375. FORMAT "%4.0" AXIS_PTS_REF ldp_n_ip_soi_amp_4_0 /end AXIS_DESCR
 /begin AXIS_DESCR COM_AXIS tqi_sp _CNV_A_R_LINEAR_____86_CM 1 -1024. 1023.96875 FORMAT "%6.2" AXIS_PTS_REF ldp_tqi_sp_ip_soi_amp_4_0 /end AXIS_DESCR
/end CHARACTERISTIC
/begin AXIS_PTS ldp_n_ip_soi_amp_4_0 "ambient pressure correction of SOI_MAIN1 at inj conf 4" 0x841d24 n _REC_AXS_20_u2 6375. _CNV_A_R_LINEAR_____5_CM 1 0. 6375. FORMAT "%4.0" /end AXIS_PTS
/begin AXIS_PTS ldp_tqi_sp_ip_soi_amp_4_0 "ambient pressure correction of SOI_MAIN1 at inj conf 4" 0x8428e8 tqi_sp _REC_AXS_20_u2 2047.96875 _CNV_A_R_LINEAR_____86_CM 1 -1024. 1023.96875 FORMAT "%6.2" /end AXIS_PTS
/begin CHARACTERISTIC ip_soi_main1_max_n_tqi_sp "SOIST: maximum SOI_MAIN1" MAP 0x859d8c _REC_MAP_20_u2_u2_u2 360. _CNV_A_R_LINEAR_____118_CM -120. 240. DISPLAY_IDENTIFIER IP_SOI_MAIN1_MAX_N_TQI_SP FORMAT "%5.2"
 /begin AXIS_DESCR COM_AXIS n _CNV_A_R_LINEAR_____5_CM 2 0. 6375. FORMAT "%4.0" AXIS_PTS_REF ldp_n_ip_soi_main1_max /end AXIS_DESCR
 /begin AXIS_DESCR COM_AXIS tqi_sp _CNV_A_R_LINEAR_____86_CM 2 -1024. 1023.96875 FORMAT "%6.2" AXIS_PTS_REF ldp_tqi_sp_ip_soi_main1_max /end AXIS_DESCR
/end CHARACTERISTIC
/begin AXIS_PTS ldp_n_ip_soi_main1_max "maximum SOI_MAIN1" 0x841d5c n _REC_AXS_20_u2 6375. _CNV_A_R_LINEAR_____5_CM 2 0. 6375. FORMAT "%4.0" /end AXIS_PTS
/begin AXIS_PTS ldp_tqi_sp_ip_soi_main1_max "maximum SOI_MAIN1" 0x84290e tqi_sp _REC_AXS_20_u2 2047.96875 _CNV_A_R_LINEAR_____86_CM 2 -1024. 1023.96875 FORMAT "%6.2" /end AXIS_PTS
/begin CHARACTERISTIC ip_soi_main1_min_n_tqi_sp "SOIST: minimum SOI_MAIN1" MAP 0x859d94 _REC_MAP_20_u2_u2_u2 360. _CNV_A_R_LINEAR_____118_CM -120. 240. DISPLAY_IDENTIFIER IP_SOI_MAIN1_MIN_N_TQI_SP FORMAT "%5.2"
 /begin AXIS_DESCR COM_AXIS n _CNV_A_R_LINEAR_____5_CM 2 0. 6375. FORMAT "%4.0" AXIS_PTS_REF ldp_n_ip_soi_main1_min /end AXIS_DESCR
 /begin AXIS_DESCR COM_AXIS tqi_sp _CNV_A_R_LINEAR_____86_CM 2 -1024. 1023.96875 FORMAT "%6.2" AXIS_PTS_REF ldp_tqi_sp_ip_soi_main1_min /end AXIS_DESCR
/end CHARACTERISTIC
/begin AXIS_PTS ldp_n_ip_soi_main1_min "minimum SOI_MAIN1" 0x841d62 n _REC_AXS_20_u2 6375. _CNV_A_R_LINEAR_____5_CM 2 0. 6375. FORMAT "%4.0" /end AXIS_PTS
/begin AXIS_PTS ldp_tqi_sp_ip_soi_main1_min "minimum SOI_MAIN1" 0x842914 tqi_sp _REC_AXS_20_u2 2047.96875 _CNV_A_R_LINEAR_____86_CM 2 -1024. 1023.96875 FORMAT "%6.2" /end AXIS_PTS
/begin CHARACTERISTIC ip_soi_main1_tgas_0_0 "SOIST: air charge temperature correction of soi_main1 at inj conf 0" MAP 0x859e74 _REC_MAP_20_u2_u2_u2 720. _CNV_A_R_LINEAR_____400_CM -360. 360. DISPLAY_IDENTIFIER IP_SOI_MAIN1_TGAS_0_0 FORMAT "%5.2"
 /begin AXIS_DESCR COM_AXIS n _CNV_A_R_LINEAR_____5_CM 8 0. 6375. FORMAT "%4.0" AXIS_PTS_REF ldp_n_ip_soi_main1_tgas_0_0 /end AXIS_DESCR
 /begin AXIS_DESCR COM_AXIS tqi_sp _CNV_A_R_LINEAR_____86_CM 8 -1024. 1023.96875 FORMAT "%6.2" AXIS_PTS_REF ldp_tqi_sp_ip_soi_tgas_0_0 /end AXIS_DESCR
/end CHARACTERISTIC
/begin AXIS_PTS ldp_n_ip_soi_main1_tgas_0_0 "air charge temperature correction of soi_main1 at inj conf 0" 0x841d68 n _REC_AXS_20_u2 6375. _CNV_A_R_LINEAR_____5_CM 8 0. 6375. FORMAT "%4.0" /end AXIS_PTS
/begin AXIS_PTS ldp_tqi_sp_ip_soi_tgas_0_0 "air charge temperature correction of soi_main1 at inj conf 0" 0x842972 tqi_sp _REC_AXS_20_u2 2047.96875 _CNV_A_R_LINEAR_____86_CM 8 -1024. 1023.96875 FORMAT "%6.2" /end AXIS_PTS
/begin CHARACTERISTIC ip_soi_main1_tgas_1_0 "SOIST: air charge temperature correction of soi_main1 at inj conf 1" MAP 0x859ef4 _REC_MAP_20_u2_u2_u2 720. _CNV_A_R_LINEAR_____400_CM -360. 360. DISPLAY_IDENTIFIER IP_SOI_MAIN1_TGAS_1_0 FORMAT "%5.2"
 /begin AXIS_DESCR COM_AXIS n _CNV_A_R_LINEAR_____5_CM 8 0. 6375. FORMAT "%4.0" AXIS_PTS_REF ldp_n_ip_soi_main1_tgas_1_0 /end AXIS_DESCR
 /begin AXIS_DESCR COM_AXIS tqi_sp _CNV_A_R_LINEAR_____86_CM 8 -1024. 1023.96875 FORMAT "%6.2" AXIS_PTS_REF ldp_tqi_sp_ip_soi_tgas_1_0 /end AXIS_DESCR
/end CHARACTERISTIC
/begin AXIS_PTS ldp_n_ip_soi_main1_tgas_1_0 "air charge temperature correction of soi_main1 at inj conf 1" 0x841d7a n _REC_AXS_20_u2 6375. _CNV_A_R_LINEAR_____5_CM 8 0. 6375. FORMAT "%4.0" /end AXIS_PTS
/begin AXIS_PTS ldp_tqi_sp_ip_soi_tgas_1_0 "air charge temperature correction of soi_main1 at inj conf 1" 0x842984 tqi_sp _REC_AXS_20_u2 2047.96875 _CNV_A_R_LINEAR_____86_CM 8 -1024. 1023.96875 FORMAT "%6.2" /end AXIS_PTS
/begin CHARACTERISTIC ip_soi_main1_tgas_2_0 "SOIST: air charge temperature correction of soi_main1 at inj conf 2" MAP 0x859f74 _REC_MAP_20_u2_u2_u2 720. _CNV_A_R_LINEAR_____400_CM -360. 360. DISPLAY_IDENTIFIER IP_SOI_MAIN1_TGAS_2_0 FORMAT "%5.2"
 /begin AXIS_DESCR COM_AXIS n _CNV_A_R_LINEAR_____5_CM 1 0. 6375. FORMAT "%4.0" AXIS_PTS_REF ldp_n_ip_soi_main1_tgas_2_0 /end AXIS_DESCR
 /begin AXIS_DESCR COM_AXIS tqi_sp _CNV_A_R_LINEAR_____86_CM 1 -1024. 1023.96875 FORMAT "%6.2" AXIS_PTS_REF ldp_tqi_sp_ip_soi_tgas_2_0 /end AXIS_DESCR
/end CHARACTERISTIC
/begin AXIS_PTS ldp_n_ip_soi_main1_tgas_2_0 "air charge temperature correction of soi_main1 at inj conf 2" 0x841d8c n _REC_AXS_20_u2 6375. _CNV_A_R_LINEAR_____5_CM 1 0. 6375. FORMAT "%4.0" /end AXIS_PTS
/begin AXIS_PTS ldp_tqi_sp_ip_soi_tgas_2_0 "air charge temperature correction of soi_main1 at inj conf 2" 0x842996 tqi_sp _REC_AXS_20_u2 2047.96875 _CNV_A_R_LINEAR_____86_CM 1 -1024. 1023.96875 FORMAT "%6.2" /end AXIS_PTS
/begin CHARACTERISTIC ip_soi_main1_tgas_3_0 "SOIST: air charge temperature correction of soi_main1 at inj conf 3" MAP 0x859f76 _REC_MAP_20_u2_u2_u2 720. _CNV_A_R_LINEAR_____400_CM -360. 360. DISPLAY_IDENTIFIER IP_SOI_MAIN1_TGAS_3_0 FORMAT "%5.2"
 /begin AXIS_DESCR COM_AXIS n _CNV_A_R_LINEAR_____5_CM 1 0. 6375. FORMAT "%4.0" AXIS_PTS_REF ldp_n_ip_soi_main1_tgas_3_0 /end AXIS_DESCR
 /begin AXIS_DESCR COM_AXIS tqi_sp _CNV_A_R_LINEAR_____86_CM 1 -1024. 1023.96875 FORMAT "%6.2" AXIS_PTS_REF ldp_tqi_sp_ip_soi_tgas_3_0 /end AXIS_DESCR
/end CHARACTERISTIC
/begin AXIS_PTS ldp_n_ip_soi_main1_tgas_3_0 "air charge temperature correction of soi_main1 at inj conf 3" 0x841d90 n _REC_AXS_20_u2 6375. _CNV_A_R_LINEAR_____5_CM 1 0. 6375. FORMAT "%4.0" /end AXIS_PTS
/begin AXIS_PTS ldp_tqi_sp_ip_soi_tgas_3_0 "air charge temperature correction of soi_main1 at inj conf 3" 0x84299a tqi_sp _REC_AXS_20_u2 2047.96875 _CNV_A_R_LINEAR_____86_CM 1 -1024. 1023.96875 FORMAT "%6.2" /end AXIS_PTS
/begin CHARACTERISTIC ip_soi_main1_tgas_4_0 "SOIST: air charge temperature correction of soi_main1 at inj conf 4" MAP 0x859f78 _REC_MAP_20_u2_u2_u2 720. _CNV_A_R_LINEAR_____400_CM -360. 360. DISPLAY_IDENTIFIER IP_SOI_MAIN1_TGAS_4_0 FORMAT "%5.2"
 /begin AXIS_DESCR COM_AXIS n _CNV_A_R_LINEAR_____5_CM 1 0. 6375. FORMAT "%4.0" AXIS_PTS_REF ldp_n_ip_soi_main1_tgas_4_0 /end AXIS_DESCR
 /begin AXIS_DESCR COM_AXIS tqi_sp _CNV_A_R_LINEAR_____86_CM 1 -1024. 1023.96875 FORMAT "%6.2" AXIS_PTS_REF ldp_tqi_sp_ip_soi_tgas_4_0 /end AXIS_DESCR
/end CHARACTERISTIC
/begin AXIS_PTS ldp_n_ip_soi_main1_tgas_4_0 "air charge temperature correction of soi_main1 at inj conf 4" 0x841d94 n _REC_AXS_20_u2 6375. _CNV_A_R_LINEAR_____5_CM 1 0. 6375. FORMAT "%4.0" /end AXIS_PTS
/begin AXIS_PTS ldp_tqi_sp_ip_soi_tgas_4_0 "air charge temperature correction of soi_main1 at inj conf 4" 0x84299e tqi_sp _REC_AXS_20_u2 2047.96875 _CNV_A_R_LINEAR_____86_CM 1 -1024. 1023.96875 FORMAT "%6.2" /end AXIS_PTS
/begin MEASUREMENT soi_main1_sel_conf_0 "start of injection MAIN1 at inj conf 0 after temperature selection" UWORD _CNV_A_R_LINEAR_____118_CM 1 0. -120. 240. DISPLAY_IDENTIFIER SOI_MAIN1_SEL_CONF_0 ECU_ADDRESS 0x7fa0b4 BYTE_ORDER MSB_LAST FORMAT "%6.2" /end MEASUREMENT
/begin MEASUREMENT soi_main1_sel_conf_1 "start of injection MAIN1 at inj conf 1 after temperature selection" UWORD _CNV_A_R_LINEAR_____118_CM 1 0. -120. 240. DISPLAY_IDENTIFIER SOI_MAIN1_SEL_CONF_1 ECU_ADDRESS 0x7fa0b6 BYTE_ORDER MSB_LAST FORMAT "%6.2" /end MEASUREMENT
/begin MEASUREMENT soi_main1_sel_conf_2 "start of injection MAIN1 at inj conf 2 after temperature selection" UWORD _CNV_A_R_LINEAR_____118_CM 1 0. -120. 240. DISPLAY_IDENTIFIER SOI_MAIN1_SEL_CONF_2 ECU_ADDRESS 0x7fa0b8 BYTE_ORDER MSB_LAST FORMAT "%6.2" /end MEASUREMENT
/begin MEASUREMENT soi_main1_sel_conf_3 "start of injection MAIN1 at inj conf 3 after temperature selection" UWORD _CNV_A_R_LINEAR_____118_CM 1 0. -120. 240. DISPLAY_IDENTIFIER SOI_MAIN1_SEL_CONF_3 ECU_ADDRESS 0x7fa0ba BYTE_ORDER MSB_LAST FORMAT "%6.2" /end MEASUREMENT
/begin MEASUREMENT soi_main1_sel_conf_4 "start of injection MAIN1 at inj conf 4 after temperature selection" UWORD _CNV_A_R_LINEAR_____118_CM 1 0. -120. 240. DISPLAY_IDENTIFIER SOI_MAIN1_SEL_CONF_4 ECU_ADDRESS 0x7fa0bc BYTE_ORDER MSB_LAST FORMAT "%6.2" /end MEASUREMENT
/begin CHARACTERISTIC c_t_rgn_trn_soi_main1 "time constant of rgn transition of soi j" VALUE 0x85cc8e _REC_VAL_20_u2 4.19424 _CNV_A_R_LINEAR_____64_CM 0. 4.19424 DISPLAY_IDENTIFIER C_T_RGN_TRN_SOI_MAIN1 FORMAT "%7.5" /end CHARACTERISTIC
/begin MEASUREMENT soi_main1_is_pl "" UWORD _CNV_A_R_LINEAR_____118_CM 1 0. -120. 240. DISPLAY_IDENTIFIER SOI_MAIN1_IS_PL ECU_ADDRESS 0x7fa0be BYTE_ORDER MSB_LAST FORMAT "%6.2" /end MEASUREMENT
/begin MEASUREMENT soi_main1_is_pl_rgn_1 "Start of Main Injection at IS/PL during rgn level 1" UWORD _CNV_A_R_LINEAR_____118_CM 1 0. -120. 240. DISPLAY_IDENTIFIER SOI_MAIN1_IS_PL_RGN_1 ECU_ADDRESS 0x7fa0c0 BYTE_ORDER MSB_LAST FORMAT "%5.2" /end MEASUREMENT
/begin MEASUREMENT soi_main1_is_pl_rgn_2 "Start of Main Injection at IS/PL durin rgn level 2" UWORD _CNV_A_R_LINEAR_____118_CM 1 0. -120. 240. DISPLAY_IDENTIFIER SOI_MAIN1_IS_PL_RGN_2 ECU_ADDRESS 0x7fa0c2 BYTE_ORDER MSB_LAST FORMAT "%5.2" /end MEASUREMENT
/begin CHARACTERISTIC ip_fac_soi_cor_amp_rgn_1 "ASOI_MAIN_RGN: Amp correction factor for soi Major injection during regeneration 1" CURVE 0x8483a8 _REC_CUR_20_u2_u2 0.9999874 _CNV_A_R_LINEAR_____87_CM 0. 0.9999874 DISPLAY_IDENTIFIER IP_FAC_SOI_COR_AMP_RGN_1 FORMAT "%6.5"
 /begin AXIS_DESCR COM_AXIS amp _CNV_A_R_LINEAR_____45_CM 2 0. 5434. FORMAT "%6.2" AXIS_PTS_REF ldp_amp_ip_fac_soi_cor_rgn_1 /end AXIS_DESCR
/end CHARACTERISTIC
/begin AXIS_PTS ldp_amp_ip_fac_soi_cor_rgn_1 "Amp correction factor for soi Major injection during regeneration 1" 0x841250 amp _REC_AXS_20_u2 5434. _CNV_A_R_LINEAR_____45_CM 2 0. 5434. FORMAT "%6.2" /end AXIS_PTS
/begin CHARACTERISTIC ip_fac_soi_cor_amp_rgn_2 "ASOI_MAIN_RGN: Amp correction factor for soi Major injection during regeneration 2" CURVE 0x8483ac _REC_CUR_20_u2_u2 0.9999874 _CNV_A_R_LINEAR_____87_CM 0. 0.9999874 DISPLAY_IDENTIFIER IP_FAC_SOI_COR_AMP_RGN_2 FORMAT "%6.5"
 /begin AXIS_DESCR COM_AXIS amp _CNV_A_R_LINEAR_____45_CM 2 0. 5434. FORMAT "%6.2" AXIS_PTS_REF ldp_amp_ip_fac_soi_cor_rgn_2 /end AXIS_DESCR
/end CHARACTERISTIC
/begin AXIS_PTS ldp_amp_ip_fac_soi_cor_rgn_2 "Amp correction factor for soi Major injection during regeneration 2" 0x841256 amp _REC_AXS_20_u2 5434. _CNV_A_R_LINEAR_____45_CM 2 0. 5434. FORMAT "%6.2" /end AXIS_PTS
/begin CHARACTERISTIC ip_soi_main1_amp_h_rgn_1 "ASOI_MAIN_RGN: AMP correction(=1) of soi_main1 during regeneration 1" MAP 0x84d69c _REC_MAP_20_u2_u2_u2 360. _CNV_A_R_LINEAR_____118_CM -120. 240. DISPLAY_IDENTIFIER IP_SOI_MAIN1_AMP_H_RGN_1 FORMAT "%5.2"
 /begin AXIS_DESCR COM_AXIS n _CNV_A_R_LINEAR_____5_CM 12 0. 8160. FORMAT "%4.0" AXIS_PTS_REF ldpm_n_ip_soi_main1_amp_rgn_1 /end AXIS_DESCR
 /begin AXIS_DESCR COM_AXIS tqi_sp _CNV_A_R_LINEAR_____86_CM 12 -1024. 1023.96875 FORMAT "%6.2" AXIS_PTS_REF ldpm_tqi_sp_ip_soi_amp_rgn_1 /end AXIS_DESCR
/end CHARACTERISTIC
/begin AXIS_PTS ldpm_n_ip_soi_main1_amp_rgn_1 "Amp correction (=0 )of soi_main1 during regeneration 1" 0x843422 n _REC_AXS_20_u2 8160. _CNV_A_R_LINEAR_____5_CM 12 0. 8160. FORMAT "%4.0" /end AXIS_PTS
/begin AXIS_PTS ldpm_tqi_sp_ip_soi_amp_rgn_1 "Amp correction (=0 )of soi_main1 during regeneration 1" 0x843dea tqi_sp _REC_AXS_20_u2 2047.96875 _CNV_A_R_LINEAR_____86_CM 12 -1024. 1023.96875 FORMAT "%6.2" /end AXIS_PTS
/begin CHARACTERISTIC ip_soi_main1_amp_l_rgn_1 "ASOI_MAIN_RGN: AMP correction (=0 ) of soi_main1 during regeneration 1" MAP 0x84d8dc _REC_MAP_20_u2_u2_u2 360. _CNV_A_R_LINEAR_____118_CM -120. 240. DISPLAY_IDENTIFIER IP_SOI_MAIN1_AMP_L_RGN_1 FORMAT "%5.2"
 /begin AXIS_DESCR COM_AXIS n _CNV_A_R_LINEAR_____5_CM 12 0. 8160. FORMAT "%4.0" AXIS_PTS_REF ldpm_n_ip_soi_main1_amp_rgn_1 /end AXIS_DESCR
 /begin AXIS_DESCR COM_AXIS tqi_sp _CNV_A_R_LINEAR_____86_CM 12 -1024. 1023.96875 FORMAT "%6.2" AXIS_PTS_REF ldpm_tqi_sp_ip_soi_amp_rgn_1 /end AXIS_DESCR
/end CHARACTERISTIC
/begin CHARACTERISTIC ip_soi_main1_amp_h_rgn_2 "ASOI_MAIN_RGN: AMP correction (=1) of soi_main1 during regeneration 2" MAP 0x84d7bc _REC_MAP_20_u2_u2_u2 360. _CNV_A_R_LINEAR_____118_CM -120. 240. DISPLAY_IDENTIFIER IP_SOI_MAIN1_AMP_H_RGN_2 FORMAT "%5.2"
 /begin AXIS_DESCR COM_AXIS n _CNV_A_R_LINEAR_____5_CM 12 0. 8160. FORMAT "%4.0" AXIS_PTS_REF ldpm_n_ip_soi_main1_amp_rgn_2 /end AXIS_DESCR
 /begin AXIS_DESCR COM_AXIS tqi_sp _CNV_A_R_LINEAR_____86_CM 12 -1024. 1023.96875 FORMAT "%6.2" AXIS_PTS_REF ldpm_tqi_sp_ip_soi_amp_rgn_2 /end AXIS_DESCR
/end CHARACTERISTIC
/begin AXIS_PTS ldpm_n_ip_soi_main1_amp_rgn_2 "Amp correction (=0 )of soi_main1 during regeneration 2" 0x84343c n _REC_AXS_20_u2 8160. _CNV_A_R_LINEAR_____5_CM 12 0. 8160. FORMAT "%4.0" /end AXIS_PTS
/begin AXIS_PTS ldpm_tqi_sp_ip_soi_amp_rgn_2 "Amp correction (=0 )of soi_main1 during regeneration 2" 0x843e04 tqi_sp _REC_AXS_20_u2 2047.96875 _CNV_A_R_LINEAR_____86_CM 12 -1024. 1023.96875 FORMAT "%6.2" /end AXIS_PTS
/begin CHARACTERISTIC ip_soi_main1_amp_l_rgn_2 "ASOI_MAIN_RGN: AMP correction ( =0 ) of soi_main1 during regeneration 2" MAP 0x84d9fc _REC_MAP_20_u2_u2_u2 360. _CNV_A_R_LINEAR_____118_CM -120. 240. DISPLAY_IDENTIFIER IP_SOI_MAIN1_AMP_L_RGN_2 FORMAT "%5.2"
 /begin AXIS_DESCR COM_AXIS n _CNV_A_R_LINEAR_____5_CM 12 0. 8160. FORMAT "%4.0" AXIS_PTS_REF ldpm_n_ip_soi_main1_amp_rgn_2 /end AXIS_DESCR
 /begin AXIS_DESCR COM_AXIS tqi_sp _CNV_A_R_LINEAR_____86_CM 12 -1024. 1023.96875 FORMAT "%6.2" AXIS_PTS_REF ldpm_tqi_sp_ip_soi_amp_rgn_2 /end AXIS_DESCR
/end CHARACTERISTIC
/begin CHARACTERISTIC c_rpt_ena[0] "" VALUE 0x84fedc _REC_VAL_20_u1 4. _CNV_S_5_ABYP_RANGE_429_CM 0. 4. DISPLAY_IDENTIFIER C_RPT_ENA_0_ /end CHARACTERISTIC
/begin CHARACTERISTIC c_rpt_ena[1] "" VALUE 0x84fedd _REC_VAL_20_u1 4. _CNV_S_5_ABYP_RANGE_429_CM 0. 4. DISPLAY_IDENTIFIER C_RPT_ENA_1_ /end CHARACTERISTIC
/begin CHARACTERISTIC c_rpt_ena[2] "" VALUE 0x84fede _REC_VAL_20_u1 4. _CNV_S_5_ABYP_RANGE_429_CM 0. 4. DISPLAY_IDENTIFIER C_RPT_ENA_2_ /end CHARACTERISTIC
/begin CHARACTERISTIC c_rpt_ena[3] "" VALUE 0x84fedf _REC_VAL_20_u1 4. _CNV_S_5_ABYP_RANGE_429_CM 0. 4. DISPLAY_IDENTIFIER C_RPT_ENA_3_ /end CHARACTERISTIC
/begin CHARACTERISTIC c_rpt_ena[4] "" VALUE 0x84fee0 _REC_VAL_20_u1 4. _CNV_S_5_ABYP_RANGE_429_CM 0. 4. DISPLAY_IDENTIFIER C_RPT_ENA_4_ /end CHARACTERISTIC
/begin CHARACTERISTIC c_rpt_ena[5] "" VALUE 0x84fee1 _REC_VAL_20_u1 4. _CNV_S_5_ABYP_RANGE_429_CM 0. 4. DISPLAY_IDENTIFIER C_RPT_ENA_5_ /end CHARACTERISTIC
/begin CHARACTERISTIC c_rpt_ena[6] "" VALUE 0x84fee2 _REC_VAL_20_u1 4. _CNV_S_5_ABYP_RANGE_429_CM 0. 4. DISPLAY_IDENTIFIER C_RPT_ENA_6_ /end CHARACTERISTIC
/begin CHARACTERISTIC c_rpt_ena[7] "" VALUE 0x84fee3 _REC_VAL_20_u1 4. _CNV_S_5_ABYP_RANGE_429_CM 0. 4. DISPLAY_IDENTIFIER C_RPT_ENA_7_ /end CHARACTERISTIC
/begin CHARACTERISTIC c_rpt_ena[8] "" VALUE 0x84fee4 _REC_VAL_20_u1 4. _CNV_S_5_ABYP_RANGE_429_CM 0. 4. DISPLAY_IDENTIFIER C_RPT_ENA_8_ /end CHARACTERISTIC
/begin CHARACTERISTIC c_rpt_ena[9] "" VALUE 0x84fee5 _REC_VAL_20_u1 4. _CNV_S_5_ABYP_RANGE_429_CM 0. 4. DISPLAY_IDENTIFIER C_RPT_ENA_9_ /end CHARACTERISTIC
/begin CHARACTERISTIC c_rpt_ena[10] "" VALUE 0x84fee6 _REC_VAL_20_u1 4. _CNV_S_5_ABYP_RANGE_429_CM 0. 4. DISPLAY_IDENTIFIER C_RPT_ENA_10_ /end CHARACTERISTIC
/begin CHARACTERISTIC c_rpt_ena[11] "" VALUE 0x84fee7 _REC_VAL_20_u1 4. _CNV_S_5_ABYP_RANGE_429_CM 0. 4. DISPLAY_IDENTIFIER C_RPT_ENA_11_ /end CHARACTERISTIC
/begin CHARACTERISTIC c_rpt_ena[12] "" VALUE 0x84fee8 _REC_VAL_20_u1 4. _CNV_S_5_ABYP_RANGE_429_CM 0. 4. DISPLAY_IDENTIFIER C_RPT_ENA_12_ /end CHARACTERISTIC
/begin CHARACTERISTIC c_rpt_ena[13] "" VALUE 0x84fee9 _REC_VAL_20_u1 4. _CNV_S_5_ABYP_RANGE_429_CM 0. 4. DISPLAY_IDENTIFIER C_RPT_ENA_13_ /end CHARACTERISTIC
/begin MEASUREMENT rpt_ena[0] "" UBYTE _CNV_S_5_ABYP_RANGE_429_CM 1 0. 0. 4. DISPLAY_IDENTIFIER RPT_ENA_0_ ECU_ADDRESS 0x7fbaf2 /end MEASUREMENT
/begin MEASUREMENT rpt_ena[1] "" UBYTE _CNV_S_5_ABYP_RANGE_429_CM 1 0. 0. 4. DISPLAY_IDENTIFIER RPT_ENA_1_ ECU_ADDRESS 0x7fbaf3 /end MEASUREMENT
/begin COMPU_METHOD _CNV_A_R_LINEAR_____0_CM "" RAT_FUNC "%6.3" "[-]" COEFFS 0 1. 0. 0 0 1 /end COMPU_METHOD
/begin COMPU_METHOD _CNV_A_R_LINEAR_____1_CM "" RAT_FUNC "%6.3" "-" COEFFS 0 1. 0. 0 0 1 /end COMPU_METHOD
/begin COMPU_METHOD _CNV_A_R_LINEAR_____5_CM "" RAT_FUNC "%6.3" "[rpm]" COEFFS 0 1. 0. 0 0 1 /end COMPU_METHOD
/begin COMPU_METHOD _CNV_S_2_RANGE______11_CM "" TAB_VERB "%6.3" "[-]" COMPU_TAB_REF _CNV_S_2_RANGE______11 /end COMPU_METHOD
/begin COMPU_VTAB _CNV_S_2_RANGE______11 "" TAB_VERB 2 0 "0" 1 "1" /end COMPU_VTAB
/begin COMPU_METHOD _CNV_A_R_LINEAR_____14_CM "" RAT_FUNC "%6.3" "[-]" COEFFS 0 65535.99999999996 0. 0 0 1 /end COMPU_METHOD
/begin COMPU_METHOD _CNV_A_R_LINEAR_____15_CM "" RAT_FUNC "%6.3" "[-]" COEFFS 0 16384. 0. 0 0 1 /end COMPU_METHOD
/begin COMPU_METHOD _CNV_A_R_LINEAR_____18_CM "" RAT_FUNC "%6.3" "[°C]" COEFFS 0 1. 50. 0 0 1 /end COMPU_METHOD
/begin COMPU_METHOD _CNV_A_R_LINEAR_____19_CM "" RAT_FUNC "%6.3" "[s]" COEFFS 0 10. 0. 0 0 1 /end COMPU_METHOD
/begin COMPU_METHOD _CNV_A_R_LINEAR_____29_CM "" RAT_FUNC "%6.3" "[-]" COEFFS 0 256. 0. 0 0 1 /end COMPU_METHOD
/begin COMPU_METHOD _CNV_A_R_LINEAR_____45_CM "" RAT_FUNC "%6.3" "[hPa]" COEFFS 0 12.06017666543982 0. 0 0 1 /end COMPU_METHOD
/begin COMPU_METHOD _CNV_A_R_LINEAR_____48_CM "" RAT_FUNC "%6.3" "[-]" COEFFS 0 32767.99807357072 0. 0 0 1 /end COMPU_METHOD
/begin COMPU_METHOD _CNV_A_R_LINEAR_____52_CM "" RAT_FUNC "%6.3" "[Nm]" COEFFS 0 32. 0. 0 0 1 /end COMPU_METHOD
/begin COMPU_METHOD _CNV_A_R_LINEAR_____59_CM "" RAT_FUNC "%6.3" "[-]" COEFFS 0 16383.81262712377 0. 0 0 1 /end COMPU_METHOD
/begin COMPU_METHOD _CNV_A_R_LINEAR_____64_CM "" RAT_FUNC "%6.3" "[s]" COEFFS 0 15625. 0. 0 0 1 /end COMPU_METHOD
/begin COMPU_METHOD _CNV_S_2_RANGE__0___85_CM "" TAB_VERB "%6.3" "-" COMPU_TAB_REF _CNV_S_2_RANGE__0___85 /end COMPU_METHOD
/begin COMPU_VTAB _CNV_S_2_RANGE__0___85 "" TAB_VERB 2 0 "0" 1 "1" /end COMPU_VTAB
/begin COMPU_METHOD _CNV_A_R_LINEAR_____86_CM "" RAT_FUNC "%6.3" "[Nm]" COEFFS 0 32. 32768. 0 0 1 /end COMPU_METHOD
/begin COMPU_METHOD _CNV_A_R_LINEAR_____87_CM "" RAT_FUNC "%6.3" "[-]" COEFFS 0 65535.82575140447 0. 0 0 1 /end COMPU_METHOD
/begin COMPU_METHOD _CNV_A_R_LINEAR_____117_CM "" RAT_FUNC "%6.3" "[MPa]" COEFFS 0 327.680000069121 32768.0000069121 0 0 1 /end COMPU_METHOD
/begin COMPU_METHOD _CNV_A_R_LINEAR_____118_CM "" RAT_FUNC "%6.3" "[°CRK]" COEFFS 0 42.66666666666666 5120. 0 0 1 /end COMPU_METHOD
/begin COMPU_METHOD _CNV_A_R_LINEAR_____119_CM "" RAT_FUNC "%6.3" "[°CRK]" COEFFS 0 42.66666666666666 0. 0 0 1 /end COMPU_METHOD
/begin COMPU_METHOD _CNV_A_R_LINEAR_____162_CM "" RAT_FUNC "%6.3" "[-]" COEFFS 0 1000. 0. 0 0 1 /end COMPU_METHOD
/begin COMPU_METHOD _CNV_A_R_LINEAR_____270_CM "" RAT_FUNC "%6.3" "[Nm/(rpm*s)]" COEFFS 0 50. 0. 0 0 1 /end COMPU_METHOD
/begin COMPU_METHOD _CNV_A_R_LINEAR_____271_CM "" RAT_FUNC "%6.3" "[Nm/rpm]" COEFFS 0 1000. 0. 0 0 1 /end COMPU_METHOD
/begin COMPU_METHOD _CNV_A_R_LINEAR_____272_CM "" RAT_FUNC "%6.3" "[-]" COEFFS 0 50. 0. 0 0 1 /end COMPU_METHOD
/begin COMPU_METHOD _CNV_A_R_LINEAR_____273_CM "" RAT_FUNC "%6.3" "[Nm/rpm]" COEFFS 0 65535.82575140447 0. 0 0 1 /end COMPU_METHOD
/begin COMPU_METHOD _CNV_A_R_LINEAR_____274_CM "" RAT_FUNC "%6.3" "[s]" COEFFS 0 7812.500000000001 0. 0 0 1 /end COMPU_METHOD
/begin COMPU_METHOD _CNV_A_R_LINEAR_____275_CM "" RAT_FUNC "%6.3" "[Nm*s/rpm]" COEFFS 0 16383.81262712377 0. 0 0 1 /end COMPU_METHOD
/begin COMPU_METHOD _CNV_A_R_LINEAR_____400_CM "" RAT_FUNC "%6.3" "[°CRK]" COEFFS 0 42.66666666666666 32768. 0 0 1 /end COMPU_METHOD
/begin COMPU_METHOD _CNV_S_5_ABYP_RANGE_429_CM "" TAB_VERB "%6.3" "-" COMPU_TAB_REF _CNV_S_5_ABYP_RANGE_429 /end COMPU_METHOD
/begin COMPU_VTAB _CNV_S_5_ABYP_RANGE_429 "" TAB_VERB 5 0 "BYP_TYP_OFF" 1 "BYP_TYP_EXT_INCL" 2 "BYP_TYP_EXT_EXCL" 3 "BYP_TYP_IT_INCL" 4 "BYP_TYP_IT_EXCL" /end COMPU_VTAB
/begin RECORD_LAYOUT _REC_VAL_20_u1 FNC_VALUES 1 UBYTE COLUMN_DIR DIRECT /end RECORD_LAYOUT
/begin RECORD_LAYOUT _REC_AXS_20_u2 NO_AXIS_PTS_X 1 UWORD AXIS_PTS_X 2 UWORD INDEX_INCR DIRECT /end RECORD_LAYOUT
/begin RECORD_LAYOUT _REC_MAP_20_u2_u2_u2 FNC_VALUES 1 UWORD COLUMN_DIR DIRECT /end RECORD_LAYOUT
/begin RECORD_LAYOUT _REC_VAL_20_u2 FNC_VALUES 1 UWORD COLUMN_DIR DIRECT /end RECORD_LAYOUT
/begin RECORD_LAYOUT _REC_VAL_20_s2 FNC_VALUES 1 SWORD COLUMN_DIR DIRECT /end RECORD_LAYOUT
/begin RECORD_LAYOUT _REC_AXS_20_u1 NO_AXIS_PTS_X 1 UBYTE AXIS_PTS_X 2 UBYTE INDEX_INCR DIRECT /end RECORD_LAYOUT
/begin RECORD_LAYOUT _REC_CUR_20_u2_u2 FNC_VALUES 1 UWORD COLUMN_DIR DIRECT /end RECORD_LAYOUT
/begin RECORD_LAYOUT _REC_CUR_20_u2_u1 FNC_VALUES 1 UWORD COLUMN_DIR DIRECT /end RECORD_LAYOUT
/begin RECORD_LAYOUT _REC_MAP_20_u2_u2_u1 FNC_VALUES 1 UWORD COLUMN_DIR DIRECT /end RECORD_LAYOUT
/begin RECORD_LAYOUT _REC_CUR_20_u1_u1 FNC_VALUES 1 UBYTE COLUMN_DIR DIRECT /end RECORD_LAYOUT
/begin RECORD_LAYOUT _REC_VAL_20_u4 FNC_VALUES 1 ULONG COLUMN_DIR DIRECT /end RECORD_LAYOUT
/begin FUNCTION Bypass_Simulation ""
 /begin DEF_CHARACTERISTIC c_byp_lih_cnt_max_A c_byp_lih_cnt_max_B c_byp_on c_byp_func_A c_byp_func_B c_byp_A_ofs_ch1 c_byp_A_ofs_ch2 c_byp_A_ofs_ch3 c_byp_A_ofs_ch4 c_byp_A_ofs_ch5 c_byp_A_ofs_ch6 c_byp_A_ofs_ch7 c_byp_A_ofs_ch8 c_byp_A_ofs_ch9 c_byp_A_ofs_ch10 c_byp_A_ofs_ch11 c_byp_A_ofs_ch12 c_byp_A_ofs_ch13 c_byp_A_ofs_ch14 c_byp_A_ofs_ch15 c_byp_A_ofs_ch0 c_byp_B_ofs_ch0 c_byp_B_ofs_ch1 c_byp_B_ofs_ch2 c_byp_B_ofs_ch3 c_byp_B_ofs_ch4 c_byp_B_ofs_ch5 c_byp_B_ofs_ch6 c_byp_B_ofs_ch7 c_byp_B_ofs_ch8 c_byp_B_ofs_ch9 c_byp_B_ofs_ch10 c_byp_B_ofs_ch11 c_byp_B_ofs_ch12 c_byp_B_ofs_ch13 c_byp_B_ofs_ch14 c_byp_B_ofs_ch15 c_byp_B_ofs_ch16 c_byp_B_ofs_ch17 c_byp_B_ofs_ch18 c_byp_B_ofs_ch19 c_byp_B_ofs_ch20 c_byp_B_ofs_ch21 c_byp_B_ofs_ch22 c_byp_B_ofs_ch23 c_byp_B_ofs_ch24 c_byp_B_ofs_ch25 c_byp_B_ofs_ch26 c_byp_B_ofs_ch27 c_byp_B_ofs_ch28 c_byp_B_ofs_ch29 c_byp_B_ofs_ch30 c_byp_B_ofs_ch31 c_rpt_ena[0] c_rpt_ena[1] c_rpt_ena[2] c_rpt_ena[3] c_rpt_ena[4] c_rpt_ena[5] c_rpt_ena[6] c_rpt_ena[7] c_rpt_ena[8] c_rpt_ena[9] c_rpt_ena[10] c_rpt_ena[11] c_rpt_ena[12] c_rpt_ena[13] /end DEF_CHARACTERISTIC
 /begin OUT_MEASUREMENT lv_byp_on byp_cnt_A byp_cnt_B byp_error rpt_ena[0] rpt_ena[1] /end OUT_MEASUREMENT
/end FUNCTION
/begin FUNCTION C_Z_SOI ""
 /begin SUB_FUNCTION SOI_ASOI_MINOR_ACT SOI_ASOI_MINOR SOI_ASOI_MINOR_ST SOI_ASOICOR SOI_ASOI_MINOR_TRAN SOI_ASOI_MINOR_TEMP SOI_ASOI_MINOR_RGN SOI_ASOI_TUNE SOI_ASOI_MAIN_ST SOI_ASOI_MAIN SOI_ASOI_MAIN_TEMP SOI_ASOI_MAIN_TRAN SOI_ASOI_MAIN_RGN SOI_ASOITRAN /end SUB_FUNCTION
/end FUNCTION
/begin FUNCTION SOI_ASOI_MINOR_ACT "" /begin DEF_CHARACTERISTIC id_conf_inj_ges /end DEF_CHARACTERISTIC
 /begin OUT_MEASUREMENT lv_soi_prev1_act_st lv_soi_prev2_act_st lv_soi_main2_act_is_pl lv_soi_prev1_act_is_pl lv_soi_prev2_act_is_pl lv_soi_post1_act_is_pl lv_soi_post1_act_st lv_soi_main2_act_st lv_conf_inj_ges sf_conf_inj_soi_rgl sf_conf_inj_soi_rgn_1 sf_conf_inj_soi_rgn_2 /end OUT_MEASUREMENT
/end FUNCTION
/begin FUNCTION SOI_ASOI_MINOR ""
 /begin DEF_CHARACTERISTIC ip_fac_soi_prev1_cor_amp ldp_amp_ip_fac_soi_prev1_cor ip_fac_soi_prev1_cor_tgas ldp_tgas_ip_fac_soi_prev1_cor ip_fac_soi_prev1_cor_tco ldp_tco_ip_fac_soi_prev1_cor ldpm_n_1_ip_soi_prev1_dif ldpm_tqi_sp_1_ip_soi_prev1_dif ip_soi_prev1_dif_amp ldp_n_ip_soi_prev1_dif_amp ldp_tqi_sp_ip_soi_prev1_dif_amp ip_soi_prev1_dif_tgas ldp_n_ip_soi_prev1_dif_tgas ldp_tqi_sp_ip_soi_prev1_dif_tgas ip_fac_soi_prev2_cor_amp ldp_amp_ip_fac_soi_prev2_cor ip_fac_soi_prev2_cor_tgas ldp_tgas_ip_fac_soi_prev2_cor ip_fac_soi_prev2_cor_tco ldp_tco_ip_fac_soi_prev2_cor ldpm_n_1_ip_soi_prev2_dif ldpm_tqi_sp_1_ip_soi_prev2_dif ip_soi_prev2_dif_amp ldp_n_ip_soi_prev2_dif_amp ldp_tqi_sp_ip_soi_prev2_dif_amp ip_soi_prev2_dif_tgas ldp_n_ip_soi_prev2_dif_tgas ldp_tqi_sp_ip_soi_prev2_dif_tgas ip_fac_soi_main2_cor_amp ldp_amp_ip_fac_soi_main2_cor ip_fac_soi_main2_cor_tgas ldp_tgas_ip_fac_soi_main2_cor ip_fac_soi_main2_cor_tco ldp_tco_ip_fac_soi_main2_cor ldpm_n_1_ip_soi_main2_dif ldpm_tqi_sp_1_ip_soi_main2_dif ip_soi_main2_dif_amp ldp_n_ip_soi_main2_dif_amp ldp_tqi_sp_ip_soi_main2_dif_amp ip_soi_main2_dif_tgas ldp_n_ip_soi_main2_dif_tgas ldp_tqi_sp_ip_soi_main2_dif_tgas ip_fac_soi_post1_cor_amp ldp_amp_ip_fac_soi_post1_cor ip_fac_soi_post1_cor_tgas ldp_tgas_ip_fac_soi_post1_cor ip_fac_soi_post1_cor_tco ldp_tco_ip_fac_soi_post1_cor ldpm_n_1_ip_soi_post1_dif ldpm_tqi_sp_1_ip_soi_post1_dif ip_soi_post1_dif_amp ldp_n_ip_soi_post1_dif_amp ldp_tqi_sp_ip_soi_post1_dif_amp ip_soi_post1_dif_tgas ldp_n_ip_soi_post1_dif_tgas ldp_tqi_sp_ip_soi_post1_dif_tgas ip_soi_main2_dif_0_0 ip_soi_main2_dif_0_2 ip_soi_main2_dif_0_1 ip_soi_post1_dif_0_0 ip_soi_post1_dif_0_2 ip_soi_post1_dif_0_1 ip_soi_prev1_dif_0_2 ip_soi_prev1_dif_0_0 ip_soi_prev1_dif_0_1 ip_soi_prev2_dif_0_0 ip_soi_prev2_dif_0_2 ip_soi_prev2_dif_0_1 /end DEF_CHARACTERISTIC
 /begin OUT_MEASUREMENT soi_main2_dif_is_pl_rgl soi_prev2_dif_is_pl_rgl soi_prev1_dif_is_pl_rgl soi_post1_dif_is_pl_rgl soi_post1_dif_cor_rgl soi_prev1_dif_cor_rgl soi_prev2_dif_cor_rgl soi_main2_dif_cor_rgl /end OUT_MEASUREMENT
/end FUNCTION
/begin FUNCTION SOI_ASOI_MINOR_ST ""
 /begin DEF_CHARACTERISTIC ip_fac_soi_main2_dif_st_cor_amp ip_fac_soi_post1_dif_st_cor_amp ip_fac_soi_prev1_dif_st_cor_amp ip_fac_soi_prev2_dif_st_cor_amp ip_soi_main2_dif_st ip_soi_post1_dif_st ip_soi_prev1_dif_st ip_soi_prev2_dif_st ip_soi_main2_dif_st_cor_amp ip_soi_post1_dif_st_cor_amp ip_soi_prev1_dif_st_cor_amp ip_soi_prev2_dif_st_cor_amp /end DEF_CHARACTERISTIC
 /begin OUT_MEASUREMENT soi_prev2_dif_st soi_main2_dif_st soi_prev1_dif_st soi_post1_dif_st /end OUT_MEASUREMENT
/end FUNCTION
/begin FUNCTION SOI_ASOICOR "" /begin DEF_CHARACTERISTIC ldpm_fup_tra_dif_1_inj ip_soi_main1_cor_fup_tra_dif /end DEF_CHARACTERISTIC
 /begin OUT_MEASUREMENT soi_prev1_cor soi_prev2_cor soi_main2_cor soi_post1_cor soi_main1_cor_conf_1 soi_main1_cor_conf_2 soi_main1_cor_conf_0 soi_main1_cor_conf_3 soi_main1_cor_conf_4 soi_prev1_dif_min soi_prev2_dif_min soi_main2_dif_min soi_post1_dif_min soi_prev1_dif_max soi_prev2_dif_max soi_main2_dif_max soi_post1_dif_max /end OUT_MEASUREMENT
/end FUNCTION
/begin FUNCTION SOI_ASOI_MINOR_TRAN ""
 /begin DEF_CHARACTERISTIC c_t_rgn_trn_soi_post1 c_t_rgn_trn_soi_prev1 c_t_rgn_trn_soi_main2 c_t_rgn_trn_soi_prev2 /end DEF_CHARACTERISTIC
 /begin OUT_MEASUREMENT soi_prev1_dif_is_pl soi_prev2_dif_is_pl soi_main2_dif_is_pl soi_post1_dif_is_pl /end OUT_MEASUREMENT
/end FUNCTION
/begin FUNCTION SOI_ASOI_MINOR_TEMP ""
 /begin OUT_MEASUREMENT soi_prev1_dif_bas_sel soi_main2_dif_bas_sel soi_prev2_dif_bas_sel soi_post1_dif_bas_sel /end OUT_MEASUREMENT
/end FUNCTION
/begin FUNCTION SOI_ASOI_MINOR_RGN ""
 /begin DEF_CHARACTERISTIC ip_fac_soi_prev1_cor_amp_rgn_1 ip_fac_soi_main2_cor_amp_rgn_1 ip_fac_soi_post1_cor_amp_rgn_1 ip_fac_soi_prev2_cor_amp_rgn_1 ldp_amp_ip_fac_soi_prev1_cor_rgn_1 ldp_amp_ip_fac_soi_main2_cor_rgn_1 ldp_amp_ip_fac_soi_post1_cor_rgn_1 ldp_amp_ip_fac_soi_prev2_cor_rgn_1 ip_fac_soi_prev1_cor_amp_rgn_2 ip_fac_soi_main2_cor_amp_rgn_2 ip_fac_soi_post1_cor_amp_rgn_2 ip_fac_soi_prev2_cor_amp_rgn_2 ldp_amp_ip_fac_soi_prev1_cor_rgn_2 ldp_amp_ip_fac_soi_main2_cor_rgn_2 ldp_amp_ip_fac_soi_post1_cor_rgn_2 ldp_amp_ip_fac_soi_prev2_cor_rgn_2 ip_soi_prev1_amp_h_rgn_1 ip_soi_main2_amp_h_rgn_1 ip_soi_post1_amp_h_rgn_1 ip_soi_prev2_amp_h_rgn_1 ldpm_n_ip_soi_prev1_amp_rgn_1 ldpm_n_ip_soi_main2_amp_rgn_1 ldpm_n_ip_soi_post1_amp_rgn_1 ldpm_n_ip_soi_prev2_amp_rgn_1 ldpm_tqi_sp_ip_soi_prev1_amp_rgn_1 ldpm_tqi_sp_ip_soi_main2_amp_rgn_1 ldpm_tqi_sp_ip_soi_post1_amp_rgn_1 ldpm_tqi_sp_ip_soi_prev2_amp_rgn_1 ip_soi_prev1_amp_l_rgn_1 ip_soi_main2_amp_l_rgn_1 ip_soi_post1_amp_l_rgn_1 ip_soi_prev2_amp_l_rgn_1 ip_soi_prev1_amp_h_rgn_2 ip_soi_main2_amp_h_rgn_2 ip_soi_post1_amp_h_rgn_2 ip_soi_prev2_amp_h_rgn_2 ldpm_n_ip_soi_prev1_amp_rgn_2 ldpm_n_ip_soi_main2_amp_rgn_2 ldpm_n_ip_soi_post1_amp_rgn_2 ldpm_n_ip_soi_prev2_amp_rgn_2 ldpm_tqi_sp_ip_soi_prev1_amp_rgn_2 ldpm_tqi_sp_ip_soi_main2_amp_rgn_2 ldpm_tqi_sp_ip_soi_post1_amp_rgn_2 ldpm_tqi_sp_ip_soi_prev2_amp_rgn_2 ip_soi_prev1_amp_l_rgn_2 ip_soi_main2_amp_l_rgn_2 ip_soi_post1_amp_l_rgn_2 ip_soi_prev2_amp_l_rgn_2 /end DEF_CHARACTERISTIC
 /begin OUT_MEASUREMENT soi_prev1_is_pl_rgn_1 soi_main2_is_pl_rgn_1 soi_post1_is_pl_rgn_1 soi_prev2_is_pl_rgn_1 soi_prev2_is_pl_rgn_2 soi_main2_is_pl_rgn_2 soi_post1_is_pl_rgn_2 soi_prev1_is_pl_rgn_2 /end OUT_MEASUREMENT
/end FUNCTION
/begin FUNCTION SOI_ASOI_TUNE ""
 /begin DEF_CHARACTERISTIC c_fac_soi_prev1_tu lc_soi_prev1_tu_on c_soi_prev1_add_tu c_soi_prev1_add_tu_cyl[0] c_soi_prev1_add_tu_cyl[1] c_soi_prev1_add_tu_cyl[2] c_soi_prev1_add_tu_cyl[3] c_fac_soi_prev2_tu lc_soi_prev2_tu_on c_soi_prev2_add_tu c_soi_prev2_add_tu_cyl[0] c_soi_prev2_add_tu_cyl[1] c_soi_prev2_add_tu_cyl[2] c_soi_prev2_add_tu_cyl[3] c_fac_soi_main1_tu lc_soi_main1_tu_on c_soi_main1_add_tu c_soi_main1_add_tu_cyl[0] c_soi_main1_add_tu_cyl[1] c_soi_main1_add_tu_cyl[2] c_soi_main1_add_tu_cyl[3] c_fac_soi_main2_tu lc_soi_main2_tu_on c_soi_main2_add_tu c_soi_main2_add_tu_cyl[0] c_soi_main2_add_tu_cyl[1] c_soi_main2_add_tu_cyl[2] c_soi_main2_add_tu_cyl[3] c_soi_main1_test_add_tu[0] c_soi_main1_test_add_tu[1] c_soi_main1_test_add_tu[2] c_soi_main1_test_add_tu[3] c_soi_main2_test_add_tu[0] c_soi_main2_test_add_tu[1] c_soi_main2_test_add_tu[2] c_soi_main2_test_add_tu[3] c_soi_prev1_test_add_tu[0] c_soi_prev1_test_add_tu[1] c_soi_prev1_test_add_tu[2] c_soi_prev1_test_add_tu[3] c_soi_prev2_test_add_tu[0] c_soi_prev2_test_add_tu[1] c_soi_prev2_test_add_tu[2] c_soi_prev2_test_add_tu[3] lc_soi_post1_tu_on lc_soi_post2_tu_on c_fac_soi_post1_tu c_fac_soi_post2_tu c_soi_post1_add_tu c_soi_post2_add_tu c_soi_post1_add_tu_cyl[0] c_soi_post1_add_tu_cyl[1] c_soi_post1_add_tu_cyl[2] c_soi_post1_add_tu_cyl[3] c_soi_post2_add_tu_cyl[0] c_soi_post2_add_tu_cyl[1] c_soi_post2_add_tu_cyl[2] c_soi_post2_add_tu_cyl[3] c_soi_post1_test_add_tu[0] c_soi_post1_test_add_tu[1] c_soi_post1_test_add_tu[2] c_soi_post1_test_add_tu[3] c_soi_post2_test_add_tu[0] c_soi_post2_test_add_tu[1] c_soi_post2_test_add_tu[2] c_soi_post2_test_add_tu[3] ldp_n_ip_soi_min_tu_ad_2 ip_soi_min_tu_ad_2_n ip_soi_main1_inj_test_ad ldp_n_ip_soi_main1_inj_test_ad ldp_tqi_sp_ip_soi_main1_inj_test_ad /end DEF_CHARACTERISTIC
 /begin OUT_MEASUREMENT soi_post1_tu soi_post2_tu soi_main1_tu soi_main2_tu soi_prev2_tu soi_prev1_tu /end OUT_MEASUREMENT
/end FUNCTION
/begin FUNCTION SOI_ASOI_MAIN_ST ""
 /begin DEF_CHARACTERISTIC ip_fac_soi_main1_st_cor_amp ip_soi_main1_st ip_soi_main1_st_cor_amp /end DEF_CHARACTERISTIC
 /begin OUT_MEASUREMENT soi_main1_st /end OUT_MEASUREMENT
/end FUNCTION
/begin FUNCTION SOI_ASOI_MAIN ""
 /begin DEF_CHARACTERISTIC ip_fac_soi_main1_amp_0_0 ldp_amp_ip_fac_soi_main1_0_0 ip_fac_soi_main1_amp_1_0 ldp_amp_ip_fac_soi_main1_1_0 ip_fac_soi_main1_amp_2_0 ldp_amp_ip_fac_soi_main1_2_0 ip_fac_soi_main1_amp_3_0 ldp_amp_ip_fac_soi_main1_3_0 ip_fac_soi_main1_amp_4_0 ldp_amp_ip_fac_soi_main1_4_0 ip_fac_soi_main1_tgas_0_0 ldp_tgas_ip_fac_soi_main1_0_0 ip_fac_soi_main1_tgas_1_0 ldp_tgas_ip_fac_soi_main1_1_0 ip_fac_soi_main1_tgas_2_0 ldp_tgas_ip_fac_soi_main1_2_0 ip_fac_soi_main1_tgas_3_0 ldp_tgas_ip_fac_soi_main1_3_0 ip_fac_soi_main1_tgas_4_0 ldp_tgas_ip_fac_soi_main1_4_0 ip_fac_soi_main1_tco_0_0 ldp_tco_ip_fac_soi_main1_0_0 ip_fac_soi_main1_tco_1_0 ldp_tco_ip_fac_soi_main1_1_0 ip_fac_soi_main1_tco_2_0 ldp_tco_ip_fac_soi_main1_2_0 ip_fac_soi_main1_tco_3_0 ldp_tco_ip_fac_soi_main1_3_0 ip_fac_soi_main1_tco_4_0 ldp_tco_ip_fac_soi_main1_4_0 ip_soi_main1_0_0 ldpm_n_1_ip_soi_main1_0_0 ldpm_tqi_sp_1_ip_soi_0_0 ip_soi_main1_0_1 ip_soi_main1_0_2 ip_soi_main1_1_0 ldpm_n_1_ip_soi_main1_1_0 ldpm_tqi_sp_1_ip_soi_1_0 ip_soi_main1_1_1 ip_soi_main1_1_2 ip_soi_main1_2_0 ldpm_n_1_ip_soi_main1_2_0 ldp_n_1_ip_soi_main1_2_0_x ldpm_tqi_sp_1_ip_soi_2_0 ldp_tqi_sp_1_ip_soi_2_0_x ip_soi_main1_2_1 ip_soi_main1_2_2 ip_soi_main1_3_0 ldpm_n_1_ip_soi_main1_3_0 ldp_n_1_ip_soi_main1_3_0_x ldpm_tqi_sp_1_ip_soi_3_0 ldp_tqi_sp_1_ip_soi_3_0_x ip_soi_main1_3_1 ip_soi_main1_3_2 ip_soi_main1_4_0 ldpm_n_1_ip_soi_main1_4_0 ldp_n_1_ip_soi_main1_4_0_x ldpm_tqi_sp_1_ip_soi_4_0 ldp_tqi_sp_1_ip_soi_4_0_x ip_soi_main1_4_1 ip_soi_main1_4_2 ip_soi_main1_amp_0_0 ldp_n_ip_soi_amp_0_0 ldp_tqi_sp_ip_soi_amp_0_0 ip_soi_main1_amp_1_0 ldp_n_ip_soi_amp_1_0 ldp_tqi_sp_ip_soi_amp_1_0 ip_soi_main1_amp_2_0 ldp_n_ip_soi_amp_2_0 ldp_tqi_sp_ip_soi_amp_2_0 ip_soi_main1_amp_3_0 ldp_n_ip_soi_amp_3_0 ldp_tqi_sp_ip_soi_amp_3_0 ip_soi_main1_amp_4_0 ldp_n_ip_soi_amp_4_0 ldp_tqi_sp_ip_soi_amp_4_0 ip_soi_main1_max_n_tqi_sp ldp_n_ip_soi_main1_max ldp_tqi_sp_ip_soi_main1_max ip_soi_main1_min_n_tqi_sp ldp_n_ip_soi_main1_min ldp_tqi_sp_ip_soi_main1_min ip_soi_main1_tgas_0_0 ldp_n_ip_soi_main1_tgas_0_0 ldp_tqi_sp_ip_soi_tgas_0_0 ip_soi_main1_tgas_1_0 ldp_n_ip_soi_main1_tgas_1_0 ldp_tqi_sp_ip_soi_tgas_1_0 ip_soi_main1_tgas_2_0 ldp_n_ip_soi_main1_tgas_2_0 ldp_tqi_sp_ip_soi_tgas_2_0 ip_soi_main1_tgas_3_0 ldp_n_ip_soi_main1_tgas_3_0 ldp_tqi_sp_ip_soi_tgas_3_0 ip_soi_main1_tgas_4_0 ldp_n_ip_soi_main1_tgas_4_0 ldp_tqi_sp_ip_soi_tgas_4_0 /end DEF_CHARACTERISTIC
 /begin OUT_MEASUREMENT soi_main1_is_pl_rgl soi_main1_is_pl_cor_sum_rgl /end OUT_MEASUREMENT
/end FUNCTION
/begin FUNCTION SOI_ASOI_MAIN_TEMP ""
 /begin OUT_MEASUREMENT soi_main1_sel_conf_0 soi_main1_sel_conf_1 soi_main1_sel_conf_2 soi_main1_sel_conf_3 soi_main1_sel_conf_4 /end OUT_MEASUREMENT
/end FUNCTION
/begin FUNCTION SOI_ASOI_MAIN_TRAN "" /begin DEF_CHARACTERISTIC c_t_rgn_trn_soi_main1 /end DEF_CHARACTERISTIC /begin OUT_MEASUREMENT soi_main1_is_pl /end OUT_MEASUREMENT /end FUNCTION
/begin FUNCTION SOI_ASOI_MAIN_RGN ""
 /begin DEF_CHARACTERISTIC ip_fac_soi_cor_amp_rgn_1 ldp_amp_ip_fac_soi_cor_rgn_1 ip_fac_soi_cor_amp_rgn_2 ldp_amp_ip_fac_soi_cor_rgn_2 ip_soi_main1_amp_h_rgn_1 ldpm_n_ip_soi_main1_amp_rgn_1 ldpm_tqi_sp_ip_soi_amp_rgn_1 ip_soi_main1_amp_l_rgn_1 ip_soi_main1_amp_h_rgn_2 ldpm_n_ip_soi_main1_amp_rgn_2 ldpm_tqi_sp_ip_soi_amp_rgn_2 ip_soi_main1_amp_l_rgn_2 /end DEF_CHARACTERISTIC
 /begin OUT_MEASUREMENT soi_main1_is_pl_rgn_1 soi_main1_is_pl_rgn_2 /end OUT_MEASUREMENT
/end FUNCTION
/begin FUNCTION SOI_ASOITRAN ""
 /begin OUT_MEASUREMENT soi_post1 soi_post1_dif soi_post1_bas soi_main2 soi_prev1 soi_prev2 soi_post2 soi_prev1_dif soi_prev2_dif soi_main1 soi_main2_dif soi_main1_bas soi_main2_bas soi_post2_bas soi_prev2_bas soi_prev1_bas /end OUT_MEASUREMENT
/end FUNCTION
/begin FUNCTION C_A_FMY "" /end FUNCTION
/begin FUNCTION C_8_IS ""
 /begin SUB_FUNCTION IS_ATQ_IS IS_ATQSTGEN IS_AIS_PI IS_AIS_CTL IS_ATQI_ST IS_AIS_LIM IS_AIS_PCTL /end SUB_FUNCTION
/end FUNCTION
/begin FUNCTION IS_ATQ_IS ""
 /begin DEF_CHARACTERISTIC lc_is_n_pred c_t1_dt1_is_acin_off c_t1_dt1_is_acin_on c_kr_dt1_is_acin_off c_kr_dt1_is_acin_on c_tqi_dt1_is_min c_tqi_dt1_is_max c_t_dly_dt1_is c_tqi_dt1_is_thd c_kr_dt1_is c_kr_dt1_is_vs_run c_t1_dt1_is c_t1_dt1_is_vs_run c_fac_is_tqi_ini_brake c_fac_is_tqi_ini c_tqi_ini_add_acin lc_is_ini_bls_on id_fac_n_dif_rng_is__dri ldpm_dri_id_isc id_n_dif_rng_is__dri id_tqi_ini__dri ip_n_dif_dt1_is__tco ldp_tco_ip_n_dif_dt1_is ip_tqi_ini__tco ldp_tco_ip_tqi_ini /end DEF_CHARACTERISTIC
 /begin OUT_MEASUREMENT n_dif_is tqi_is_ctl kr_dt1_is tqi_p_is_ctl tqi_is_dt1_acin tqi_is_dt1_n tqi_pi_is_ctl tqi_i_is_ctl tqi_dt1_is_ctl n_dif t1_dt1_is lv_act_dt1_is tqi_is_ini /end OUT_MEASUREMENT
/end FUNCTION
/begin FUNCTION IS_ATQSTGEN ""
 /begin DEF_CHARACTERISTIC ip_dly_ctr_tqi_st ldp_tco_ip_dly_ctr_tq_st ip_tqi_st ldp_n_ip_tqi_st ldp_tco_ip_tqi_st /end DEF_CHARACTERISTIC
 /begin OUT_MEASUREMENT lv_is_ena_st dly_ctr_tqi_st tqi_st /end OUT_MEASUREMENT
/end FUNCTION
/begin FUNCTION IS_AIS_PI ""
 /begin DEF_CHARACTERISTIC c_gain_n_dif_pos_ki c_gain_n_dif_neg_ki c_gain_n_dif_pos_kp c_gain_n_dif_neg_kp c_n_dif_thd_pos_kp c_n_dif_thd_neg_kp c_n_dif_thd_pos_ki c_n_dif_thd_neg_ki c_n_dif_win_pos_ki c_n_dif_win_neg_ki c_n_dif_win_pos_kp c_n_dif_win_neg_kp lc_is_p_ctl_brake c_fac_kr_pi_is_brake id_kr_pi_is__dri ip_ki_pi_neg_is_tco ldp_tco_ip_ki_pi_neg_is ip_ki_pi_pos_is_tco ldp_tco_ip_ki_pi_pos_is ip_kr_pi_neg_is__tco ldp_tco_ip_kr_pi_neg_is ip_kr_pi_pos_is__tco ldp_tco_ip_kr_pi_pos_is id_ki_pi_is_dri /end DEF_CHARACTERISTIC
 /begin OUT_MEASUREMENT ki_pi_is kp_pi_is /end OUT_MEASUREMENT
/end FUNCTION
/begin FUNCTION IS_AIS_CTL "" /begin DEF_CHARACTERISTIC ip_n_is_add_tco ldp_tco_ip_n_is_add id_n_add_dri /end DEF_CHARACTERISTIC /begin OUT_MEASUREMENT lv_req_is_ctl t_ais_req /end OUT_MEASUREMENT /end FUNCTION
/begin FUNCTION IS_ATQI_ST "" /begin OUT_MEASUREMENT tqi_st_add /end OUT_MEASUREMENT /end FUNCTION
/begin FUNCTION IS_AIS_LIM "" /begin DEF_CHARACTERISTIC c_tqi_is_max c_tqi_is_min /end DEF_CHARACTERISTIC /begin OUT_MEASUREMENT lv_tqi_is_min lv_tqi_is_max tqi_is_min tqi_is_max /end OUT_MEASUREMENT /end FUNCTION
/begin FUNCTION IS_AIS_PCTL "" /begin OUT_MEASUREMENT tqi_is_pre_ctl /end OUT_MEASUREMENT /end FUNCTION
/begin FUNCTION C_B_ERRM_extended "Error Management data for diagnosis B extended" /end FUNCTION
/begin FUNCTION C_S_AGGR "Transfer Modules for Aggregates" /begin SUB_FUNCTION AGGR_ATRANEGCP /end SUB_FUNCTION /end FUNCTION
/end MODULE
/end PROJECT
