ASAP2_VERSION 1 41
/begin PROJECT SN0 "SIMOS PPD"
/begin HEADER "_default_HeaderComment" PROJECT_NO PRJ_NUM /end HEADER
/begin MODULE _default_ModuleName "_default_ModuleLongIdentifier"
/begin MOD_COMMON "_default_ModCommonComment" DEPOSIT ABSOLUTE BYTE_ORDER MSB_FIRST ALIGNMENT_BYTE 1 ALIGNMENT_WORD 2 ALIGNMENT_LONG 4 ALIGNMENT_FLOAT32_IEEE 4 ALIGNMENT_FLOAT64_IEEE 8 /end MOD_COMMON
/begin CHARACTERISTIC lc_inh_lsl_gain_ad_swi_man "Switch for manual inhibition of Gain Adaptation" VALUE 0x840fa7 _REC_VAL_20_u1 1. _CNV_A_R_LINEAR_____1_CM 0. 1. DISPLAY_IDENTIFIER LC_INH_LSL_GAIN_AD_SWI_MAN FORMAT "%1.0" /end CHARACTERISTIC
/begin CHARACTERISTIC c_ctr_icplsl_dec "Decrement of counter used to approximate emptying of WRAF sensor pumped oxygen reference" VALUE 0x840d9b _REC_VAL_20_u1 255. _CNV_A_R_LINEAR_____1_CM 0. 255. DISPLAY_IDENTIFIER C_CTR_ICPLSL_DEC FORMAT "%3.0" /end CHARACTERISTIC
/begin CHARACTERISTIC c_ctr_icplsl_inc "Increment of counter used to approximate filling of WRAF sensor pumped oxygen reference" VALUE 0x840d9c _REC_VAL_20_u1 255. _CNV_A_R_LINEAR_____1_CM 0. 255. DISPLAY_IDENTIFIER C_CTR_ICPLSL_INC FORMAT "%3.0" /end CHARACTERISTIC
/begin CHARACTERISTIC c_ctr_icplsl_thd "Threshold of counter used to approximate filling & emptying of WRAF sensor pumped oxygen reference" VALUE 0x840d9e _REC_VAL_20_u2 65535. _CNV_A_R_LINEAR_____1_CM 0. 65535. DISPLAY_IDENTIFIER C_CTR_ICPLSL_THD FORMAT "%5.0" /end CHARACTERISTIC
/begin CHARACTERISTIC lc_icplsl_act "Boolean flag indicating whether upstream WRAF sensors are of type pumped-reference or not" VALUE 0x840fa5 _REC_VAL_20_u1 1. _CNV_A_R_LINEAR_____1_CM 0. 1. DISPLAY_IDENTIFIER LC_ICPLSL_ACT FORMAT "%1.0" /end CHARACTERISTIC
/begin CHARACTERISTIC lc_icplsl_ena_lsl_if "Boolean flag permitting manual activation / deactivation of pumped-reference current (Icp)" VALUE 0x840fa6 _REC_VAL_20_u1 1. _CNV_A_R_LINEAR_____1_CM 0. 1. DISPLAY_IDENTIFIER LC_ICPLSL_ENA_LSL_IF FORMAT "%1.0" /end CHARACTERISTIC
/begin CHARACTERISTIC lc_iplsl_ctl_ena_man_swi_lsl_if "Boolean flag permitting manual activation / deactivation of pump current control" VALUE 0x840fa9 _REC_VAL_20_u1 1. _CNV_A_R_LINEAR_____1_CM 0. 1. DISPLAY_IDENTIFIER LC_IPLSL_CTL_ENA_MAN_SWI_LSL_IF FORMAT "%1.0" /end CHARACTERISTIC
/begin CHARACTERISTIC lc_iplsl_ctl_ena_man_lsl_if "Boolean flag requesting activation / deactivation of pump current control during manual control" VALUE 0x840fa8 _REC_VAL_20_u1 1. _CNV_A_R_LINEAR_____1_CM 0. 1. DISPLAY_IDENTIFIER LC_IPLSL_CTL_ENA_MAN_LSL_IF FORMAT "%1.0" /end CHARACTERISTIC
/begin AXIS_PTS ldp_lamb_sp_ip_r_it_iplsl "" 0x840840 online_dummy _REC_AXS_20_u2 31.9990234375 _CNV_A_R_LINEAR_____465_CM 8 0. 31.9990234375 FORMAT "%7.4" /end AXIS_PTS
/begin CHARACTERISTIC c_r_it_iplsl_agi_add "Additive ageing constant for WRAF sensor internal pump cell DC resistance" VALUE 0x840e80 _REC_VAL_20_u2 16383.75 _CNV_A_R_EGCP_LINEA_466_CM 0. 16383.75 DISPLAY_IDENTIFIER C_R_IT_IPLSL_AGI_ADD FORMAT "%9.2" /end CHARACTERISTIC
/begin CHARACTERISTIC c_icplsl_pwl_lsl_if "Configuration of pumping current for WRAF sensor oxygen reference  (Icp) during power latch phase" VALUE 0x840de6 _REC_VAL_20_u1 31. _CNV_A_R_LINEAR_____1_CM 0. 31. DISPLAY_IDENTIFIER C_ICPLSL_PWL_LSL_IF FORMAT "%2.0" /end CHARACTERISTIC
/begin CHARACTERISTIC c_vplsl_thd_vnlsl_lim "Pumping voltage (Vp) thrshold below which Icp cut-off /Vn overvoltage conditions are detected" VALUE 0x840f9c _REC_VAL_20_s1 6.422813 _CNV_A_R_EGCP_LINEA_467_CM -3.224 3.198813 DISPLAY_IDENTIFIER C_VPLSL_THD_VNLSL_LIM FORMAT "%5.2" /end CHARACTERISTIC
/begin CHARACTERISTIC c_t_icplsl_dly_pwl "Delay time for limited Icp supply during ECU power latch" VALUE 0x840ec2 _REC_VAL_20_u2 655.35 _CNV_A_R_LINEAR_____226_CM 0. 655.35 DISPLAY_IDENTIFIER C_T_ICPLSL_DLY_PWL FORMAT "%6.2" /end CHARACTERISTIC
/begin CHARACTERISTIC c_ctr_iplsl_ctl_ena_nr_cyc "Number of cycles for pulsed activation of pump control" VALUE 0x840da1 _REC_VAL_20_u1 255. _CNV_A_R_LINEAR_____1_CM 0. 255. DISPLAY_IDENTIFIER C_CTR_IPLSL_CTL_ENA_NR_CYC FORMAT "%3.0" /end CHARACTERISTIC
/begin CHARACTERISTIC c_ctr_iplsl_ctl_ena_pwm_on "Threshold for duration of \"Ip on\" phase during pulsed activation of pump current" VALUE 0x840da3 _REC_VAL_20_u1 255. _CNV_A_R_LINEAR_____1_CM 0. 255. DISPLAY_IDENTIFIER C_CTR_IPLSL_CTL_ENA_PWM_ON FORMAT "%3.0" /end CHARACTERISTIC
/begin CHARACTERISTIC c_ctr_iplsl_ctl_ena_pwm_off "Threshold for duration of \"Ip off\" phase during pulsed activation of pump current" VALUE 0x840da2 _REC_VAL_20_u1 255. _CNV_A_R_LINEAR_____1_CM 0. 255. DISPLAY_IDENTIFIER C_CTR_IPLSL_CTL_ENA_PWM_OFF FORMAT "%3.0" /end CHARACTERISTIC
/begin CHARACTERISTIC c_ttip_thd_iplsl_act_ls_up "Ceramic temperature above which Ip control loop may be activated" VALUE 0x840f32 _REC_VAL_20_s2 4095.9375 _CNV_A_R_EGCP_LINEA_468_CM -2048. 2047.9375 DISPLAY_IDENTIFIER C_TTIP_THD_IPLSL_ACT_LS_UP FORMAT "%10.4" /end CHARACTERISTIC
/begin CHARACTERISTIC c_t_dly_iplsl_ctl_ena "Delay to be exceeded from switching on of pump current control to setting validity flag" VALUE 0x840ea9 _REC_VAL_20_u1 2.55 _CNV_A_R_LINEAR_____226_CM 0. 2.55 DISPLAY_IDENTIFIER C_T_DLY_IPLSL_CTL_ENA FORMAT "%4.2" /end CHARACTERISTIC
/begin CHARACTERISTIC c_t_dly_max_vnlsl_lim_act "Delay from determining Icp cut-off / Vn voltage to forced revokation of Ip control loop disable flag" VALUE 0x840eae _REC_VAL_20_u2 655.35 _CNV_A_R_LINEAR_____226_CM 0. 655.35 DISPLAY_IDENTIFIER C_T_DLY_MAX_VNLSL_LIM_ACT FORMAT "%6.2" /end CHARACTERISTIC
/begin CHARACTERISTIC c_ttip_thd_icplsl_inc_ls_up "Ceramic temperature above which Ip can be switched to elevated values (warm sensor)" VALUE 0x840f30 _REC_VAL_20_s2 4095.9375 _CNV_A_R_EGCP_LINEA_468_CM -2048. 2047.9375 DISPLAY_IDENTIFIER C_TTIP_THD_ICPLSL_INC_LS_UP FORMAT "%10.4" /end CHARACTERISTIC
/begin CHARACTERISTIC c_lamb_thd_max_vnlsl_lim "Maximum value of lambda threshold for Vn overvoltage / reverse Icp cut-off monitoring" VALUE 0x840e30 _REC_VAL_20_u2 31.9990234375 _CNV_A_R_LINEAR_____465_CM 0. 31.9990234375 DISPLAY_IDENTIFIER C_LAMB_THD_MAX_VNLSL_LIM FORMAT "%7.4" /end CHARACTERISTIC
/begin CHARACTERISTIC c_lamb_thd_max_vplsl_lim "Maximum value of lambda threshold for Vp limitation" VALUE 0x840e32 _REC_VAL_20_u2 31.9990234375 _CNV_A_R_LINEAR_____465_CM 0. 31.9990234375 DISPLAY_IDENTIFIER C_LAMB_THD_MAX_VPLSL_LIM FORMAT "%7.4" /end CHARACTERISTIC
/begin CHARACTERISTIC c_lamb_sp_min_iplsl_ctl_ena "Minimum value of lambda setpoint for activation of Ip control loop" VALUE 0x840e2a _REC_VAL_20_u2 31.9990234375 _CNV_A_R_LINEAR_____465_CM 0. 31.9990234375 DISPLAY_IDENTIFIER C_LAMB_SP_MIN_IPLSL_CTL_ENA FORMAT "%7.4" /end CHARACTERISTIC
/begin CHARACTERISTIC c_lamb_sp_max_iplsl_ctl_ena "Maximum value of lambda setpoint for activation of Ip control loop" VALUE 0x840e28 _REC_VAL_20_u2 31.9990234375 _CNV_A_R_LINEAR_____465_CM 0. 31.9990234375 DISPLAY_IDENTIFIER C_LAMB_SP_MAX_IPLSL_CTL_ENA FORMAT "%7.4" /end CHARACTERISTIC
/begin AXIS_PTS ldp_r_it_ls_up_ip_r_it_iplsl "" 0x8408d2 online_dummy _REC_AXS_20_u2 16383.75 _CNV_A_R_EGCP_LINEA_466_CM 8 0. 16383.75 FORMAT "%9.2" /end AXIS_PTS
/begin AXIS_PTS ldp_ttip_ls_ip_ctr_icplsl_thd "" 0x840944 online_dummy _REC_AXS_20_u2 4095.9375 _CNV_A_R_EGCP_LINEA_469_CM 3 -2048. 2047.9375 FORMAT "%10.4" /end AXIS_PTS
/begin AXIS_PTS ldp_icplsl_ip_ctr_icplsl_thd "" 0x84081a online_dummy _REC_AXS_20_u1 31. _CNV_A_R_LINEAR_____1_CM 3 0. 31. FORMAT "%2.0" /end AXIS_PTS
/begin AXIS_PTS ldp_lamb_ip_icplsl_iplsl_ena "" 0x840828 online_dummy _REC_AXS_20_u2 31.9990234375 _CNV_A_R_LINEAR_____465_CM 3 0. 31.9990234375 FORMAT "%7.4" /end AXIS_PTS
/begin AXIS_PTS ldp_lamb_sp_ip_icplsl_iplsl_di "" 0x840830 online_dummy _REC_AXS_20_u2 31.9990234375 _CNV_A_R_LINEAR_____465_CM 3 0. 31.9990234375 FORMAT "%7.4" /end AXIS_PTS
/begin AXIS_PTS ldp_lamb_sp_ip_icplsl_wup "" 0x840838 online_dummy _REC_AXS_20_u2 31.9990234375 _CNV_A_R_LINEAR_____465_CM 3 0. 31.9990234375 FORMAT "%7.4" /end AXIS_PTS
/begin AXIS_PTS ldp_saf_kgh_ip_icplsl_iplsl_di "" 0x840908 online_dummy _REC_AXS_20_u2 1023.984375 _CNV_A_R_LINEAR_____110_CM 3 0. 1023.984375 FORMAT "%7.2" /end AXIS_PTS
/begin AXIS_PTS ldp_saf_kgh_ip_icplsl_wup "" 0x840910 online_dummy _REC_AXS_20_u2 1023.984375 _CNV_A_R_LINEAR_____110_CM 3 0. 1023.984375 FORMAT "%7.2" /end AXIS_PTS
/begin CHARACTERISTIC ip_r_it_iplsl "Internal DC resistance of WRAF sensor pump cell" MAP 0x85cee4 _REC_MAP_20_u2_u2_u2 16383.75 _CNV_A_R_EGCP_LINEA_466_CM 0. 16383.75 DISPLAY_IDENTIFIER IP_R_IT_IPLSL FORMAT "%9.2"
 /begin AXIS_DESCR COM_AXIS online_dummy _CNV_A_R_EGCP_LINEA_466_CM 8 0. 16383.75 FORMAT "%9.2" AXIS_PTS_REF ldp_r_it_ls_up_ip_r_it_iplsl /end AXIS_DESCR
 /begin AXIS_DESCR COM_AXIS online_dummy _CNV_A_R_LINEAR_____465_CM 8 0. 31.9990234375 FORMAT "%7.4" AXIS_PTS_REF ldp_lamb_sp_ip_r_it_iplsl /end AXIS_DESCR
/end CHARACTERISTIC
/begin CHARACTERISTIC id_ctr_icplsl_thd "Variable threshold of counter used to approximate filling and emptying of WRAF sensor pumped reference area" MAP 0x840a4c _REC_MAP_20_u2_u2_u1 65535. _CNV_A_R_LINEAR_____1_CM 0. 65535. DISPLAY_IDENTIFIER ID_CTR_ICPLSL_THD FORMAT "%5.0"
 /begin AXIS_DESCR COM_AXIS online_dummy _CNV_A_R_EGCP_LINEA_469_CM 3 -2048. 2047.9375 FORMAT "%10.4" AXIS_PTS_REF ldp_ttip_ls_ip_ctr_icplsl_thd /end AXIS_DESCR
 /begin AXIS_DESCR COM_AXIS online_dummy _CNV_A_R_LINEAR_____1_CM 3 0. 31. FORMAT "%2.0" AXIS_PTS_REF ldp_icplsl_ip_ctr_icplsl_thd /end AXIS_DESCR
/end CHARACTERISTIC
/begin CHARACTERISTIC ip_lsl_if_icplsl_iplsl_ctl_ena "Configuration of current to pump reference air (Icp) with Ip control enabled" CURVE 0x840c6a _REC_CUR_20_u1_u2 31. _CNV_A_R_LINEAR_____1_CM 0. 31. DISPLAY_IDENTIFIER IP_LSL_IF_ICPLSL_IPLSL_CTL_ENA FORMAT "%2.0"
 /begin AXIS_DESCR COM_AXIS online_dummy _CNV_A_R_LINEAR_____465_CM 3 0. 31.9990234375 FORMAT "%7.4" AXIS_PTS_REF ldp_lamb_ip_icplsl_iplsl_ena /end AXIS_DESCR
/end CHARACTERISTIC
/begin CHARACTERISTIC id_lsl_if_icplsl_iplsl_ctl_di "Configuration of current to pump reference air (Icp) with Ip control disabled and warm WRAF sensor" MAP 0x840a5e _REC_MAP_20_u1_u2_u2 31. _CNV_A_R_LINEAR_____1_CM 0. 31. DISPLAY_IDENTIFIER ID_LSL_IF_ICPLSL_IPLSL_CTL_DI FORMAT "%2.0"
 /begin AXIS_DESCR COM_AXIS online_dummy _CNV_A_R_LINEAR_____465_CM 3 0. 31.9990234375 FORMAT "%7.4" AXIS_PTS_REF ldp_lamb_sp_ip_icplsl_iplsl_di /end AXIS_DESCR
 /begin AXIS_DESCR COM_AXIS online_dummy _CNV_A_R_LINEAR_____110_CM 3 0. 1023.984375 FORMAT "%7.2" AXIS_PTS_REF ldp_saf_kgh_ip_icplsl_iplsl_di /end AXIS_DESCR
/end CHARACTERISTIC
/begin CHARACTERISTIC id_lsl_if_icplsl_wup "Configuration of current to pump reference air (Icp) with Ip control disabled and cold WRAF sensor" MAP 0x840a67 _REC_MAP_20_u1_u2_u2 31. _CNV_A_R_LINEAR_____1_CM 0. 31. DISPLAY_IDENTIFIER ID_LSL_IF_ICPLSL_WUP FORMAT "%2.0"
 /begin AXIS_DESCR COM_AXIS online_dummy _CNV_A_R_LINEAR_____465_CM 3 0. 31.9990234375 FORMAT "%7.4" AXIS_PTS_REF ldp_lamb_sp_ip_icplsl_wup /end AXIS_DESCR
 /begin AXIS_DESCR COM_AXIS online_dummy _CNV_A_R_LINEAR_____110_CM 3 0. 1023.984375 FORMAT "%7.2" AXIS_PTS_REF ldp_saf_kgh_ip_icplsl_wup /end AXIS_DESCR
/end CHARACTERISTIC
/begin CHARACTERISTIC c_r_it_iplsl_agi_fac "Multiplicative ageing factor for WRAF sensor internal pump cell DC resistance" VALUE 0x840e82 _REC_VAL_20_u1 7.96875 _CNV_A_R_LINEAR_____304_CM 0. 7.96875 DISPLAY_IDENTIFIER C_R_IT_IPLSL_AGI_FAC FORMAT "%4.2" /end CHARACTERISTIC
/begin CHARACTERISTIC ip_fac_neg_ctl_p_lsh_up "Closed loop controller P-term factor for temperature too high; decrease heater voltage" MAP 0x840b42 _REC_MAP_20_u1_u1_u2 0.255 _CNV_A_R_EGCP_LINEA_470_CM 0. 0.255 DISPLAY_IDENTIFIER IP_FAC_NEG_CTL_P_LSH_UP FORMAT "%5.3"
 /begin AXIS_DESCR COM_AXIS n_32 _CNV_A_R_LINEAR_____81_CM 6 0. 8160. FORMAT "%4.0" AXIS_PTS_REF ldpm_n_32_1_egcp /end AXIS_DESCR
 /begin AXIS_DESCR COM_AXIS online_dummy _CNV_A_R_EGCP_LINEA_468_CM 6 0. 2047. FORMAT "%9.4" AXIS_PTS_REF ldpm_teg_cat_up_mdl_1_egcp /end AXIS_DESCR
/end CHARACTERISTIC
/begin CHARACTERISTIC ip_fac_pos_ctl_p_lsh_up "Closed loop controller P-term factor for temperature too low; increase heater voltage" MAP 0x840b8a _REC_MAP_20_u1_u1_u2 0.255 _CNV_A_R_EGCP_LINEA_470_CM 0. 0.255 DISPLAY_IDENTIFIER IP_FAC_POS_CTL_P_LSH_UP FORMAT "%5.3"
 /begin AXIS_DESCR COM_AXIS n_32 _CNV_A_R_LINEAR_____81_CM 6 0. 8160. FORMAT "%4.0" AXIS_PTS_REF ldpm_n_32_1_egcp /end AXIS_DESCR
 /begin AXIS_DESCR COM_AXIS online_dummy _CNV_A_R_EGCP_LINEA_468_CM 6 0. 2047. FORMAT "%9.4" AXIS_PTS_REF ldpm_teg_cat_up_mdl_1_egcp /end AXIS_DESCR
/end CHARACTERISTIC
/begin CHARACTERISTIC ip_fac_pos_ctl_i_lsh_up "Closed loop controller I-term factor for temperature too low; increase heater voltage" MAP 0x840b66 _REC_MAP_20_u1_u1_u2 0.255 _CNV_A_R_EGCP_LINEA_470_CM 0. 0.255 DISPLAY_IDENTIFIER IP_FAC_POS_CTL_I_LSH_UP FORMAT "%5.3"
 /begin AXIS_DESCR COM_AXIS n_32 _CNV_A_R_LINEAR_____81_CM 6 0. 8160. FORMAT "%4.0" AXIS_PTS_REF ldpm_n_32_1_egcp /end AXIS_DESCR
 /begin AXIS_DESCR COM_AXIS online_dummy _CNV_A_R_EGCP_LINEA_468_CM 6 0. 2047. FORMAT "%9.4" AXIS_PTS_REF ldpm_teg_cat_up_mdl_1_egcp /end AXIS_DESCR
/end CHARACTERISTIC
/begin CHARACTERISTIC c_ttip_dif_min_ctl_p_ls_up "Minimum required temperature difference in order to calculate P term of controller" VALUE 0x840f22 _REC_VAL_20_u2 2047.9375 _CNV_A_R_EGCP_LINEA_468_CM 0. 2047.9375 DISPLAY_IDENTIFIER C_TTIP_DIF_MIN_CTL_P_LS_UP FORMAT "%7.2" /end CHARACTERISTIC
/begin CHARACTERISTIC c_fac_ctl_p_lsh_up "Multiplicative scaling factor for closed loop P-term" VALUE 0x840dc1 _REC_VAL_20_u1 6.348 _CNV_A_R_EGCP_LINEA_471_CM 0. 6.348 DISPLAY_IDENTIFIER C_FAC_CTL_P_LSH_UP FORMAT "%5.3" /end CHARACTERISTIC
/begin CHARACTERISTIC ip_v_efc_ini_lsh_up "Initial effective heater voltage" CURVE 0x840d62 _REC_CUR_20_u1_u2 25.8984375 _CNV_A_R_LINEAR_____349_CM 0. 25.8984375 DISPLAY_IDENTIFIER IP_V_EFC_INI_LSH_UP FORMAT "%9.6"
 /begin AXIS_DESCR COM_AXIS online_dummy _CNV_A_R_EGCP_LINEA_469_CM 6 -2048. 2047.9375 FORMAT "%10.4" AXIS_PTS_REF ldpm_temp_ini_ls_up_1_egcp /end AXIS_DESCR
/end CHARACTERISTIC
/begin CHARACTERISTIC ip_v_efc_ctl_lsh_up "Open loop control effective heater voltage" MAP 0x840d38 _REC_MAP_20_u1_u1_u2 25.8984375 _CNV_A_R_LINEAR_____349_CM 0. 25.8984375 DISPLAY_IDENTIFIER IP_V_EFC_CTL_LSH_UP FORMAT "%9.6"
 /begin AXIS_DESCR COM_AXIS n_32 _CNV_A_R_LINEAR_____81_CM 6 0. 8160. FORMAT "%4.0" AXIS_PTS_REF ldpm_n_32_1_egcp /end AXIS_DESCR
 /begin AXIS_DESCR COM_AXIS online_dummy _CNV_A_R_EGCP_LINEA_468_CM 6 0. 2047. FORMAT "%9.4" AXIS_PTS_REF ldpm_teg_cat_up_mdl_1_egcp /end AXIS_DESCR
/end CHARACTERISTIC
/begin CHARACTERISTIC ip_t_temp_thd_lsh_up "Duration until critical water splash sensor temperature reached" CURVE 0x840cee _REC_CUR_20_u1_u2 25.5 _CNV_A_R_LINEAR_____240_CM 0. 25.5 DISPLAY_IDENTIFIER IP_T_TEMP_THD_LSH_UP FORMAT "%4.1"
 /begin AXIS_DESCR COM_AXIS online_dummy _CNV_A_R_EGCP_LINEA_469_CM 6 -2048. 2047.9375 FORMAT "%10.4" AXIS_PTS_REF ldpm_temp_ini_ls_up_1_egcp /end AXIS_DESCR
/end CHARACTERISTIC
/begin CHARACTERISTIC ip_fac_v_efc_teg_lsh_up "Factor for the heat transfer rate, bank 2 only" CURVE 0x840bc4 _REC_CUR_20_u1_u1 3.984375 _CNV_A_R_LINEAR_____244_CM 0. 3.984375 DISPLAY_IDENTIFIER IP_FAC_V_EFC_TEG_LSH_UP FORMAT "%8.6"
 /begin AXIS_DESCR COM_AXIS online_dummy _CNV_A_R_LINEAR_____245_CM 6 0. 255. FORMAT "%3.0" AXIS_PTS_REF ldp_vs_ip_fac_v_efc_teg_lsh_up /end AXIS_DESCR
/end CHARACTERISTIC
/begin CHARACTERISTIC c_v_efc_inc_lsh_up "Effective heater voltage increment to raise temperature" VALUE 0x840f3d _REC_VAL_20_u1 1.625 _CNV_A_R_EGCP_LINEA_472_CM 0. 1.625 DISPLAY_IDENTIFIER C_V_EFC_INC_LSH_UP FORMAT "%5.3" /end CHARACTERISTIC
/begin CHARACTERISTIC c_v_efc_dec_lsh_up "Effective heater voltage decrement to lower temperature" VALUE 0x840f3b _REC_VAL_20_u1 1.625 _CNV_A_R_EGCP_LINEA_472_CM 0. 1.625 DISPLAY_IDENTIFIER C_V_EFC_DEC_LSH_UP FORMAT "%5.3" /end CHARACTERISTIC
/begin CHARACTERISTIC c_v_efc_red_lsh_up "Reduced effective heater voltage during danger of water splash damage" VALUE 0x840f47 _REC_VAL_20_u1 25.8984375 _CNV_A_R_LINEAR_____349_CM 0. 25.8984375 DISPLAY_IDENTIFIER C_V_EFC_RED_LSH_UP FORMAT "%9.6" /end CHARACTERISTIC
/begin CHARACTERISTIC c_v_efc_step_lsh_up "Additional effective heater voltage step on transition from LSH_POW_RED to LSH_POW_RISE" VALUE 0x840f49 _REC_VAL_20_s1 25.898438 _CNV_A_R_EGCP_LINEA_473_CM -13. 12.898438 DISPLAY_IDENTIFIER C_V_EFC_STEP_LSH_UP FORMAT "%5.1" /end CHARACTERISTIC
/begin CHARACTERISTIC c_t_max_pow_rise_lsh_up "Duration of open loop pre-heating in LSH_POW_RISE from dew-point to set-point temperature" VALUE 0x840ed0 _REC_VAL_20_u2 6553.5 _CNV_A_R_LINEAR_____240_CM 0. 6553.5 DISPLAY_IDENTIFIER C_T_MAX_POW_RISE_LSH_UP FORMAT "%6.1" /end CHARACTERISTIC
/begin CHARACTERISTIC c_t_max_v_efc_tol_lsh_up "Maximum permitted duration where excessive effective heater voltage tolerated" VALUE 0x840ed7 _REC_VAL_20_u1 25.5 _CNV_A_R_LINEAR_____240_CM 0. 25.5 DISPLAY_IDENTIFIER C_T_MAX_V_EFC_TOL_LSH_UP FORMAT "%4.1" /end CHARACTERISTIC
/begin CHARACTERISTIC c_t_max_v_efc_lim_lsh_up "Maximum duration of effective heater voltage limiting" VALUE 0x840ed3 _REC_VAL_20_u1 25.5 _CNV_A_R_LINEAR_____240_CM 0. 25.5 DISPLAY_IDENTIFIER C_T_MAX_V_EFC_LIM_LSH_UP FORMAT "%4.1" /end CHARACTERISTIC
/begin CHARACTERISTIC c_t_max_v_efc_max_st_lsh_up "Time after start at which step in max. effective heater voltage applied" VALUE 0x840ed5 _REC_VAL_20_u1 25.5 _CNV_A_R_LINEAR_____240_CM 0. 25.5 DISPLAY_IDENTIFIER C_T_MAX_V_EFC_MAX_ST_LSH_UP FORMAT "%4.1" /end CHARACTERISTIC
/begin CHARACTERISTIC c_t_ast_max_lsh_up "Time after start at which step in max. effective heater voltage applied" VALUE 0x840e90 _REC_VAL_20_u2 6553.5 _CNV_A_R_LINEAR_____240_CM 0. 6553.5 DISPLAY_IDENTIFIER C_T_AST_MAX_LSH_UP FORMAT "%6.1" /end CHARACTERISTIC
/begin CHARACTERISTIC c_v_efc_tol_lsh_up "Effective heater voltage threshold above which voltage limiting may occur if threshold persistently exceeded" VALUE 0x840f4b _REC_VAL_20_u1 25.8984375 _CNV_A_R_LINEAR_____349_CM 0. 25.8984375 DISPLAY_IDENTIFIER C_V_EFC_TOL_LSH_UP FORMAT "%9.6" /end CHARACTERISTIC
/begin CHARACTERISTIC c_v_efc_lim_lsh_up "Effective heater voltage limit under persistent excessive heater voltage condition" VALUE 0x840f3f _REC_VAL_20_u1 25.8984375 _CNV_A_R_LINEAR_____349_CM 0. 25.8984375 DISPLAY_IDENTIFIER C_V_EFC_LIM_LSH_UP FORMAT "%9.6" /end CHARACTERISTIC
/begin CHARACTERISTIC c_vb_max_prot_lsh_up "Maximum permitted battery voltage threshold, over which overvoltage detected" VALUE 0x840f4f _REC_VAL_20_u1 25.8984375 _CNV_A_R_LINEAR_____349_CM 0. 25.8984375 DISPLAY_IDENTIFIER C_VB_MAX_PROT_LSH_UP FORMAT "%9.6" /end CHARACTERISTIC
/begin CHARACTERISTIC c_v_efc_prot_vb_lsh_up "Effective heater voltage in the case of battery voltage overvoltage condition" VALUE 0x840f45 _REC_VAL_20_u1 25.8984375 _CNV_A_R_LINEAR_____349_CM 0. 25.8984375 DISPLAY_IDENTIFIER C_V_EFC_PROT_VB_LSH_UP FORMAT "%9.6" /end CHARACTERISTIC
/begin CHARACTERISTIC c_v_efc_max_lsh_up "Absolute maximum permitted effective heater voltage after initial phase; threshold & limit " VALUE 0x840f41 _REC_VAL_20_u1 25.8984375 _CNV_A_R_LINEAR_____349_CM 0. 25.8984375 DISPLAY_IDENTIFIER C_V_EFC_MAX_LSH_UP FORMAT "%9.6" /end CHARACTERISTIC
/begin CHARACTERISTIC c_v_efc_max_st_lsh_up "Absolute maximum permitted effective heater voltage during initial phase; threshold & limit " VALUE 0x840f43 _REC_VAL_20_u1 25.8984375 _CNV_A_R_LINEAR_____349_CM 0. 25.8984375 DISPLAY_IDENTIFIER C_V_EFC_MAX_ST_LSH_UP FORMAT "%9.6" /end CHARACTERISTIC
/begin CHARACTERISTIC c_v_efc_as_lsh_up "Effective heater voltage calibration system additive factor" VALUE 0x840f39 _REC_VAL_20_s1 25.898438 _CNV_A_R_EGCP_LINEA_473_CM -13. 12.898438 DISPLAY_IDENTIFIER C_V_EFC_AS_LSH_UP FORMAT "%5.1" /end CHARACTERISTIC
/begin CHARACTERISTIC c_fac_v_efc_as_lsh_up "Multiplicative correction factor to effective heater voltage" VALUE 0x840ddf _REC_VAL_20_u1 1.9921875 _CNV_A_R_LINEAR_____246_CM 0. 1.9921875 DISPLAY_IDENTIFIER C_FAC_V_EFC_AS_LSH_UP FORMAT "%8.6" /end CHARACTERISTIC
/begin CHARACTERISTIC c_fac_v_efc_as_lsh_down "Multiplicative correction factor to effective heater voltage" VALUE 0x840dde _REC_VAL_20_u1 1.9921875 _CNV_A_R_LINEAR_____246_CM 0. 1.9921875 DISPLAY_IDENTIFIER C_FAC_V_EFC_AS_LSH_DOWN FORMAT "%8.6" /end CHARACTERISTIC
/begin CHARACTERISTIC c_teg_cat_up_mdl_max_lsh_up "Maximum permitted exhaust gas temperature above which LSH switched off" VALUE 0x840f10 _REC_VAL_20_u2 2047. _CNV_A_R_EGCP_LINEA_468_CM 0. 2047. DISPLAY_IDENTIFIER C_TEG_CAT_UP_MDL_MAX_LSH_UP FORMAT "%9.4" /end CHARACTERISTIC
/begin CHARACTERISTIC c_fac_ctl_i_lsh_up "Multiplicative scaling factor for closed loop I-term" VALUE 0x840dc0 _REC_VAL_20_u1 6.348 _CNV_A_R_EGCP_LINEA_471_CM 0. 6.348 DISPLAY_IDENTIFIER C_FAC_CTL_I_LSH_UP FORMAT "%5.3" /end CHARACTERISTIC
/begin CHARACTERISTIC c_ttip_sp_ls_up[0] "Oxygen sensor set temperature for closed loop control" VALUE 0x840f2e _REC_VAL_20_s2 4095.9375 _CNV_A_R_EGCP_LINEA_468_CM -2048. 2047.9375 DISPLAY_IDENTIFIER C_TTIP_SP_LS_UP_1_ FORMAT "%10.4" /end CHARACTERISTIC
/begin CHARACTERISTIC lc_lsh_ctl_cll_inh_lsh_up[0] "Boolean constant to permit suspension of closed loop heater control" VALUE 0x840faa _REC_VAL_20_u1 1. _CNV_A_R_LINEAR_____1_CM 0. 1. DISPLAY_IDENTIFIER LC_LSH_CTL_CLL_INH_LSH_UP_1_ FORMAT "%1.0" /end CHARACTERISTIC
/begin AXIS_PTS ldp_vs_ip_fac_v_efc_teg_lsh_up "" 0x840992 online_dummy _REC_AXS_20_u1 255. _CNV_A_R_LINEAR_____245_CM 6 0. 255. FORMAT "%3.0" /end AXIS_PTS
/begin AXIS_PTS ldp_t_pow_rise_lsh_up_id_ttip "" 0x840918 online_dummy _REC_AXS_20_u2 6553.5 _CNV_A_R_LINEAR_____240_CM 4 0. 6553.5 FORMAT "%6.1" /end AXIS_PTS
/begin CHARACTERISTIC ip_fac_neg_ctl_i_lsh_up "Closed loop controller I-term factor for temperature too high; decrease heater voltage" MAP 0x840b1e _REC_MAP_20_u1_u1_u2 0.255 _CNV_A_R_EGCP_LINEA_470_CM 0. 0.255 DISPLAY_IDENTIFIER IP_FAC_NEG_CTL_I_LSH_UP FORMAT "%5.3"
 /begin AXIS_DESCR COM_AXIS n_32 _CNV_A_R_LINEAR_____81_CM 6 0. 8160. FORMAT "%4.0" AXIS_PTS_REF ldpm_n_32_1_egcp /end AXIS_DESCR
 /begin AXIS_DESCR COM_AXIS online_dummy _CNV_A_R_EGCP_LINEA_468_CM 6 0. 2047. FORMAT "%9.4" AXIS_PTS_REF ldpm_teg_cat_up_mdl_1_egcp /end AXIS_DESCR
/end CHARACTERISTIC
/begin CHARACTERISTIC id_ttip_sp_dif_lsh_up "Reducing value for TTIP threshold of transition conditions LSH_POW_RISE to LSH_POW_CTL" CURVE 0x840a88 _REC_CUR_20_s2_u2 4095.9375 _CNV_A_R_EGCP_LINEA_468_CM -2048. 2047.9375 DISPLAY_IDENTIFIER ID_TTIP_SP_DIF_LSH_UP FORMAT "%10.4"
 /begin AXIS_DESCR COM_AXIS online_dummy _CNV_A_R_LINEAR_____240_CM 4 0. 6553.5 FORMAT "%6.1" AXIS_PTS_REF ldp_t_pow_rise_lsh_up_id_ttip /end AXIS_DESCR
/end CHARACTERISTIC
/begin CHARACTERISTIC ip_v_efc_ini_lsh_down "Initial effective heater voltage" CURVE 0x840d5c _REC_CUR_20_u1_u2 25.8984375 _CNV_A_R_LINEAR_____349_CM 0. 25.8984375 DISPLAY_IDENTIFIER IP_V_EFC_INI_LSH_DOWN FORMAT "%9.6"
 /begin AXIS_DESCR COM_AXIS online_dummy _CNV_A_R_EGCP_LINEA_469_CM 6 -2048. 2047.9375 FORMAT "%10.4" AXIS_PTS_REF ldpm_temp_ini_ls_down_1_egcp /end AXIS_DESCR
/end CHARACTERISTIC
/begin CHARACTERISTIC ip_v_efc_ctl_lsh_down "Open loop control effective heater voltage" MAP 0x840d14 _REC_MAP_20_u1_u1_u2 25.8984375 _CNV_A_R_LINEAR_____349_CM 0. 25.8984375 DISPLAY_IDENTIFIER IP_V_EFC_CTL_LSH_DOWN FORMAT "%9.6"
 /begin AXIS_DESCR COM_AXIS n_32 _CNV_A_R_LINEAR_____81_CM 6 0. 8160. FORMAT "%4.0" AXIS_PTS_REF ldpm_n_32_3_egcp /end AXIS_DESCR
 /begin AXIS_DESCR COM_AXIS online_dummy _CNV_A_R_EGCP_LINEA_468_CM 6 0. 2047. FORMAT "%9.4" AXIS_PTS_REF ldpm_teg_cat_down_mdl_1_egcp /end AXIS_DESCR
/end CHARACTERISTIC
/begin CHARACTERISTIC ip_t_temp_thd_lsh_down "Duration until critical water splash sensor temperature reached" CURVE 0x840ce2 _REC_CUR_20_u2_u2 6553.5 _CNV_A_R_LINEAR_____240_CM 0. 6553.5 DISPLAY_IDENTIFIER IP_T_TEMP_THD_LSH_DOWN FORMAT "%6.1"
 /begin AXIS_DESCR COM_AXIS online_dummy _CNV_A_R_EGCP_LINEA_469_CM 6 -2048. 2047.9375 FORMAT "%10.4" AXIS_PTS_REF ldpm_temp_ini_ls_down_1_egcp /end AXIS_DESCR
/end CHARACTERISTIC
/begin CHARACTERISTIC ip_fac_v_efc_teg_lsh_down "Factor for the heat transfer rate, bank 2 only" CURVE 0x840bbe _REC_CUR_20_u1_u1 3.984375 _CNV_A_R_LINEAR_____244_CM 0. 3.984375 DISPLAY_IDENTIFIER IP_FAC_V_EFC_TEG_LSH_DOWN FORMAT "%8.6"
 /begin AXIS_DESCR COM_AXIS online_dummy _CNV_A_R_LINEAR_____245_CM 6 0. 255. FORMAT "%3.0" AXIS_PTS_REF ldpm_vs_1_egcp /end AXIS_DESCR
/end CHARACTERISTIC
/begin CHARACTERISTIC c_v_efc_inc_lsh_down "Effective heater voltage increment to raise temperature" VALUE 0x840f3c _REC_VAL_20_u1 1.625 _CNV_A_R_EGCP_LINEA_472_CM 0. 1.625 DISPLAY_IDENTIFIER C_V_EFC_INC_LSH_DOWN FORMAT "%5.3" /end CHARACTERISTIC
/begin CHARACTERISTIC c_v_efc_dec_lsh_down "Effective heater voltage decrement to lower temperature" VALUE 0x840f3a _REC_VAL_20_u1 1.625 _CNV_A_R_EGCP_LINEA_472_CM 0. 1.625 DISPLAY_IDENTIFIER C_V_EFC_DEC_LSH_DOWN FORMAT "%5.3" /end CHARACTERISTIC
/begin CHARACTERISTIC c_v_efc_red_lsh_down "Reduced effective heater voltage during danger of water splash damage" VALUE 0x840f46 _REC_VAL_20_u1 25.8984375 _CNV_A_R_LINEAR_____349_CM 0. 25.8984375 DISPLAY_IDENTIFIER C_V_EFC_RED_LSH_DOWN FORMAT "%9.6" /end CHARACTERISTIC
/begin CHARACTERISTIC c_v_efc_step_lsh_down "Additional effective heater voltage step on transition from LSH_POW_RED to LSH_POW_RISE" VALUE 0x840f48 _REC_VAL_20_s1 25.898438 _CNV_A_R_EGCP_LINEA_473_CM -13. 12.898438 DISPLAY_IDENTIFIER C_V_EFC_STEP_LSH_DOWN FORMAT "%5.1" /end CHARACTERISTIC
/begin CHARACTERISTIC c_t_max_pow_rise_lsh_down "Duration of open loop pre-heating in LSH_POW_RISE from dew-point to set-point temperature" VALUE 0x840ece _REC_VAL_20_u2 6553.5 _CNV_A_R_LINEAR_____240_CM 0. 6553.5 DISPLAY_IDENTIFIER C_T_MAX_POW_RISE_LSH_DOWN FORMAT "%6.1" /end CHARACTERISTIC
/begin CHARACTERISTIC c_t_max_v_efc_tol_lsh_down "Maximum permitted duration where excessive effective heater voltage tolerated" VALUE 0x840ed6 _REC_VAL_20_u1 25.5 _CNV_A_R_LINEAR_____240_CM 0. 25.5 DISPLAY_IDENTIFIER C_T_MAX_V_EFC_TOL_LSH_DOWN FORMAT "%4.1" /end CHARACTERISTIC
/begin CHARACTERISTIC c_t_max_v_efc_lim_lsh_down "Maximum duration of effective heater voltage limiting" VALUE 0x840ed2 _REC_VAL_20_u1 25.5 _CNV_A_R_LINEAR_____240_CM 0. 25.5 DISPLAY_IDENTIFIER C_T_MAX_V_EFC_LIM_LSH_DOWN FORMAT "%4.1" /end CHARACTERISTIC
/begin CHARACTERISTIC c_t_max_v_efc_max_st_lsh_down "Time after start at which step in max. effective heater voltage applied" VALUE 0x840ed4 _REC_VAL_20_u1 25.5 _CNV_A_R_LINEAR_____240_CM 0. 25.5 DISPLAY_IDENTIFIER C_T_MAX_V_EFC_MAX_ST_LSH_DOWN FORMAT "%4.1" /end CHARACTERISTIC
/begin CHARACTERISTIC c_t_ast_max_lsh_down "Time after start at which step in max. effective heater voltage applied" VALUE 0x840e8e _REC_VAL_20_u2 6553.5 _CNV_A_R_LINEAR_____240_CM 0. 6553.5 DISPLAY_IDENTIFIER C_T_AST_MAX_LSH_DOWN FORMAT "%6.1" /end CHARACTERISTIC
/begin CHARACTERISTIC c_v_efc_tol_lsh_down "Effective heater voltage threshold above which voltage limiting may occur if threshold persistently exceeded" VALUE 0x840f4a _REC_VAL_20_u1 25.8984375 _CNV_A_R_LINEAR_____349_CM 0. 25.8984375 DISPLAY_IDENTIFIER C_V_EFC_TOL_LSH_DOWN FORMAT "%9.6" /end CHARACTERISTIC
/begin CHARACTERISTIC c_v_efc_lim_lsh_down "Effective heater voltage limit under persistent excessive heater voltage condition" VALUE 0x840f3e _REC_VAL_20_u1 25.8984375 _CNV_A_R_LINEAR_____349_CM 0. 25.8984375 DISPLAY_IDENTIFIER C_V_EFC_LIM_LSH_DOWN FORMAT "%9.6" /end CHARACTERISTIC
/begin CHARACTERISTIC c_vb_max_prot_lsh_down "Maximum permitted battery voltage threshold, over which overvoltage detected" VALUE 0x840f4e _REC_VAL_20_u1 25.8984375 _CNV_A_R_LINEAR_____349_CM 0. 25.8984375 DISPLAY_IDENTIFIER C_VB_MAX_PROT_LSH_DOWN FORMAT "%9.6" /end CHARACTERISTIC
/begin CHARACTERISTIC c_v_efc_prot_vb_lsh_down "Effective heater voltage in the case of battery voltage overvoltage condition" VALUE 0x840f44 _REC_VAL_20_u1 25.8984375 _CNV_A_R_LINEAR_____349_CM 0. 25.8984375 DISPLAY_IDENTIFIER C_V_EFC_PROT_VB_LSH_DOWN FORMAT "%9.6" /end CHARACTERISTIC
/begin CHARACTERISTIC c_v_efc_max_lsh_down "Absolute maximum permitted effective heater voltage after initial phase; threshold & limit " VALUE 0x840f40 _REC_VAL_20_u1 25.8984375 _CNV_A_R_LINEAR_____349_CM 0. 25.8984375 DISPLAY_IDENTIFIER C_V_EFC_MAX_LSH_DOWN FORMAT "%9.6" /end CHARACTERISTIC
/begin CHARACTERISTIC c_v_efc_max_st_lsh_down "Absolute maximum permitted effective heater voltage during initial phase; threshold & limit " VALUE 0x840f42 _REC_VAL_20_u1 25.8984375 _CNV_A_R_LINEAR_____349_CM 0. 25.8984375 DISPLAY_IDENTIFIER C_V_EFC_MAX_ST_LSH_DOWN FORMAT "%9.6" /end CHARACTERISTIC
/begin CHARACTERISTIC c_v_efc_as_lsh_down "Effective heater voltage calibration system additive factor" VALUE 0x840f38 _REC_VAL_20_s1 25.898438 _CNV_A_R_EGCP_LINEA_473_CM -13. 12.898438 DISPLAY_IDENTIFIER C_V_EFC_AS_LSH_DOWN FORMAT "%5.1" /end CHARACTERISTIC
/begin CHARACTERISTIC c_teg_cat_down_mdl_max_lsh_down "Maximum permitted exhaust gas temperature above which LSH switched off" VALUE 0x840f0a _REC_VAL_20_u2 2047. _CNV_A_R_EGCP_LINEA_468_CM 0. 2047. DISPLAY_IDENTIFIER C_TEG_CAT_DOWN_MDL_MAX_LSH_DOWN FORMAT "%9.4" /end CHARACTERISTIC
/begin CHARACTERISTIC lc_lsh_down[0] "Boolean variable to enable oxygen sensor heating" VALUE 0x840fac _REC_VAL_20_u1 1. _CNV_A_R_LINEAR_____1_CM 0. 1. DISPLAY_IDENTIFIER LC_LSH_DOWN_1_ FORMAT "%1.0" /end CHARACTERISTIC
/begin AXIS_PTS ldpm_tco_st_1_egcp "" 0x8409ff tco_st _REC_AXS_20_u1 190.5 _CNV_A_R_LINEAR_____257_CM 6 -48. 142.5 FORMAT "%6.2" /end AXIS_PTS
/begin AXIS_PTS ldpm_tia_thr_st_1_egcp "" 0x840a3e online_dummy _REC_AXS_20_u1 190.5 _CNV_A_R_LINEAR_____257_CM 6 -48. 142.5 FORMAT "%6.2" /end AXIS_PTS
/begin CHARACTERISTIC ip_temp_ini_ls_down "Initial oxygen sensor temperature value" MAP 0x85cfe4 _REC_MAP_20_u2_u1_u1 4095.9375 _CNV_A_R_EGCP_LINEA_469_CM -2048. 2047.9375 DISPLAY_IDENTIFIER IP_TEMP_INI_LS_DOWN FORMAT "%10.4"
 /begin AXIS_DESCR COM_AXIS tco_st _CNV_A_R_LINEAR_____257_CM 6 -48. 142.5 FORMAT "%6.2" AXIS_PTS_REF ldpm_tco_st_1_egcp /end AXIS_DESCR
 /begin AXIS_DESCR COM_AXIS online_dummy _CNV_A_R_LINEAR_____257_CM 6 -48. 142.5 FORMAT "%6.2" AXIS_PTS_REF ldpm_tia_thr_st_1_egcp /end AXIS_DESCR
/end CHARACTERISTIC
/begin CHARACTERISTIC ip_temp_ini_ls_up "Oxygen sensor temperature value after engine start" MAP 0x85d02c _REC_MAP_20_u2_u1_u1 4095.9375 _CNV_A_R_EGCP_LINEA_469_CM -2048. 2047.9375 DISPLAY_IDENTIFIER IP_TEMP_INI_LS_UP FORMAT "%10.4"
 /begin AXIS_DESCR COM_AXIS tco_st _CNV_A_R_LINEAR_____257_CM 6 -48. 142.5 FORMAT "%6.2" AXIS_PTS_REF ldp_tco_st_1_egcp /end AXIS_DESCR
 /begin AXIS_DESCR COM_AXIS online_dummy _CNV_A_R_LINEAR_____257_CM 6 -48. 142.5 FORMAT "%6.2" AXIS_PTS_REF ldp_tia_thr_st_1_egcp /end AXIS_DESCR
/end CHARACTERISTIC
/begin CHARACTERISTIC lc_lsh_ctl_cll_lsh_up[0] "Boolean variable to enable closed loop oxygen sensor heater control" VALUE 0x840fab _REC_VAL_20_u1 1. _CNV_A_R_LINEAR_____1_CM 0. 1. DISPLAY_IDENTIFIER LC_LSH_CTL_CLL_LSH_UP_1_ FORMAT "%1.0" /end CHARACTERISTIC
/begin CHARACTERISTIC lc_lsh_up[0] "Boolean variable to enable oxygen sensor heating" VALUE 0x840fad _REC_VAL_20_u1 1. _CNV_A_R_LINEAR_____1_CM 0. 1. DISPLAY_IDENTIFIER LC_LSH_UP_1_ FORMAT "%1.0" /end CHARACTERISTIC
/begin AXIS_PTS ldp_tco_st_1_egcp "" 0x840927 tco_st _REC_AXS_20_u1 190.5 _CNV_A_R_LINEAR_____257_CM 6 -48. 142.5 FORMAT "%6.2" /end AXIS_PTS
/begin AXIS_PTS ldp_tia_thr_st_1_egcp "" 0x84093c online_dummy _REC_AXS_20_u1 190.5 _CNV_A_R_LINEAR_____257_CM 6 -48. 142.5 FORMAT "%6.2" /end AXIS_PTS
/begin CHARACTERISTIC c_lamb_ls_up_max_ofs_adj "Maximum lambda threshold for the offset calculation  " VALUE 0x840e12 _REC_VAL_20_u2 31.9990234375 _CNV_A_R_LINEAR_____465_CM 0. 31.9990234375 DISPLAY_IDENTIFIER C_LAMB_LS_UP_MAX_OFS_ADJ FORMAT "%7.4" /end CHARACTERISTIC
/begin CHARACTERISTIC c_lamb_ls_up_min_ofs_adj "Minimum lambda threshold for the offset calculation  " VALUE 0x840e14 _REC_VAL_20_u2 31.9990234375 _CNV_A_R_LINEAR_____465_CM 0. 31.9990234375 DISPLAY_IDENTIFIER C_LAMB_LS_UP_MIN_OFS_ADJ FORMAT "%7.4" /end CHARACTERISTIC
/begin CHARACTERISTIC c_crlc_vls_up_ofs_adj "Correlation constant for filtering of mean value of WRAF sensor lambda signal" VALUE 0x840d92 _REC_VAL_20_u2 0.9999847412109381 _CNV_A_R_LINEAR_____137_CM 0. 0.9999847412109381 DISPLAY_IDENTIFIER C_CRLC_VLS_UP_OFS_ADJ FORMAT "%7.5" /end CHARACTERISTIC
/begin CHARACTERISTIC c_t_wait_lsl_ofs_adj "Lock time after a offset calculation prior to the next calculation" VALUE 0x840ef2 _REC_VAL_20_u2 655.35 _CNV_A_R_LINEAR_____226_CM 0. 655.35 DISPLAY_IDENTIFIER C_T_WAIT_LSL_OFS_ADJ FORMAT "%6.2" /end CHARACTERISTIC
/begin CHARACTERISTIC c_vls_ofs_sp_lsl "Nominal lambda sensor voltage ( valid for Ip = 0 or LAMB = 1)" VALUE 0x840f8c _REC_VAL_20_u2 4.999847 _CNV_A_R_EGCP_LINEA_474_CM 0. 4.999847 DISPLAY_IDENTIFIER C_VLS_OFS_SP_LSL FORMAT "%6.4" /end CHARACTERISTIC
/begin CHARACTERISTIC c_t_dly_lamb_sti_off_ofs_adj "Delay time for the offset calculation after switching off forced lambda stimulation" VALUE 0x840eaa _REC_VAL_20_u2 655.35 _CNV_A_R_LINEAR_____226_CM 0. 655.35 DISPLAY_IDENTIFIER C_T_DLY_LAMB_STI_OFF_OFS_ADJ FORMAT "%6.2" /end CHARACTERISTIC
/begin CHARACTERISTIC c_vls_ofs_dif_ok_lsl "Maximum permitted deviation of two successive offset values" VALUE 0x840f88 _REC_VAL_20_u2 4.999847 _CNV_A_R_EGCP_LINEA_474_CM 0. 4.999847 DISPLAY_IDENTIFIER C_VLS_OFS_DIF_OK_LSL FORMAT "%6.4" /end CHARACTERISTIC
/begin CHARACTERISTIC c_vls_ofs_max_absv_lsl "Limit value for the offset as a maximum value (absolute value)" VALUE 0x840f8a _REC_VAL_20_u2 4.999847 _CNV_A_R_EGCP_LINEA_474_CM 0. 4.999847 DISPLAY_IDENTIFIER C_VLS_OFS_MAX_ABSV_LSL FORMAT "%6.4" /end CHARACTERISTIC
/begin CHARACTERISTIC lc_lsl_ofs_adj_ena "Switch to enable offset adjustment in every engine state" VALUE 0x840fb0 _REC_VAL_20_u1 1. _CNV_A_R_LINEAR_____1_CM 0. 1. DISPLAY_IDENTIFIER LC_LSL_OFS_ADJ_ENA FORMAT "%1.0" /end CHARACTERISTIC
/begin CHARACTERISTIC c_iplsl_gain "Gain of WRAF sensor interface circuit  ( Ip / V_LMBD_IP )" VALUE 0x840dea _REC_VAL_20_u2 5.038331 _CNV_A_R_EGCP_LINEA_475_CM 0. 5.038331 DISPLAY_IDENTIFIER C_IPLSL_GAIN FORMAT "%7.5" /end CHARACTERISTIC
/begin MEASUREMENT lamb_ls_up_mv "Mean value lambda in multiple-branched exhaust gas lines" UWORD _CNV_A_R_LINEAR_____465_CM 1 0. 0. 31.9990234375 DISPLAY_IDENTIFIER LAMB_LS_UP_MV ECU_ADDRESS 0x7f979a BYTE_ORDER MSB_LAST FORMAT "%7.4" /end MEASUREMENT
/begin MEASUREMENT lamb_ls_up_min "Minimum lambda in multiple-branched exhaust gas lines" UWORD _CNV_A_R_LINEAR_____465_CM 1 0. 0. 31.9990234375 DISPLAY_IDENTIFIER LAMB_LS_UP_MIN ECU_ADDRESS 0x7f9798 BYTE_ORDER MSB_LAST FORMAT "%7.4" /end MEASUREMENT
/begin CHARACTERISTIC ip_fac_cor_iplsl_prs_ex "Factor for exhaust gas pressure correction" CURVE 0x840af0 _REC_CUR_20_u2_u2 1.99996948242188 _CNV_A_R_LINEAR_____476_CM 0. 1.99996948242188 DISPLAY_IDENTIFIER IP_FAC_COR_IPLSL_PRS_EX FORMAT "%7.5"
 /begin AXIS_DESCR COM_AXIS prs_ex _CNV_A_R_LINEAR_____45_CM 8 0. 5434. FORMAT "%8.3" AXIS_PTS_REF ldp_prs_ex_ip_fac_cor_iplsl /end AXIS_DESCR
/end CHARACTERISTIC
/begin CHARACTERISTIC ip_lamb_ls_up "Characteristic curve of the lambda sensor (lambda vs. corrected VLS_UP)" CURVE 0x840c4a _REC_CUR_20_u2_u2 31.9990234375 _CNV_A_R_LINEAR_____465_CM 0. 31.9990234375 DISPLAY_IDENTIFIER IP_LAMB_LS_UP FORMAT "%7.4"
 /begin AXIS_DESCR COM_AXIS online_dummy _CNV_A_R_EGCP_LINEA_474_CM 16 0. 4.999847 FORMAT "%6.4" AXIS_PTS_REF ldp_vls_cor_mv_ip_lamb_ls_up /end AXIS_DESCR
/end CHARACTERISTIC
/begin AXIS_PTS ldp_prs_ex_ip_fac_cor_iplsl "" 0x8408b6 prs_ex _REC_AXS_20_u2 5434. _CNV_A_R_LINEAR_____45_CM 8 0. 5434. FORMAT "%8.3" /end AXIS_PTS
/begin AXIS_PTS ldp_vls_cor_mv_ip_lamb_ls_up "" 0x840970 online_dummy _REC_AXS_20_u2 4.999847 _CNV_A_R_EGCP_LINEA_474_CM 16 0. 4.999847 FORMAT "%6.4" /end AXIS_PTS
/begin CHARACTERISTIC c_t_dly_lsl_ofs_adj "Delay time for the offset calculation after activating offset adjustment" VALUE 0x840eac _REC_VAL_20_u1 2.55 _CNV_A_R_LINEAR_____226_CM 0. 2.55 DISPLAY_IDENTIFIER C_T_DLY_LSL_OFS_ADJ FORMAT "%4.2" /end CHARACTERISTIC
/begin CHARACTERISTIC c_t_dly_lsl_ofs_adj_is "Delay time for activation of offset adjustment upon entering state idle speed" VALUE 0x840ead _REC_VAL_20_u1 2.55 _CNV_A_R_LINEAR_____226_CM 0. 2.55 DISPLAY_IDENTIFIER C_T_DLY_LSL_OFS_ADJ_IS FORMAT "%4.2" /end CHARACTERISTIC
/begin CHARACTERISTIC c_tam_max_lsl_gain_ad "Maximum ambient temperature to allow fuel cut Ip determination" VALUE 0x840ef4 _REC_VAL_20_u1 190.5 _CNV_A_R_LINEAR_____257_CM -48. 142.5 DISPLAY_IDENTIFIER C_TAM_MAX_LSL_GAIN_AD FORMAT "%6.2" /end CHARACTERISTIC
/begin CHARACTERISTIC c_amp_min_lsl_gain_ad "Minimum ambient pressure to allow fuel cut Ip determination" VALUE 0x840d80 _REC_VAL_20_u2 5434. _CNV_A_R_LINEAR_____247_CM 0. 5434. DISPLAY_IDENTIFIER C_AMP_MIN_LSL_GAIN_AD FORMAT "%7.2" /end CHARACTERISTIC
/begin CHARACTERISTIC c_tco_min_lsl_gain_ad "Minimum coolant temperature to allow fuel cut Ip determination" VALUE 0x840f04 _REC_VAL_20_u1 190.5 _CNV_A_R_LINEAR_____257_CM -48. 142.5 DISPLAY_IDENTIFIER C_TCO_MIN_LSL_GAIN_AD FORMAT "%6.2" /end CHARACTERISTIC
/begin CHARACTERISTIC c_ttip_max_lsl_gain_ad "Maximum tip temperature to allow fuel cut Ip determination" VALUE 0x840f24 _REC_VAL_20_s2 4095.9375 _CNV_A_R_EGCP_LINEA_468_CM -2048. 2047.9375 DISPLAY_IDENTIFIER C_TTIP_MAX_LSL_GAIN_AD FORMAT "%10.4" /end CHARACTERISTIC
/begin CHARACTERISTIC c_ttip_min_lsl_gain_ad "Minimum tip temperature to allow fuel cut Ip determination" VALUE 0x840f2a _REC_VAL_20_s2 4095.9375 _CNV_A_R_EGCP_LINEA_468_CM -2048. 2047.9375 DISPLAY_IDENTIFIER C_TTIP_MIN_LSL_GAIN_AD FORMAT "%10.4" /end CHARACTERISTIC
/begin CHARACTERISTIC c_n_32_max_lsl_gain_ad "Maximum engine speed to allow fuel cut Ip determination" VALUE 0x840e74 _REC_VAL_20_u1 8160. _CNV_A_R_LINEAR_____81_CM 0. 8160. DISPLAY_IDENTIFIER C_N_32_MAX_LSL_GAIN_AD FORMAT "%4.0" /end CHARACTERISTIC
/begin CHARACTERISTIC c_n_32_min_lsl_gain_ad "Minimum engine speed to allow fuel cut Ip determination" VALUE 0x840e75 _REC_VAL_20_u1 8160. _CNV_A_R_LINEAR_____81_CM 0. 8160. DISPLAY_IDENTIFIER C_N_32_MIN_LSL_GAIN_AD FORMAT "%4.0" /end CHARACTERISTIC
/begin CHARACTERISTIC c_crlc_iplsl_cor_fcut "Correlation constant for filtering of corrected pumping current " VALUE 0x840d84 _REC_VAL_20_u2 0.9999847412109381 _CNV_A_R_LINEAR_____137_CM 0. 0.9999847412109381 DISPLAY_IDENTIFIER C_CRLC_IPLSL_COR_FCUT FORMAT "%7.5" /end CHARACTERISTIC
/begin CHARACTERISTIC c_crlc_iplsl_mv_vld "Correlation constant for filtering of valid Ip samples (is also time constant for adaptation)" VALUE 0x840d86 _REC_VAL_20_u2 0.9999847412109381 _CNV_A_R_LINEAR_____137_CM 0. 0.9999847412109381 DISPLAY_IDENTIFIER C_CRLC_IPLSL_MV_VLD FORMAT "%7.5" /end CHARACTERISTIC
/begin CHARACTERISTIC c_iplsl_vari_thd_max_purge "Maximum variance of the low pass filtered pumping current to confirm stable conditions " VALUE 0x840df0 _REC_VAL_20_u2 619.692407 _CNV_A_R_EGCP_LINEA_477_CM 0. 619.692407 DISPLAY_IDENTIFIER C_IPLSL_VARI_THD_MAX_PURGE FORMAT "%7.3" /end CHARACTERISTIC
/begin CHARACTERISTIC c_iplsl_vari_thd_min_purge "Minimum variance of the low pass filtered pumping current to confirm that sensor is operable" VALUE 0x840df2 _REC_VAL_20_u2 619.692407 _CNV_A_R_EGCP_LINEA_477_CM 0. 619.692407 DISPLAY_IDENTIFIER C_IPLSL_VARI_THD_MIN_PURGE FORMAT "%7.3" /end CHARACTERISTIC
/begin CHARACTERISTIC c_t_acq_iplsl_purge "Duration of Ip acquisition and averaging" VALUE 0x840e8c _REC_VAL_20_u1 25.4 _CNV_A_R_LINEAR_____240_CM 0.1 25.5 DISPLAY_IDENTIFIER C_T_ACQ_IPLSL_PURGE FORMAT "%4.1" /end CHARACTERISTIC
/begin CHARACTERISTIC c_iplsl_cor_grd_thd_fcut "Maximum gradient of low pass filtered pumping correct to detect stable conditions (end of PURGE)" VALUE 0x840de8 _REC_VAL_20_s2 25.191 _CNV_A_R_LINEAR_____478_CM -12.596 12.595 DISPLAY_IDENTIFIER C_IPLSL_COR_GRD_THD_FCUT FORMAT "%8.4" /end CHARACTERISTIC
/begin CHARACTERISTIC c_fac_iplsl_cor_thd_fcut "Factor for minimum threshold of the low pass filtered pumping current to detect stable conditions (end of PURGE)" VALUE 0x840dce _REC_VAL_20_u1 0.99609375 _CNV_A_R_LINEAR_____254_CM 0. 0.99609375 DISPLAY_IDENTIFIER C_FAC_IPLSL_COR_THD_FCUT FORMAT "%5.3" /end CHARACTERISTIC
/begin CHARACTERISTIC c_fac_lsl_gain_ad_lim_max "Maximum threshold for WRAF sensor gain adaptation" VALUE 0x840dd4 _REC_VAL_20_u2 1.99996948242188 _CNV_A_R_LINEAR_____476_CM 0. 1.99996948242188 DISPLAY_IDENTIFIER C_FAC_LSL_GAIN_AD_LIM_MAX FORMAT "%7.5" /end CHARACTERISTIC
/begin CHARACTERISTIC c_fac_lsl_gain_ad_lim_min "Minimum threshold for WRAF sensor gain adaptation" VALUE 0x840dd6 _REC_VAL_20_u2 1.99996948242188 _CNV_A_R_LINEAR_____476_CM 0. 1.99996948242188 DISPLAY_IDENTIFIER C_FAC_LSL_GAIN_AD_LIM_MIN FORMAT "%7.5" /end CHARACTERISTIC
/begin CHARACTERISTIC c_iplsl_mv_vld_vari_max "Maximum permitted variance of valid Ip sample to allow adaptation" VALUE 0x840dec _REC_VAL_20_u2 619.692407 _CNV_A_R_EGCP_LINEA_477_CM 0. 619.692407 DISPLAY_IDENTIFIER C_IPLSL_MV_VLD_VARI_MAX FORMAT "%7.3" /end CHARACTERISTIC
/begin CHARACTERISTIC c_nr_gear_min_lsl_gain_ad "Minimum gear to allow fuel cut Ip determination" VALUE 0x840e7c _REC_VAL_20_u1 255. _CNV_A_R_LINEAR_____1_CM 0. 255. DISPLAY_IDENTIFIER C_NR_GEAR_MIN_LSL_GAIN_AD FORMAT "%3.0" /end CHARACTERISTIC
/begin CHARACTERISTIC lc_fac_lsl_gain_ad_lim_rst "Switch for reset of adaptation factor to one when exceeding thresholds, or for adoption of threshold value, resp." VALUE 0x840fa3 _REC_VAL_20_u1 1. _CNV_A_R_LINEAR_____1_CM 0. 1. DISPLAY_IDENTIFIER LC_FAC_LSL_GAIN_AD_LIM_RST FORMAT "%1.0" /end CHARACTERISTIC
/begin CHARACTERISTIC lc_fac_lsl_gain_ad_ena "Enable adoption of WRAF sensor gain adaptation factor" VALUE 0x840fa2 _REC_VAL_20_u1 1. _CNV_A_R_LINEAR_____1_CM 0. 1. DISPLAY_IDENTIFIER LC_FAC_LSL_GAIN_AD_ENA FORMAT "%1.0" /end CHARACTERISTIC
/begin CHARACTERISTIC lc_map_puc_lim_req_lsl_gain_ad "Enable request to torque management for limitation of MAP during PUC" VALUE 0x840fb2 _REC_VAL_20_u1 1. _CNV_A_R_LINEAR_____1_CM 0. 1. DISPLAY_IDENTIFIER LC_MAP_PUC_LIM_REQ_LSL_GAIN_AD FORMAT "%1.0" /end CHARACTERISTIC
/begin CHARACTERISTIC lc_map_puc_lim_act_not_vld "Flag to ignore activation of limitation of MAP during PUC by torque management" VALUE 0x840fb1 _REC_VAL_20_u1 1. _CNV_A_R_LINEAR_____1_CM 0. 1. DISPLAY_IDENTIFIER LC_MAP_PUC_LIM_ACT_NOT_VLD FORMAT "%1.0" /end CHARACTERISTIC
/begin CHARACTERISTIC lc_lsl_gain_ad_test "Manual enable of LV_LSL_GAIN_AD_REQ_i for test purposes" VALUE 0x840faf _REC_VAL_20_u1 1. _CNV_A_R_LINEAR_____1_CM 0. 1. DISPLAY_IDENTIFIER LC_LSL_GAIN_AD_TEST FORMAT "%1.0" /end CHARACTERISTIC
/begin AXIS_PTS ldp_amp_ip_fac_cor_iplsl_amp "" 0x840800 amp _REC_AXS_20_u2 5434. _CNV_A_R_LINEAR_____247_CM 12 0. 5434. FORMAT "%7.2" /end AXIS_PTS
/begin AXIS_PTS ldp_maf_kgh_ip_fac_cor_iplsl "" 0x84085c maf_kgh _REC_AXS_20_u2 2047.96875 _CNV_A_R_LINEAR_____479_CM 12 0. 2047.96875 FORMAT "%10.5" /end AXIS_PTS
/begin AXIS_PTS ldp_n_32_ip_fac_cor_iplsl "" 0x840892 n_32 _REC_AXS_20_u1 8160. _CNV_A_R_LINEAR_____81_CM 16 0. 8160. FORMAT "%4.0" /end AXIS_PTS
/begin AXIS_PTS ldp_ttip_mes_ls_up_ip_fac_iplsl "" 0x84094c online_dummy _REC_AXS_20_u2 4095.9375 _CNV_A_R_EGCP_LINEA_469_CM 8 -2048. 2047.9375 FORMAT "%10.4" /end AXIS_PTS
/begin AXIS_PTS ldp_iplsl_chg_purge_ip_iplsl "" 0x84081e online_dummy _REC_AXS_20_u2 25.191 _CNV_A_R_EGCP_LINEA_480_CM 4 -12.596 12.595 FORMAT "%8.4" /end AXIS_PTS
/begin CHARACTERISTIC ip_fac_cor_iplsl_amp "Factor for AMP correction" CURVE 0x840a98 _REC_CUR_20_u2_u2 1.99996948242188 _CNV_A_R_LINEAR_____476_CM 0. 1.99996948242188 DISPLAY_IDENTIFIER IP_FAC_COR_IPLSL_AMP FORMAT "%7.5"
 /begin AXIS_DESCR COM_AXIS amp _CNV_A_R_LINEAR_____247_CM 12 0. 5434. FORMAT "%7.2" AXIS_PTS_REF ldp_amp_ip_fac_cor_iplsl_amp /end AXIS_DESCR
/end CHARACTERISTIC
/begin CHARACTERISTIC ip_fac_cor_iplsl_maf_kgh "Factor for MAF correction" CURVE 0x840ab8 _REC_CUR_20_u2_u2 1.99996948242188 _CNV_A_R_LINEAR_____476_CM 0. 1.99996948242188 DISPLAY_IDENTIFIER IP_FAC_COR_IPLSL_MAF_KGH FORMAT "%7.5"
 /begin AXIS_DESCR COM_AXIS maf_kgh _CNV_A_R_LINEAR_____479_CM 12 0. 2047.96875 FORMAT "%10.5" AXIS_PTS_REF ldp_maf_kgh_ip_fac_cor_iplsl /end AXIS_DESCR
/end CHARACTERISTIC
/begin CHARACTERISTIC ip_fac_cor_iplsl_n_32 "Factor for engine speed correction" CURVE 0x840ad0 _REC_CUR_20_u2_u1 1.99996948242188 _CNV_A_R_LINEAR_____476_CM 0. 1.99996948242188 DISPLAY_IDENTIFIER IP_FAC_COR_IPLSL_N_32 FORMAT "%7.5"
 /begin AXIS_DESCR COM_AXIS n_32 _CNV_A_R_LINEAR_____81_CM 16 0. 8160. FORMAT "%4.0" AXIS_PTS_REF ldp_n_32_ip_fac_cor_iplsl /end AXIS_DESCR
/end CHARACTERISTIC
/begin CHARACTERISTIC ip_fac_cor_iplsl_ttip_mes_ls_up "Factor for tip temperature correction" CURVE 0x840b00 _REC_CUR_20_u2_u2 1.99996948242188 _CNV_A_R_LINEAR_____476_CM 0. 1.99996948242188 DISPLAY_IDENTIFIER IP_FAC_COR_IPLSL_TTIP_MES_LS_UP FORMAT "%7.5"
 /begin AXIS_DESCR COM_AXIS online_dummy _CNV_A_R_EGCP_LINEA_469_CM 8 -2048. 2047.9375 FORMAT "%10.4" AXIS_PTS_REF ldp_ttip_mes_ls_up_ip_fac_iplsl /end AXIS_DESCR
/end CHARACTERISTIC
/begin CHARACTERISTIC ip_fac_cor_iplsl_chg_purge "Factor for residual gas after purging correction" CURVE 0x840ab0 _REC_CUR_20_u2_u2 1.99996948242188 _CNV_A_R_LINEAR_____476_CM 0. 1.99996948242188 DISPLAY_IDENTIFIER IP_FAC_COR_IPLSL_CHG_PURGE FORMAT "%7.5"
 /begin AXIS_DESCR COM_AXIS online_dummy _CNV_A_R_EGCP_LINEA_480_CM 4 -12.596 12.595 FORMAT "%8.4" AXIS_PTS_REF ldp_iplsl_chg_purge_ip_iplsl /end AXIS_DESCR
/end CHARACTERISTIC
/begin MEASUREMENT lv_map_puc_lim_req_lsl_gain_ad "Status flag for request of limitation of MAP during next PUC phase from torque management" UBYTE _CNV_S_2_RANGE__0___85_CM 1 0. 0. 1. DISPLAY_IDENTIFIER LV_MAP_PUC_LIM_REQ_LSL_GAIN_AD ECU_ADDRESS 0x7fb695 BIT_MASK 0x1 /end MEASUREMENT
/begin CHARACTERISTIC lc_lsl_gain_ad_ena "Enable WRAF sensor gain adaptation" VALUE 0x840fae _REC_VAL_20_u1 1. _CNV_A_R_LINEAR_____1_CM 0. 1. DISPLAY_IDENTIFIER LC_LSL_GAIN_AD_ENA FORMAT "%1.0" /end CHARACTERISTIC
/begin CHARACTERISTIC lc_fac_lsl_gain_ad_man_adj_ena "Enable manual adjustment of WRAF sensor gain adaptation factor" VALUE 0x840fa4 _REC_VAL_20_u1 1. _CNV_A_R_LINEAR_____1_CM 0. 1. DISPLAY_IDENTIFIER LC_FAC_LSL_GAIN_AD_MAN_ADJ_ENA FORMAT "%1.0" /end CHARACTERISTIC
/begin CHARACTERISTIC c_iplsl_nom_purge "Nominal pumping current at fuel cut " VALUE 0x840dee _REC_VAL_20_s2 25.191 _CNV_A_R_LINEAR_____481_CM -12.596 12.595 DISPLAY_IDENTIFIER C_IPLSL_NOM_PURGE FORMAT "%8.4" /end CHARACTERISTIC
/begin CHARACTERISTIC c_fac_lsl_gain_ad_man_adj "Value for manual adjustment of WRAF sensor gain adaptation factor" VALUE 0x840dd8 _REC_VAL_20_u2 1.99996948242188 _CNV_A_R_LINEAR_____476_CM 0. 1.99996948242188 DISPLAY_IDENTIFIER C_FAC_LSL_GAIN_AD_MAN_ADJ FORMAT "%7.5" /end CHARACTERISTIC
/begin CHARACTERISTIC c_vls_down_afl_thd_ready "Lean VLS_DOWN[i] threshold for operative readiness detection" VALUE 0x840f64 _REC_VAL_20_u2 4.9951171875 _CNV_A_R_LINEAR_____265_CM 0. 4.9951171875 DISPLAY_IDENTIFIER C_VLS_DOWN_AFL_THD_READY FORMAT "%5.3" /end CHARACTERISTIC
/begin CHARACTERISTIC c_vls_down_afr_thd_ready "Rich VLS_DOWN[i] threshold for operative readiness detection" VALUE 0x840f68 _REC_VAL_20_u2 4.9951171875 _CNV_A_R_LINEAR_____265_CM 0. 4.9951171875 DISPLAY_IDENTIFIER C_VLS_DOWN_AFR_THD_READY FORMAT "%5.3" /end CHARACTERISTIC
/begin CHARACTERISTIC c_maf_int_puc_max_down_ls_ready "Maximum MAF integral during PUC for operability reset" VALUE 0x840e5e _REC_VAL_20_u2 1820.42 _CNV_A_R_LINEAR_____482_CM 0. 1820.42 DISPLAY_IDENTIFIER C_MAF_INT_PUC_MAX_DOWN_LS_READY FORMAT "%7.2" /end CHARACTERISTIC
/begin CHARACTERISTIC c_teg_cat_down_ls_down_ready "Temperature threshold above which O2 sensor recognised as operatively ready" VALUE 0x840f06 _REC_VAL_20_u2 2047. _CNV_A_R_EGCP_LINEA_468_CM 0. 2047. DISPLAY_IDENTIFIER C_TEG_CAT_DOWN_LS_DOWN_READY FORMAT "%9.4" /end CHARACTERISTIC
/begin CHARACTERISTIC c_crlc_lamb_ls_up_ready "Correlation constant for mean value calculation of lambda sensor output signal" VALUE 0x840d88 _REC_VAL_20_u1 0.99609375 _CNV_A_R_LINEAR_____254_CM 0. 0.99609375 DISPLAY_IDENTIFIER C_CRLC_LAMB_LS_UP_READY FORMAT "%5.3" /end CHARACTERISTIC
/begin CHARACTERISTIC c_lamb_de_int_thd_ls_up_ready "Dispersion threshold for readiness detection" VALUE 0x840e0a _REC_VAL_20_u2 63.99886000000001 _CNV_A_R_EGCP_LINEA_483_CM 0. 63.99886 DISPLAY_IDENTIFIER C_LAMB_DE_INT_THD_LS_UP_READY FORMAT "%7.4" /end CHARACTERISTIC
/begin CHARACTERISTIC c_ttip_min_ls_up_ready "Minimum oxygen sensor ceramic temperature for save operation" VALUE 0x840f28 _REC_VAL_20_s2 4095.9375 _CNV_A_R_EGCP_LINEA_468_CM -2048. 2047.9375 DISPLAY_IDENTIFIER C_TTIP_MIN_LS_UP_READY FORMAT "%10.4" /end CHARACTERISTIC
/begin CHARACTERISTIC c_lamb_thd_max_ls_up_ready "Upper threshold of sensor signal for readiness detection" VALUE 0x840e2e _REC_VAL_20_u2 1.999018 _CNV_A_R_EGCP_LINEA_484_CM 0. 1.999018 DISPLAY_IDENTIFIER C_LAMB_THD_MAX_LS_UP_READY FORMAT "%6.4" /end CHARACTERISTIC
/begin CHARACTERISTIC c_lamb_thd_min_ls_up_ready "Lower threshold of sensor signal for readiness detection" VALUE 0x840e34 _REC_VAL_20_u2 1.999018 _CNV_A_R_EGCP_LINEA_484_CM 0. 1.999018 DISPLAY_IDENTIFIER C_LAMB_THD_MIN_LS_UP_READY FORMAT "%6.4" /end CHARACTERISTIC
/begin CHARACTERISTIC c_t_lamb_de_int_rst "Time for sensor dispersion calculation up to reset" VALUE 0x840ec6 _REC_VAL_20_u2 1310.7 _CNV_A_R_EGCP_LINEA_485_CM 0. 1310.7 DISPLAY_IDENTIFIER C_T_LAMB_DE_INT_RST FORMAT "%7.2" /end CHARACTERISTIC
/begin CHARACTERISTIC c_maf_int_puc_max_ls_up_ready "Maximum MAF integral value during PUC used for reset of operability" VALUE 0x840e60 _REC_VAL_20_u2 1820.42 _CNV_A_R_LINEAR_____482_CM 0. 1820.42 DISPLAY_IDENTIFIER C_MAF_INT_PUC_MAX_LS_UP_READY FORMAT "%7.2" /end CHARACTERISTIC
/begin AXIS_PTS ldp_tco_st_id_t_dly_chk_ls_up "" 0x84092e tco_st _REC_AXS_20_u1 190.5 _CNV_A_R_LINEAR_____257_CM 8 -48. 142.5 FORMAT "%6.2" /end AXIS_PTS
/begin AXIS_PTS ldp_tco_st_id_t_tout_ls_up "" 0x840937 tco_st _REC_AXS_20_u1 190.5 _CNV_A_R_LINEAR_____257_CM 4 -48. 142.5 FORMAT "%6.2" /end AXIS_PTS
/begin CHARACTERISTIC id_t_dly_chk_ls_up_ready "Delay time for begin of readiness detection after engine start" CURVE 0x840a70 _REC_CUR_20_u2_u1 1310.7 _CNV_A_R_EGCP_LINEA_485_CM 0. 1310.7 DISPLAY_IDENTIFIER ID_T_DLY_CHK_LS_UP_READY FORMAT "%7.2"
 /begin AXIS_DESCR COM_AXIS tco_st _CNV_A_R_LINEAR_____257_CM 8 -48. 142.5 FORMAT "%6.2" AXIS_PTS_REF ldp_tco_st_id_t_dly_chk_ls_up /end AXIS_DESCR
/end CHARACTERISTIC
/begin CHARACTERISTIC id_t_tout_ls_up_ready "Time-out constant for readiness detection" CURVE 0x840a80 _REC_CUR_20_u2_u1 1310.7 _CNV_A_R_EGCP_LINEA_485_CM 0. 1310.7 DISPLAY_IDENTIFIER ID_T_TOUT_LS_UP_READY FORMAT "%7.2"
 /begin AXIS_DESCR COM_AXIS tco_st _CNV_A_R_LINEAR_____257_CM 4 -48. 142.5 FORMAT "%6.2" AXIS_PTS_REF ldp_tco_st_id_t_tout_ls_up /end AXIS_DESCR
/end CHARACTERISTIC
/begin CHARACTERISTIC c_vls_afr_thd "Threshold for detection of rich mixture" VALUE 0x840f56 _REC_VAL_20_u2 4.9951171875 _CNV_A_R_LINEAR_____265_CM 0. 4.9951171875 DISPLAY_IDENTIFIER C_VLS_AFR_THD FORMAT "%5.3" /end CHARACTERISTIC
/begin CHARACTERISTIC c_vls_afl_thd "Threshold for detection of lean mixture" VALUE 0x840f50 _REC_VAL_20_u2 4.9951171875 _CNV_A_R_LINEAR_____265_CM 0. 4.9951171875 DISPLAY_IDENTIFIER C_VLS_AFL_THD FORMAT "%5.3" /end CHARACTERISTIC
/begin CHARACTERISTIC ip_t_afl_lock "LV_AFL[i] transition lock-out time after transition of AF mixture" MAP 0x840c76 _REC_MAP_20_u1_u1_u2 2.55 _CNV_A_R_LINEAR_____226_CM 0. 2.55 DISPLAY_IDENTIFIER IP_T_AFL_LOCK FORMAT "%4.2"
 /begin AXIS_DESCR COM_AXIS n_32 _CNV_A_R_LINEAR_____81_CM 8 0. 8160. FORMAT "%4.0" AXIS_PTS_REF ldpm_n_32_2_egcp /end AXIS_DESCR
 /begin AXIS_DESCR COM_AXIS maf _CNV_A_R_LINEAR_____490_CM 8 0. 1389. FORMAT "%7.2" AXIS_PTS_REF ldpm_maf_1_egcp /end AXIS_DESCR
/end CHARACTERISTIC
/begin MEASUREMENT egcp[0].egcp_struct_acctlifa0.ctr_icplsl "Counter used to approximate filling & emptying of WRAF sensor pumped reference area" UWORD _CNV_A_R_LINEAR_____1_CM 1 0. 0. 65535. DISPLAY_IDENTIFIER CTR_ICPLSL_1_ ECU_ADDRESS 0x7f953c BYTE_ORDER MSB_LAST FORMAT "%5.0" /end MEASUREMENT
/begin MEASUREMENT egcp[0].egcp_struct_acctlifa0.ctr_icplsl_max "Delay for filling and emptying of WRAF sensor pumped reference area" UWORD _CNV_A_R_LINEAR_____1_CM 1 0. 0. 65535. DISPLAY_IDENTIFIER CTR_ICPLSL_MAX_1_ ECU_ADDRESS 0x7f953e BYTE_ORDER MSB_LAST FORMAT "%5.0" /end MEASUREMENT
/begin MEASUREMENT egcp[0].egcp_struct_acctlifa0.t_icplsl_dly_pwl "Delay timer for limited Icp supply during ECU power latch" UWORD _CNV_A_R_LINEAR_____226_CM 1 0. 0. 655.35 DISPLAY_IDENTIFIER T_ICPLSL_DLY_PWL_1_ ECU_ADDRESS 0x7f9540 BYTE_ORDER MSB_LAST FORMAT "%6.2" /end MEASUREMENT
/begin MEASUREMENT egcp[0].egcp_struct_acctlifa0.lamb_thd_vplsl_lim "Threshold for Vp limitation in terms of lambda" UWORD _CNV_A_R_LINEAR_____465_CM 1 0. 0. 31.9990234375 DISPLAY_IDENTIFIER LAMB_THD_VPLSL_LIM_1_ ECU_ADDRESS 0x7f9542 BYTE_ORDER MSB_LAST FORMAT "%7.4" /end MEASUREMENT
/begin MEASUREMENT egcp[0].egcp_struct_acctlifa0.lamb_thd_tmp_vplsl_lim "Intermediate storage variable of threshold for Vp limitation in terms of lambda" UWORD _CNV_A_R_LINEAR_____465_CM 1 0. 0. 31.9990234375 DISPLAY_IDENTIFIER LAMB_THD_TMP_VPLSL_LIM_1_ ECU_ADDRESS 0x7f9544 BYTE_ORDER MSB_LAST FORMAT "%7.4" /end MEASUREMENT
/begin MEASUREMENT egcp[0].egcp_struct_acctlifa0.t_dly_vnlsl_lim_act "Timer for limitation of maximum Ip control loop inhibition duration due to Icp cut-off conditions" UWORD _CNV_A_R_LINEAR_____226_CM 1 0. 0. 655.35 DISPLAY_IDENTIFIER T_DLY_VNLSL_LIM_ACT_1_ ECU_ADDRESS 0x7f9546 BYTE_ORDER MSB_LAST FORMAT "%6.2" /end MEASUREMENT
/begin MEASUREMENT egcp[0].egcp_struct_acctlifa0.r_it_iplsl "Internal DC resistance of WRAF sensor pump cell" UWORD _CNV_A_R_EGCP_LINEA_466_CM 1 0. 0. 16383.75 DISPLAY_IDENTIFIER R_IT_IPLSL_1_ ECU_ADDRESS 0x7f9548 BYTE_ORDER MSB_LAST FORMAT "%9.2" /end MEASUREMENT
/begin MEASUREMENT egcp[0].egcp_struct_acctlifa0.vplsl "Voltage across WRAF sensor pump cell (VIP-VG)" SBYTE _CNV_A_R_EGCP_LINEA_467_CM 1 0. -3.224 3.198813 DISPLAY_IDENTIFIER VPLSL_1_ ECU_ADDRESS 0x7f954a FORMAT "%5.2" /end MEASUREMENT
/begin MEASUREMENT egcp[0].egcp_struct_acctlifa0.t_dly_iplsl_ctl_ena "Delay timer for validation of Ip after enabling of Ip control loop" UBYTE _CNV_A_R_LINEAR_____226_CM 1 0. 0. 2.55 DISPLAY_IDENTIFIER T_DLY_IPLSL_CTL_ENA_1_ ECU_ADDRESS 0x7f954b FORMAT "%4.2" /end MEASUREMENT
/begin MEASUREMENT egcp[0].egcp_struct_acctlifa0.icplsl_lsl_if "Value of the pumping current for filling of WRAF sensor oxygen reference (Icp)" UBYTE _CNV_A_R_LINEAR_____1_CM 1 0. 0. 31. DISPLAY_IDENTIFIER ICPLSL_LSL_IF_1_ ECU_ADDRESS 0x7f954c FORMAT "%2.0" /end MEASUREMENT
/begin MEASUREMENT egcp[0].egcp_struct_acctlifa0.ctr_iplsl_ctl_ena_nr_cyc "Cycle counter for pulsed activation of pump current" UBYTE _CNV_A_R_LINEAR_____1_CM 1 0. 0. 255. DISPLAY_IDENTIFIER CTR_IPLSL_CTL_ENA_NR_CYC_1_ ECU_ADDRESS 0x7f954d FORMAT "%3.0" /end MEASUREMENT
/begin MEASUREMENT egcp[0].egcp_struct_acctlifa0.ctr_iplsl_ctl_ena_pwm_on "Counter for duration of \" Ip on \" phase during pulsed activation of pump current " UBYTE _CNV_A_R_LINEAR_____1_CM 1 0. 0. 255. DISPLAY_IDENTIFIER CTR_IPLSL_CTL_ENA_PWM_ON_1_ ECU_ADDRESS 0x7f954e FORMAT "%3.0" /end MEASUREMENT
/begin MEASUREMENT egcp[0].egcp_struct_acctlifa0.ctr_iplsl_ctl_ena_pwm_off "Counter for duration of \" Ip off \" phase during pulsed activation of pump current " UBYTE _CNV_A_R_LINEAR_____1_CM 1 0. 0. 255. DISPLAY_IDENTIFIER CTR_IPLSL_CTL_ENA_PWM_OFF_1_ ECU_ADDRESS 0x7f954f FORMAT "%3.0" /end MEASUREMENT
/begin MEASUREMENT egcp[0].egcp_struct_acctlifa0.lv_icplsl_ena_lsl_if "Boolean flag requesting activation / deactivation of pumped-reference pumping current (Icp)" UBYTE _CNV_S_2_RANGE__0___85_CM 1 0. 0. 1. DISPLAY_IDENTIFIER LV_ICPLSL_ENA_LSL_IF_1_ ECU_ADDRESS 0x7f9550 BIT_MASK 0x1 /end MEASUREMENT
/begin MEASUREMENT egcp[0].egcp_struct_acctlifa0.lv_icplsl_vld "Boolean flag indicating that WRAF pumped reference is filled" UBYTE _CNV_S_2_RANGE__0___85_CM 1 0. 0. 1. DISPLAY_IDENTIFIER LV_ICPLSL_VLD_1_ ECU_ADDRESS 0x7f9551 BIT_MASK 0x1 /end MEASUREMENT
/begin MEASUREMENT egcp[0].egcp_struct_acctlifa0.lv_iplsl_ctl_ena_lsl_if "Boolean flag requesting activation / deactivation of pump current (Ip) Controller" UBYTE _CNV_S_2_RANGE__0___85_CM 1 0. 0. 1. DISPLAY_IDENTIFIER LV_IPLSL_CTL_ENA_LSL_IF_1_ ECU_ADDRESS 0x7f9552 BIT_MASK 0x1 /end MEASUREMENT
/begin MEASUREMENT egcp[0].egcp_struct_acctlifa0.lv_iplsl_ctl_inh_vplsl_lim "Boolean flag indicating that pump current control is inhibited by active Icp cut-off conditions" UBYTE _CNV_S_2_RANGE__0___85_CM 1 0. 0. 1. DISPLAY_IDENTIFIER LV_IPLSL_CTL_INH_VPLSL_LIM_1_ ECU_ADDRESS 0x7f9553 BIT_MASK 0x1 /end MEASUREMENT
/begin MEASUREMENT egcp[0].egcp_struct_acctlifa0.lv_iplsl_vld "Boolean flag indicating that WRAF sensor pump current is valid" UBYTE _CNV_S_2_RANGE__0___85_CM 1 0. 0. 1. DISPLAY_IDENTIFIER LV_IPLSL_VLD_1_ ECU_ADDRESS 0x7f9554 BIT_MASK 0x1 /end MEASUREMENT
/begin MEASUREMENT egcp[0].egcp_struct_acctlifa0.lv_iplsl_ctl_ena_pls_act "Boolean flag indicating that pulsed activation of pump current is active" UBYTE _CNV_S_2_RANGE__0___85_CM 1 0. 0. 1. DISPLAY_IDENTIFIER LV_IPLSL_CTL_ENA_PLS_ACT_1_ ECU_ADDRESS 0x7f9555 BIT_MASK 0x1 /end MEASUREMENT
/begin MEASUREMENT egcp[0].egcp_struct_acctlifa0.lv_lamb_ls_up_vld "Boolean flag indicating that lambda signal from WRAF system is reliable and up-to-date" UBYTE _CNV_S_2_RANGE__0___85_CM 1 0. 0. 1. DISPLAY_IDENTIFIER LV_LAMB_LS_UP_VLD_1_ ECU_ADDRESS 0x7f9556 BIT_MASK 0x1 /end MEASUREMENT
/begin MEASUREMENT egcp[0].egcp_struct_acctlifa0.lv_iplsl_ctl_inh_vnlsl_lim "Boolean flag indicating that pump current control is inhibited by active Icp cut-off / Vn overvoltage conditions" UBYTE _CNV_S_2_RANGE__0___85_CM 1 0. 0. 1. DISPLAY_IDENTIFIER LV_IPLSL_CTL_INH_VNLSL_LIM_1_ ECU_ADDRESS 0x7f9557 BIT_MASK 0x1 /end MEASUREMENT
/begin MEASUREMENT egcp[0].egcp_struct_acctlifa0.lv_vplsl_lim_act "Boolean flag indicating active pumping voltage (Vp) limitation conditions" UBYTE _CNV_S_2_RANGE__0___85_CM 1 0. 0. 1. DISPLAY_IDENTIFIER LV_VPLSL_LIM_ACT_1_ ECU_ADDRESS 0x7f9558 BIT_MASK 0x1 /end MEASUREMENT
/begin MEASUREMENT egcp[0].egcp_struct_acctllsh0.v_efc_ctl_p_lsh_up "additive effective heater voltage from closed loop controller, P term" SWORD _CNV_A_R_EGCP_LINEA_491_CM 1 0. -13. 12.999603 DISPLAY_IDENTIFIER V_EFC_CTL_P_LSH_UP_1_ ECU_ADDRESS 0x7f955a BYTE_ORDER MSB_LAST FORMAT "%10.4" /end MEASUREMENT
/begin MEASUREMENT egcp[0].egcp_struct_acctllsh0.v_efc_ctl_i_lsh_up "additive effective heater voltage from closed loop controller, I term" SWORD _CNV_A_R_EGCP_LINEA_491_CM 1 0. -13. 12.999603 DISPLAY_IDENTIFIER V_EFC_CTL_I_LSH_UP_1_ ECU_ADDRESS 0x7f955c BYTE_ORDER MSB_LAST FORMAT "%10.4" /end MEASUREMENT
/begin MEASUREMENT egcp[0].egcp_struct_acctllsh0.ttip_mes_dif_ls_up "Difference between actual and set oxygen sensor tip temperature" SWORD _CNV_A_R_EGCP_LINEA_468_CM 1 0. -2048. 2047.9375 DISPLAY_IDENTIFIER TTIP_MES_DIF_LS_UP_1_ ECU_ADDRESS 0x7f955e BYTE_ORDER MSB_LAST FORMAT "%10.4" /end MEASUREMENT
/begin MEASUREMENT egcp[0].egcp_struct_acctllsh0.t_pow_rise_lsh_up "Timer indicating the duration of  the pre-heating and post dew point heating phases " UWORD _CNV_A_R_LINEAR_____240_CM 1 0. 0. 6553.5 DISPLAY_IDENTIFIER T_POW_RISE_LSH_UP_1_ ECU_ADDRESS 0x7f9560 BYTE_ORDER MSB_LAST FORMAT "%6.1" /end MEASUREMENT
/begin MEASUREMENT egcp[0].egcp_struct_acctllsh0.v_efc_clc_lsh_up "Effective calculated heater voltage value prior to overvoltage protection" UWORD _CNV_A_R_EGCP_LINEA_492_CM 1 0. 0. 25.999603 DISPLAY_IDENTIFIER V_EFC_CLC_LSH_UP_1_ ECU_ADDRESS 0x7f9562 BYTE_ORDER MSB_LAST FORMAT "%7.4" /end MEASUREMENT
/begin MEASUREMENT egcp[0].egcp_struct_acctllsh0.v_efc_ctl_add_lsh_up "additive effective heater voltage from closed loop controller" SBYTE _CNV_A_R_EGCP_LINEA_473_CM 1 0. -13. 12.898438 DISPLAY_IDENTIFIER V_EFC_CTL_ADD_LSH_UP_1_ ECU_ADDRESS 0x7f9564 FORMAT "%5.1" /end MEASUREMENT
/begin MEASUREMENT egcp[0].egcp_struct_acctllsh0.lshpwm_up "Heater driver PWM duty cycle; acquired also by BSW" UBYTE _CNV_A_R_LINEAR_____486_CM 1 0. 0. 99.609375 DISPLAY_IDENTIFIER LSHPWM_UP_1_ ECU_ADDRESS 0x7f9565 FORMAT "%9.6" /end MEASUREMENT
/begin MEASUREMENT egcp[0].egcp_struct_acctllsh0.v_efc_lsh_up "Effective final output value of heater voltage" UBYTE _CNV_A_R_LINEAR_____349_CM 1 0. 0. 25.8984375 DISPLAY_IDENTIFIER V_EFC_LSH_UP_1_ ECU_ADDRESS 0x7f9566 FORMAT "%9.6" /end MEASUREMENT
/begin MEASUREMENT egcp[0].egcp_struct_acctllsh0.t_v_efc_tol_lsh_up "Timer indicating permitted effective heater voltage overvoltage duration" UBYTE _CNV_A_R_LINEAR_____240_CM 1 0. 0. 25.5 DISPLAY_IDENTIFIER T_V_EFC_TOL_LSH_UP_1_ ECU_ADDRESS 0x7f9567 FORMAT "%4.1" /end MEASUREMENT
/begin MEASUREMENT egcp[0].egcp_struct_acctllsh0.t_v_efc_lim_lsh_up "Timer indicating the duration of the effective heater voltage limitation preventing overvoltage" UBYTE _CNV_A_R_LINEAR_____240_CM 1 0. 0. 25.5 DISPLAY_IDENTIFIER T_V_EFC_LIM_LSH_UP_1_ ECU_ADDRESS 0x7f9568 FORMAT "%4.1" /end MEASUREMENT
/begin MEASUREMENT egcp[0].egcp_struct_acctllsh0.lv_lsh_ctl_cll_lsh_up "Boolean variable indicating closed loop control mode active" UBYTE _CNV_S_2_RANGE__0___85_CM 1 0. 0. 1. DISPLAY_IDENTIFIER LV_LSH_CTL_CLL_LSH_UP_1_ ECU_ADDRESS 0x7f9569 BIT_MASK 0x1 /end MEASUREMENT
/begin MEASUREMENT egcp[0].egcp_struct_acctllsh0.lv_v_efc_lim_bol_lsh_up "Boolean flag indicating effective heater voltage limited due to sum of voltage components falling below zero." UBYTE _CNV_S_2_RANGE__0___85_CM 1 0. 0. 1. DISPLAY_IDENTIFIER LV_V_EFC_LIM_BOL_LSH_UP_1_ ECU_ADDRESS 0x7f956a BIT_MASK 0x1 /end MEASUREMENT
/begin MEASUREMENT egcp[0].egcp_struct_acctllsh0.lv_v_efc_lim_tol_lsh_up "Boolean flag indicating effective heater voltage limited due to exceeding threshold for period of time." UBYTE _CNV_S_2_RANGE__0___85_CM 1 0. 0. 1. DISPLAY_IDENTIFIER LV_V_EFC_LIM_TOL_LSH_UP_1_ ECU_ADDRESS 0x7f956b BIT_MASK 0x1 /end MEASUREMENT
/begin MEASUREMENT egcp[0].egcp_struct_acctllsh0.lv_v_efc_lim_max_lsh_up "Boolean flag indicating effective heater voltage limited due to exceeding absolute maximum voltage spec." UBYTE _CNV_S_2_RANGE__0___85_CM 1 0. 0. 1. DISPLAY_IDENTIFIER LV_V_EFC_LIM_MAX_LSH_UP_1_ ECU_ADDRESS 0x7f956c BIT_MASK 0x1 /end MEASUREMENT
/begin MEASUREMENT egcp[0].egcp_struct_acctllsh0.state_lsh_up "Present heater state" UBYTE _CNV_S_7_EGCP_RANGE_493_CM 1 0. 0. 6. DISPLAY_IDENTIFIER STATE_LSH_UP_1_ ECU_ADDRESS 0x7f956d /end MEASUREMENT
/begin MEASUREMENT egcp[0].egcp_struct_acctllsh0.lv_v_efc_lim_prot_vb_lsh_up "Boolean flag indicating effective heater voltage limited due to excessive battery voltage level" UBYTE _CNV_S_2_RANGE__0___85_CM 1 0. 0. 1. DISPLAY_IDENTIFIER LV_V_EFC_LIM_PROT_VB_LSH_UP_1_ ECU_ADDRESS 0x7f956e BIT_MASK 0x1 /end MEASUREMENT
/begin MEASUREMENT egcp[0].egcp_struct_acctllshd0.t_pow_rise_lsh_down "Timer indicating the duration of  the pre-heating and post dew point heating phases " UWORD _CNV_A_R_LINEAR_____240_CM 1 0. 0. 6553.5 DISPLAY_IDENTIFIER T_POW_RISE_LSH_DOWN_1_ ECU_ADDRESS 0x7f9570 BYTE_ORDER MSB_LAST FORMAT "%6.1" /end MEASUREMENT
/begin MEASUREMENT egcp[0].egcp_struct_acctllshd0.v_efc_clc_lsh_down "Effective calculated heater voltage value prior to overvoltage protection" UWORD _CNV_A_R_EGCP_LINEA_492_CM 1 0. 0. 25.999603 DISPLAY_IDENTIFIER V_EFC_CLC_LSH_DOWN_1_ ECU_ADDRESS 0x7f9572 BYTE_ORDER MSB_LAST FORMAT "%7.4" /end MEASUREMENT
/begin MEASUREMENT egcp[0].egcp_struct_acctllshd0.v_efc_lsh_down "Effective final output value of heater voltage" UBYTE _CNV_A_R_LINEAR_____349_CM 1 0. 0. 25.8984375 DISPLAY_IDENTIFIER V_EFC_LSH_DOWN_1_ ECU_ADDRESS 0x7f9574 FORMAT "%9.6" /end MEASUREMENT
/begin MEASUREMENT egcp[0].egcp_struct_acctllshd0.lshpwm_down "Heater driver PWM duty cycle; acquired also by BSW" UBYTE _CNV_A_R_LINEAR_____486_CM 1 0. 0. 99.609375 DISPLAY_IDENTIFIER LSHPWM_DOWN_1_ ECU_ADDRESS 0x7f9575 FORMAT "%9.6" /end MEASUREMENT
/begin MEASUREMENT egcp[0].egcp_struct_acctllshd0.t_v_efc_tol_lsh_down "Timer indicating permitted effective heater voltage overvoltage duration" UBYTE _CNV_A_R_LINEAR_____240_CM 1 0. 0. 25.5 DISPLAY_IDENTIFIER T_V_EFC_TOL_LSH_DOWN_1_ ECU_ADDRESS 0x7f9576 FORMAT "%4.1" /end MEASUREMENT
/begin MEASUREMENT egcp[0].egcp_struct_acctllshd0.t_v_efc_lim_lsh_down "Timer indicating the duration of the effective heater voltage limitation preventing overvoltage" UBYTE _CNV_A_R_LINEAR_____240_CM 1 0. 0. 25.5 DISPLAY_IDENTIFIER T_V_EFC_LIM_LSH_DOWN_1_ ECU_ADDRESS 0x7f9577 FORMAT "%4.1" /end MEASUREMENT
/begin MEASUREMENT egcp[0].egcp_struct_acctllshd0.lv_v_efc_lim_bol_lsh_down "Boolean flag indicating effective heater voltage limited due to sum of voltage components falling below zero." UBYTE _CNV_S_2_RANGE__0___85_CM 1 0. 0. 1. DISPLAY_IDENTIFIER LV_V_EFC_LIM_BOL_LSH_DOWN_1_ ECU_ADDRESS 0x7f9578 BIT_MASK 0x1 /end MEASUREMENT
/begin MEASUREMENT egcp[0].egcp_struct_acctllshd0.lv_v_efc_lim_tol_lsh_down "Boolean flag indicating effective heater voltage limited due to exceeding threshold for period of time." UBYTE _CNV_S_2_RANGE__0___85_CM 1 0. 0. 1. DISPLAY_IDENTIFIER LV_V_EFC_LIM_TOL_LSH_DOWN_1_ ECU_ADDRESS 0x7f9579 BIT_MASK 0x1 /end MEASUREMENT
/begin MEASUREMENT egcp[0].egcp_struct_acctllshd0.lv_v_efc_lim_max_lsh_down "Boolean flag indicating effective heater voltage limited due to exceeding absolute maximum voltage spec." UBYTE _CNV_S_2_RANGE__0___85_CM 1 0. 0. 1. DISPLAY_IDENTIFIER LV_V_EFC_LIM_MAX_LSH_DOWN_1_ ECU_ADDRESS 0x7f957a BIT_MASK 0x1 /end MEASUREMENT
/begin MEASUREMENT egcp[0].egcp_struct_acctllshd0.state_lsh_down "Present heater state" UBYTE _CNV_S_7_EGCP_RANGE_493_CM 1 0. 0. 6. DISPLAY_IDENTIFIER STATE_LSH_DOWN_1_ ECU_ADDRESS 0x7f957b /end MEASUREMENT
/begin MEASUREMENT egcp[0].egcp_struct_acctllshd0.lv_v_efc_lim_prot_vb_lsh_down "Boolean flag indicating effective heater voltage limited due to excessive battery voltage level" UBYTE _CNV_S_2_RANGE__0___85_CM 1 0. 0. 1. DISPLAY_IDENTIFIER LV_V_EFC_LIM_PROT_VB_LSH_DOWN_1_ ECU_ADDRESS 0x7f957c BIT_MASK 0x1 /end MEASUREMENT
/begin MEASUREMENT egcp[0].egcp_struct_acctllshdi0.temp_ini_ls_down "Oxygen sensor temperature at start" SWORD _CNV_A_R_EGCP_LINEA_468_CM 1 0. -2048. 2047.9375 DISPLAY_IDENTIFIER TEMP_INI_LS_DOWN_1_ ECU_ADDRESS 0x7f957e BYTE_ORDER MSB_LAST FORMAT "%10.4" /end MEASUREMENT
/begin MEASUREMENT egcp[0].egcp_struct_acctllshdi0.lshpwm_ext_ls_down "Downstream heater PWM duty cycle preset from external tester" UBYTE _CNV_A_R_LINEAR_____486_CM 1 0. 0. 99.609375 DISPLAY_IDENTIFIER LSHPWM_EXT_LS_DOWN_1_ ECU_ADDRESS 0x7f9580 FORMAT "%9.6" /end MEASUREMENT
/begin MEASUREMENT egcp[0].egcp_struct_acctllshdi0.lv_inh_lsh_down "Boolean flag indicating project specific application conditions for heating not met" UBYTE _CNV_S_2_RANGE__0___85_CM 1 0. 0. 1. DISPLAY_IDENTIFIER LV_INH_LSH_DOWN_1_ ECU_ADDRESS 0x7f9581 BIT_MASK 0x1 /end MEASUREMENT
/begin MEASUREMENT egcp[0].egcp_struct_acctllshi0.temp_ini_ls_up "Oxygen sensor temperature at engine start" SWORD _CNV_A_R_EGCP_LINEA_468_CM 1 0. -2048. 2047.9375 DISPLAY_IDENTIFIER TEMP_INI_LS_UP_1_ ECU_ADDRESS 0x7f9582 BYTE_ORDER MSB_LAST FORMAT "%10.4" /end MEASUREMENT
/begin MEASUREMENT egcp[0].egcp_struct_acctllshi0.lshpwm_ext_ls_up "Upstream heater PWM duty cycle preset from external tester" UBYTE _CNV_A_R_LINEAR_____486_CM 1 0. 0. 99.609375 DISPLAY_IDENTIFIER LSHPWM_EXT_LS_UP_1_ ECU_ADDRESS 0x7f9584 FORMAT "%9.6" /end MEASUREMENT
/begin MEASUREMENT egcp[0].egcp_struct_acctllshi0.lv_inh_lsh_ctl_cll_lsh_up "Boolean flag indicating project specific application conditions closed loop heater control not met" UBYTE _CNV_S_2_RANGE__0___85_CM 1 0. 0. 1. DISPLAY_IDENTIFIER LV_INH_LSH_CTL_CLL_LSH_UP_1_ ECU_ADDRESS 0x7f9585 BIT_MASK 0x1 /end MEASUREMENT
/begin MEASUREMENT egcp[0].egcp_struct_acctllshi0.lv_inh_lsh_up "Boolean flag indicating project specific application conditions for heating not met" UBYTE _CNV_S_2_RANGE__0___85_CM 1 0. 0. 1. DISPLAY_IDENTIFIER LV_INH_LSH_UP_1_ ECU_ADDRESS 0x7f9586 BIT_MASK 0x1 /end MEASUREMENT
/begin MEASUREMENT egcp[0].egcp_struct_adcprlsl1.vls_ofs_tmp_old_lsl "Storage variable for calculated offset value" SWORD _CNV_A_R_EGCP_LINEA_494_CM 1 0. -5. 4.999847 DISPLAY_IDENTIFIER VLS_OFS_TMP_OLD_LSL_1_ ECU_ADDRESS 0x7f9588 BYTE_ORDER MSB_LAST FORMAT "%7.4" /end MEASUREMENT
/begin MEASUREMENT egcp[0].egcp_struct_adcprlsl1.vls_ofs_lsl "Output signal offset of linear lambda sensor" SWORD _CNV_A_R_EGCP_LINEA_494_CM 1 0. -5. 4.999847 DISPLAY_IDENTIFIER VLS_OFS_LSL_1_ ECU_ADDRESS 0x7f958c BYTE_ORDER MSB_LAST FORMAT "%7.4" /end MEASUREMENT
/begin MEASUREMENT egcp[0].egcp_struct_adcprlsl1.iplsl_cor "Compensated nominal pumping current ( after sensor / sensor dispersion compensation for new  / aged sensor)" SWORD _CNV_A_R_LINEAR_____481_CM 1 0. -12.596 12.595 DISPLAY_IDENTIFIER IPLSL_COR_1_ ECU_ADDRESS 0x7f958e BYTE_ORDER MSB_LAST FORMAT "%8.4" /end MEASUREMENT
/begin MEASUREMENT egcp[0].egcp_struct_adcprlsl1.vls_mv_lsl_buf "Buffer for mean value calculation " UWORD _CNV_A_R_EGCP_LINEA_495_CM 1 0. 0. 319.995117 DISPLAY_IDENTIFIER VLS_MV_LSL_BUF_1_ ECU_ADDRESS 0x7f9590 BYTE_ORDER MSB_LAST FORMAT "%7.3" /end MEASUREMENT
/begin MEASUREMENT egcp[0].egcp_struct_adcprlsl1.t_wait_lsl_ofs_adj "Wait timer to define minimum interval between two subsequent offset adjustment cycles" UWORD _CNV_A_R_LINEAR_____226_CM 1 0. 0. 655.35 DISPLAY_IDENTIFIER T_WAIT_LSL_OFS_ADJ_1_ ECU_ADDRESS 0x7f9592 BYTE_ORDER MSB_LAST FORMAT "%6.2" /end MEASUREMENT
/begin MEASUREMENT egcp[0].egcp_struct_adcprlsl1.t_dly_lamb_sti_off_ofs_adj "Wait timer to allow for lambda signal settling upon deactivation of forced stimulation" UWORD _CNV_A_R_LINEAR_____226_CM 1 0. 0. 655.35 DISPLAY_IDENTIFIER T_DLY_LAMB_STI_OFF_OFS_ADJ_1_ ECU_ADDRESS 0x7f9594 BYTE_ORDER MSB_LAST FORMAT "%6.2" /end MEASUREMENT
/begin MEASUREMENT egcp[0].egcp_struct_adcprlsl1.vls_cor_h_res_lsl "Corrected output signal of  lambda sensor with extended resolution" UWORD _CNV_A_R_EGCP_LINEA_474_CM 1 0. 0. 4.999847 DISPLAY_IDENTIFIER VLS_COR_H_RES_LSL_1_ ECU_ADDRESS 0x7f9596 BYTE_ORDER MSB_LAST FORMAT "%6.4" /end MEASUREMENT
/begin MEASUREMENT egcp[0].egcp_struct_adcprlsl1.vls_mv_lsl "Mean value of output signal of linear lambda sensor" UWORD _CNV_A_R_EGCP_LINEA_474_CM 1 0. 0. 4.999847 DISPLAY_IDENTIFIER VLS_MV_LSL_1_ ECU_ADDRESS 0x7f9598 BYTE_ORDER MSB_LAST FORMAT "%6.4" /end MEASUREMENT
/begin MEASUREMENT egcp[0].egcp_struct_adcprlsl1.vls_mmv_lsl "Moving mean value of output signal of linear lambda sensor" UWORD _CNV_A_R_EGCP_LINEA_474_CM 1 0. 0. 4.999847 DISPLAY_IDENTIFIER VLS_MMV_LSL_1_ ECU_ADDRESS 0x7f959a BYTE_ORDER MSB_LAST FORMAT "%6.4" /end MEASUREMENT
/begin MEASUREMENT egcp[0].egcp_struct_adcprlsl1.vls_cor_mv_lsl "Corrected output signal of the lambda sensor" UWORD _CNV_A_R_EGCP_LINEA_474_CM 1 0. 0. 4.999847 DISPLAY_IDENTIFIER VLS_COR_MV_LSL_1_ ECU_ADDRESS 0x7f959e BYTE_ORDER MSB_LAST FORMAT "%6.4" /end MEASUREMENT
/begin MEASUREMENT egcp[0].egcp_struct_adcprlsl1.vls_cor_tmp_lsl "Corrected output signal of the lambda sensor" UWORD _CNV_A_R_EGCP_LINEA_474_CM 1 0. 0. 4.999847 DISPLAY_IDENTIFIER VLS_COR_TMP_LSL_1_ ECU_ADDRESS 0x7f95a0 BYTE_ORDER MSB_LAST FORMAT "%6.4" /end MEASUREMENT
/begin MEASUREMENT egcp[0].egcp_struct_adcprlsl1.lamb_ls_up "Lambda signal value of the WRAF sensor" UWORD _CNV_A_R_LINEAR_____465_CM 1 0. 0. 31.9990234375 DISPLAY_IDENTIFIER LAMB_LS_UP_1_ ECU_ADDRESS 0x7f95a2 BYTE_ORDER MSB_LAST FORMAT "%7.4" /end MEASUREMENT
/begin MEASUREMENT egcp[0].egcp_struct_adcprlsl1.vls_cor_lsl "Corrected output signal of  lambda sensor" UWORD _CNV_A_R_LINEAR_____265_CM 1 0. 0. 4.9951171875 DISPLAY_IDENTIFIER VLS_COR_LSL_1_ ECU_ADDRESS 0x7f95a4 BYTE_ORDER MSB_LAST FORMAT "%5.3" /end MEASUREMENT
/begin MEASUREMENT egcp[0].egcp_struct_adcprlsl1.ctr_vls_mv_lsl_nr_sample "Sample counter for mean value calculation " UBYTE _CNV_A_R_LINEAR_____1_CM 1 0. 0. 255. DISPLAY_IDENTIFIER CTR_VLS_MV_LSL_NR_SAMPLE_1_ ECU_ADDRESS 0x7f95a6 FORMAT "%3.0" /end MEASUREMENT
/begin MEASUREMENT egcp[0].egcp_struct_adcprlsl1.ctr_err_lsl_if_spi_ofs_adj_save "Storage variable for SPI communication error counter value of WRAF controller " UBYTE _CNV_A_R_LINEAR_____1_CM 1 0. 0. 255. DISPLAY_IDENTIFIER CTR_ERR_LSL_IF_SPI_OFS_ADJ_SAVE_1_ ECU_ADDRESS 0x7f95a7 FORMAT "%3.0" /end MEASUREMENT
/begin MEASUREMENT egcp[0].egcp_struct_adcprlsl1.state_lsl_ofs_adj "State of  WRAF controller lambda output  voltage offset adjustment" UBYTE _CNV_S_3_EGCP_RANGE_496_CM 1 0. 0. 2. DISPLAY_IDENTIFIER STATE_LSL_OFS_ADJ_1_ ECU_ADDRESS 0x7f95a8 /end MEASUREMENT
/begin MEASUREMENT egcp[0].egcp_struct_adcprlsl1.t_dly_lsl_ofs_adj "Wait timer to delay acquisition of measurement  values upon activation of adjustment" UBYTE _CNV_A_R_LINEAR_____226_CM 1 0. 0. 2.55 DISPLAY_IDENTIFIER T_DLY_LSL_OFS_ADJ_1_ ECU_ADDRESS 0x7f95a9 FORMAT "%4.2" /end MEASUREMENT
/begin MEASUREMENT egcp[0].egcp_struct_adcprlsl1.lv_lsl_ofs_adj_act "State of the offset measurement (active / not active)" UBYTE _CNV_S_2_RANGE__0___85_CM 1 0. 0. 1. DISPLAY_IDENTIFIER LV_LSL_OFS_ADJ_ACT_1_ ECU_ADDRESS 0x7f95aa BIT_MASK 0x1 /end MEASUREMENT
/begin MEASUREMENT egcp[0].egcp_struct_adcprlsl1.lv_lsl_ofs_act_ast "Switch to chose activation conditions directly after engine start" UBYTE _CNV_S_2_RANGE__0___85_CM 1 0. 0. 1. DISPLAY_IDENTIFIER LV_LSL_OFS_ACT_AST_1_ ECU_ADDRESS 0x7f95ab BIT_MASK 0x1 /end MEASUREMENT
/begin MEASUREMENT egcp[0].egcp_struct_adcprlsl1.lv_lamb_sti_off_lsl_ofs_adj "Request for disabling of forced lambda stimulation" UBYTE _CNV_S_2_RANGE__0___85_CM 1 0. 0. 1. DISPLAY_IDENTIFIER LV_LAMB_STI_OFF_LSL_OFS_ADJ_1_ ECU_ADDRESS 0x7f95ac BIT_MASK 0x1 /end MEASUREMENT
/begin MEASUREMENT egcp[0].egcp_struct_adcprlsl1.lv_lsl_ofs_adj_is "Offset measurement carried out during current idle phase" UBYTE _CNV_S_2_RANGE__0___85_CM 1 0. 0. 1. DISPLAY_IDENTIFIER LV_LSL_OFS_ADJ_IS_1_ ECU_ADDRESS 0x7f95ad BIT_MASK 0x1 /end MEASUREMENT
/begin MEASUREMENT egcp[0].egcp_struct_adcprlsl1.lv_vls_ofs_lim_lsl "Boolean flag indicating limitation of  output voltage offset adjustment value" UBYTE _CNV_S_2_RANGE__0___85_CM 1 0. 0. 1. DISPLAY_IDENTIFIER LV_VLS_OFS_LIM_LSL_1_ ECU_ADDRESS 0x7f95ae BIT_MASK 0x1 /end MEASUREMENT
/begin MEASUREMENT egcp[0].egcp_struct_adcprlsl1.lv_vls_ofs_adj_ena_lsl_if "Boolean flag requesting enabling offset adjustment  mode of WRAF sensor interface for lambda signal output voltage " UBYTE _CNV_S_2_RANGE__0___85_CM 1 0. 0. 1. DISPLAY_IDENTIFIER LV_VLS_OFS_ADJ_ENA_LSL_IF_1_ ECU_ADDRESS 0x7f95af BIT_MASK 0x1 /end MEASUREMENT
/begin MEASUREMENT egcp[0].egcp_struct_adcprlsl1.lv_lamb_pls_swi_off "Indicator for need to switch off forced lambda stimulation" UBYTE _CNV_S_2_RANGE__0___85_CM 1 0. 0. 1. DISPLAY_IDENTIFIER LV_LAMB_PLS_SWI_OFF_1_ ECU_ADDRESS 0x7f95b0 BIT_MASK 0x1 /end MEASUREMENT
/begin MEASUREMENT egcp[0].egcp_struct_adcprlsl1.t_dly_lsl_ofs_adj_is "Wait timer to delay activation of offset adjustment upon entering engine state idle speed" UBYTE _CNV_A_R_LINEAR_____226_CM 1 0. 0. 2.55 DISPLAY_IDENTIFIER T_DLY_LSL_OFS_ADJ_IS_1_ ECU_ADDRESS 0x7f95b1 FORMAT "%4.2" /end MEASUREMENT
/begin MEASUREMENT egcp[0].egcp_struct_adcprlsl1.lv_swi_clc_lsl_ofs_adj "Logical variable for switching of lambda calculation routines" UBYTE _CNV_S_2_RANGE__0___85_CM 1 0. 0. 1. DISPLAY_IDENTIFIER LV_SWI_CLC_LSL_OFS_ADJ_1_ ECU_ADDRESS 0x7f95b2 BIT_MASK 0x1 /end MEASUREMENT
/begin MEASUREMENT egcp[0].egcp_struct_adcprlsl2.iplsl_cor_mmv_fcut "Moving mean value of corrected pumping current during fuel cut" SWORD _CNV_A_R_LINEAR_____481_CM 1 0. -12.596 12.595 DISPLAY_IDENTIFIER IPLSL_COR_MMV_FCUT_1_ ECU_ADDRESS 0x7f95b4 BYTE_ORDER MSB_LAST FORMAT "%8.4" /end MEASUREMENT
/begin MEASUREMENT egcp[0].egcp_struct_adcprlsl2.iplsl_purge "Compensated (excluding factor for gain adaptation)  pumping current during fuel cut at purged condition" SWORD _CNV_A_R_LINEAR_____481_CM 1 0. -12.596 12.595 DISPLAY_IDENTIFIER IPLSL_PURGE_1_ ECU_ADDRESS 0x7f95b6 BYTE_ORDER MSB_LAST FORMAT "%8.4" /end MEASUREMENT
/begin MEASUREMENT egcp[0].egcp_struct_adcprlsl2.iplsl_mv_purge "Arithmetic mean of compensated pumping current during fuel cut at purged condition" SWORD _CNV_A_R_LINEAR_____481_CM 1 0. -12.596 12.595 DISPLAY_IDENTIFIER IPLSL_MV_PURGE_1_ ECU_ADDRESS 0x7f95b8 BYTE_ORDER MSB_LAST FORMAT "%8.4" /end MEASUREMENT
/begin MEASUREMENT egcp[0].egcp_struct_adcprlsl2.iplsl_cor_beg_purge "Corrected pumping current during fuel cut at begin of purged condition" SWORD _CNV_A_R_LINEAR_____481_CM 1 0. -12.596 12.595 DISPLAY_IDENTIFIER IPLSL_COR_BEG_PURGE_1_ ECU_ADDRESS 0x7f95ba BYTE_ORDER MSB_LAST FORMAT "%8.4" /end MEASUREMENT
/begin MEASUREMENT egcp[0].egcp_struct_adcprlsl2.iplsl_cor_chg_purge "Change of corrected pumping current during acquisition at purged condition" SWORD _CNV_A_R_LINEAR_____481_CM 1 0. -12.596 12.595 DISPLAY_IDENTIFIER IPLSL_COR_CHG_PURGE_1_ ECU_ADDRESS 0x7f95bc BYTE_ORDER MSB_LAST FORMAT "%8.4" /end MEASUREMENT
/begin MEASUREMENT egcp[0].egcp_struct_adcprlsl2.iplsl_mmv_vld_fcut "Moving mean of valid samples of pumping current during fuel cut" SWORD _CNV_A_R_LINEAR_____481_CM 1 0. -12.596 12.595 DISPLAY_IDENTIFIER IPLSL_MMV_VLD_FCUT_1_ ECU_ADDRESS 0x7f95be BYTE_ORDER MSB_LAST FORMAT "%8.4" /end MEASUREMENT
/begin MEASUREMENT egcp[0].egcp_struct_adcprlsl2.iplsl_vari_vld_fcut "Moving variance of valid samples of pumping current during fuel cut" UWORD _CNV_A_R_EGCP_LINEA_477_CM 1 0. 0. 619.692407 DISPLAY_IDENTIFIER IPLSL_VARI_VLD_FCUT_1_ ECU_ADDRESS 0x7f95c0 BYTE_ORDER MSB_LAST FORMAT "%7.3" /end MEASUREMENT
/begin MEASUREMENT egcp[0].egcp_struct_adcprlsl2.iplsl_vari_purge "Variance of corrected pumping current during fuel cut at purged condition" UWORD _CNV_A_R_EGCP_LINEA_477_CM 1 0. 0. 619.692407 DISPLAY_IDENTIFIER IPLSL_VARI_PURGE_1_ ECU_ADDRESS 0x7f95c2 BYTE_ORDER MSB_LAST FORMAT "%7.3" /end MEASUREMENT
/begin MEASUREMENT egcp[0].egcp_struct_adcprlsl2.fac_lsl_gain_ad "Adaptive factor for WRAF sensor gain" UWORD _CNV_A_R_LINEAR_____476_CM 1 0. 0. 1.99996948242188 DISPLAY_IDENTIFIER FAC_LSL_GAIN_AD_1_ ECU_ADDRESS 0x7f95c4 BYTE_ORDER MSB_LAST FORMAT "%7.5" /end MEASUREMENT
/begin MEASUREMENT egcp[0].egcp_struct_adcprlsl2.t_acq_iplsl_purge "Timer for acquisition interval of compensated pumping current during fuel cut at purged condition" UBYTE _CNV_A_R_LINEAR_____240_CM 1 0. 0. 25.5 DISPLAY_IDENTIFIER T_ACQ_IPLSL_PURGE_1_ ECU_ADDRESS 0x7f95c6 FORMAT "%4.1" /end MEASUREMENT
/begin MEASUREMENT egcp[0].egcp_struct_adcprlsl2.state_iplsl_ad_fcut "State of fuel cut gain adaptation procedure" UBYTE _CNV_S_5_EGCP_RANGE_497_CM 1 0. 0. 4. DISPLAY_IDENTIFIER STATE_IPLSL_AD_FCUT_1_ ECU_ADDRESS 0x7f95c7 /end MEASUREMENT
/begin MEASUREMENT egcp[0].egcp_struct_adcprlsl2.state_iplsl_gain_ad "State of WRAF sensor gain adaptation factor" UBYTE _CNV_S_4_EGCP_RANGE_498_CM 1 0. 0. 3. DISPLAY_IDENTIFIER STATE_IPLSL_GAIN_AD_1_ ECU_ADDRESS 0x7f95c8 /end MEASUREMENT
/begin MEASUREMENT egcp[0].egcp_struct_adcprlsl2.lv_lsl_gain_ad_req "Request for fuel cut Ip measurement" UBYTE _CNV_S_2_RANGE__0___85_CM 1 0. 0. 1. DISPLAY_IDENTIFIER LV_LSL_GAIN_AD_REQ_1_ ECU_ADDRESS 0x7f95c9 BIT_MASK 0x1 /end MEASUREMENT
/begin MEASUREMENT egcp[0].egcp_struct_adcprlsl2.lv_lsl_gain_ad_req_vld "Validation of request for fuel cut Ip measurement" UBYTE _CNV_S_2_RANGE__0___85_CM 1 0. 0. 1. DISPLAY_IDENTIFIER LV_LSL_GAIN_AD_REQ_VLD_1_ ECU_ADDRESS 0x7f95ca BIT_MASK 0x1 /end MEASUREMENT
/begin MEASUREMENT egcp[0].egcp_struct_adcprlsl2.lv_iplsl_vld_fcut "Valid Ip sample has been acquired during current fuel cut" UBYTE _CNV_S_2_RANGE__0___85_CM 1 0. 0. 1. DISPLAY_IDENTIFIER LV_IPLSL_VLD_FCUT_1_ ECU_ADDRESS 0x7f95cb BIT_MASK 0x1 /end MEASUREMENT
/begin MEASUREMENT egcp[0].egcp_struct_adcprlsl2.lv_lsl_fcut_mes_rep_inh "Status flag indicating successful fuel cut Ip measurement during current PUC phase" UBYTE _CNV_S_2_RANGE__0___85_CM 1 0. 0. 1. DISPLAY_IDENTIFIER LV_LSL_FCUT_MES_REP_INH_1_ ECU_ADDRESS 0x7f95cc BIT_MASK 0x1 /end MEASUREMENT
/begin MEASUREMENT egcp[0].egcp_struct_adcprlsl2.lv_lsl_fcut_mes_not_plaus "Actual fuel cut Ip measurement not plausible" UBYTE _CNV_S_2_RANGE__0___85_CM 1 0. 0. 1. DISPLAY_IDENTIFIER LV_LSL_FCUT_MES_NOT_PLAUS_1_ ECU_ADDRESS 0x7f95cd BIT_MASK 0x1 /end MEASUREMENT
/begin MEASUREMENT egcp[0].egcp_struct_adcprlsl2.lv_lsl_gain_ad_fcut_not_ok "Factor for gain adaptation out of valid range" UBYTE _CNV_S_2_RANGE__0___85_CM 1 0. 0. 1. DISPLAY_IDENTIFIER LV_LSL_GAIN_AD_FCUT_NOT_OK_1_ ECU_ADDRESS 0x7f95ce BIT_MASK 0x1 /end MEASUREMENT
/begin MEASUREMENT egcp[0].egcp_struct_adcprlsl2.lv_fac_lsl_gain_ad_lim_max "Status flag for limitation of WRAF gain adaptation factor to maximum" UBYTE _CNV_S_2_RANGE__0___85_CM 1 0. 0. 1. DISPLAY_IDENTIFIER LV_FAC_LSL_GAIN_AD_LIM_MAX_1_ ECU_ADDRESS 0x7f95cf BIT_MASK 0x1 /end MEASUREMENT
/begin MEASUREMENT egcp[0].egcp_struct_adcprlsl2.lv_fac_lsl_gain_ad_lim_min "Status flag for limitation of WRAF gain adaptation factor to minimum" UBYTE _CNV_S_2_RANGE__0___85_CM 1 0. 0. 1. DISPLAY_IDENTIFIER LV_FAC_LSL_GAIN_AD_LIM_MIN_1_ ECU_ADDRESS 0x7f95d0 BIT_MASK 0x1 /end MEASUREMENT
/begin MEASUREMENT egcp[0].egcp_struct_adcprlsli2.lv_inh_lsl_gain_ad "WRAF sensor Gain Adaptation: application incidences for inhibition" UBYTE _CNV_S_2_RANGE__0___85_CM 1 0. 0. 1. DISPLAY_IDENTIFIER LV_INH_LSL_GAIN_AD_1_ ECU_ADDRESS 0x7f95d2 BIT_MASK 0x1 /end MEASUREMENT
/begin MEASUREMENT egcp[0].egcp_struct_dtsyslsd0.lv_ls_down_ready "Logical variable for operative readiness of downstream oxygen sensor(s)" UBYTE _CNV_S_2_RANGE__0___85_CM 1 0. 0. 1. DISPLAY_IDENTIFIER LV_LS_DOWN_READY_1_ ECU_ADDRESS 0x7f95d3 BIT_MASK 0x1 /end MEASUREMENT
/begin MEASUREMENT egcp[0].egcp_struct_dtsyslsl0.lamb_de_int_ls_up_ready "Value as a measure of the sensor signal variation" UWORD _CNV_A_R_EGCP_LINEA_483_CM 1 0. 0. 63.99886 DISPLAY_IDENTIFIER LAMB_DE_INT_LS_UP_READY_1_ ECU_ADDRESS 0x7f95d4 BYTE_ORDER MSB_LAST FORMAT "%7.4" /end MEASUREMENT
/begin MEASUREMENT egcp[0].egcp_struct_dtsyslsl0.t_tout_ls_up_ready "Timer for forced activation" UWORD _CNV_A_R_EGCP_LINEA_485_CM 1 0. 0. 1310.7 DISPLAY_IDENTIFIER T_TOUT_LS_UP_READY_1_ ECU_ADDRESS 0x7f95d6 BYTE_ORDER MSB_LAST FORMAT "%7.2" /end MEASUREMENT
/begin MEASUREMENT egcp[0].egcp_struct_dtsyslsl0.t_dly_chk_ls_up_ready "Timer for delay time for the readiness detection after engine start" UWORD _CNV_A_R_EGCP_LINEA_485_CM 1 0. 0. 1310.7 DISPLAY_IDENTIFIER T_DLY_CHK_LS_UP_READY_1_ ECU_ADDRESS 0x7f95d8 BYTE_ORDER MSB_LAST FORMAT "%7.2" /end MEASUREMENT
/begin MEASUREMENT egcp[0].egcp_struct_dtsyslsl0.t_lamb_de_int_rst "Timer for duration of summation of sensor signal dispersion up to reset" UWORD _CNV_A_R_EGCP_LINEA_485_CM 1 0. 0. 1310.7 DISPLAY_IDENTIFIER T_LAMB_DE_INT_RST_1_ ECU_ADDRESS 0x7f95da BYTE_ORDER MSB_LAST FORMAT "%7.2" /end MEASUREMENT
/begin MEASUREMENT egcp[0].egcp_struct_dtsyslsl0.lamb_mv_ls_up_ready "Mean value of the converted upstream oxygen sensor signal in terms of A/F-ratio" UWORD _CNV_A_R_LINEAR_____465_CM 1 0. 0. 31.9990234375 DISPLAY_IDENTIFIER LAMB_MV_LS_UP_READY_1_ ECU_ADDRESS 0x7f95dc BYTE_ORDER MSB_LAST FORMAT "%7.4" /end MEASUREMENT
/begin MEASUREMENT egcp[0].egcp_struct_dtsyslsl0.lv_ls_up_ready "Logical variable for operative readiness of upstream oxygen sensor" UBYTE _CNV_S_2_RANGE__0___85_CM 1 0. 0. 1. DISPLAY_IDENTIFIER LV_LS_UP_READY_1_ ECU_ADDRESS 0x7f95de BIT_MASK 0x1 /end MEASUREMENT
/begin MEASUREMENT egcp[0].egcp_struct_dtsyslsl0.lv_ls_up_ready_cdn "Logical variable for forced operative readiness of upstream oxygen sensor" UBYTE _CNV_S_2_RANGE__0___85_CM 1 0. 0. 1. DISPLAY_IDENTIFIER LV_LS_UP_READY_CDN_1_ ECU_ADDRESS 0x7f95df BIT_MASK 0x1 /end MEASUREMENT
/begin MEASUREMENT egcp[0].egcp_struct_dtsyslsl0.lv_ls_up_ready_raw "Logical variable for raw operative readiness of upstream oxygen sensor" UBYTE _CNV_S_2_RANGE__0___85_CM 1 0. 0. 1. DISPLAY_IDENTIFIER LV_LS_UP_READY_RAW_1_ ECU_ADDRESS 0x7f95e0 BIT_MASK 0x1 /end MEASUREMENT
/begin MEASUREMENT egcp[0].egcp_struct_ifinf0.vls_up "upstream oxygen sensor voltage - bank1" UWORD _CNV_A_R_LINEAR_____265_CM 1 0. 0. 4.9951171875 DISPLAY_IDENTIFIER VLS_UP_1_ ECU_ADDRESS 0x7f95e2 BYTE_ORDER MSB_LAST FORMAT "%5.3" /end MEASUREMENT
/begin MEASUREMENT egcp[0].egcp_struct_ifinf0.vls_down "downstream oxygen sensor voltage - bank1" UWORD _CNV_A_R_LINEAR_____265_CM 1 0. 0. 4.9951171875 DISPLAY_IDENTIFIER VLS_DOWN_1_ ECU_ADDRESS 0x7f95e4 BYTE_ORDER MSB_LAST FORMAT "%5.3" /end MEASUREMENT
/begin MEASUREMENT egcp[0].egcp_struct_ispclls0.ctr_afl_cyc "Counter indicating number of air fuel cycles" UWORD _CNV_A_R_LINEAR_____1_CM 1 0. 0. 65535. DISPLAY_IDENTIFIER CTR_AFL_CYC_1_ ECU_ADDRESS 0x7f95e6 BYTE_ORDER MSB_LAST FORMAT "%5.0" /end MEASUREMENT
/begin MEASUREMENT egcp[0].egcp_struct_ispclls0.t_afr_cyc "Rich mixture cycle time" UWORD _CNV_A_R_LINEAR_____226_CM 1 0. 0. 655.35 DISPLAY_IDENTIFIER T_AFR_CYC_1_ ECU_ADDRESS 0x7f95e8 BYTE_ORDER MSB_LAST FORMAT "%6.2" /end MEASUREMENT
/begin MEASUREMENT egcp[0].egcp_struct_ispclls0.t_afl_cyc "Lean mixture cycle time" UWORD _CNV_A_R_LINEAR_____226_CM 1 0. 0. 655.35 DISPLAY_IDENTIFIER T_AFL_CYC_1_ ECU_ADDRESS 0x7f95ea BYTE_ORDER MSB_LAST FORMAT "%6.2" /end MEASUREMENT
/begin MEASUREMENT egcp[0].egcp_struct_ispclls0.t_afl_cyc_hld "Lean mixture cycle time, held until next new value available" UWORD _CNV_A_R_LINEAR_____226_CM 1 0. 0. 655.35 DISPLAY_IDENTIFIER T_AFL_CYC_HLD_1_ ECU_ADDRESS 0x7f95ec BYTE_ORDER MSB_LAST FORMAT "%6.2" /end MEASUREMENT
/begin MEASUREMENT egcp[0].egcp_struct_ispclls0.t_afl_lock "timer indicating duration of LV_AFL[i] lock" UBYTE _CNV_A_R_LINEAR_____226_CM 1 0. 0. 2.55 DISPLAY_IDENTIFIER T_AFL_LOCK_1_ ECU_ADDRESS 0x7f95ee FORMAT "%4.2" /end MEASUREMENT
/begin MEASUREMENT egcp[0].egcp_struct_ispclls0.lv_afl "Boolean flag indicating detection of lean Air-Fuel mixture when set" UBYTE _CNV_S_2_RANGE__0___85_CM 1 0. 0. 1. DISPLAY_IDENTIFIER LV_AFL_1_ ECU_ADDRESS 0x7f95ef BIT_MASK 0x1 /end MEASUREMENT
/begin MEASUREMENT egcp[0].egcp_struct_outdglsh0.err_diag_lsh_up "diagnosis condition for each symptom of upstream heater diagnosis OBD I" UBYTE _CNV_A_R_LINEAR_____0_CM 1 0. 0. 7. DISPLAY_IDENTIFIER ERR_DIAG_LSH_UP_1_ ECU_ADDRESS 0x7f95f2 FORMAT "%1.0" /end MEASUREMENT
/begin MEASUREMENT egcp[0].egcp_struct_outdglsh0.cdn_diag_lsh_up "Diagnosis condition for each symptom of upstream heater diagnosis OBD I" UBYTE _CNV_A_R_LINEAR_____0_CM 1 0. 0. 7. DISPLAY_IDENTIFIER CDN_DIAG_LSH_UP_1_ ECU_ADDRESS 0x7f95f3 FORMAT "%1.0" /end MEASUREMENT
/begin MEASUREMENT egcp[0].egcp_struct_outdglsh0.lv_lsh_scg_act_lsh_up "Boolean flag indicating that debounce for upstream heater OBD I SCG diagnosis active" UBYTE _CNV_S_2_RANGE__0___85_CM 1 0. 0. 1. DISPLAY_IDENTIFIER LV_LSH_SCG_ACT_LSH_UP_1_ ECU_ADDRESS 0x7f95f4 /end MEASUREMENT
/begin MEASUREMENT egcp[0].egcp_struct_outdglshd0.err_diag_lsh_down "raw value of error symptom for downstream heater diagnosis OBD I" UBYTE _CNV_A_R_LINEAR_____0_CM 1 0. 0. 7. DISPLAY_IDENTIFIER ERR_DIAG_LSH_DOWN_1_ ECU_ADDRESS 0x7f95f6 FORMAT "%1.0" /end MEASUREMENT
/begin MEASUREMENT egcp[0].egcp_struct_outdglshd0.cdn_diag_lsh_down "Diagnosis condition for each symptom of downstream heater diagnosis OBD I" UBYTE _CNV_A_R_LINEAR_____0_CM 1 0. 0. 7. DISPLAY_IDENTIFIER CDN_DIAG_LSH_DOWN_1_ ECU_ADDRESS 0x7f95f7 FORMAT "%1.0" /end MEASUREMENT
/begin MEASUREMENT egcp[0].egcp_struct_pladglsd2.lv_diag_cdn_plaus_ls_down "Boolean flag, plausibility check on downstream oxygen sensor signal possible" UBYTE _CNV_S_2_RANGE__0___85_CM 1 0. 0. 1. DISPLAY_IDENTIFIER LV_DIAG_CDN_PLAUS_LS_DOWN_1_ ECU_ADDRESS 0x7f95f9 BIT_MASK 0x1 /end MEASUREMENT
/begin MEASUREMENT egcp[0].egcp_struct_pladglsd2.lv_err_plaus_ls_down "Boolean flag, error plausibility check on downstream oxygen sensor signal" UBYTE _CNV_S_2_RANGE__0___85_CM 1 0. 0. 1. DISPLAY_IDENTIFIER LV_ERR_PLAUS_LS_DOWN_1_ ECU_ADDRESS 0x7f95fa BIT_MASK 0x1 /end MEASUREMENT
/begin MEASUREMENT egcp[0].egcp_struct_pladgspi0.ctr_err_save_diag_lsl_up_if "Number of communication errors during the WRAF sensor controller initialization " UBYTE _CNV_A_R_LINEAR_____1_CM 1 0. 0. 255. DISPLAY_IDENTIFIER CTR_ERR_SAVE_DIAG_LSL_UP_IF_1_ ECU_ADDRESS 0x7f95fb FORMAT "%3.0" /end MEASUREMENT
/begin MEASUREMENT egcp[0].egcp_struct_sigcvif1.state_lsl_if_spi_rd "Bit-field, mapping verified contents of ATIC42 Configuration Register" UBYTE _CNV_A_R_LINEAR_____1_CM 1 0. 0. 255. DISPLAY_IDENTIFIER STATE_LSL_IF_SPI_RD_1_ ECU_ADDRESS 0x7f95fd FORMAT "%3.0" /end MEASUREMENT
/begin MEASUREMENT egcp[0].egcp_struct_sigcvif1.state_lsl_if_conf_spi_rd "Content of the configuration register comprising sensor disconnection time delay and Icp value" UBYTE _CNV_A_R_LINEAR_____1_CM 1 0. 0. 255. DISPLAY_IDENTIFIER STATE_LSL_IF_CONF_SPI_RD_1_ ECU_ADDRESS 0x7f95fe FORMAT "%3.0" /end MEASUREMENT
/begin MEASUREMENT egcp[0].egcp_struct_sigcvif1.ctr_err_lsl_if_spi_wr "Counter indicating number of invalid INIT_REG_x write validation cycles which have been detected" UBYTE _CNV_A_R_LINEAR_____1_CM 1 0. 0. 255. DISPLAY_IDENTIFIER CTR_ERR_LSL_IF_SPI_WR_1_ ECU_ADDRESS 0x7f95ff FORMAT "%3.0" /end MEASUREMENT
/begin MEASUREMENT egcp[0].egcp_struct_sigcvif1.frq_r_it_osc_lsl_if_spi_rd "Content of the configuration register comprising  Ri-measurement frequency and bit for pin selective disabling " UBYTE _CNV_A_R_LINEAR_____1_CM 1 0. 0. 127. DISPLAY_IDENTIFIER FRQ_R_IT_OSC_LSL_IF_SPI_RD_1_ ECU_ADDRESS 0x7f9600 FORMAT "%3.0" /end MEASUREMENT
/begin MEASUREMENT egcp[0].egcp_struct_sigcvif1.state_err_vnlsl "Diagnosis status of the Nernst Cell positive pin." UBYTE _CNV_S_3_EGCP_RANGE_499_CM 1 0. 0. 2. DISPLAY_IDENTIFIER STATE_ERR_VNLSL_1_ ECU_ADDRESS 0x7f9601 /end MEASUREMENT
/begin MEASUREMENT egcp[0].egcp_struct_sigcvif1.state_err_vglsl "Diagnosis status of the Virtual Ground pin." UBYTE _CNV_S_3_EGCP_RANGE_499_CM 1 0. 0. 2. DISPLAY_IDENTIFIER STATE_ERR_VGLSL_1_ ECU_ADDRESS 0x7f9602 /end MEASUREMENT
/begin MEASUREMENT egcp[0].egcp_struct_sigcvif1.state_err_viplsl "Diagnosis status of the Pump Cell pin." UBYTE _CNV_S_3_EGCP_RANGE_499_CM 1 0. 0. 2. DISPLAY_IDENTIFIER STATE_ERR_VIPLSL_1_ ECU_ADDRESS 0x7f9603 /end MEASUREMENT
/begin MEASUREMENT egcp[0].egcp_struct_sigcvif1.state_err_vrclsl "Diagnosis status of the Calibration Resistance pin." UBYTE _CNV_S_3_EGCP_RANGE_499_CM 1 0. 0. 2. DISPLAY_IDENTIFIER STATE_ERR_VRCLSL_1_ ECU_ADDRESS 0x7f9604 /end MEASUREMENT
/begin MEASUREMENT egcp[0].egcp_struct_sigcvif1.state_err_iplsl "Diagnosis status of the Pumping Current." UBYTE _CNV_S_3_EGCP_RANGE_500_CM 1 0. 0. 2. DISPLAY_IDENTIFIER STATE_ERR_IPLSL_1_ ECU_ADDRESS 0x7f9605 /end MEASUREMENT
/begin MEASUREMENT egcp[0].egcp_struct_sigcvif1.state_err_lsl "OBDI General Status" UBYTE _CNV_S_2_EGCP_RANGE_501_CM 1 0. 0. 1. DISPLAY_IDENTIFIER STATE_ERR_LSL_1_ ECU_ADDRESS 0x7f9606 /end MEASUREMENT
/begin MEASUREMENT egcp[0].egcp_struct_sigcvif1.lv_lsl_deac "Boolean flag indicating pending OBDI signal fault " UBYTE _CNV_S_2_RANGE__0___85_CM 1 0. 0. 1. DISPLAY_IDENTIFIER LV_LSL_DEAC_1_ ECU_ADDRESS 0x7f9607 BIT_MASK 0x1 /end MEASUREMENT
/begin MEASUREMENT egcp[0].egcp_struct_sigcvif1.lv_vplsl_lim "Boolean flag indicating that Pump Cell voltage has reached its limits" UBYTE _CNV_S_2_RANGE__0___85_CM 1 0. 0. 1. DISPLAY_IDENTIFIER LV_VPLSL_LIM_1_ ECU_ADDRESS 0x7f9608 BIT_MASK 0x1 /end MEASUREMENT
/begin MEASUREMENT egcp[0].egcp_struct_sigcvif1.lv_vnlsl_lim "Boolean flag indicating overvoltage at Nernst Cell positive pin" UBYTE _CNV_S_2_RANGE__0___85_CM 1 0. 0. 1. DISPLAY_IDENTIFIER LV_VNLSL_LIM_1_ ECU_ADDRESS 0x7f9609 BIT_MASK 0x1 /end MEASUREMENT
/begin MEASUREMENT egcp[0].egcp_struct_sigcvif1.ctr_err_lsl_if_spi_it_osc_ena "Counter indicating number of invalid transmissions of \"R_IT_OSC_ENA\" bit" UBYTE _CNV_A_R_LINEAR_____1_CM 1 0. 0. 255. DISPLAY_IDENTIFIER CTR_ERR_LSL_IF_SPI_IT_OSC_ENA_1_ ECU_ADDRESS 0x7f960a FORMAT "%3.0" /end MEASUREMENT
/begin MEASUREMENT egcp[0].egcp_struct_sigcvif2.state_lsl_if_spi_wr "Bit-field mapping of contents to be written to ATIC42 INIT_REG_1" UBYTE _CNV_A_R_LINEAR_____1_CM 1 0. 0. 255. DISPLAY_IDENTIFIER STATE_LSL_IF_SPI_WR_1_ ECU_ADDRESS 0x7f960b FORMAT "%3.0" /end MEASUREMENT
/begin MEASUREMENT egcp[0].egcp_struct_sigcvif2.state_lsl_if_conf_spi_wr "Mapping of contents to be written to ATIC42 INIT_REG_1" UBYTE _CNV_A_R_LINEAR_____1_CM 1 0. 0. 255. DISPLAY_IDENTIFIER STATE_LSL_IF_CONF_SPI_WR_1_ ECU_ADDRESS 0x7f960c FORMAT "%3.0" /end MEASUREMENT
/begin MEASUREMENT egcp[0].egcp_struct_sigcvif2.lv_lsl_if_spi_rst_end "Boolean flag indicating general status of  ATIC42 initialisation after RESET" UBYTE _CNV_S_2_RANGE__0___85_CM 1 0. 0. 1. DISPLAY_IDENTIFIER LV_LSL_IF_SPI_RST_END_1_ ECU_ADDRESS 0x7f960d BIT_MASK 0x1 /end MEASUREMENT
/begin MEASUREMENT egcp[0].egcp_struct_sigcvifi2.t_dly_di_lsl_if "Configuration of the Sensor Protection Time" UBYTE _CNV_A_R_LINEAR_____0_CM 1 0. 0. 7. DISPLAY_IDENTIFIER T_DLY_DI_LSL_IF_1_ ECU_ADDRESS 0x7f960e FORMAT "%1.0" /end MEASUREMENT
/begin MEASUREMENT egcp[0].egcp_struct_sigcvifi2.lv_lsl_ena_lsl_if "Boolean flag to enable/disable WRAF sensor connection" UBYTE _CNV_S_2_RANGE__0___85_CM 1 0. 0. 1. DISPLAY_IDENTIFIER LV_LSL_ENA_LSL_IF_1_ ECU_ADDRESS 0x7f960f BIT_MASK 0x1 /end MEASUREMENT
/begin MEASUREMENT egcp[0].egcp_struct_sigcvifi2.lv_lsl_if_rst "Boolean flag to reset the ATIC42" UBYTE _CNV_S_2_RANGE__0___85_CM 1 0. 0. 1. DISPLAY_IDENTIFIER LV_LSL_IF_RST_1_ ECU_ADDRESS 0x7f9610 BIT_MASK 0x1 /end MEASUREMENT
/begin MEASUREMENT egcp[0].egcp_struct_sigcvifi2.lv_swi_gain_lsl_if "Boolean flag configuring the WRAF sensor interface gain-selection" UBYTE _CNV_S_2_RANGE__0___85_CM 1 0. 0. 1. DISPLAY_IDENTIFIER LV_SWI_GAIN_LSL_IF_1_ ECU_ADDRESS 0x7f9611 BIT_MASK 0x1 /end MEASUREMENT
/begin MEASUREMENT egcp[0].egcp_struct_sigcvifi2.lv_lsl_ena_tmp_lsl_if "Temporary storage variable for content of WRAF sensor enable bit" UBYTE _CNV_S_2_RANGE__0___85_CM 1 0. 0. 1. DISPLAY_IDENTIFIER LV_LSL_ENA_TMP_LSL_IF_1_ ECU_ADDRESS 0x7f9612 BIT_MASK 0x1 /end MEASUREMENT
/begin MEASUREMENT egcp[0].egcp_struct_sigcvlsd0.vls_down_drv1_mmv "Mean of buffer containing 1st derivative of VLS_DOWN[i] signal" SWORD _CNV_A_R_EGCP_LINEA_502_CM 1 0. -2.5 2.499924 DISPLAY_IDENTIFIER VLS_DOWN_DRV1_MMV_1_ ECU_ADDRESS 0x7f9614 BYTE_ORDER MSB_LAST FORMAT "%8.5" /end MEASUREMENT
/begin MEASUREMENT egcp[0].egcp_struct_sigcvlsd0.vls_down_drv1_mmv_min "Minimum value of mean of buffer containing 1st derivative of VLS_DOWN[i] signal in lean phase" SWORD _CNV_A_R_EGCP_LINEA_502_CM 1 0. -2.5 2.499924 DISPLAY_IDENTIFIER VLS_DOWN_DRV1_MMV_MIN_1_ ECU_ADDRESS 0x7f9616 BYTE_ORDER MSB_LAST FORMAT "%8.5" /end MEASUREMENT
/begin MEASUREMENT egcp[0].egcp_struct_sigcvlsd0.vls_down_drv1_abs_max "Absolute maximum value within buffer containing 1st derivative of VLS_DOWN[i] signal" UWORD _CNV_A_R_EGCP_LINEA_503_CM 1 0. 0. 4.99992370605469 DISPLAY_IDENTIFIER VLS_DOWN_DRV1_ABS_MAX_1_ ECU_ADDRESS 0x7f9618 BYTE_ORDER MSB_LAST FORMAT "%7.5" /end MEASUREMENT
/begin MEASUREMENT egcp[0].egcp_struct_sigcvlsd0.vls_down_mmv_min "Mean oxygen sensor lean voltage" UWORD _CNV_A_R_EGCP_LINEA_504_CM 1 0. 0. 4.99992370605469 DISPLAY_IDENTIFIER VLS_DOWN_MMV_MIN_1_ ECU_ADDRESS 0x7f961a BYTE_ORDER MSB_LAST FORMAT "%7.5" /end MEASUREMENT
/begin MEASUREMENT egcp[0].egcp_struct_sigcvlsd0.vls_down_mmv_max "Mean oxygen sensor rich voltage" UWORD _CNV_A_R_EGCP_LINEA_504_CM 1 0. 0. 4.99992370605469 DISPLAY_IDENTIFIER VLS_DOWN_MMV_MAX_1_ ECU_ADDRESS 0x7f961c BYTE_ORDER MSB_LAST FORMAT "%7.5" /end MEASUREMENT
/begin MEASUREMENT egcp[0].egcp_struct_sigcvlsd0.vls_down_bol "Variable switching threshold for calculation of VLS_DOWN_MMV_MIN[i]" UWORD _CNV_A_R_LINEAR_____265_CM 1 0. 0. 4.9951171875 DISPLAY_IDENTIFIER VLS_DOWN_BOL_1_ ECU_ADDRESS 0x7f961e BYTE_ORDER MSB_LAST FORMAT "%5.3" /end MEASUREMENT
/begin MEASUREMENT egcp[0].egcp_struct_sigcvlsd0.vls_down_tol "Variable switching threshold for calculation of VLS_DOWN_MMV_MAX[i]" UWORD _CNV_A_R_LINEAR_____265_CM 1 0. 0. 4.9951171875 DISPLAY_IDENTIFIER VLS_DOWN_TOL_1_ ECU_ADDRESS 0x7f9620 BYTE_ORDER MSB_LAST FORMAT "%5.3" /end MEASUREMENT
/begin MEASUREMENT egcp[0].egcp_struct_sigcvlsd0.vls_down_mmv_hys "Variable hysteresis used to determine switching thresholds" UWORD _CNV_A_R_EGCP_LINEA_505_CM 1 0. 0. 0.999924 DISPLAY_IDENTIFIER VLS_DOWN_MMV_HYS_1_ ECU_ADDRESS 0x7f9622 BYTE_ORDER MSB_LAST FORMAT "%7.5" /end MEASUREMENT
/begin MEASUREMENT egcp[0].egcp_struct_sigcvlsd0.lv_vls_down_mmv_lim "Boolean flag indicating VLS_DOWN_MMV_xxx[i] signals being limited when set" UBYTE _CNV_S_2_RANGE__0___85_CM 1 0. 0. 1. DISPLAY_IDENTIFIER LV_VLS_DOWN_MMV_LIM_1_ ECU_ADDRESS 0x7f9624 BIT_MASK 0x1 /end MEASUREMENT
/begin MEASUREMENT egcp[0].egcp_struct_sigcvlsl2.lamb_sp_fil_delta_rise "Acquired lambda model value at the rising edge of heater PWM" UWORD _CNV_A_R_LINEAR_____506_CM 1 0. 0. 1.99993896484375 DISPLAY_IDENTIFIER LAMB_SP_FIL_DELTA_RISE_1_ ECU_ADDRESS 0x7f9626 BYTE_ORDER MSB_LAST FORMAT "%7.5" /end MEASUREMENT
/begin MEASUREMENT egcp[0].egcp_struct_sigcvlsl2.lamb_sp_fil_delta_fall "Acquired lambda model value at the falling edge of heater PWM" UWORD _CNV_A_R_LINEAR_____506_CM 1 0. 0. 1.99993896484375 DISPLAY_IDENTIFIER LAMB_SP_FIL_DELTA_FALL_1_ ECU_ADDRESS 0x7f9628 BYTE_ORDER MSB_LAST FORMAT "%7.5" /end MEASUREMENT
/begin MEASUREMENT egcp[0].egcp_struct_sigcvlsl2.vls_up_delta_rise "Acquired oxygen sensor voltage at the rising edge of heater PWM" UWORD _CNV_A_R_LINEAR_____265_CM 1 0. 0. 4.9951171875 DISPLAY_IDENTIFIER VLS_UP_DELTA_RISE_1_ ECU_ADDRESS 0x7f962a BYTE_ORDER MSB_LAST FORMAT "%5.3" /end MEASUREMENT
/begin MEASUREMENT egcp[0].egcp_struct_sigcvlsl2.vls_up_delta_fall "Acquired oxygen sensor voltage at the falling edge of heater PWM" UWORD _CNV_A_R_LINEAR_____265_CM 1 0. 0. 4.9951171875 DISPLAY_IDENTIFIER VLS_UP_DELTA_FALL_1_ ECU_ADDRESS 0x7f962c BYTE_ORDER MSB_LAST FORMAT "%5.3" /end MEASUREMENT
/begin MEASUREMENT egcp[0].egcp_struct_sigcvrid0.vls_down_mmv_drv1_thd_min "Lower variable VLS_DOWN gradient threshold" SWORD _CNV_A_R_EGCP_LINEA_502_CM 1 0. -2.5 2.499924 DISPLAY_IDENTIFIER VLS_DOWN_MMV_DRV1_THD_MIN_1_ ECU_ADDRESS 0x7f962e BYTE_ORDER MSB_LAST FORMAT "%8.5" /end MEASUREMENT
/begin MEASUREMENT egcp[0].egcp_struct_sigcvrid0.vls_down_mmv_drv1_thd_max "Upper variable VLS_DOWN gradient threshold" SWORD _CNV_A_R_EGCP_LINEA_502_CM 1 0. -2.5 2.499924 DISPLAY_IDENTIFIER VLS_DOWN_MMV_DRV1_THD_MAX_1_ ECU_ADDRESS 0x7f9630 BYTE_ORDER MSB_LAST FORMAT "%8.5" /end MEASUREMENT
/begin MEASUREMENT egcp[0].egcp_struct_sigcvrid0.ttip_mes_ls_down "Downstream oxygen sensor ceramic temperature" SWORD _CNV_A_R_EGCP_LINEA_468_CM 1 0. -2048. 2047.9375 DISPLAY_IDENTIFIER TTIP_MES_LS_DOWN_1_ ECU_ADDRESS 0x7f9632 BYTE_ORDER MSB_LAST FORMAT "%10.4" /end MEASUREMENT
/begin MEASUREMENT egcp[0].egcp_struct_sigcvrid0.ttip_mes_tol_ls_down "Downstream oxygen sensor ceramic temperature, Upper limit, Unfiltered" SWORD _CNV_A_R_EGCP_LINEA_468_CM 1 0. -2048. 2047.9375 DISPLAY_IDENTIFIER TTIP_MES_TOL_LS_DOWN_1_ ECU_ADDRESS 0x7f9634 BYTE_ORDER MSB_LAST FORMAT "%10.4" /end MEASUREMENT
/begin MEASUREMENT egcp[0].egcp_struct_sigcvrid0.ttip_mes_bol_ls_down "Downstream oxygen sensor ceramic temperature, Lower limit, Unfiltered" SWORD _CNV_A_R_EGCP_LINEA_468_CM 1 0. -2048. 2047.9375 DISPLAY_IDENTIFIER TTIP_MES_BOL_LS_DOWN_1_ ECU_ADDRESS 0x7f9636 BYTE_ORDER MSB_LAST FORMAT "%10.4" /end MEASUREMENT
/begin MEASUREMENT egcp[0].egcp_struct_sigcvrid0.ttip_mes_tol_mmv_ls_down "Downstream oxygen sensor ceramic temperature, Upper limit, Filtered" SWORD _CNV_A_R_EGCP_LINEA_468_CM 1 0. -2048. 2047.9375 DISPLAY_IDENTIFIER TTIP_MES_TOL_MMV_LS_DOWN_1_ ECU_ADDRESS 0x7f9638 BYTE_ORDER MSB_LAST FORMAT "%10.4" /end MEASUREMENT
/begin MEASUREMENT egcp[0].egcp_struct_sigcvrid0.ttip_mes_bol_mmv_ls_down "Downstream oxygen sensor ceramic temperature, Lower limit, Filtered" SWORD _CNV_A_R_EGCP_LINEA_468_CM 1 0. -2048. 2047.9375 DISPLAY_IDENTIFIER TTIP_MES_BOL_MMV_LS_DOWN_1_ ECU_ADDRESS 0x7f963a BYTE_ORDER MSB_LAST FORMAT "%10.4" /end MEASUREMENT
/begin MEASUREMENT egcp[0].egcp_struct_sigcvrid0.ctr_cycnr_r_it_ls_down_vld "Handshake counter indicating the number of valid resistance values determined since initial activation" UWORD _CNV_A_R_LINEAR_____1_CM 1 0. 0. 65535. DISPLAY_IDENTIFIER CTR_CYCNR_R_IT_LS_DOWN_VLD_1_ ECU_ADDRESS 0x7f963c BYTE_ORDER MSB_LAST FORMAT "%5.0" /end MEASUREMENT
/begin MEASUREMENT egcp[0].egcp_struct_sigcvrid0.pow_mmv_lsh_down "Moving mean value of downstream oxygen sensor heater power" UWORD _CNV_A_R_EGCP_LINEA_507_CM 1 0. 0. 84.498711 DISPLAY_IDENTIFIER POW_MMV_LSH_DOWN_1_ ECU_ADDRESS 0x7f963e BYTE_ORDER MSB_LAST /end MEASUREMENT
/begin MEASUREMENT egcp[0].egcp_struct_sigcvrid0.r_it_ls_down "Internal resistance of downstream oxygen sensor (Released)" UWORD _CNV_A_R_LINEAR_____487_CM 1 0. 0. 65535. DISPLAY_IDENTIFIER R_IT_LS_DOWN_1_ ECU_ADDRESS 0x7f9640 BYTE_ORDER MSB_LAST FORMAT "%5.0" /end MEASUREMENT
/begin MEASUREMENT egcp[0].egcp_struct_sigcvrid0.r_it_mes_ls_down "Internal resistance of downstream oxygen sensor (Measured)" UWORD _CNV_A_R_LINEAR_____487_CM 1 0. 0. 65535. DISPLAY_IDENTIFIER R_IT_MES_LS_DOWN_1_ ECU_ADDRESS 0x7f9642 BYTE_ORDER MSB_LAST FORMAT "%5.0" /end MEASUREMENT
/begin MEASUREMENT egcp[0].egcp_struct_sigcvrid0.r_it_mdl_ls_down_new "Internal resistance of downstream oxygen sensor (Modelled for new sensor)" UWORD _CNV_A_R_LINEAR_____487_CM 1 0. 0. 65535. DISPLAY_IDENTIFIER R_IT_MDL_LS_DOWN_NEW_1_ ECU_ADDRESS 0x7f9644 BYTE_ORDER MSB_LAST FORMAT "%5.0" /end MEASUREMENT
/begin MEASUREMENT egcp[0].egcp_struct_sigcvrid0.t_sample_r_it_ls_down "Time measured between internal resistance samples" UWORD _CNV_A_R_LINEAR_____226_CM 1 0. 0. 655.35 DISPLAY_IDENTIFIER T_SAMPLE_R_IT_LS_DOWN_1_ ECU_ADDRESS 0x7f9646 BYTE_ORDER MSB_LAST FORMAT "%6.2" /end MEASUREMENT
/begin MEASUREMENT egcp[0].egcp_struct_sigcvrid0.ttip_ref_mdl_mmv_ls_down "Reference of downstream oxygen sensor ceramic temperature (Modelled for new sensor)" UWORD _CNV_A_R_EGCP_LINEA_468_CM 1 0. 0. 2047.9375 DISPLAY_IDENTIFIER TTIP_REF_MDL_MMV_LS_DOWN_1_ ECU_ADDRESS 0x7f9648 BYTE_ORDER MSB_LAST FORMAT "%7.2" /end MEASUREMENT
/begin MEASUREMENT egcp[0].egcp_struct_sigcvrid0.vls_down_cur_pump_on "Downstream oxygen sensor voltage C_T_CUR_PUMP_ON_LS_DOWN after switching on pump current switch" UWORD _CNV_A_R_LINEAR_____265_CM 1 0. 0. 4.9951171875 DISPLAY_IDENTIFIER VLS_DOWN_CUR_PUMP_ON_1_ ECU_ADDRESS 0x7f964a BYTE_ORDER MSB_LAST FORMAT "%5.3" /end MEASUREMENT
/begin MEASUREMENT egcp[0].egcp_struct_sigcvrid0.vls_down_cur_pump_off "Downstream oxygen sensor voltage prior to switching on pump current switch" UWORD _CNV_A_R_LINEAR_____265_CM 1 0. 0. 4.9951171875 DISPLAY_IDENTIFIER VLS_DOWN_CUR_PUMP_OFF_1_ ECU_ADDRESS 0x7f964c BYTE_ORDER MSB_LAST FORMAT "%5.3" /end MEASUREMENT
/begin MEASUREMENT egcp[0].egcp_struct_sigcvrid0.fac_t_vls_down_mmv_drv1 "Multiplicative factor modifies DRV1_VLS_DOWN_MMV_MIN_THD dependent on T_VLS_CYC_AFL_HLD" UBYTE _CNV_A_R_EGCP_LINEA_508_CM 1 0. 0. 63.75 DISPLAY_IDENTIFIER FAC_T_VLS_DOWN_MMV_DRV1_1_ ECU_ADDRESS 0x7f964e FORMAT "%5.2" /end MEASUREMENT
/begin MEASUREMENT egcp[0].egcp_struct_sigcvrid0.fac_t_vls_down_mmv_drv1_abs "Multiplicative factor modifies C_VLS_DOWN_MMV_DRV1_ABS_MAX dependent on T_VLS_CYC_AFL_HLD" UBYTE _CNV_A_R_LINEAR_____251_CM 1 0. 0. 15.9375 DISPLAY_IDENTIFIER FAC_T_VLS_DOWN_MMV_DRV1_ABS_1_ ECU_ADDRESS 0x7f964f FORMAT "%7.4" /end MEASUREMENT
/begin MEASUREMENT egcp[0].egcp_struct_sigcvrid0.t_afl_cyc_hld_ri_it_ls_down "Lean mixture cycle time (measured upstream), held until next threshold crossing downstream" UBYTE _CNV_A_R_LINEAR_____226_CM 1 0. 0. 2.55 DISPLAY_IDENTIFIER T_AFL_CYC_HLD_RI_IT_LS_DOWN_1_ ECU_ADDRESS 0x7f9650 FORMAT "%4.2" /end MEASUREMENT
/begin MEASUREMENT egcp[0].egcp_struct_sigcvrid0.lv_r_it_req_ls_down "Boolean flag indicating that conditions have been met and resistance determination requested" UBYTE _CNV_S_2_RANGE__0___85_CM 1 0. 0. 1. DISPLAY_IDENTIFIER LV_R_IT_REQ_LS_DOWN_1_ ECU_ADDRESS 0x7f9651 BIT_MASK 0x1 /end MEASUREMENT
/begin MEASUREMENT egcp[0].egcp_struct_sigcvrid0.lv_r_it_det_ls_down "Boolean flag indicating that resistance has already been determined (lock out)" UBYTE _CNV_S_2_RANGE__0___85_CM 1 0. 0. 1. DISPLAY_IDENTIFIER LV_R_IT_DET_LS_DOWN_1_ ECU_ADDRESS 0x7f9652 BIT_MASK 0x1 /end MEASUREMENT
/begin MEASUREMENT egcp[0].egcp_struct_sigcvrid0.lv_vls_down_drv1_cdn_r_ls "Boolean flag indicating that low gradient condition met" UBYTE _CNV_S_2_RANGE__0___85_CM 1 0. 0. 1. DISPLAY_IDENTIFIER LV_VLS_DOWN_DRV1_CDN_R_LS_1_ ECU_ADDRESS 0x7f9653 BIT_MASK 0x1 /end MEASUREMENT
/begin MEASUREMENT egcp[0].egcp_struct_sigcvrid0.lv_vls_down_rng_cdn_r_ls "Boolean flag indicating that VLS_DOWN at low gradient condition met" UBYTE _CNV_S_2_RANGE__0___85_CM 1 0. 0. 1. DISPLAY_IDENTIFIER LV_VLS_DOWN_RNG_CDN_R_LS_1_ ECU_ADDRESS 0x7f9654 BIT_MASK 0x1 /end MEASUREMENT
/begin MEASUREMENT egcp[0].egcp_struct_sigcvtipa0.ttip_mes_ls_up "Oxygen sensor ceramic temperature" SWORD _CNV_A_R_EGCP_LINEA_468_CM 1 0. -2048. 2047.9375 DISPLAY_IDENTIFIER TTIP_MES_LS_UP_1_ ECU_ADDRESS 0x7f9658 BYTE_ORDER MSB_LAST FORMAT "%10.4" /end MEASUREMENT
/begin MEASUREMENT egcp[0].egcp_struct_sigcvtipa0.r_it_ls_up "Oxygen sensor element internal resistance" UWORD _CNV_A_R_EGCP_LINEA_466_CM 1 0. 0. 16383.75 DISPLAY_IDENTIFIER R_IT_LS_UP_1_ ECU_ADDRESS 0x7f965a BYTE_ORDER MSB_LAST FORMAT "%9.2" /end MEASUREMENT
/begin MEASUREMENT egcp[0].egcp_struct_sigcvtipa0.tcc_v_ofs_mes_r_it_ls_up "Counter incremented for every measured offset voltage in resistance measurement mode" UWORD _CNV_A_R_LINEAR_____1_CM 1 0. 0. 65535. DISPLAY_IDENTIFIER TCC_V_OFS_MES_R_IT_LS_UP_1_ ECU_ADDRESS 0x7f965c BYTE_ORDER MSB_LAST FORMAT "%5.0" /end MEASUREMENT
/begin MEASUREMENT egcp[0].egcp_struct_sigcvtipa0.tcc_v_ofs_adj_r_it_ls_up "Counter incremented for every offset voltage in resistance adjust mode" UWORD _CNV_A_R_LINEAR_____1_CM 1 0. 0. 65535. DISPLAY_IDENTIFIER TCC_V_OFS_ADJ_R_IT_LS_UP_1_ ECU_ADDRESS 0x7f965e BYTE_ORDER MSB_LAST FORMAT "%5.0" /end MEASUREMENT
/begin MEASUREMENT egcp[0].egcp_struct_sigcvtipa0.tcc_fac_gain_h_r_it_ls_up "Counter incremented for every high gain adjust measurement" UWORD _CNV_A_R_LINEAR_____1_CM 1 0. 0. 65535. DISPLAY_IDENTIFIER TCC_FAC_GAIN_H_R_IT_LS_UP_1_ ECU_ADDRESS 0x7f9660 BYTE_ORDER MSB_LAST FORMAT "%5.0" /end MEASUREMENT
/begin MEASUREMENT egcp[0].egcp_struct_sigcvtipa0.tcc_fac_gain_l_r_it_ls_up "Counter incremented for every low gain adjust measurement" UWORD _CNV_A_R_LINEAR_____1_CM 1 0. 0. 65535. DISPLAY_IDENTIFIER TCC_FAC_GAIN_L_R_IT_LS_UP_1_ ECU_ADDRESS 0x7f9662 BYTE_ORDER MSB_LAST FORMAT "%5.0" /end MEASUREMENT
/begin MEASUREMENT egcp[0].egcp_struct_sigcvtipa0.tcc_err_v_ofs_mes_r_it_ls_up "Counter incremented for every invalid offset voltage in resistance measurement mode" UWORD _CNV_A_R_LINEAR_____1_CM 1 0. 0. 65535. DISPLAY_IDENTIFIER TCC_ERR_V_OFS_MES_R_IT_LS_UP_1_ ECU_ADDRESS 0x7f9664 BYTE_ORDER MSB_LAST FORMAT "%5.0" /end MEASUREMENT
/begin MEASUREMENT egcp[0].egcp_struct_sigcvtipa0.tcc_err_v_ofs_adj_r_it_ls_up "Counter incremented for every invalid offset voltage in resistance adjust mode" UWORD _CNV_A_R_LINEAR_____1_CM 1 0. 0. 65535. DISPLAY_IDENTIFIER TCC_ERR_V_OFS_ADJ_R_IT_LS_UP_1_ ECU_ADDRESS 0x7f9666 BYTE_ORDER MSB_LAST FORMAT "%5.0" /end MEASUREMENT
/begin MEASUREMENT egcp[0].egcp_struct_sigcvtipa0.tcc_err_fac_gain_h_r_ls_up "Counter incremented for every invalid high gain adjust measurement" UWORD _CNV_A_R_LINEAR_____1_CM 1 0. 0. 65535. DISPLAY_IDENTIFIER TCC_ERR_FAC_GAIN_H_R_LS_UP_1_ ECU_ADDRESS 0x7f9668 BYTE_ORDER MSB_LAST FORMAT "%5.0" /end MEASUREMENT
/begin MEASUREMENT egcp[0].egcp_struct_sigcvtipa0.tcc_err_fac_gain_l_r_ls_up "Counter incremented for every invalid low gain adjust measurement" UWORD _CNV_A_R_LINEAR_____1_CM 1 0. 0. 65535. DISPLAY_IDENTIFIER TCC_ERR_FAC_GAIN_L_R_LS_UP_1_ ECU_ADDRESS 0x7f966a BYTE_ORDER MSB_LAST FORMAT "%5.0" /end MEASUREMENT
/begin MEASUREMENT egcp[0].egcp_struct_sigcvtipa0.v_ofs_adj_r_it_ls_up "Internal resistance determination circuit offset in resistance adjust mode" UWORD _CNV_A_R_EGCP_LINEA_509_CM 1 0. 0. 4.995 DISPLAY_IDENTIFIER V_OFS_ADJ_R_IT_LS_UP_1_ ECU_ADDRESS 0x7f966c BYTE_ORDER MSB_LAST FORMAT "%5.3" /end MEASUREMENT
/begin MEASUREMENT egcp[0].egcp_struct_sigcvtipa0.v_ofs_mes_r_it_ls_up "Internal resistance determination circuit offset in resistance measurement mode" UWORD _CNV_A_R_EGCP_LINEA_509_CM 1 0. 0. 4.995 DISPLAY_IDENTIFIER V_OFS_MES_R_IT_LS_UP_1_ ECU_ADDRESS 0x7f966e BYTE_ORDER MSB_LAST FORMAT "%5.3" /end MEASUREMENT
/begin MEASUREMENT egcp[0].egcp_struct_sigcvtipa0.fac_gain_h_r_it_ls_up "High gain of oxygen sensor internal resistance determination circuit" UWORD _CNV_A_R_EGCP_LINEA_510_CM 1 0. 0. 23.999634 DISPLAY_IDENTIFIER FAC_GAIN_H_R_IT_LS_UP_1_ ECU_ADDRESS 0x7f9670 BYTE_ORDER MSB_LAST FORMAT "%7.4" /end MEASUREMENT
/begin MEASUREMENT egcp[0].egcp_struct_sigcvtipa0.fac_gain_l_r_it_ls_up "Low gain of oxygen sensor internal resistance determination circuit" UWORD _CNV_A_R_EGCP_LINEA_510_CM 1 0. 0. 23.999634 DISPLAY_IDENTIFIER FAC_GAIN_L_R_IT_LS_UP_1_ ECU_ADDRESS 0x7f9672 BYTE_ORDER MSB_LAST FORMAT "%7.4" /end MEASUREMENT
/begin MEASUREMENT egcp[0].egcp_struct_sigcvtipa0.frq_r_it_osc_lsl_if_spi_wr "Variable indicating coded information for requested Ri determination oscillator frequency" UBYTE _CNV_A_R_LINEAR_____1_CM 1 0. 0. 127. DISPLAY_IDENTIFIER FRQ_R_IT_OSC_LSL_IF_SPI_WR_1_ ECU_ADDRESS 0x7f9674 FORMAT "%3.0" /end MEASUREMENT
/begin MEASUREMENT egcp[0].egcp_struct_sigcvtipa0.state_ttip_mes_ls_up "State variable indicating current state of function" UBYTE _CNV_S_5_EGCP_RANGE_511_CM 1 0. 0. 4. DISPLAY_IDENTIFIER STATE_TTIP_MES_LS_UP_1_ ECU_ADDRESS 0x7f9675 /end MEASUREMENT
/begin MEASUREMENT egcp[0].egcp_struct_sigcvtipa0.lv_fac_gain_h_vld_r_it_ls_up "Boolean flag indicating measured high gain valid" UBYTE _CNV_S_2_RANGE__0___85_CM 1 0. 0. 1. DISPLAY_IDENTIFIER LV_FAC_GAIN_H_VLD_R_IT_LS_UP_1_ ECU_ADDRESS 0x7f9676 BIT_MASK 0x1 /end MEASUREMENT
/begin MEASUREMENT egcp[0].egcp_struct_sigcvtipa0.lv_fac_gain_l_vld_r_it_ls_up "Boolean flag indicating measured low gain valid" UBYTE _CNV_S_2_RANGE__0___85_CM 1 0. 0. 1. DISPLAY_IDENTIFIER LV_FAC_GAIN_L_VLD_R_IT_LS_UP_1_ ECU_ADDRESS 0x7f9677 BIT_MASK 0x1 /end MEASUREMENT
/begin MEASUREMENT egcp[0].egcp_struct_sigcvtipa0.lv_r_it_cal_ena_lsl_if "Boolean flag requesting WRAF interface internal resistance adjust mode to be enabled" UBYTE _CNV_S_2_RANGE__0___85_CM 1 0. 0. 1. DISPLAY_IDENTIFIER LV_R_IT_CAL_ENA_LSL_IF_1_ ECU_ADDRESS 0x7f9678 BIT_MASK 0x1 /end MEASUREMENT
/begin MEASUREMENT egcp[0].egcp_struct_sigcvtipa0.lv_r_it_osc_ena_lsl_if "Boolean flag requesting WRAF interface internal oscillator to be enabled" UBYTE _CNV_S_2_RANGE__0___85_CM 1 0. 0. 1. DISPLAY_IDENTIFIER LV_R_IT_OSC_ENA_LSL_IF_1_ ECU_ADDRESS 0x7f9679 BIT_MASK 0x1 /end MEASUREMENT
/begin MEASUREMENT egcp[0].egcp_struct_sigcvtipa0.lv_r_it_swi_rng_lsl_if "Boolean flag requesting WRAF interface to select internal resistance gain (range)" UBYTE _CNV_S_2_RANGE__0___85_CM 1 0. 0. 1. DISPLAY_IDENTIFIER LV_R_IT_SWI_RNG_LSL_IF_1_ ECU_ADDRESS 0x7f967a BIT_MASK 0x1 /end MEASUREMENT
/begin MEASUREMENT egcp[0].egcp_struct_sigcvtipa0.lv_ttip_mes_vld_ls_up "Boolean flag indicating validity of oxygen sensor ceramic temperature TTIP_MES_LS_UP[NC_CBK_EX_NR]" UBYTE _CNV_S_2_RANGE__0___85_CM 1 0. 0. 1. DISPLAY_IDENTIFIER LV_TTIP_MES_VLD_LS_UP_1_ ECU_ADDRESS 0x7f967b BIT_MASK 0x1 /end MEASUREMENT
/begin MEASUREMENT egcp[0].egcp_struct_sigcvtipa0.lv_v_ofs_adj_vld_r_it_ls_up "Boolean flag indicating offset in resistance adjust mode valid" UBYTE _CNV_S_2_RANGE__0___85_CM 1 0. 0. 1. DISPLAY_IDENTIFIER LV_V_OFS_ADJ_VLD_R_IT_LS_UP_1_ ECU_ADDRESS 0x7f967c BIT_MASK 0x1 /end MEASUREMENT
/begin MEASUREMENT egcp[0].egcp_struct_sigcvtipa0.lv_v_ofs_mes_vld_r_it_ls_up "Boolean flag indicating offset in resistance measurement mode valid" UBYTE _CNV_S_2_RANGE__0___85_CM 1 0. 0. 1. DISPLAY_IDENTIFIER LV_V_OFS_MES_VLD_R_IT_LS_UP_1_ ECU_ADDRESS 0x7f967d BIT_MASK 0x1 /end MEASUREMENT
/begin MEASUREMENT egcp[0].egcp_struct_sigcvtipa0.lv_v_ref_vld_r_it_ls_up "Boolean flag indicating internal resistance determination circuit references valid" UBYTE _CNV_S_2_RANGE__0___85_CM 1 0. 0. 1. DISPLAY_IDENTIFIER LV_V_REF_VLD_R_IT_LS_UP_1_ ECU_ADDRESS 0x7f967e BIT_MASK 0x1 /end MEASUREMENT
/begin MEASUREMENT egcp[0].egcp_struct_sigcvtipa0.lv_r_it_req_ls_up "Boolean flag indicating that conditions have been met and resistance determination requested" UBYTE _CNV_S_2_RANGE__0___85_CM 1 0. 0. 1. DISPLAY_IDENTIFIER LV_R_IT_REQ_LS_UP_1_ ECU_ADDRESS 0x7f967f BIT_MASK 0x1 /end MEASUREMENT
/begin MEASUREMENT egcp[0].egcp_struct_sigcvtipai0.lv_inh_ttip_ls_up "Boolean flag indicating that upstream oxygen sensor ceramic temperature determination shall be inhibited " UBYTE _CNV_S_2_RANGE__0___85_CM 1 0. 0. 1. DISPLAY_IDENTIFIER LV_INH_TTIP_LS_UP_1_ ECU_ADDRESS 0x7f9680 BIT_MASK 0x1 /end MEASUREMENT
/begin MEASUREMENT egcp[0].egcp_struct_sigdglsd1.t_act_pls_diag_scg_ls_down "Delay time for final diagnosis activation " UWORD _CNV_A_R_LINEAR_____240_CM 1 0. 0. 6553.5 DISPLAY_IDENTIFIER T_ACT_PLS_DIAG_SCG_LS_DOWN_1_ ECU_ADDRESS 0x7f9682 BYTE_ORDER MSB_LAST FORMAT "%6.1" /end MEASUREMENT
/begin MEASUREMENT egcp[0].egcp_struct_sigdglsd1.t_act_pls_diag_oc_ls_down "Delay time for final diagnosis activation " UWORD _CNV_A_R_LINEAR_____240_CM 1 0. 0. 6553.5 DISPLAY_IDENTIFIER T_ACT_PLS_DIAG_OC_LS_DOWN_1_ ECU_ADDRESS 0x7f9684 BYTE_ORDER MSB_LAST FORMAT "%6.1" /end MEASUREMENT
/begin MEASUREMENT egcp[0].egcp_struct_sigdglsd1.t_cdn_diag_oc_ls_down "Detection time for status OC before diagnosis" UWORD _CNV_A_R_LINEAR_____240_CM 1 0. 0. 6553.5 DISPLAY_IDENTIFIER T_CDN_DIAG_OC_LS_DOWN_1_ ECU_ADDRESS 0x7f9686 BYTE_ORDER MSB_LAST FORMAT "%6.1" /end MEASUREMENT
/begin MEASUREMENT egcp[0].egcp_struct_sigdglsd1.ctr_r_upd_diag_scg_ls_down "Value of handshake counter for last valid resistance value used for short circuit to ground diagnosis" UWORD _CNV_A_R_LINEAR_____1_CM 1 0. 0. 65535. DISPLAY_IDENTIFIER CTR_R_UPD_DIAG_SCG_LS_DOWN_1_ ECU_ADDRESS 0x7f9688 BYTE_ORDER MSB_LAST FORMAT "%5.0" /end MEASUREMENT
/begin MEASUREMENT egcp[0].egcp_struct_sigdglsd1.ctr_r_upd_diag_oc_ls_down "Value of handshake counter for last valid resistance value used for diagnosis" UWORD _CNV_A_R_LINEAR_____1_CM 1 0. 0. 65535. DISPLAY_IDENTIFIER CTR_R_UPD_DIAG_OC_LS_DOWN_1_ ECU_ADDRESS 0x7f968a BYTE_ORDER MSB_LAST FORMAT "%5.0" /end MEASUREMENT
/begin MEASUREMENT egcp[0].egcp_struct_sigdglsd1.ctr_sym_diag_scg_ls_down "Detection time for SCG " UBYTE _CNV_A_R_LINEAR_____1_CM 1 0. 0. 255. DISPLAY_IDENTIFIER CTR_SYM_DIAG_SCG_LS_DOWN_1_ ECU_ADDRESS 0x7f968c FORMAT "%3.0" /end MEASUREMENT
/begin MEASUREMENT egcp[0].egcp_struct_sigdglsd1.lv_err_el_ls_down "Boolean error flag, electrical fault currently present on downstream oxygen sensor signal" UBYTE _CNV_S_2_RANGE__0___85_CM 1 0. 0. 1. DISPLAY_IDENTIFIER LV_ERR_EL_LS_DOWN_1_ ECU_ADDRESS 0x7f968d BIT_MASK 0x1 /end MEASUREMENT
/begin MEASUREMENT egcp[0].egcp_struct_sigdglsd1.lv_diag_act_req_ls_down "Request for starting the downstream sensor active plausibility check" UBYTE _CNV_S_2_RANGE__0___85_CM 1 0. 0. 1. DISPLAY_IDENTIFIER LV_DIAG_ACT_REQ_LS_DOWN_1_ ECU_ADDRESS 0x7f968e BIT_MASK 0x1 /end MEASUREMENT
/begin MEASUREMENT egcp[0].egcp_struct_sigdglsd1.lv_r_it_vld_diag_oc_ls_down "Valid conditions of resistance of downstream oxygen sensor open circuit diagnosis" UBYTE _CNV_S_2_RANGE__0___85_CM 1 0. 0. 1. DISPLAY_IDENTIFIER LV_R_IT_VLD_DIAG_OC_LS_DOWN_1_ ECU_ADDRESS 0x7f968f BIT_MASK 0x1 /end MEASUREMENT
/begin MEASUREMENT egcp[0].egcp_struct_sigdglsd1.lv_t_cdn_diag_oc_ls_down "Boolean error flag, short to plus fault currently present on downstream oxygen sensor signal" UBYTE _CNV_S_2_RANGE__0___85_CM 1 0. 0. 1. DISPLAY_IDENTIFIER LV_T_CDN_DIAG_OC_LS_DOWN_1_ ECU_ADDRESS 0x7f9690 BIT_MASK 0x1 /end MEASUREMENT
/begin MEASUREMENT egcp[0].egcp_struct_sigdglsla0.ctr_iplsl_sym_diag_lsl_up "Error debounce counter" UWORD _CNV_A_R_LINEAR_____1_CM 1 0. 0. 65535. DISPLAY_IDENTIFIER CTR_IPLSL_SYM_DIAG_LSL_UP_1_ ECU_ADDRESS 0x7f9698 BYTE_ORDER MSB_LAST FORMAT "%5.0" /end MEASUREMENT
/begin MEASUREMENT egcp[0].egcp_struct_sigdglsla0.t_diag_oc_lsl_up "Open Circuit Diagnosis Timer" UWORD _CNV_A_R_LINEAR_____240_CM 1 0. 0. 6553.5 DISPLAY_IDENTIFIER T_DIAG_OC_LSL_UP_1_ ECU_ADDRESS 0x7f969a BYTE_ORDER MSB_LAST FORMAT "%6.1" /end MEASUREMENT
/begin MEASUREMENT egcp[0].egcp_struct_sigdglsla0.t_vls_up_min_diag_oc_lsl_up "Timer for LSL signal under voltage" UWORD _CNV_A_R_LINEAR_____240_CM 1 0. 0. 6553.5 DISPLAY_IDENTIFIER T_VLS_UP_MIN_DIAG_OC_LSL_UP_1_ ECU_ADDRESS 0x7f969c BYTE_ORDER MSB_LAST FORMAT "%6.1" /end MEASUREMENT
/begin MEASUREMENT egcp[0].egcp_struct_sigdglsla0.iplsl_sym_diag_lsl_up "Symptoms of the WRAF sensor Pump Current Controller Diagnosis" UBYTE _CNV_S_3_EGCP_RANGE_512_CM 1 0. 0. 2. DISPLAY_IDENTIFIER IPLSL_SYM_DIAG_LSL_UP_1_ ECU_ADDRESS 0x7f969e /end MEASUREMENT
/begin MEASUREMENT egcp[0].egcp_struct_sigdglsla0.state_err_el_lsl_up "State to get visible the separate OBD-I failures" UBYTE _CNV_S_11_EGCP_RANGE_513_CM 1 0. 0. 10. DISPLAY_IDENTIFIER STATE_ERR_EL_LSL_UP_1_ ECU_ADDRESS 0x7f969f /end MEASUREMENT
/begin MEASUREMENT egcp[0].egcp_struct_sigdglsla0.state_diag_oc_lsl_up "Status of the LSL Open Circuit Diagnosis" UBYTE _CNV_S_3_EGCP_RANGE_514_CM 1 0. 0. 2. DISPLAY_IDENTIFIER STATE_DIAG_OC_LSL_UP_1_ ECU_ADDRESS 0x7f96a0 /end MEASUREMENT
/begin MEASUREMENT egcp[0].egcp_struct_sigdglsla0.lv_lsl_up_spi_com_inh "Inhibit bit for the SPI-communication" UBYTE _CNV_S_2_RANGE__0___85_CM 1 0. 0. 1. DISPLAY_IDENTIFIER LV_LSL_UP_SPI_COM_INH_1_ ECU_ADDRESS 0x7f96a1 BIT_MASK 0x1 /end MEASUREMENT
/begin MEASUREMENT egcp[0].egcp_struct_sigdglsla0.lv_diag_iplsl_sym_lsl_up "Pump Current Controller in Limitation for too long time" UBYTE _CNV_S_2_RANGE__0___85_CM 1 0. 0. 1. DISPLAY_IDENTIFIER LV_DIAG_IPLSL_SYM_LSL_UP_1_ ECU_ADDRESS 0x7f96a2 BIT_MASK 0x1 /end MEASUREMENT
/begin MEASUREMENT egcp[0].egcp_struct_sigdglsla0.lv_diag_iplsl_cdn_lsl_up "Conditions to run the WRAF sensor Pump Current Controller Diagnosis" UBYTE _CNV_S_2_RANGE__0___85_CM 1 0. 0. 1. DISPLAY_IDENTIFIER LV_DIAG_IPLSL_CDN_LSL_UP_1_ ECU_ADDRESS 0x7f96a3 BIT_MASK 0x1 /end MEASUREMENT
/begin MEASUREMENT egcp[0].egcp_struct_sigdglsla0.lv_diag_oc_if_osc_di_lsl_up "Request stop oscillator used to determine sensor internal resistance" UBYTE _CNV_S_2_RANGE__0___85_CM 1 0. 0. 1. DISPLAY_IDENTIFIER LV_DIAG_OC_IF_OSC_DI_LSL_UP_1_ ECU_ADDRESS 0x7f96a4 BIT_MASK 0x1 /end MEASUREMENT
/begin MEASUREMENT egcp[0].egcp_struct_sigdglsla0.lv_vls_up_min_diag_oc_lsl_up "Bit indicating LSL undervoltage " UBYTE _CNV_S_2_RANGE__0___85_CM 1 0. 0. 1. DISPLAY_IDENTIFIER LV_VLS_UP_MIN_DIAG_OC_LSL_UP_1_ ECU_ADDRESS 0x7f96a5 BIT_MASK 0x1 /end MEASUREMENT
/begin CHARACTERISTIC c_lshpwm_max_diag_lsh_up "Maximum O2-Sensor heater duty cycle to perform the electrical diagnosis" VALUE 0x840e3c _REC_VAL_20_u1 99.609375 _CNV_A_R_LINEAR_____486_CM 0. 99.609375 DISPLAY_IDENTIFIER C_LSHPWM_MAX_DIAG_LSH_UP FORMAT "%9.6" /end CHARACTERISTIC
/begin CHARACTERISTIC c_teg_dyn_min_diag_lsh_up "Minimum exhaust gas temperature threshold to permit SCP to set fault during LSH power rise state" VALUE 0x840f14 _REC_VAL_20_u2 2047. _CNV_A_R_EGCP_LINEA_468_CM 0. 2047. DISPLAY_IDENTIFIER C_TEG_DYN_MIN_DIAG_LSH_UP FORMAT "%9.4" /end CHARACTERISTIC
/begin CHARACTERISTIC c_lshpwm_min_diag_lsh_up "Minimum O2-Sensor heater duty cycle to perform the electrical diagnosis" VALUE 0x840e40 _REC_VAL_20_u1 99.609375 _CNV_A_R_LINEAR_____486_CM 0. 99.609375 DISPLAY_IDENTIFIER C_LSHPWM_MIN_DIAG_LSH_UP FORMAT "%9.6" /end CHARACTERISTIC
/begin MEASUREMENT lv_err_lsh_up_1 "Error flag for upstream heater diagnosis OBD I after debouncing " UBYTE _CNV_S_2_RANGE__0___85_CM 1 0. 0. 1. DISPLAY_IDENTIFIER LV_ERR_LSH_UP_1_ ECU_ADDRESS 0x7fb94b BIT_MASK 0x1 /end MEASUREMENT
/begin CHARACTERISTIC c_lshpwm_max_diag_lsh_down "Maximum O2-Sensor heater duty cycle to perform the electrical diagnosis" VALUE 0x840e3a _REC_VAL_20_u1 99.609375 _CNV_A_R_LINEAR_____486_CM 0. 99.609375 DISPLAY_IDENTIFIER C_LSHPWM_MAX_DIAG_LSH_DOWN FORMAT "%9.6" /end CHARACTERISTIC
/begin CHARACTERISTIC c_lshpwm_min_diag_lsh_down "Minimum O2-Sensor heater duty cycle to perform the electrical diagnosis" VALUE 0x840e3e _REC_VAL_20_u1 99.609375 _CNV_A_R_LINEAR_____486_CM 0. 99.609375 DISPLAY_IDENTIFIER C_LSHPWM_MIN_DIAG_LSH_DOWN FORMAT "%9.6" /end CHARACTERISTIC
/begin CHARACTERISTIC c_teg_cat_mdl_down_min_lsh_down "Minimum exhaust gas temperature threshold to permit SCP to set fault during LSH power rise state" VALUE 0x840f0c _REC_VAL_20_u2 2047. _CNV_A_R_EGCP_LINEA_468_CM 0. 2047. DISPLAY_IDENTIFIER C_TEG_CAT_MDL_DOWN_MIN_LSH_DOWN FORMAT "%9.4" /end CHARACTERISTIC
/begin MEASUREMENT lv_err_lsh_down_1 "Error flag for downstream heater diagnosis OBD I after debouncing " UBYTE _CNV_S_2_RANGE__0___85_CM 1 0. 0. 1. DISPLAY_IDENTIFIER LV_ERR_LSH_DOWN_1_ ECU_ADDRESS 0x7fb94c BIT_MASK 0x1 /end MEASUREMENT
/begin MEASUREMENT lv_err_puc_ls_down_1 "Boolean error flag, PUC plausibility fault currently present on downstream oxygen sensor signal" UBYTE _CNV_S_2_RANGE__0___85_CM 1 0. 0. 1. DISPLAY_IDENTIFIER LV_ERR_PUC_LS_DOWN_1_ ECU_ADDRESS 0x7fb953 BIT_MASK 0x1 /end MEASUREMENT
/begin MEASUREMENT lv_err_fl_ls_down_1 "Boolean error flag, FL plausibility fault currently present on downstream oxygen sensor signal" UBYTE _CNV_S_2_RANGE__0___85_CM 1 0. 0. 1. DISPLAY_IDENTIFIER LV_ERR_FL_LS_DOWN_1_ ECU_ADDRESS 0x7fb954 BIT_MASK 0x1 /end MEASUREMENT
/begin CHARACTERISTIC c_maf_int_max_diag_puc_ls_down "Maximum threshold for MAF integral to end downstream PUC signal plausibility" VALUE 0x840e54 _REC_VAL_20_u2 1820.42 _CNV_A_R_LINEAR_____482_CM 0. 1820.42 DISPLAY_IDENTIFIER C_MAF_INT_MAX_DIAG_PUC_LS_DOWN FORMAT "%7.2" /end CHARACTERISTIC
/begin CHARACTERISTIC c_maf_int_max_diag_fl_ls_down "Maximum threshold for MAF integral to end downstream FL signal plausibility" VALUE 0x840e52 _REC_VAL_20_u2 1820.42 _CNV_A_R_LINEAR_____482_CM 0. 1820.42 DISPLAY_IDENTIFIER C_MAF_INT_MAX_DIAG_FL_LS_DOWN FORMAT "%7.2" /end CHARACTERISTIC
/begin CHARACTERISTIC c_maf_int_min_diag_puc_ls_down "Minimum threshold for MAF integral required to start downstream PUC signal plausibility" VALUE 0x840e58 _REC_VAL_20_u2 1820.42 _CNV_A_R_LINEAR_____482_CM 0. 1820.42 DISPLAY_IDENTIFIER C_MAF_INT_MIN_DIAG_PUC_LS_DOWN FORMAT "%7.2" /end CHARACTERISTIC
/begin CHARACTERISTIC c_maf_int_min_diag_fl_ls_down "Minimum threshold for MAF integral required to start downstream FL signal plausibility" VALUE 0x840e56 _REC_VAL_20_u2 1820.42 _CNV_A_R_LINEAR_____482_CM 0. 1820.42 DISPLAY_IDENTIFIER C_MAF_INT_MIN_DIAG_FL_LS_DOWN FORMAT "%7.2" /end CHARACTERISTIC
/begin CHARACTERISTIC c_vls_min_diag_puc_ls_down "VLS voltage threshold for PUC fault detection" VALUE 0x840f86 _REC_VAL_20_u2 4.9951171875 _CNV_A_R_LINEAR_____265_CM 0. 4.9951171875 DISPLAY_IDENTIFIER C_VLS_MIN_DIAG_PUC_LS_DOWN FORMAT "%5.3" /end CHARACTERISTIC
/begin MEASUREMENT maf_int_fl "integral of air mass flow  while FL active" UWORD _CNV_A_R_LINEAR_____482_CM 1 0. 0. 1820.42 DISPLAY_IDENTIFIER MAF_INT_FL ECU_ADDRESS 0x7f979c BYTE_ORDER MSB_LAST FORMAT "%7.2" /end MEASUREMENT
/begin CHARACTERISTIC c_vls_max_diag_fl_ls_down "VLS voltage threshold for FL fault detection" VALUE 0x840f84 _REC_VAL_20_u2 4.9951171875 _CNV_A_R_LINEAR_____265_CM 0. 4.9951171875 DISPLAY_IDENTIFIER C_VLS_MAX_DIAG_FL_LS_DOWN FORMAT "%5.3" /end CHARACTERISTIC
/begin MEASUREMENT lv_err_lsl_up_if_1 "Present error in the CJ120 WRAF sensor controller" UBYTE _CNV_S_2_RANGE__0___85_CM 1 0. 0. 1. DISPLAY_IDENTIFIER LV_ERR_LSL_UP_IF_1_ ECU_ADDRESS 0x7fb957 BIT_MASK 0x1 /end MEASUREMENT
/begin CHARACTERISTIC c_ctr_max_spi_com_lsl_up[0] "Max. allowed number of SPI comunication errors" VALUE 0x840da6 _REC_VAL_20_u1 255. _CNV_A_R_LINEAR_____1_CM 0. 255. DISPLAY_IDENTIFIER C_CTR_MAX_SPI_COM_LSL_UP_1_ FORMAT "%3.0" /end CHARACTERISTIC
/begin CHARACTERISTIC c_t_rst_max_diag_lsl_up_if[0] "Max. waiting time for the initialization of the WRAF sensor controller" VALUE 0x840ee2 _REC_VAL_20_u2 655.35 _CNV_A_R_LINEAR_____226_CM 0. 655.35 DISPLAY_IDENTIFIER C_T_RST_MAX_DIAG_LSL_UP_IF_1_ FORMAT "%6.2" /end CHARACTERISTIC
/begin CHARACTERISTIC c_t_end_diag_lsl_up_if[0] "Time to diagnostic availability" VALUE 0x840ec0 _REC_VAL_20_u2 655.35 _CNV_A_R_LINEAR_____226_CM 0. 655.35 DISPLAY_IDENTIFIER C_T_END_DIAG_LSL_UP_IF_1_ FORMAT "%6.2" /end CHARACTERISTIC
/begin CHARACTERISTIC c_state_lsl_if_spi_wr_ini "Initialisation data of SPI register INIT_REG_1" VALUE 0x840e8b _REC_VAL_20_u1 255. _CNV_A_R_LINEAR_____1_CM 0. 255. DISPLAY_IDENTIFIER C_STATE_LSL_IF_SPI_WR_INI FORMAT "%3.0" /end CHARACTERISTIC
/begin CHARACTERISTIC c_state_lsl_if_conf_spi_wr_ini "Initialisation data of SPI register INIT_REG_2" VALUE 0x840e8a _REC_VAL_20_u1 255. _CNV_A_R_LINEAR_____1_CM 0. 255. DISPLAY_IDENTIFIER C_STATE_LSL_IF_CONF_SPI_WR_INI FORMAT "%3.0" /end CHARACTERISTIC
/begin CHARACTERISTIC c_t_dly_di_lsl_if "Configuration of sensor protection time" VALUE 0x840ea0 _REC_VAL_20_u1 7. _CNV_A_R_LINEAR_____0_CM 0. 7. DISPLAY_IDENTIFIER C_T_DLY_DI_LSL_IF FORMAT "%1.0" /end CHARACTERISTIC
/begin MEASUREMENT lv_vls_down_mmv_act "Boolean flag indicating calibrateable delay since PUC deactivation passed" UBYTE _CNV_S_2_RANGE__0___85_CM 1 0. 0. 1. DISPLAY_IDENTIFIER LV_VLS_DOWN_MMV_ACT ECU_ADDRESS 0x7fb698 BIT_MASK 0x1 /end MEASUREMENT
/begin CHARACTERISTIC c_t_dly_puc_end_vls_down "Delay between completion of engine state PUC and computation of VLS_DOWN_MMV_xxx[i]" VALUE 0x840eb4 _REC_VAL_20_u2 655.35 _CNV_A_R_LINEAR_____226_CM 0. 655.35 DISPLAY_IDENTIFIER C_T_DLY_PUC_END_VLS_DOWN FORMAT "%6.2" /end CHARACTERISTIC
/begin CHARACTERISTIC c_fac_vls_down_mmv_hys "Multiplicative factor governing amplitude of hysteresis" VALUE 0x840de2 _REC_VAL_20_u1 0.99609375 _CNV_A_R_LINEAR_____254_CM 0. 0.99609375 DISPLAY_IDENTIFIER C_FAC_VLS_DOWN_MMV_HYS FORMAT "%5.3" /end CHARACTERISTIC
/begin CHARACTERISTIC c_vls_down_mmv_hys_min "Minimum hysteresis for the computation of the thresholds VLS_DOWN_TOL[i] and VLS_DOWN_BOL[i]" VALUE 0x840f7c _REC_VAL_20_u2 0.999924 _CNV_A_R_EGCP_LINEA_505_CM 0. 0.999924 DISPLAY_IDENTIFIER C_VLS_DOWN_MMV_HYS_MIN FORMAT "%7.5" /end CHARACTERISTIC
/begin CHARACTERISTIC c_vls_down_ini_min "Lower initialisation value for VLS_DOWN_TOL[i]. VLS_DOWN_MMV_MIN[i]" VALUE 0x840f6c _REC_VAL_20_u2 4.9951171875 _CNV_A_R_LINEAR_____265_CM 0. 4.9951171875 DISPLAY_IDENTIFIER C_VLS_DOWN_INI_MIN FORMAT "%5.3" /end CHARACTERISTIC
/begin CHARACTERISTIC c_vls_down_ini_max "Upper initialisation value for VLS_DOWN_BOL[i]. VLS_DOWN_MMV_MAX[i]" VALUE 0x840f6a _REC_VAL_20_u2 4.9951171875 _CNV_A_R_LINEAR_____265_CM 0. 4.9951171875 DISPLAY_IDENTIFIER C_VLS_DOWN_INI_MAX FORMAT "%5.3" /end CHARACTERISTIC
/begin CHARACTERISTIC c_crlc_vls_down "Filter constant for determination of VLS_DOWN_MMV_xxx[i] values when respective threshold passed" VALUE 0x840d8e _REC_VAL_20_u2 0.9999847412109381 _CNV_A_R_LINEAR_____137_CM 0. 0.9999847412109381 DISPLAY_IDENTIFIER C_CRLC_VLS_DOWN FORMAT "%7.5" /end CHARACTERISTIC
/begin CHARACTERISTIC c_crlc_vls_down_off "Filter constant for determination of VLS_DOWN_MMV_xxx[i] values when respective threshold not passed" VALUE 0x840d90 _REC_VAL_20_u2 0.9999847412109381 _CNV_A_R_LINEAR_____137_CM 0. 0.9999847412109381 DISPLAY_IDENTIFIER C_CRLC_VLS_DOWN_OFF FORMAT "%7.5" /end CHARACTERISTIC
/begin MEASUREMENT vls_up_cyl_sel[0] "upstream oxygen sensor acquisition (cylinder individual)" UWORD _CNV_A_R_LINEAR_____265_CM 1 0. 0. 4.9951171875 DISPLAY_IDENTIFIER VLS_UP_CYL_SEL_0_ ECU_ADDRESS 0x7f97a2 BYTE_ORDER MSB_LAST FORMAT "%5.3" /end MEASUREMENT
/begin MEASUREMENT vls_up_cyl_sel[1] "upstream oxygen sensor acquisition (cylinder individual)" UWORD _CNV_A_R_LINEAR_____265_CM 1 0. 0. 4.9951171875 DISPLAY_IDENTIFIER VLS_UP_CYL_SEL_1_ ECU_ADDRESS 0x7f97a4 BYTE_ORDER MSB_LAST FORMAT "%5.3" /end MEASUREMENT
/begin MEASUREMENT vls_up_cyl_sel[2] "upstream oxygen sensor acquisition (cylinder individual)" UWORD _CNV_A_R_LINEAR_____265_CM 1 0. 0. 4.9951171875 DISPLAY_IDENTIFIER VLS_UP_CYL_SEL_2_ ECU_ADDRESS 0x7f97a6 BYTE_ORDER MSB_LAST FORMAT "%5.3" /end MEASUREMENT
/begin MEASUREMENT vls_up_cyl_sel[3] "upstream oxygen sensor acquisition (cylinder individual)" UWORD _CNV_A_R_LINEAR_____265_CM 1 0. 0. 4.9951171875 DISPLAY_IDENTIFIER VLS_UP_CYL_SEL_3_ ECU_ADDRESS 0x7f97a8 BYTE_ORDER MSB_LAST FORMAT "%5.3" /end MEASUREMENT
/begin MEASUREMENT ctr_vls_up_cyl_sel_trig[0] "cylinder selective update counter for trigger event " UBYTE _CNV_A_R_LINEAR_____1_CM 1 0. 0. 255. DISPLAY_IDENTIFIER CTR_VLS_UP_CYL_SEL_TRIG_0_ ECU_ADDRESS 0x7fb68e FORMAT "%3.0" /end MEASUREMENT
/begin MEASUREMENT ctr_vls_up_cyl_sel_trig[1] "cylinder selective update counter for trigger event " UBYTE _CNV_A_R_LINEAR_____1_CM 1 0. 0. 255. DISPLAY_IDENTIFIER CTR_VLS_UP_CYL_SEL_TRIG_1_ ECU_ADDRESS 0x7fb68f FORMAT "%3.0" /end MEASUREMENT
/begin MEASUREMENT ctr_vls_up_cyl_sel_trig[2] "cylinder selective update counter for trigger event " UBYTE _CNV_A_R_LINEAR_____1_CM 1 0. 0. 255. DISPLAY_IDENTIFIER CTR_VLS_UP_CYL_SEL_TRIG_2_ ECU_ADDRESS 0x7fb690 FORMAT "%3.0" /end MEASUREMENT
/begin MEASUREMENT ctr_vls_up_cyl_sel_trig[3] "cylinder selective update counter for trigger event " UBYTE _CNV_A_R_LINEAR_____1_CM 1 0. 0. 255. DISPLAY_IDENTIFIER CTR_VLS_UP_CYL_SEL_TRIG_3_ ECU_ADDRESS 0x7fb691 FORMAT "%3.0" /end MEASUREMENT
/begin CHARACTERISTIC c_temp_cur_pump_on_ls_down "Temperature threshold for the activation of sensor pumping" VALUE 0x840f1e _REC_VAL_20_u2 1023.984375 _CNV_A_R_LINEAR_____530_CM -33. 990.984375 DISPLAY_IDENTIFIER C_TEMP_CUR_PUMP_ON_LS_DOWN FORMAT "%10.6" /end CHARACTERISTIC
/begin CHARACTERISTIC c_t_cur_pump_on_ls_down "Duration for pump current active" VALUE 0x840e96 _REC_VAL_20_u1 8.e-003 _CNV_A_R_EGCP_LINEA_529_CM 0. 8.e-003 DISPLAY_IDENTIFIER C_T_CUR_PUMP_ON_LS_DOWN FORMAT "%5.3" /end CHARACTERISTIC
/begin CHARACTERISTIC c_t_cur_pump_off_ls_down "Minimum delay between consecutive pump current activation" VALUE 0x840e94 _REC_VAL_20_u2 655.35 _CNV_A_R_LINEAR_____226_CM 0. 655.35 DISPLAY_IDENTIFIER C_T_CUR_PUMP_OFF_LS_DOWN FORMAT "%6.2" /end CHARACTERISTIC
/begin CHARACTERISTIC c_t_dly_cur_pump_ls_down "Duration in which VLS_DOWN[NC_CBK_EX_NR] signal masked directly after Ri determination" VALUE 0x840e9f _REC_VAL_20_u1 0.255 _CNV_A_R_EGCP_LINEA_529_CM 0. 0.255 DISPLAY_IDENTIFIER C_T_DLY_CUR_PUMP_LS_DOWN FORMAT "%5.3" /end CHARACTERISTIC
/begin CHARACTERISTIC c_vls_down_mmv_min_rng_bol_r_it "Permitted range of VLS_DOWN[NC_CBK_EX_NR] below VLS_DOWN_MMV_MIN[NC_CBK_EX_NR] at low gradient for Ri determination" VALUE 0x840f7e _REC_VAL_20_u2 4.99992370605469 _CNV_A_R_EGCP_LINEA_504_CM 0. 4.99992370605469 DISPLAY_IDENTIFIER C_VLS_DOWN_MMV_MIN_RNG_BOL_R_IT FORMAT "%7.5" /end CHARACTERISTIC
/begin CHARACTERISTIC c_vls_down_mmv_min_rng_tol_r_it "Permitted range of VLS_DOWN[NC_CBK_EX_NR] above VLS_DOWN_MMV_MIN[NC_CBK_EX_NR] at low gradient for Ri determination" VALUE 0x840f80 _REC_VAL_20_u2 4.99992370605469 _CNV_A_R_EGCP_LINEA_504_CM 0. 4.99992370605469 DISPLAY_IDENTIFIER C_VLS_DOWN_MMV_MIN_RNG_TOL_R_IT FORMAT "%7.5" /end CHARACTERISTIC
/begin CHARACTERISTIC c_vls_down_mmv_drv1_thd_min "Minimum threshold for mean 1st derivative of VLS_DOWN[NC_CBK_EX_NR] signal for Ri determination" VALUE 0x840f7a _REC_VAL_20_s2 4.999924 _CNV_A_R_EGCP_LINEA_502_CM -2.5 2.499924 DISPLAY_IDENTIFIER C_VLS_DOWN_MMV_DRV1_THD_MIN FORMAT "%8.5" /end CHARACTERISTIC
/begin CHARACTERISTIC c_vls_down_mmv_drv1_thd_max "Maximum threshold for mean 1st derivative of VLS_DOWN[NC_CBK_EX_NR] signal for Ri determination" VALUE 0x840f78 _REC_VAL_20_s2 4.999924 _CNV_A_R_EGCP_LINEA_502_CM -2.5 2.499924 DISPLAY_IDENTIFIER C_VLS_DOWN_MMV_DRV1_THD_MAX FORMAT "%8.5" /end CHARACTERISTIC
/begin CHARACTERISTIC c_fac_vls_down_mmv_drv1_thd "Multiplicative factor used to weight gradient thresholds dependent on VLS_DOWN_MMV_xxx[NC_CBK_EX_NR] amplitude" VALUE 0x840de0 _REC_VAL_20_u1 1.9921875 _CNV_A_R_LINEAR_____246_CM 0. 1.9921875 DISPLAY_IDENTIFIER C_FAC_VLS_DOWN_MMV_DRV1_THD FORMAT "%8.6" /end CHARACTERISTIC
/begin CHARACTERISTIC c_ctr_afl_cyc_min_ri_it_ls_down "Min. no. AF cycles post lambda controller activation to permit use of T_VLS_CYC_AFL_HLD dependency" VALUE 0x840d94 _REC_VAL_20_u2 65535. _CNV_A_R_LINEAR_____1_CM 0. 65535. DISPLAY_IDENTIFIER C_CTR_AFL_CYC_MIN_RI_IT_LS_DOWN FORMAT "%5.0" /end CHARACTERISTIC
/begin CHARACTERISTIC c_maf_kgh_max_r_it_ls_down "Maximum MAF_KGH threshold for activation of internal resistance determination" VALUE 0x840e68 _REC_VAL_20_u2 2047.96875 _CNV_A_R_LINEAR_____479_CM 0. 2047.96875 DISPLAY_IDENTIFIER C_MAF_KGH_MAX_R_IT_LS_DOWN FORMAT "%10.5" /end CHARACTERISTIC
/begin CHARACTERISTIC c_fac_vls_down_mmv_drv1_thd_min "Hysteresis factor of DRV1_VLS_DOWN_MMV_MIN governing limiting of DRV1_VLS_DOWN_MMV_MIN_THD" VALUE 0x840de1 _REC_VAL_20_u1 0.99609375 _CNV_A_R_LINEAR_____254_CM 0. 0.99609375 DISPLAY_IDENTIFIER C_FAC_VLS_DOWN_MMV_DRV1_THD_MIN FORMAT "%5.3" /end CHARACTERISTIC
/begin CHARACTERISTIC c_fac_r_it_err_neg_ls_down "Internal resistance measurement negative error (i.e. 100% to 0%)" VALUE 0x840ddc _REC_VAL_20_u1 0.99609375 _CNV_A_R_LINEAR_____254_CM 0. 0.99609375 DISPLAY_IDENTIFIER C_FAC_R_IT_ERR_NEG_LS_DOWN FORMAT "%5.3" /end CHARACTERISTIC
/begin CHARACTERISTIC c_fac_r_it_err_pos_ls_down "Internal resistance measurement positive error (i.e. 0% to 100%)" VALUE 0x840ddd _REC_VAL_20_u1 0.99609375 _CNV_A_R_LINEAR_____254_CM 0. 0.99609375 DISPLAY_IDENTIFIER C_FAC_R_IT_ERR_POS_LS_DOWN FORMAT "%5.3" /end CHARACTERISTIC
/begin CHARACTERISTIC c_crlc_pow_mmv_lsh_down "Correlation (filter) constant for moving mean value of downstream heater power" VALUE 0x840d8b _REC_VAL_20_u1 0.99609375 _CNV_A_R_LINEAR_____254_CM 0. 0.99609375 DISPLAY_IDENTIFIER C_CRLC_POW_MMV_LSH_DOWN FORMAT "%5.3" /end CHARACTERISTIC
/begin CHARACTERISTIC c_crlc_ttip_fall_r_it_ls_down "Correlation (filter) constant for falling ceramic temperature, limit calculation" VALUE 0x840d8c _REC_VAL_20_u1 0.99609375 _CNV_A_R_LINEAR_____531_CM 0. 0.99609375 DISPLAY_IDENTIFIER C_CRLC_TTIP_FALL_R_IT_LS_DOWN FORMAT "%5.3" /end CHARACTERISTIC
/begin CHARACTERISTIC c_crlc_ttip_rise_r_it_ls_down "Correlation (filter) constant for rising ceramic temperature, limit calculation" VALUE 0x840d8d _REC_VAL_20_u1 0.99609375 _CNV_A_R_LINEAR_____531_CM 0. 0.99609375 DISPLAY_IDENTIFIER C_CRLC_TTIP_RISE_R_IT_LS_DOWN FORMAT "%5.3" /end CHARACTERISTIC
/begin CHARACTERISTIC lc_r_it_vld_inh_ls_down "Boolean flag inhibiting internal resistance determination validity function" VALUE 0x840fb5 _REC_VAL_20_u1 1. _CNV_A_R_LINEAR_____1_CM 0. 1. DISPLAY_IDENTIFIER LC_R_IT_VLD_INH_LS_DOWN FORMAT "%1.0" /end CHARACTERISTIC
/begin CHARACTERISTIC ip_crlc_ttip_ref_mdl_ls_down "Correlation map for calculation of reference downstream tip temperature (modelled for new sensor)" CURVE 0x840a90 _REC_CUR_20_u1_u2 0.99609375 _CNV_A_R_LINEAR_____254_CM 0. 0.99609375 DISPLAY_IDENTIFIER IP_CRLC_TTIP_REF_MDL_LS_DOWN FORMAT "%5.3"
 /begin AXIS_DESCR COM_AXIS maf_kgh _CNV_A_R_LINEAR_____479_CM 8 0. 2047.96875 FORMAT "%10.5" AXIS_PTS_REF ldpm_maf_kgh_1_egcp /end AXIS_DESCR
/end CHARACTERISTIC
/begin AXIS_PTS ldp_ttip_ref_mdl_mmv_ls_down_r "" 0x84095e online_dummy _REC_AXS_20_u2 2047.9375 _CNV_A_R_EGCP_LINEA_468_CM 8 0. 2047.9375 FORMAT "%7.2" /end AXIS_PTS
/begin CHARACTERISTIC ip_fac_t_drv1_vls_down_mmv "Multiplicative factor modifies DRV1_VLS_DOWN_MMV_MIN_THD dependent on T_VLS_CYC_AFL_HLD" CURVE 0x840bae _REC_CUR_20_u1_u1 63.75 _CNV_A_R_EGCP_LINEA_508_CM 0. 63.75 DISPLAY_IDENTIFIER IP_FAC_T_DRV1_VLS_DOWN_MMV FORMAT "%5.2"
 /begin AXIS_DESCR COM_AXIS online_dummy _CNV_A_R_LINEAR_____226_CM 8 0. 2.55 FORMAT "%4.2" AXIS_PTS_REF ldpm_t_afl_cyc_hld_1_egcp /end AXIS_DESCR
/end CHARACTERISTIC
/begin CHARACTERISTIC ip_fac_t_vls_down_mmv_drv1_abs "Multiplicative factor modifies C_VLS_DOWN_MMV_DRV1_ABS_MAX dependent on T_VLS_CYC_AFL_HLD" CURVE 0x840bb6 _REC_CUR_20_u1_u1 15.9375 _CNV_A_R_LINEAR_____251_CM 0. 15.9375 DISPLAY_IDENTIFIER IP_FAC_T_VLS_DOWN_MMV_DRV1_ABS FORMAT "%7.4"
 /begin AXIS_DESCR COM_AXIS online_dummy _CNV_A_R_LINEAR_____226_CM 8 0. 2.55 FORMAT "%4.2" AXIS_PTS_REF ldpm_t_afl_cyc_hld_1_egcp /end AXIS_DESCR
/end CHARACTERISTIC
/begin CHARACTERISTIC ip_r_it_mdl_ls_down_new "Internal resistance of a new downstream oxygen sensor (modelled)" MAP 0x85cf64 _REC_MAP_20_u2_u2_u2 65535. _CNV_A_R_LINEAR_____487_CM 0. 65535. DISPLAY_IDENTIFIER IP_R_IT_MDL_LS_DOWN_NEW FORMAT "%5.0"
 /begin AXIS_DESCR COM_AXIS online_dummy _CNV_A_R_EGCP_LINEA_507_CM 8 0. 84.498711 AXIS_PTS_REF ldp_pow_mmv_lsh_down_ip_ls_down /end AXIS_DESCR
 /begin AXIS_DESCR COM_AXIS online_dummy _CNV_A_R_EGCP_LINEA_468_CM 8 0. 2047.9375 FORMAT "%7.2" AXIS_PTS_REF ldp_ttip_ref_mdl_mmv_ls_down_r /end AXIS_DESCR
/end CHARACTERISTIC
/begin CHARACTERISTIC ip_ttip_mes_ls_down "Oxygen sensor temperature vs. internal resistance characteristic" CURVE 0x840cf4 _REC_CUR_20_u2_u2 2047.9375 _CNV_A_R_EGCP_LINEA_468_CM 0. 2047.9375 DISPLAY_IDENTIFIER IP_TTIP_MES_LS_DOWN FORMAT "%7.2"
 /begin AXIS_DESCR COM_AXIS online_dummy _CNV_A_R_LINEAR_____487_CM 8 0. 65535. FORMAT "%5.0" AXIS_PTS_REF ldp_r_it_mes_ls_down_ip_ls_down /end AXIS_DESCR
/end CHARACTERISTIC
/begin AXIS_PTS ldp_pow_mmv_lsh_down_ip_ls_down "" 0x8408a4 online_dummy _REC_AXS_20_u2 84.498711 _CNV_A_R_EGCP_LINEA_507_CM 8 0. 84.498711 /end AXIS_PTS
/begin AXIS_PTS ldp_r_it_mes_ls_down_ip_ls_down "" 0x8408f6 online_dummy _REC_AXS_20_u2 65535. _CNV_A_R_LINEAR_____487_CM 8 0. 65535. FORMAT "%5.0" /end AXIS_PTS
/begin CHARACTERISTIC c_vls_down_mmv_drv1_abs_max "Threshold for absolute maximum 1st derivative of VLS_DOWN[NC_CBK_EX_NR] signal for Ri determination" VALUE 0x840f76 _REC_VAL_20_u2 4.99992370605469 _CNV_A_R_EGCP_LINEA_504_CM 0. 4.99992370605469 DISPLAY_IDENTIFIER C_VLS_DOWN_MMV_DRV1_ABS_MAX FORMAT "%7.5" /end CHARACTERISTIC
/begin AXIS_PTS ldp_r_it_ls_up_ip_ttip_ls_up "" 0x8408e4 online_dummy _REC_AXS_20_u2 16383.75 _CNV_A_R_EGCP_LINEA_466_CM 8 0. 16383.75 FORMAT "%9.2" /end AXIS_PTS
/begin CHARACTERISTIC ip_ttip_mes_ls_up "Oxygen sensor temperature vs. internal resistance characteristic" CURVE 0x840d04 _REC_CUR_20_u2_u2 2047.9375 _CNV_A_R_EGCP_LINEA_468_CM 0. 2047.9375 DISPLAY_IDENTIFIER IP_TTIP_MES_LS_UP FORMAT "%7.2"
 /begin AXIS_DESCR COM_AXIS online_dummy _CNV_A_R_EGCP_LINEA_466_CM 8 0. 16383.75 FORMAT "%9.2" AXIS_PTS_REF ldp_r_it_ls_up_ip_ttip_ls_up /end AXIS_DESCR
/end CHARACTERISTIC
/begin CHARACTERISTIC c_t_dly_ofs_adj_r_it_ls_up "Delay required from switching from internal resistance measurement offset to adjust offset mode" VALUE 0x840eb1 _REC_VAL_20_u1 2.55 _CNV_A_R_LINEAR_____226_CM 0. 2.55 DISPLAY_IDENTIFIER C_T_DLY_OFS_ADJ_R_IT_LS_UP FORMAT "%4.2" /end CHARACTERISTIC
/begin CHARACTERISTIC c_t_dly_fac_gain_r_it_ls_up "Delay required from switching from internal resistance adjust offset to adjust gain mode" VALUE 0x840ea8 _REC_VAL_20_u1 2.55 _CNV_A_R_LINEAR_____226_CM 0. 2.55 DISPLAY_IDENTIFIER C_T_DLY_FAC_GAIN_R_IT_LS_UP FORMAT "%4.2" /end CHARACTERISTIC
/begin CHARACTERISTIC c_t_dly_clc_r_it_ls_up "Delay required from switching from internal resistance adjust gain to measurement mode" VALUE 0x840e9e _REC_VAL_20_u1 2.55 _CNV_A_R_LINEAR_____226_CM 0. 2.55 DISPLAY_IDENTIFIER C_T_DLY_CLC_R_IT_LS_UP FORMAT "%4.2" /end CHARACTERISTIC
/begin CHARACTERISTIC c_t_dly_ofs_mes_r_it_ls_up "Delay required from switching oscillator off or internal resistance measurement to measurement offset mode" VALUE 0x840eb2 _REC_VAL_20_u1 2.55 _CNV_A_R_LINEAR_____226_CM 0. 2.55 DISPLAY_IDENTIFIER C_T_DLY_OFS_MES_R_IT_LS_UP FORMAT "%4.2" /end CHARACTERISTIC
/begin CHARACTERISTIC c_t_max_v_ofs_adj_r_it_ls_up "Maximum permitted time for offset measurement in adjust mode" VALUE 0x840ed8 _REC_VAL_20_u2 655.35 _CNV_A_R_LINEAR_____226_CM 0. 655.35 DISPLAY_IDENTIFIER C_T_MAX_V_OFS_ADJ_R_IT_LS_UP FORMAT "%6.2" /end CHARACTERISTIC
/begin CHARACTERISTIC c_t_max_fac_gain_r_it_ls_up "Maximum permitted time for gain adjust measurement" VALUE 0x840ecc _REC_VAL_20_u2 655.35 _CNV_A_R_LINEAR_____226_CM 0. 655.35 DISPLAY_IDENTIFIER C_T_MAX_FAC_GAIN_R_IT_LS_UP FORMAT "%6.2" /end CHARACTERISTIC
/begin CHARACTERISTIC c_t_max_v_ofs_mes_r_it_ls_up "Maximum permitted time for offset measurement in measurement mode" VALUE 0x840eda _REC_VAL_20_u2 655.35 _CNV_A_R_LINEAR_____226_CM 0. 655.35 DISPLAY_IDENTIFIER C_T_MAX_V_OFS_MES_R_IT_LS_UP FORMAT "%6.2" /end CHARACTERISTIC
/begin CHARACTERISTIC c_v_dif_max_ofs_adj_r_it_ls_up "Maximum permitted deviation of V_OFS_ADJ_R_IT_LS_UP[NC_CBK_EX_NR] to nominal reference value" VALUE 0x840f34 _REC_VAL_20_u2 4.995 _CNV_A_R_EGCP_LINEA_509_CM 0. 4.995 DISPLAY_IDENTIFIER C_V_DIF_MAX_OFS_ADJ_R_IT_LS_UP FORMAT "%5.3" /end CHARACTERISTIC
/begin CHARACTERISTIC c_v_dif_max_ofs_mes_r_it_ls_up "Maximum permitted deviation of V_OFS_MES_R_IT_LS_UP[NC_CBK_EX_NR] to nominal reference value" VALUE 0x840f36 _REC_VAL_20_u2 4.995 _CNV_A_R_EGCP_LINEA_509_CM 0. 4.995 DISPLAY_IDENTIFIER C_V_DIF_MAX_OFS_MES_R_IT_LS_UP FORMAT "%5.3" /end CHARACTERISTIC
/begin CHARACTERISTIC lc_r_rng_req_ls_up_lsl_if "Boolean flag selecting internal resistance determination circuit gain when manual switching enabled" VALUE 0x840fb6 _REC_VAL_20_u1 1. _CNV_A_R_LINEAR_____1_CM 0. 1. DISPLAY_IDENTIFIER LC_R_RNG_REQ_LS_UP_LSL_IF FORMAT "%1.0" /end CHARACTERISTIC
/begin CHARACTERISTIC lc_r_rng_req_swi_ls_up_lsl_if "Boolean flag enabling manual switching of internal resistance determination circuit gain" VALUE 0x840fb7 _REC_VAL_20_u1 1. _CNV_A_R_LINEAR_____1_CM 0. 1. DISPLAY_IDENTIFIER LC_R_RNG_REQ_SWI_LS_UP_LSL_IF FORMAT "%1.0" /end CHARACTERISTIC
/begin CHARACTERISTIC c_fac_gain_r_it_ls_up "Factor used when determining high gain = (C_R_IT_REF_LS_UP+R5+R6)/(5V*(R5+R6)" VALUE 0x840dca _REC_VAL_20_u2 76.7988 _CNV_A_R_EGCP_LINEA_532_CM 0. 76.7988 DISPLAY_IDENTIFIER C_FAC_GAIN_R_IT_LS_UP /end CHARACTERISTIC
/begin CHARACTERISTIC c_r_it_ref_ls_up "Reference current pulse resistor for internal resistance determination circuit = (R2*R1)/(R2+R1)" VALUE 0x840e88 _REC_VAL_20_u2 65535. _CNV_A_R_LINEAR_____487_CM 0. 65535. DISPLAY_IDENTIFIER C_R_IT_REF_LS_UP FORMAT "%5.0" /end CHARACTERISTIC
/begin CHARACTERISTIC c_fac_gain_h_dif_r_it_ls_up "Maximum permitted deviation of measured FAC_GAIN_H_R_IT_LS_UP[NC_CBK_EX_NR] from nominal reference value" VALUE 0x840dc2 _REC_VAL_20_u2 23.999634 _CNV_A_R_EGCP_LINEA_510_CM 0. 23.999634 DISPLAY_IDENTIFIER C_FAC_GAIN_H_DIF_R_IT_LS_UP FORMAT "%7.4" /end CHARACTERISTIC
/begin CHARACTERISTIC c_fac_gain_h_r_it_ls_up "Reference high gain for internal resistance determination circuit" VALUE 0x840dc4 _REC_VAL_20_u2 23.999634 _CNV_A_R_EGCP_LINEA_510_CM 0. 23.999634 DISPLAY_IDENTIFIER C_FAC_GAIN_H_R_IT_LS_UP FORMAT "%7.4" /end CHARACTERISTIC
/begin CHARACTERISTIC c_fac_gain_l_dif_r_it_ls_up "Maximum permitted deviation of measured FAC_GAIN_L_R_IT_LS_UP[NC_CBK_EX_NR] from nominal reference value" VALUE 0x840dc6 _REC_VAL_20_u2 23.999634 _CNV_A_R_EGCP_LINEA_510_CM 0. 23.999634 DISPLAY_IDENTIFIER C_FAC_GAIN_L_DIF_R_IT_LS_UP FORMAT "%7.4" /end CHARACTERISTIC
/begin CHARACTERISTIC c_fac_gain_l_r_it_ls_up "Reference low gain for internal resistance determination circuit" VALUE 0x840dc8 _REC_VAL_20_u2 23.999634 _CNV_A_R_EGCP_LINEA_510_CM 0. 23.999634 DISPLAY_IDENTIFIER C_FAC_GAIN_L_R_IT_LS_UP FORMAT "%7.4" /end CHARACTERISTIC
/begin CHARACTERISTIC c_v_ofs_ref_r_it_ls_up "Reference offset voltage for internal resistance determination circuit" VALUE 0x840f4c _REC_VAL_20_u2 4.995 _CNV_A_R_EGCP_LINEA_509_CM 0. 4.995 DISPLAY_IDENTIFIER C_V_OFS_REF_R_IT_LS_UP FORMAT "%5.3" /end CHARACTERISTIC
/begin CHARACTERISTIC c_frq_r_it_osc_lsl_if "Coded information for Ri determination oscillator frequency" VALUE 0x840de5 _REC_VAL_20_u1 127. _CNV_A_R_LINEAR_____1_CM 0. 127. DISPLAY_IDENTIFIER C_FRQ_R_IT_OSC_LSL_IF FORMAT "%3.0" /end CHARACTERISTIC
/begin CHARACTERISTIC lc_v_ref_r_it_ls_up "Boolean flag enabling internal resistance determination circuit reference measurement" VALUE 0x840fbb _REC_VAL_20_u1 1. _CNV_A_R_LINEAR_____1_CM 0. 1. DISPLAY_IDENTIFIER LC_V_REF_R_IT_LS_UP FORMAT "%1.0" /end CHARACTERISTIC
/begin CHARACTERISTIC c_ctr_min_diag_scg_ls_down "Minimum duration required for continious low VLS_DOWN[i] detection" VALUE 0x840da9 _REC_VAL_20_u1 255. _CNV_A_R_LINEAR_____1_CM 0. 255. DISPLAY_IDENTIFIER C_CTR_MIN_DIAG_SCG_LS_DOWN FORMAT "%3.0" /end CHARACTERISTIC
/begin CHARACTERISTIC c_maf_kgh_min_diag_scg_ls_down "Minimum MAF_KGH flow required for continious low VLS_DOWN[i] detection" VALUE 0x840e6c _REC_VAL_20_u2 2047.96875 _CNV_A_R_LINEAR_____479_CM 0. 2047.96875 DISPLAY_IDENTIFIER C_MAF_KGH_MIN_DIAG_SCG_LS_DOWN FORMAT "%10.5" /end CHARACTERISTIC
/begin CHARACTERISTIC c_vls_thd_diag_scp_ls_down "Oxygen sensor voltage threshold over which short to Vbatt present" VALUE 0x840f92 _REC_VAL_20_u2 4.9951171875 _CNV_A_R_LINEAR_____265_CM 0. 4.9951171875 DISPLAY_IDENTIFIER C_VLS_THD_DIAG_SCP_LS_DOWN FORMAT "%5.3" /end CHARACTERISTIC
/begin CHARACTERISTIC c_r_it_max_diag_scg_ls_down "Maximum resistance threshold oxygen sensor internal resistance during short to ground sensor" VALUE 0x840e84 _REC_VAL_20_u2 65535. _CNV_A_R_LINEAR_____487_CM 0. 65535. DISPLAY_IDENTIFIER C_R_IT_MAX_DIAG_SCG_LS_DOWN FORMAT "%5.0" /end CHARACTERISTIC
/begin CHARACTERISTIC c_r_it_min_diag_oc_ls_down "Minimum resistance threshold oxygen sensor internal resistance during open circuit sensor" VALUE 0x840e86 _REC_VAL_20_u2 65535. _CNV_A_R_LINEAR_____487_CM 0. 65535. DISPLAY_IDENTIFIER C_R_IT_MIN_DIAG_OC_LS_DOWN FORMAT "%5.0" /end CHARACTERISTIC
/begin CHARACTERISTIC c_t_cdn_diag_oc_ls_down "Minimum required duration where voltage lies outside of the limits for operable sensor to detect fault" VALUE 0x840e92 _REC_VAL_20_u2 6553.5 _CNV_A_R_LINEAR_____240_CM 0. 6553.5 DISPLAY_IDENTIFIER C_T_CDN_DIAG_OC_LS_DOWN FORMAT "%6.1" /end CHARACTERISTIC
/begin CHARACTERISTIC c_t_dly_diag_oc_ls_down "Minimum required duration where voltage lies outside of the limits for operable sensor to detect fault" VALUE 0x840ea2 _REC_VAL_20_u2 6553.5 _CNV_A_R_LINEAR_____240_CM 0. 6553.5 DISPLAY_IDENTIFIER C_T_DLY_DIAG_OC_LS_DOWN FORMAT "%6.1" /end CHARACTERISTIC
/begin CHARACTERISTIC c_t_dly_diag_scg_ls_down "Minimum duration required for low VLS_DOWN[i] detection" VALUE 0x840ea6 _REC_VAL_20_u2 6553.5 _CNV_A_R_LINEAR_____240_CM 0. 6553.5 DISPLAY_IDENTIFIER C_T_DLY_DIAG_SCG_LS_DOWN FORMAT "%6.1" /end CHARACTERISTIC
/begin CHARACTERISTIC c_teg_cat_min_diag_oc_ls_down "Minimum requested exhaust gas temperature for diagnosis" VALUE 0x840f0e _REC_VAL_20_u2 2047. _CNV_A_R_EGCP_LINEA_468_CM 0. 2047. DISPLAY_IDENTIFIER C_TEG_CAT_MIN_DIAG_OC_LS_DOWN FORMAT "%9.4" /end CHARACTERISTIC
/begin CHARACTERISTIC c_vls_thd_diag_scg_ls_down "Oxygen sensor voltage threshold under which short to GND may be present" VALUE 0x840f90 _REC_VAL_20_u2 4.9951171875 _CNV_A_R_LINEAR_____265_CM 0. 4.9951171875 DISPLAY_IDENTIFIER C_VLS_THD_DIAG_SCG_LS_DOWN FORMAT "%5.3" /end CHARACTERISTIC
/begin CHARACTERISTIC c_vls_afl_thd_diag_oc_ls_down "Oxygen sensor voltage-lean mixture threshold for diagnosis" VALUE 0x840f54 _REC_VAL_20_u2 4.9951171875 _CNV_A_R_LINEAR_____265_CM 0. 4.9951171875 DISPLAY_IDENTIFIER C_VLS_AFL_THD_DIAG_OC_LS_DOWN FORMAT "%5.3" /end CHARACTERISTIC
/begin CHARACTERISTIC c_vls_afr_thd_diag_oc_ls_down "Oxygen sensor voltage-rich mixture threshold for diagnosis" VALUE 0x840f5a _REC_VAL_20_u2 4.9951171875 _CNV_A_R_LINEAR_____265_CM 0. 4.9951171875 DISPLAY_IDENTIFIER C_VLS_AFR_THD_DIAG_OC_LS_DOWN FORMAT "%5.3" /end CHARACTERISTIC
/begin MEASUREMENT lv_err_scp_ls_down_1 "Boolean error flag, short to plus fault currently present on downstream oxygen sensor signal" UBYTE _CNV_S_2_RANGE__0___85_CM 1 0. 0. 1. DISPLAY_IDENTIFIER LV_ERR_SCP_LS_DOWN_1_ ECU_ADDRESS 0x7fb94e BIT_MASK 0x1 /end MEASUREMENT
/begin MEASUREMENT lv_err_scg_ls_down_1 "Boolean error flag, short to ground fault currently present on downstream oxygen sensor signal" UBYTE _CNV_S_2_RANGE__0___85_CM 1 0. 0. 1. DISPLAY_IDENTIFIER LV_ERR_SCG_LS_DOWN_1_ ECU_ADDRESS 0x7fb94d BIT_MASK 0x1 /end MEASUREMENT
/begin MEASUREMENT lv_err_oc_ls_down_1 "Boolean error flag, open circuit fault currently present on downstream oxygen sensor signal" UBYTE _CNV_S_2_RANGE__0___85_CM 1 0. 0. 1. DISPLAY_IDENTIFIER LV_ERR_OC_LS_DOWN_1_ ECU_ADDRESS 0x7fb94f BIT_MASK 0x1 /end MEASUREMENT
/begin MEASUREMENT lv_err_el_lsl_up_1 "Debounced diagnosis value caused by an OBD-I error at the WRAF-Sensor" UBYTE _CNV_S_2_RANGE__0___85_CM 1 0. 0. 1. DISPLAY_IDENTIFIER LV_ERR_EL_LSL_UP_1_ ECU_ADDRESS 0x7fb955 BIT_MASK 0x1 /end MEASUREMENT
/begin CHARACTERISTIC c_ctr_iplsl_sym_diag_lsl_up "Max. error debounce counter" VALUE 0x840da4 _REC_VAL_20_u2 65535. _CNV_A_R_LINEAR_____1_CM 0. 65535. DISPLAY_IDENTIFIER C_CTR_IPLSL_SYM_DIAG_LSL_UP FORMAT "%5.0" /end CHARACTERISTIC
/begin CHARACTERISTIC c_lamb_sp_afr_iplsl_diag_lsl_up "Max. rich lambda set point to activate the IP diagnosis" VALUE 0x840e24 _REC_VAL_20_u2 31.9990234375 _CNV_A_R_LINEAR_____465_CM 0. 31.9990234375 DISPLAY_IDENTIFIER C_LAMB_SP_AFR_IPLSL_DIAG_LSL_UP FORMAT "%7.4" /end CHARACTERISTIC
/begin CHARACTERISTIC c_lamb_sp_afl_iplsl_diag_lsl_up "Min. lean lambda set point to activate the IP diagnosis" VALUE 0x840e20 _REC_VAL_20_u2 31.9990234375 _CNV_A_R_LINEAR_____465_CM 0. 31.9990234375 DISPLAY_IDENTIFIER C_LAMB_SP_AFL_IPLSL_DIAG_LSL_UP FORMAT "%7.4" /end CHARACTERISTIC
/begin MEASUREMENT lv_err_oc_lsl_up_1 "Debounced open circuit failure detected" UBYTE _CNV_S_2_RANGE__0___85_CM 1 0. 0. 1. DISPLAY_IDENTIFIER LV_ERR_OC_LSL_UP_1_ ECU_ADDRESS 0x7fb956 BIT_MASK 0x1 /end MEASUREMENT
/begin CHARACTERISTIC c_t_oc_lsl_diag "Max. waiting time before begin diagnosis" VALUE 0x840edc _REC_VAL_20_u2 6553.5 _CNV_A_R_LINEAR_____240_CM 0. 6553.5 DISPLAY_IDENTIFIER C_T_OC_LSL_DIAG FORMAT "%6.1" /end CHARACTERISTIC
/begin CHARACTERISTIC c_t_vls_up_min_diag_oc_lsl_up "Max allowed time for LSL undervoltage" VALUE 0x840ef0 _REC_VAL_20_u2 6553.5 _CNV_A_R_LINEAR_____240_CM 0. 6553.5 DISPLAY_IDENTIFIER C_T_VLS_UP_MIN_DIAG_OC_LSL_UP FORMAT "%6.1" /end CHARACTERISTIC
/begin CHARACTERISTIC c_vls_up_min_diag_oc_lsl_up "LSL undervoltage threshold" VALUE 0x840f98 _REC_VAL_20_u2 4.9951171875 _CNV_A_R_LINEAR_____265_CM 0. 4.9951171875 DISPLAY_IDENTIFIER C_VLS_UP_MIN_DIAG_OC_LSL_UP FORMAT "%5.3" /end CHARACTERISTIC
/begin AXIS_PTS ldpm_temp_ini_ls_up_1_egcp "" 0x840a30 online_dummy _REC_AXS_20_u2 4095.9375 _CNV_A_R_EGCP_LINEA_469_CM 6 -2048. 2047.9375 FORMAT "%10.4" /end AXIS_PTS
/begin AXIS_PTS ldpm_temp_ini_ls_down_1_egcp "" 0x840a22 online_dummy _REC_AXS_20_u2 4095.9375 _CNV_A_R_EGCP_LINEA_469_CM 6 -2048. 2047.9375 FORMAT "%10.4" /end AXIS_PTS
/begin AXIS_PTS ldpm_n_32_3_egcp "" 0x8409e6 n_32 _REC_AXS_20_u1 8160. _CNV_A_R_LINEAR_____81_CM 6 0. 8160. FORMAT "%4.0" /end AXIS_PTS
/begin AXIS_PTS ldpm_teg_cat_up_mdl_1_egcp "" 0x840a14 online_dummy _REC_AXS_20_u2 2047. _CNV_A_R_EGCP_LINEA_468_CM 6 0. 2047. FORMAT "%9.4" /end AXIS_PTS
/begin AXIS_PTS ldpm_teg_cat_down_mdl_1_egcp "" 0x840a06 online_dummy _REC_AXS_20_u2 2047. _CNV_A_R_EGCP_LINEA_468_CM 6 0. 2047. FORMAT "%9.4" /end AXIS_PTS
/begin AXIS_PTS ldpm_vs_1_egcp "" 0x840a45 online_dummy _REC_AXS_20_u1 255. _CNV_A_R_LINEAR_____245_CM 6 0. 255. FORMAT "%3.0" /end AXIS_PTS
/begin AXIS_PTS ldpm_t_afl_cyc_hld_1_egcp "" 0x8409f6 online_dummy _REC_AXS_20_u1 2.55 _CNV_A_R_LINEAR_____226_CM 8 0. 2.55 FORMAT "%4.2" /end AXIS_PTS
/begin AXIS_PTS ldpm_n_32_1_egcp "" 0x8409d6 n_32 _REC_AXS_20_u1 8160. _CNV_A_R_LINEAR_____81_CM 6 0. 8160. FORMAT "%4.0" /end AXIS_PTS
/begin AXIS_PTS ldpm_n_32_2_egcp "" 0x8409dd n_32 _REC_AXS_20_u1 8160. _CNV_A_R_LINEAR_____81_CM 8 0. 8160. FORMAT "%4.0" /end AXIS_PTS
/begin AXIS_PTS ldpm_maf_kgh_1_egcp "" 0x8409b6 maf_kgh _REC_AXS_20_u2 2047.96875 _CNV_A_R_LINEAR_____479_CM 8 0. 2047.96875 FORMAT "%10.5" /end AXIS_PTS
/begin AXIS_PTS ldpm_maf_1_egcp "" 0x84099a maf _REC_AXS_20_u2 1389. _CNV_A_R_LINEAR_____490_CM 8 0. 1389. FORMAT "%7.2" /end AXIS_PTS
/begin AXIS_PTS ldpm_maf_kgh_3_egcp "" 0x8409c8 maf_kgh _REC_AXS_20_u2 2047.96875 _CNV_A_R_LINEAR_____479_CM 6 0. 2047.96875 FORMAT "%10.5" /end AXIS_PTS
/begin COMPU_METHOD _CNV_A_R_LINEAR_____0_CM "" RAT_FUNC "%6.3" "[-]" COEFFS 0 1. 0. 0 0 1 /end COMPU_METHOD
/begin COMPU_METHOD _CNV_A_R_LINEAR_____1_CM "" RAT_FUNC "%6.3" "-" COEFFS 0 1. 0. 0 0 1 /end COMPU_METHOD
/begin COMPU_METHOD _CNV_A_R_LINEAR_____45_CM "" RAT_FUNC "%6.3" "[hPa]" COEFFS 0 12.06017666543982 0. 0 0 1 /end COMPU_METHOD
/begin COMPU_METHOD _CNV_A_R_LINEAR_____81_CM "" RAT_FUNC "%6.3" "rpm" COEFFS 0 3.125e-002 0. 0 0 1 /end COMPU_METHOD
/begin COMPU_METHOD _CNV_S_2_RANGE__0___85_CM "" TAB_VERB "%6.3" "-" COMPU_TAB_REF _CNV_S_2_RANGE__0___85 /end COMPU_METHOD
/begin COMPU_VTAB _CNV_S_2_RANGE__0___85 "" TAB_VERB 2 0 "0" 1 "1" /end COMPU_VTAB
/begin COMPU_METHOD _CNV_A_R_LINEAR_____110_CM "" RAT_FUNC "%6.3" "[kg/h]" COEFFS 0 64. 0. 0 0 1 /end COMPU_METHOD
/begin COMPU_METHOD _CNV_A_R_LINEAR_____137_CM "" RAT_FUNC "%6.3" "-" COEFFS 0 65535.99999999996 0. 0 0 1 /end COMPU_METHOD
/begin COMPU_METHOD _CNV_A_R_LINEAR_____226_CM "" RAT_FUNC "%6.3" "s" COEFFS 0 100. 0. 0 0 1 /end COMPU_METHOD
/begin COMPU_METHOD _CNV_A_R_LINEAR_____240_CM "" RAT_FUNC "%6.3" "s" COEFFS 0 10. 0. 0 0 1 /end COMPU_METHOD
/begin COMPU_METHOD _CNV_A_R_LINEAR_____244_CM "" RAT_FUNC "%6.3" "-" COEFFS 0 64. 0. 0 0 1 /end COMPU_METHOD
/begin COMPU_METHOD _CNV_A_R_LINEAR_____245_CM "" RAT_FUNC "%6.3" "km/h" COEFFS 0 1. 0. 0 0 1 /end COMPU_METHOD
/begin COMPU_METHOD _CNV_A_R_LINEAR_____246_CM "" RAT_FUNC "%6.3" "-" COEFFS 0 128. 0. 0 0 1 /end COMPU_METHOD
/begin COMPU_METHOD _CNV_A_R_LINEAR_____247_CM "" RAT_FUNC "%6.3" "hPa" COEFFS 0 12.06017666543982 0. 0 0 1 /end COMPU_METHOD
/begin COMPU_METHOD _CNV_A_R_LINEAR_____251_CM "" RAT_FUNC "%6.3" "-" COEFFS 0 16. 0. 0 0 1 /end COMPU_METHOD
/begin COMPU_METHOD _CNV_A_R_LINEAR_____254_CM "" RAT_FUNC "%6.3" "-" COEFFS 0 256. 0. 0 0 1 /end COMPU_METHOD
/begin COMPU_METHOD _CNV_A_R_LINEAR_____257_CM "" RAT_FUNC "%6.3" "°C" COEFFS 0 1.333333333333333 64. 0 0 1 /end COMPU_METHOD
/begin COMPU_METHOD _CNV_A_R_LINEAR_____265_CM "" RAT_FUNC "%6.3" "V" COEFFS 0 204.8 0. 0 0 1 /end COMPU_METHOD
/begin COMPU_METHOD _CNV_A_R_LINEAR_____304_CM "" RAT_FUNC "%6.3" "-" COEFFS 0 32. 0. 0 0 1 /end COMPU_METHOD
/begin COMPU_METHOD _CNV_A_R_LINEAR_____349_CM "Battery voltage" RAT_FUNC "%6.3" "V" COEFFS 0 9.846153846153847 0. 0 0 1 /end COMPU_METHOD
/begin COMPU_METHOD _CNV_A_R_LINEAR_____465_CM "" RAT_FUNC "%6.3" "-" COEFFS 0 1024. 0. 0 0 1 /end COMPU_METHOD
/begin COMPU_METHOD _CNV_A_R_EGCP_LINEA_466_CM "" RAT_FUNC "%6.3" "Ohm" COEFFS 0 4. 0. 0 0 1 /end COMPU_METHOD
/begin COMPU_METHOD _CNV_A_R_EGCP_LINEA_467_CM "Battery voltage" RAT_FUNC "%6.3" "V" COEFFS 0 39.70223015990035 -9.964481279212123e-006 0 0 1 /end COMPU_METHOD
/begin COMPU_METHOD _CNV_A_R_EGCP_LINEA_468_CM "Battery voltage" RAT_FUNC "%6.3" "°C" COEFFS 0 16. 0. 0 0 1 /end COMPU_METHOD
/begin COMPU_METHOD _CNV_A_R_EGCP_LINEA_469_CM "Battery voltage" RAT_FUNC "%6.3" "°C" COEFFS 0 16. 32768. 0 0 1 /end COMPU_METHOD
/begin COMPU_METHOD _CNV_A_R_EGCP_LINEA_470_CM "" RAT_FUNC "%6.3" "V/K" COEFFS 0 1000. 0. 0 0 1 /end COMPU_METHOD
/begin COMPU_METHOD _CNV_A_R_EGCP_LINEA_471_CM "" RAT_FUNC "%6.3" "-" COEFFS 0 40.17013232514178 0. 0 0 1 /end COMPU_METHOD
/begin COMPU_METHOD _CNV_A_R_EGCP_LINEA_472_CM "Battery voltage" RAT_FUNC "%6.3" "V/100ms" COEFFS 0 156.9230769230769 0. 0 0 1 /end COMPU_METHOD
/begin COMPU_METHOD _CNV_A_R_EGCP_LINEA_473_CM "Battery voltage" RAT_FUNC "%6.3" "V" COEFFS 0 9.846153656062192 -2.471191493214064e-006 0 0 1 /end COMPU_METHOD
/begin COMPU_METHOD _CNV_A_R_EGCP_LINEA_474_CM "" RAT_FUNC "%6.3" "V" COEFFS 0 6553.60054017653 0. 0 0 1 /end COMPU_METHOD
/begin COMPU_METHOD _CNV_A_R_EGCP_LINEA_475_CM "" RAT_FUNC "%6.3" "mA/V" COEFFS 0 13007.28356275124 0. 0 0 1 /end COMPU_METHOD
/begin COMPU_METHOD _CNV_A_R_LINEAR_____476_CM "" RAT_FUNC "%6.3" "-" COEFFS 0 32767.99999999992 0. 0 0 1 /end COMPU_METHOD
/begin COMPU_METHOD _CNV_A_R_EGCP_LINEA_477_CM "Battery voltage" RAT_FUNC "%6.3" "µA" COEFFS 0 105.7540793782874 0. 0 0 1 /end COMPU_METHOD
/begin COMPU_METHOD _CNV_A_R_LINEAR_____478_CM "" RAT_FUNC "%6.3" "mA/100ms" COEFFS 0 2601.524353935929 0.8007621769647813 0 0 1 /end COMPU_METHOD
/begin COMPU_METHOD _CNV_A_R_LINEAR_____479_CM "" RAT_FUNC "%6.3" "kg/h" COEFFS 0 32. 0. 0 0 1 /end COMPU_METHOD
/begin COMPU_METHOD _CNV_A_R_EGCP_LINEA_480_CM "" RAT_FUNC "%6.3" "mA" COEFFS 0 2601.524353935929 32768.80076217697 0 0 1 /end COMPU_METHOD
/begin COMPU_METHOD _CNV_A_R_LINEAR_____481_CM "" RAT_FUNC "%6.3" "mA" COEFFS 0 2601.524353935929 0.8007621769647813 0 0 1 /end COMPU_METHOD
/begin COMPU_METHOD _CNV_A_R_LINEAR_____482_CM "" RAT_FUNC "%6.3" "g" COEFFS 0 35.99993408114611 0. 0 0 1 /end COMPU_METHOD
/begin COMPU_METHOD _CNV_A_R_EGCP_LINEA_483_CM "Battery voltage" RAT_FUNC "%6.3" "-" COEFFS 0 1024.002615046581 0. 0 0 1 /end COMPU_METHOD
/begin COMPU_METHOD _CNV_A_R_EGCP_LINEA_484_CM "" RAT_FUNC "%6.3" "-" COEFFS 0 1024.002785367616 0. 0 0 1 /end COMPU_METHOD
/begin COMPU_METHOD _CNV_A_R_EGCP_LINEA_485_CM "Battery voltage" RAT_FUNC "%6.3" "s" COEFFS 0 50. 0. 0 0 1 /end COMPU_METHOD
/begin COMPU_METHOD _CNV_A_R_LINEAR_____486_CM "" RAT_FUNC "%6.3" "%" COEFFS 0 2.56 0. 0 0 1 /end COMPU_METHOD
/begin COMPU_METHOD _CNV_A_R_LINEAR_____487_CM "" RAT_FUNC "%6.3" "Ohm" COEFFS 0 1. 0. 0 0 1 /end COMPU_METHOD
/begin COMPU_METHOD _CNV_A_R_LINEAR_____490_CM "" RAT_FUNC "%6.3" "mg/stk" COEFFS 0 47.18142548596112 0. 0 0 1 /end COMPU_METHOD
/begin COMPU_METHOD _CNV_A_R_EGCP_LINEA_491_CM "Battery voltage" RAT_FUNC "%6.3" "V" COEFFS 0 2520.615410935313 3.42159066349268e-004 0 0 1 /end COMPU_METHOD
/begin COMPU_METHOD _CNV_A_R_EGCP_LINEA_492_CM "Battery voltage" RAT_FUNC "%6.3" "V" COEFFS 0 2520.615410935313 0. 0 0 1 /end COMPU_METHOD
/begin COMPU_METHOD _CNV_S_7_EGCP_RANGE_493_CM "" TAB_VERB "%6.3" "-" COMPU_TAB_REF _CNV_S_7_EGCP_RANGE_493 /end COMPU_METHOD
/begin COMPU_VTAB _CNV_S_7_EGCP_RANGE_493 "" TAB_VERB 7 0 "LSH_OFF" 1 "LSH_POW_RISE" 2 "LSH_POW_RED" 3 "LSH_POW_FALL" 4 "LSH_POW_CTL" 5 "LSH_VB_PROT" 6 "LSH_TEMP_PROT" /end COMPU_VTAB
/begin COMPU_METHOD _CNV_A_R_EGCP_LINEA_494_CM "Battery voltage" RAT_FUNC "%6.3" "V" COEFFS 0 6553.600270084133 1.350420665403362e-003 0 0 1 /end COMPU_METHOD
/begin COMPU_METHOD _CNV_A_R_EGCP_LINEA_495_CM "" RAT_FUNC "%6.3" "V" COEFFS 0 204.8000001200018 0. 0 0 1 /end COMPU_METHOD
/begin COMPU_METHOD _CNV_S_3_EGCP_RANGE_496_CM "" TAB_VERB "%6.3" "-" COMPU_TAB_REF _CNV_S_3_EGCP_RANGE_496 /end COMPU_METHOD
/begin COMPU_VTAB _CNV_S_3_EGCP_RANGE_496 "" TAB_VERB 3 0 "0: WAIT" 1 "1: PREPARE" 2 "2: ADJUST" /end COMPU_VTAB
/begin COMPU_METHOD _CNV_S_5_EGCP_RANGE_497_CM "" TAB_VERB "%6.3" "-" COMPU_TAB_REF _CNV_S_5_EGCP_RANGE_497 /end COMPU_METHOD
/begin COMPU_VTAB _CNV_S_5_EGCP_RANGE_497 "" TAB_VERB 5 0 "0: INIT" 1 "1: WAIT" 2 "2: PURGE" 3 "3: ACQ" 4 "4: ADAPT" /end COMPU_VTAB
/begin COMPU_METHOD _CNV_S_4_EGCP_RANGE_498_CM "" TAB_VERB "%6.3" "-" COMPU_TAB_REF _CNV_S_4_EGCP_RANGE_498 /end COMPU_METHOD
/begin COMPU_VTAB _CNV_S_4_EGCP_RANGE_498 "" TAB_VERB 4 0 "0: in_range" 1 "1: low_limit" 2 "2: high_limit" 3 "3: impossible" /end COMPU_VTAB
/begin COMPU_METHOD _CNV_S_3_EGCP_RANGE_499_CM "" TAB_VERB "%6.3" "-" COMPU_TAB_REF _CNV_S_3_EGCP_RANGE_499 /end COMPU_METHOD
/begin COMPU_VTAB _CNV_S_3_EGCP_RANGE_499 "" TAB_VERB 3 0 "NO_FAULT" 1 "SCG" 2 "SCB" /end COMPU_VTAB
/begin COMPU_METHOD _CNV_S_3_EGCP_RANGE_500_CM "" TAB_VERB "%6.3" "-" COMPU_TAB_REF _CNV_S_3_EGCP_RANGE_500 /end COMPU_METHOD
/begin COMPU_VTAB _CNV_S_3_EGCP_RANGE_500 "" TAB_VERB 3 0 "NO_FAULT" 1 "Current low" 2 "Current high" /end COMPU_VTAB
/begin COMPU_METHOD _CNV_S_2_EGCP_RANGE_501_CM "" TAB_VERB "%6.3" "-" COMPU_TAB_REF _CNV_S_2_EGCP_RANGE_501 /end COMPU_METHOD
/begin COMPU_VTAB _CNV_S_2_EGCP_RANGE_501 "" TAB_VERB 2 0 "NO_FAULT" 1 "FAULT" /end COMPU_VTAB
/begin COMPU_METHOD _CNV_A_R_EGCP_LINEA_502_CM "Battery voltage" RAT_FUNC "%6.3" "V/10ms" COEFFS 0 13107.19922942829 -1.926429285958875e-003 0 0 1 /end COMPU_METHOD
/begin COMPU_METHOD _CNV_A_R_EGCP_LINEA_503_CM "Battery voltage" RAT_FUNC "%6.3" "V/10ms" COEFFS 0 13107.19999999999 0. 0 0 1 /end COMPU_METHOD
/begin COMPU_METHOD _CNV_A_R_EGCP_LINEA_504_CM "Battery voltage" RAT_FUNC "%6.3" "V" COEFFS 0 13107.19999999999 0. 0 0 1 /end COMPU_METHOD
/begin COMPU_METHOD _CNV_A_R_EGCP_LINEA_505_CM "Battery voltage" RAT_FUNC "%6.3" "V" COEFFS 0 13107.99620771179 0. 0 0 1 /end COMPU_METHOD
/begin COMPU_METHOD _CNV_A_R_LINEAR_____506_CM "" RAT_FUNC "%6.3" "-" COEFFS 0 16384. 0. 0 0 1 /end COMPU_METHOD
/begin COMPU_METHOD _CNV_A_R_EGCP_LINEA_507_CM "" RAT_FUNC "%6.3" "W" COEFFS 0 775.5739611223182 0. 0 0 1 /end COMPU_METHOD
/begin COMPU_METHOD _CNV_A_R_EGCP_LINEA_508_CM "" RAT_FUNC "%6.3" "-" COEFFS 0 4. 0. 0 0 1 /end COMPU_METHOD
/begin COMPU_METHOD _CNV_A_R_EGCP_LINEA_509_CM "" RAT_FUNC "%6.3" "V" COEFFS 0 819.2192192192192 0. 0 0 1 /end COMPU_METHOD
/begin COMPU_METHOD _CNV_A_R_EGCP_LINEA_510_CM "" RAT_FUNC "%6.3" "-" COEFFS 0 2730.666642666301 0. 0 0 1 /end COMPU_METHOD
/begin COMPU_METHOD _CNV_S_5_EGCP_RANGE_511_CM "" TAB_VERB "%6.3" "-" COMPU_TAB_REF _CNV_S_5_EGCP_RANGE_511 /end COMPU_METHOD
/begin COMPU_VTAB _CNV_S_5_EGCP_RANGE_511 "" TAB_VERB 5 0 "OFF" 1 "MES_OFS" 2 "ADJ_OFS" 3 "ADJ_GAIN" 4 "MES" /end COMPU_VTAB
/begin COMPU_METHOD _CNV_S_3_EGCP_RANGE_512_CM "" TAB_VERB "%6.3" "-" COMPU_TAB_REF _CNV_S_3_EGCP_RANGE_512 /end COMPU_METHOD
/begin COMPU_VTAB _CNV_S_3_EGCP_RANGE_512 "" TAB_VERB 3 0 "NO_SYM" 1 "SYM_0" 2 "SYM_1" /end COMPU_VTAB
/begin COMPU_METHOD _CNV_S_11_EGCP_RANGE_513_CM "" TAB_VERB "%6.3" "-" COMPU_TAB_REF _CNV_S_11_EGCP_RANGE_513 /end COMPU_METHOD
/begin COMPU_VTAB _CNV_S_11_EGCP_RANGE_513 "" TAB_VERB 11 0 "No Fault" 1 "SCG line RCD" 2 "SCG line VIP" 3 "SCG line VG" 4 "SCG line VN" 5 "SCG" 6 "SCBat line RCD" 7 "SCBat line VIP" 8 "SCBat line VG" 9 "SCBat line VN" 10 "SCBat" /end COMPU_VTAB
/begin COMPU_METHOD _CNV_S_3_EGCP_RANGE_514_CM "" TAB_VERB "%6.3" "-" COMPU_TAB_REF _CNV_S_3_EGCP_RANGE_514 /end COMPU_METHOD
/begin COMPU_VTAB _CNV_S_3_EGCP_RANGE_514 "" TAB_VERB 3 0 "PASSIVE" 1 "ACTIVE" 2 "END" /end COMPU_VTAB
/begin COMPU_METHOD _CNV_A_R_EGCP_LINEA_529_CM "" RAT_FUNC "%6.3" "s" COEFFS 0 1000. 0. 0 0 1 /end COMPU_METHOD
/begin COMPU_METHOD _CNV_A_R_LINEAR_____530_CM "" RAT_FUNC "%6.3" "°C" COEFFS 0 64. 2112. 0 0 1 /end COMPU_METHOD
/begin COMPU_METHOD _CNV_A_R_LINEAR_____531_CM "" RAT_FUNC "%6.3" "1/s" COEFFS 0 256. 0. 0 0 1 /end COMPU_METHOD
/begin COMPU_METHOD _CNV_A_R_EGCP_LINEA_532_CM "Battery voltage" RAT_FUNC "%6.3" "1/V" COEFFS 0 853.3336458382162 0. 0 0 1 /end COMPU_METHOD
/begin RECORD_LAYOUT _REC_VAL_20_u1 FNC_VALUES 1 UBYTE COLUMN_DIR DIRECT /end RECORD_LAYOUT
/begin RECORD_LAYOUT _REC_AXS_20_u2 NO_AXIS_PTS_X 1 UWORD AXIS_PTS_X 2 UWORD INDEX_INCR DIRECT /end RECORD_LAYOUT
/begin RECORD_LAYOUT _REC_MAP_20_u2_u2_u2 FNC_VALUES 1 UWORD COLUMN_DIR DIRECT /end RECORD_LAYOUT
/begin RECORD_LAYOUT _REC_VAL_20_u2 FNC_VALUES 1 UWORD COLUMN_DIR DIRECT /end RECORD_LAYOUT
/begin RECORD_LAYOUT _REC_VAL_20_s2 FNC_VALUES 1 SWORD COLUMN_DIR DIRECT /end RECORD_LAYOUT
/begin RECORD_LAYOUT _REC_AXS_20_u1 NO_AXIS_PTS_X 1 UBYTE AXIS_PTS_X 2 UBYTE INDEX_INCR DIRECT /end RECORD_LAYOUT
/begin RECORD_LAYOUT _REC_CUR_20_u2_u2 FNC_VALUES 1 UWORD COLUMN_DIR DIRECT /end RECORD_LAYOUT
/begin RECORD_LAYOUT _REC_CUR_20_u2_u1 FNC_VALUES 1 UWORD COLUMN_DIR DIRECT /end RECORD_LAYOUT
/begin RECORD_LAYOUT _REC_MAP_20_u1_u2_u2 FNC_VALUES 1 UBYTE COLUMN_DIR DIRECT /end RECORD_LAYOUT
/begin RECORD_LAYOUT _REC_MAP_20_u2_u1_u1 FNC_VALUES 1 UWORD COLUMN_DIR DIRECT /end RECORD_LAYOUT
/begin RECORD_LAYOUT _REC_MAP_20_u2_u2_u1 FNC_VALUES 1 UWORD COLUMN_DIR DIRECT /end RECORD_LAYOUT
/begin RECORD_LAYOUT _REC_CUR_20_u1_u2 FNC_VALUES 1 UBYTE COLUMN_DIR DIRECT /end RECORD_LAYOUT
/begin RECORD_LAYOUT _REC_CUR_20_u1_u1 FNC_VALUES 1 UBYTE COLUMN_DIR DIRECT /end RECORD_LAYOUT
/begin RECORD_LAYOUT _REC_MAP_20_u1_u1_u2 FNC_VALUES 1 UBYTE COLUMN_DIR DIRECT /end RECORD_LAYOUT
/begin RECORD_LAYOUT _REC_VAL_20_s1 FNC_VALUES 1 SBYTE COLUMN_DIR DIRECT /end RECORD_LAYOUT
/begin RECORD_LAYOUT _REC_CUR_20_s2_u2 FNC_VALUES 1 SWORD COLUMN_DIR DIRECT /end RECORD_LAYOUT
/begin FUNCTION EGCP_Upstream_ls_heat_mng "_Upstream_ls_heat_mng"
 /begin DEF_CHARACTERISTIC ip_fac_neg_ctl_p_lsh_up ip_fac_pos_ctl_p_lsh_up ip_fac_pos_ctl_i_lsh_up c_ttip_dif_min_ctl_p_ls_up c_fac_ctl_p_lsh_up ip_v_efc_ini_lsh_up ip_v_efc_ctl_lsh_up ip_t_temp_thd_lsh_up ip_fac_v_efc_teg_lsh_up c_v_efc_inc_lsh_up c_v_efc_dec_lsh_up c_v_efc_red_lsh_up c_v_efc_step_lsh_up c_t_max_pow_rise_lsh_up c_t_max_v_efc_tol_lsh_up c_t_max_v_efc_lim_lsh_up c_t_max_v_efc_max_st_lsh_up c_t_ast_max_lsh_up c_v_efc_tol_lsh_up c_v_efc_lim_lsh_up c_vb_max_prot_lsh_up c_v_efc_prot_vb_lsh_up c_v_efc_max_lsh_up c_v_efc_max_st_lsh_up c_v_efc_as_lsh_up c_fac_v_efc_as_lsh_up c_teg_cat_up_mdl_max_lsh_up c_fac_ctl_i_lsh_up c_ttip_sp_ls_up[0] lc_lsh_ctl_cll_inh_lsh_up[0] ldp_vs_ip_fac_v_efc_teg_lsh_up ldp_t_pow_rise_lsh_up_id_ttip ip_fac_neg_ctl_i_lsh_up id_ttip_sp_dif_lsh_up /end DEF_CHARACTERISTIC
 /begin OUT_MEASUREMENT egcp[0].egcp_struct_acctllsh0.v_efc_ctl_p_lsh_up egcp[0].egcp_struct_acctllsh0.v_efc_ctl_i_lsh_up egcp[0].egcp_struct_acctllsh0.ttip_mes_dif_ls_up egcp[0].egcp_struct_acctllsh0.t_pow_rise_lsh_up egcp[0].egcp_struct_acctllsh0.v_efc_clc_lsh_up egcp[0].egcp_struct_acctllsh0.v_efc_ctl_add_lsh_up egcp[0].egcp_struct_acctllsh0.lshpwm_up egcp[0].egcp_struct_acctllsh0.v_efc_lsh_up egcp[0].egcp_struct_acctllsh0.t_v_efc_tol_lsh_up egcp[0].egcp_struct_acctllsh0.t_v_efc_lim_lsh_up egcp[0].egcp_struct_acctllsh0.lv_lsh_ctl_cll_lsh_up egcp[0].egcp_struct_acctllsh0.lv_v_efc_lim_bol_lsh_up egcp[0].egcp_struct_acctllsh0.lv_v_efc_lim_tol_lsh_up egcp[0].egcp_struct_acctllsh0.lv_v_efc_lim_max_lsh_up egcp[0].egcp_struct_acctllsh0.state_lsh_up egcp[0].egcp_struct_acctllsh0.lv_v_efc_lim_prot_vb_lsh_up /end OUT_MEASUREMENT
/end FUNCTION
/begin FUNCTION EGCP_Downstream_ls_heat_mng "_Downstream_ls_heat_mng"
 /begin DEF_CHARACTERISTIC c_fac_v_efc_as_lsh_down ip_v_efc_ini_lsh_down ip_v_efc_ctl_lsh_down ip_t_temp_thd_lsh_down ip_fac_v_efc_teg_lsh_down c_v_efc_inc_lsh_down c_v_efc_dec_lsh_down c_v_efc_red_lsh_down c_v_efc_step_lsh_down c_t_max_pow_rise_lsh_down c_t_max_v_efc_tol_lsh_down c_t_max_v_efc_lim_lsh_down c_t_max_v_efc_max_st_lsh_down c_t_ast_max_lsh_down c_v_efc_tol_lsh_down c_v_efc_lim_lsh_down c_vb_max_prot_lsh_down c_v_efc_prot_vb_lsh_down c_v_efc_max_lsh_down c_v_efc_max_st_lsh_down c_v_efc_as_lsh_down c_teg_cat_down_mdl_max_lsh_down /end DEF_CHARACTERISTIC
 /begin OUT_MEASUREMENT egcp[0].egcp_struct_acctllshd0.t_pow_rise_lsh_down egcp[0].egcp_struct_acctllshd0.v_efc_clc_lsh_down egcp[0].egcp_struct_acctllshd0.v_efc_lsh_down egcp[0].egcp_struct_acctllshd0.lshpwm_down egcp[0].egcp_struct_acctllshd0.t_v_efc_tol_lsh_down egcp[0].egcp_struct_acctllshd0.t_v_efc_lim_lsh_down egcp[0].egcp_struct_acctllshd0.lv_v_efc_lim_bol_lsh_down egcp[0].egcp_struct_acctllshd0.lv_v_efc_lim_tol_lsh_down egcp[0].egcp_struct_acctllshd0.lv_v_efc_lim_max_lsh_down egcp[0].egcp_struct_acctllshd0.state_lsh_down egcp[0].egcp_struct_acctllshd0.lv_v_efc_lim_prot_vb_lsh_down /end OUT_MEASUREMENT
/end FUNCTION
/begin FUNCTION EGCP_Downstream_ls_sig_V "_Downstream_ls_sig_V"
 /begin DEF_CHARACTERISTIC c_t_dly_puc_end_vls_down c_fac_vls_down_mmv_hys c_vls_down_mmv_hys_min c_vls_down_ini_min c_vls_down_ini_max c_crlc_vls_down c_crlc_vls_down_off /end DEF_CHARACTERISTIC
 /begin OUT_MEASUREMENT egcp[0].egcp_struct_sigcvlsd0.vls_down_drv1_mmv egcp[0].egcp_struct_sigcvlsd0.vls_down_drv1_mmv_min egcp[0].egcp_struct_sigcvlsd0.vls_down_drv1_abs_max egcp[0].egcp_struct_sigcvlsd0.vls_down_mmv_min egcp[0].egcp_struct_sigcvlsd0.vls_down_mmv_max egcp[0].egcp_struct_sigcvlsd0.vls_down_bol egcp[0].egcp_struct_sigcvlsd0.vls_down_tol egcp[0].egcp_struct_sigcvlsd0.vls_down_mmv_hys egcp[0].egcp_struct_sigcvlsd0.lv_vls_down_mmv_lim lv_vls_down_mmv_act /end OUT_MEASUREMENT
/end FUNCTION
/begin FUNCTION EGCP_Downstream_ls_read_det "_Downstream_ls_read_det"
 /begin DEF_CHARACTERISTIC c_vls_down_afl_thd_ready c_vls_down_afr_thd_ready c_maf_int_puc_max_down_ls_ready c_teg_cat_down_ls_down_ready /end DEF_CHARACTERISTIC
 /begin OUT_MEASUREMENT egcp[0].egcp_struct_dtsyslsd0.lv_ls_down_ready /end OUT_MEASUREMENT
/end FUNCTION
/begin FUNCTION EGCP_ACQ_compensation_WRAF_ls "_ACQ_compensation_WRAF_ls"
 /begin DEF_CHARACTERISTIC c_lamb_ls_up_max_ofs_adj c_lamb_ls_up_min_ofs_adj c_crlc_vls_up_ofs_adj c_t_wait_lsl_ofs_adj c_vls_ofs_sp_lsl c_t_dly_lamb_sti_off_ofs_adj c_vls_ofs_dif_ok_lsl c_vls_ofs_max_absv_lsl lc_lsl_ofs_adj_ena c_iplsl_gain ip_fac_cor_iplsl_prs_ex ip_lamb_ls_up ldp_prs_ex_ip_fac_cor_iplsl ldp_vls_cor_mv_ip_lamb_ls_up c_t_dly_lsl_ofs_adj c_t_dly_lsl_ofs_adj_is /end DEF_CHARACTERISTIC
 /begin OUT_MEASUREMENT lamb_ls_up_mv lamb_ls_up_min egcp[0].egcp_struct_adcprlsl1.vls_ofs_tmp_old_lsl egcp[0].egcp_struct_adcprlsl1.vls_ofs_lsl egcp[0].egcp_struct_adcprlsl1.iplsl_cor egcp[0].egcp_struct_adcprlsl1.vls_mv_lsl_buf egcp[0].egcp_struct_adcprlsl1.t_wait_lsl_ofs_adj egcp[0].egcp_struct_adcprlsl1.t_dly_lamb_sti_off_ofs_adj egcp[0].egcp_struct_adcprlsl1.vls_cor_h_res_lsl egcp[0].egcp_struct_adcprlsl1.vls_mv_lsl egcp[0].egcp_struct_adcprlsl1.vls_mmv_lsl egcp[0].egcp_struct_adcprlsl1.vls_cor_mv_lsl egcp[0].egcp_struct_adcprlsl1.vls_cor_tmp_lsl egcp[0].egcp_struct_adcprlsl1.lamb_ls_up egcp[0].egcp_struct_adcprlsl1.vls_cor_lsl egcp[0].egcp_struct_adcprlsl1.ctr_vls_mv_lsl_nr_sample egcp[0].egcp_struct_adcprlsl1.ctr_err_lsl_if_spi_ofs_adj_save egcp[0].egcp_struct_adcprlsl1.state_lsl_ofs_adj egcp[0].egcp_struct_adcprlsl1.t_dly_lsl_ofs_adj egcp[0].egcp_struct_adcprlsl1.lv_lsl_ofs_adj_act egcp[0].egcp_struct_adcprlsl1.lv_lsl_ofs_act_ast egcp[0].egcp_struct_adcprlsl1.lv_lamb_sti_off_lsl_ofs_adj egcp[0].egcp_struct_adcprlsl1.lv_lsl_ofs_adj_is egcp[0].egcp_struct_adcprlsl1.lv_vls_ofs_lim_lsl egcp[0].egcp_struct_adcprlsl1.lv_vls_ofs_adj_ena_lsl_if egcp[0].egcp_struct_adcprlsl1.lv_lamb_pls_swi_off egcp[0].egcp_struct_adcprlsl1.t_dly_lsl_ofs_adj_is egcp[0].egcp_struct_adcprlsl1.lv_swi_clc_lsl_ofs_adj /end OUT_MEASUREMENT
/end FUNCTION
/begin FUNCTION EGCP_Operability_detection_lsl "_Operability_detection_lsl"
 /begin DEF_CHARACTERISTIC c_crlc_lamb_ls_up_ready c_lamb_de_int_thd_ls_up_ready c_ttip_min_ls_up_ready c_lamb_thd_max_ls_up_ready c_lamb_thd_min_ls_up_ready c_t_lamb_de_int_rst c_maf_int_puc_max_ls_up_ready ldp_tco_st_id_t_dly_chk_ls_up ldp_tco_st_id_t_tout_ls_up id_t_dly_chk_ls_up_ready id_t_tout_ls_up_ready /end DEF_CHARACTERISTIC
 /begin OUT_MEASUREMENT egcp[0].egcp_struct_dtsyslsl0.lamb_de_int_ls_up_ready egcp[0].egcp_struct_dtsyslsl0.t_tout_ls_up_ready egcp[0].egcp_struct_dtsyslsl0.t_dly_chk_ls_up_ready egcp[0].egcp_struct_dtsyslsl0.t_lamb_de_int_rst egcp[0].egcp_struct_dtsyslsl0.lamb_mv_ls_up_ready egcp[0].egcp_struct_dtsyslsl0.lv_ls_up_ready egcp[0].egcp_struct_dtsyslsl0.lv_ls_up_ready_cdn egcp[0].egcp_struct_dtsyslsl0.lv_ls_up_ready_raw /end OUT_MEASUREMENT
/end FUNCTION
/begin FUNCTION EGCP_WRAF_sensor_control "_WRAF_sensor_control"
 /begin DEF_CHARACTERISTIC c_ctr_icplsl_dec c_ctr_icplsl_inc c_ctr_icplsl_thd lc_icplsl_act lc_icplsl_ena_lsl_if lc_iplsl_ctl_ena_man_swi_lsl_if lc_iplsl_ctl_ena_man_lsl_if ldp_lamb_sp_ip_r_it_iplsl c_r_it_iplsl_agi_add c_icplsl_pwl_lsl_if c_vplsl_thd_vnlsl_lim c_t_icplsl_dly_pwl c_ctr_iplsl_ctl_ena_nr_cyc c_ctr_iplsl_ctl_ena_pwm_on c_ctr_iplsl_ctl_ena_pwm_off c_ttip_thd_iplsl_act_ls_up c_t_dly_iplsl_ctl_ena c_t_dly_max_vnlsl_lim_act c_ttip_thd_icplsl_inc_ls_up c_lamb_thd_max_vnlsl_lim c_lamb_thd_max_vplsl_lim c_lamb_sp_min_iplsl_ctl_ena c_lamb_sp_max_iplsl_ctl_ena ldp_r_it_ls_up_ip_r_it_iplsl ldp_ttip_ls_ip_ctr_icplsl_thd ldp_icplsl_ip_ctr_icplsl_thd ldp_lamb_ip_icplsl_iplsl_ena ldp_lamb_sp_ip_icplsl_iplsl_di ldp_lamb_sp_ip_icplsl_wup ldp_saf_kgh_ip_icplsl_iplsl_di ldp_saf_kgh_ip_icplsl_wup ip_r_it_iplsl id_ctr_icplsl_thd ip_lsl_if_icplsl_iplsl_ctl_ena id_lsl_if_icplsl_iplsl_ctl_di id_lsl_if_icplsl_wup c_r_it_iplsl_agi_fac /end DEF_CHARACTERISTIC
 /begin OUT_MEASUREMENT egcp[0].egcp_struct_acctlifa0.ctr_icplsl egcp[0].egcp_struct_acctlifa0.ctr_icplsl_max egcp[0].egcp_struct_acctlifa0.t_icplsl_dly_pwl egcp[0].egcp_struct_acctlifa0.lamb_thd_vplsl_lim egcp[0].egcp_struct_acctlifa0.lamb_thd_tmp_vplsl_lim egcp[0].egcp_struct_acctlifa0.t_dly_vnlsl_lim_act egcp[0].egcp_struct_acctlifa0.r_it_iplsl egcp[0].egcp_struct_acctlifa0.vplsl egcp[0].egcp_struct_acctlifa0.t_dly_iplsl_ctl_ena egcp[0].egcp_struct_acctlifa0.icplsl_lsl_if egcp[0].egcp_struct_acctlifa0.ctr_iplsl_ctl_ena_nr_cyc egcp[0].egcp_struct_acctlifa0.ctr_iplsl_ctl_ena_pwm_on egcp[0].egcp_struct_acctlifa0.ctr_iplsl_ctl_ena_pwm_off egcp[0].egcp_struct_acctlifa0.lv_icplsl_ena_lsl_if egcp[0].egcp_struct_acctlifa0.lv_icplsl_vld egcp[0].egcp_struct_acctlifa0.lv_iplsl_ctl_ena_lsl_if egcp[0].egcp_struct_acctlifa0.lv_iplsl_ctl_inh_vplsl_lim egcp[0].egcp_struct_acctlifa0.lv_iplsl_vld egcp[0].egcp_struct_acctlifa0.lv_iplsl_ctl_ena_pls_act egcp[0].egcp_struct_acctlifa0.lv_lamb_ls_up_vld egcp[0].egcp_struct_acctlifa0.lv_iplsl_ctl_inh_vnlsl_lim egcp[0].egcp_struct_acctlifa0.lv_vplsl_lim_act /end OUT_MEASUREMENT
/end FUNCTION
/begin FUNCTION EGCP_WRAF_GAIN_AD_fuel_cut_off "_WRAF_GAIN_AD_fuel_cut_off"
 /begin DEF_CHARACTERISTIC c_tam_max_lsl_gain_ad c_amp_min_lsl_gain_ad c_tco_min_lsl_gain_ad c_ttip_max_lsl_gain_ad c_ttip_min_lsl_gain_ad c_n_32_max_lsl_gain_ad c_n_32_min_lsl_gain_ad c_crlc_iplsl_cor_fcut c_crlc_iplsl_mv_vld c_iplsl_vari_thd_max_purge c_iplsl_vari_thd_min_purge c_t_acq_iplsl_purge c_iplsl_cor_grd_thd_fcut c_fac_iplsl_cor_thd_fcut c_fac_lsl_gain_ad_lim_max c_fac_lsl_gain_ad_lim_min c_iplsl_mv_vld_vari_max c_nr_gear_min_lsl_gain_ad lc_fac_lsl_gain_ad_lim_rst lc_fac_lsl_gain_ad_ena lc_map_puc_lim_req_lsl_gain_ad lc_map_puc_lim_act_not_vld lc_lsl_gain_ad_test ldp_amp_ip_fac_cor_iplsl_amp ldp_maf_kgh_ip_fac_cor_iplsl ldp_n_32_ip_fac_cor_iplsl ldp_ttip_mes_ls_up_ip_fac_iplsl ldp_iplsl_chg_purge_ip_iplsl ip_fac_cor_iplsl_amp ip_fac_cor_iplsl_maf_kgh ip_fac_cor_iplsl_n_32 ip_fac_cor_iplsl_ttip_mes_ls_up ip_fac_cor_iplsl_chg_purge lc_lsl_gain_ad_ena lc_fac_lsl_gain_ad_man_adj_ena c_iplsl_nom_purge c_fac_lsl_gain_ad_man_adj /end DEF_CHARACTERISTIC
 /begin OUT_MEASUREMENT lv_map_puc_lim_req_lsl_gain_ad egcp[0].egcp_struct_adcprlsl2.iplsl_cor_mmv_fcut egcp[0].egcp_struct_adcprlsl2.iplsl_purge egcp[0].egcp_struct_adcprlsl2.iplsl_mv_purge egcp[0].egcp_struct_adcprlsl2.iplsl_cor_beg_purge egcp[0].egcp_struct_adcprlsl2.iplsl_cor_chg_purge egcp[0].egcp_struct_adcprlsl2.iplsl_mmv_vld_fcut egcp[0].egcp_struct_adcprlsl2.iplsl_vari_vld_fcut egcp[0].egcp_struct_adcprlsl2.iplsl_vari_purge egcp[0].egcp_struct_adcprlsl2.fac_lsl_gain_ad egcp[0].egcp_struct_adcprlsl2.t_acq_iplsl_purge egcp[0].egcp_struct_adcprlsl2.state_iplsl_ad_fcut egcp[0].egcp_struct_adcprlsl2.state_iplsl_gain_ad egcp[0].egcp_struct_adcprlsl2.lv_lsl_gain_ad_req egcp[0].egcp_struct_adcprlsl2.lv_lsl_gain_ad_req_vld egcp[0].egcp_struct_adcprlsl2.lv_iplsl_vld_fcut egcp[0].egcp_struct_adcprlsl2.lv_lsl_fcut_mes_rep_inh egcp[0].egcp_struct_adcprlsl2.lv_lsl_fcut_mes_not_plaus egcp[0].egcp_struct_adcprlsl2.lv_lsl_gain_ad_fcut_not_ok egcp[0].egcp_struct_adcprlsl2.lv_fac_lsl_gain_ad_lim_max egcp[0].egcp_struct_adcprlsl2.lv_fac_lsl_gain_ad_lim_min /end OUT_MEASUREMENT
/end FUNCTION
/begin FUNCTION EGCP_Air_fuel_cycle_evaluation "_Air_fuel_cycle_evaluation" /begin DEF_CHARACTERISTIC c_vls_afr_thd c_vls_afl_thd ip_t_afl_lock /end DEF_CHARACTERISTIC
 /begin OUT_MEASUREMENT egcp[0].egcp_struct_ispclls0.ctr_afl_cyc egcp[0].egcp_struct_ispclls0.t_afr_cyc egcp[0].egcp_struct_ispclls0.t_afl_cyc egcp[0].egcp_struct_ispclls0.t_afl_cyc_hld egcp[0].egcp_struct_ispclls0.t_afl_lock egcp[0].egcp_struct_ispclls0.lv_afl /end OUT_MEASUREMENT
/end FUNCTION
/begin FUNCTION EGCP_WRAF_GAIN_AD_fuel_cutoff_AI "_A_I_WRAF_GAIN_AD_fuel_cut_off" /begin DEF_CHARACTERISTIC lc_inh_lsl_gain_ad_swi_man /end DEF_CHARACTERISTIC /begin OUT_MEASUREMENT egcp[0].egcp_struct_adcprlsli2.lv_inh_lsl_gain_ad /end OUT_MEASUREMENT /end FUNCTION
/begin FUNCTION EGCP_A_I_upstream_ls_heater_mng "_A_I_upstream_ls_heater_mng"
 /begin DEF_CHARACTERISTIC ip_temp_ini_ls_up lc_lsh_ctl_cll_lsh_up[0] lc_lsh_up[0] ldp_tco_st_1_egcp ldp_tia_thr_st_1_egcp /end DEF_CHARACTERISTIC
 /begin OUT_MEASUREMENT egcp[0].egcp_struct_acctllshi0.temp_ini_ls_up egcp[0].egcp_struct_acctllshi0.lshpwm_ext_ls_up egcp[0].egcp_struct_acctllshi0.lv_inh_lsh_ctl_cll_lsh_up egcp[0].egcp_struct_acctllshi0.lv_inh_lsh_up /end OUT_MEASUREMENT
/end FUNCTION
/begin FUNCTION EGCP_A_I_downstream_ls_heat_mng "_A_I_downstream_ls_heat_mng"
 /begin DEF_CHARACTERISTIC lc_lsh_down[0] ldpm_tco_st_1_egcp ldpm_tia_thr_st_1_egcp ip_temp_ini_ls_down /end DEF_CHARACTERISTIC
 /begin OUT_MEASUREMENT egcp[0].egcp_struct_acctllshdi0.temp_ini_ls_down egcp[0].egcp_struct_acctllshdi0.lshpwm_ext_ls_down egcp[0].egcp_struct_acctllshdi0.lv_inh_lsh_down /end OUT_MEASUREMENT
/end FUNCTION
/begin FUNCTION C_2_EGCP "C_2_EGCP"
 /begin SUB_FUNCTION EGCP_Exhaust_gas_composition EGCP_Sig_ACQ_cyl_individual_LAM EGCP_WRAF_interface_ATIC42 EGCP_ACQ_ls_V_LAMB_model_value /end SUB_FUNCTION
/end FUNCTION
/begin FUNCTION EGCP_Exhaust_gas_composition "_Exhaust_gas_composition"
 /begin OUT_MEASUREMENT egcp[0].egcp_struct_ifinf0.vls_up egcp[0].egcp_struct_ifinf0.vls_down /end OUT_MEASUREMENT
/end FUNCTION
/begin FUNCTION EGCP_Sig_ACQ_cyl_individual_LAM "_Sig_ACQ_cyl_individual_LAM"
 /begin OUT_MEASUREMENT vls_up_cyl_sel[0] vls_up_cyl_sel[1] vls_up_cyl_sel[2] vls_up_cyl_sel[3] ctr_vls_up_cyl_sel_trig[0] ctr_vls_up_cyl_sel_trig[1] ctr_vls_up_cyl_sel_trig[2] ctr_vls_up_cyl_sel_trig[3] /end OUT_MEASUREMENT
/end FUNCTION
/begin FUNCTION EGCP_WRAF_interface_ATIC42 "_WRAF_interface_ATIC42"
 /begin OUT_MEASUREMENT egcp[0].egcp_struct_sigcvif1.state_lsl_if_spi_rd egcp[0].egcp_struct_sigcvif1.state_lsl_if_conf_spi_rd egcp[0].egcp_struct_sigcvif1.ctr_err_lsl_if_spi_wr egcp[0].egcp_struct_sigcvif1.frq_r_it_osc_lsl_if_spi_rd egcp[0].egcp_struct_sigcvif1.state_err_vnlsl egcp[0].egcp_struct_sigcvif1.state_err_vglsl egcp[0].egcp_struct_sigcvif1.state_err_viplsl egcp[0].egcp_struct_sigcvif1.state_err_vrclsl egcp[0].egcp_struct_sigcvif1.state_err_iplsl egcp[0].egcp_struct_sigcvif1.state_err_lsl egcp[0].egcp_struct_sigcvif1.lv_lsl_deac egcp[0].egcp_struct_sigcvif1.lv_vplsl_lim egcp[0].egcp_struct_sigcvif1.lv_vnlsl_lim egcp[0].egcp_struct_sigcvif1.ctr_err_lsl_if_spi_it_osc_ena /end OUT_MEASUREMENT
/end FUNCTION
/begin FUNCTION EGCP_ACQ_ls_V_LAMB_model_value "_ACQ_ls_V_LAMB_model_value"
 /begin OUT_MEASUREMENT egcp[0].egcp_struct_sigcvlsl2.lamb_sp_fil_delta_rise egcp[0].egcp_struct_sigcvlsl2.lamb_sp_fil_delta_fall egcp[0].egcp_struct_sigcvlsl2.vls_up_delta_rise egcp[0].egcp_struct_sigcvlsl2.vls_up_delta_fall /end OUT_MEASUREMENT
/end FUNCTION
/begin FUNCTION C_4_EGCP "C_4_EGCP"
 /begin DEF_CHARACTERISTIC ldpm_t_afl_cyc_hld_1_egcp ldpm_maf_kgh_1_egcp ldpm_maf_kgh_3_egcp /end DEF_CHARACTERISTIC
 /begin SUB_FUNCTION EGCP_Downstream_ls_R_det EGCP_ls_ceramic_temperature EGCP_WRAF_IF_BSW_ASW_ATIC42 EGCP_Appl_Inc_ATIC42_ASW_BSW_IF EGCP_Appl_Inc_ls_temperature EGCP_Appl_Inc_downst_ls_intern_R /end SUB_FUNCTION
/end FUNCTION
/begin FUNCTION EGCP_Downstream_ls_R_det "_Downstream_ls_R_det"
 /begin DEF_CHARACTERISTIC c_temp_cur_pump_on_ls_down c_t_cur_pump_on_ls_down c_t_cur_pump_off_ls_down c_t_dly_cur_pump_ls_down c_vls_down_mmv_min_rng_bol_r_it c_vls_down_mmv_min_rng_tol_r_it c_vls_down_mmv_drv1_thd_min c_vls_down_mmv_drv1_thd_max c_fac_vls_down_mmv_drv1_thd c_ctr_afl_cyc_min_ri_it_ls_down c_maf_kgh_max_r_it_ls_down c_fac_vls_down_mmv_drv1_thd_min c_fac_r_it_err_neg_ls_down c_fac_r_it_err_pos_ls_down c_crlc_pow_mmv_lsh_down c_crlc_ttip_fall_r_it_ls_down c_crlc_ttip_rise_r_it_ls_down lc_r_it_vld_inh_ls_down ip_crlc_ttip_ref_mdl_ls_down ldp_ttip_ref_mdl_mmv_ls_down_r ip_fac_t_drv1_vls_down_mmv ip_fac_t_vls_down_mmv_drv1_abs ip_r_it_mdl_ls_down_new ip_ttip_mes_ls_down ldp_pow_mmv_lsh_down_ip_ls_down ldp_r_it_mes_ls_down_ip_ls_down c_vls_down_mmv_drv1_abs_max /end DEF_CHARACTERISTIC
 /begin OUT_MEASUREMENT egcp[0].egcp_struct_sigcvrid0.vls_down_mmv_drv1_thd_min egcp[0].egcp_struct_sigcvrid0.vls_down_mmv_drv1_thd_max egcp[0].egcp_struct_sigcvrid0.ttip_mes_ls_down egcp[0].egcp_struct_sigcvrid0.ttip_mes_tol_ls_down egcp[0].egcp_struct_sigcvrid0.ttip_mes_bol_ls_down egcp[0].egcp_struct_sigcvrid0.ttip_mes_tol_mmv_ls_down egcp[0].egcp_struct_sigcvrid0.ttip_mes_bol_mmv_ls_down egcp[0].egcp_struct_sigcvrid0.ctr_cycnr_r_it_ls_down_vld egcp[0].egcp_struct_sigcvrid0.pow_mmv_lsh_down egcp[0].egcp_struct_sigcvrid0.r_it_ls_down egcp[0].egcp_struct_sigcvrid0.r_it_mes_ls_down egcp[0].egcp_struct_sigcvrid0.r_it_mdl_ls_down_new egcp[0].egcp_struct_sigcvrid0.t_sample_r_it_ls_down egcp[0].egcp_struct_sigcvrid0.ttip_ref_mdl_mmv_ls_down egcp[0].egcp_struct_sigcvrid0.vls_down_cur_pump_on egcp[0].egcp_struct_sigcvrid0.vls_down_cur_pump_off egcp[0].egcp_struct_sigcvrid0.fac_t_vls_down_mmv_drv1 egcp[0].egcp_struct_sigcvrid0.fac_t_vls_down_mmv_drv1_abs egcp[0].egcp_struct_sigcvrid0.t_afl_cyc_hld_ri_it_ls_down egcp[0].egcp_struct_sigcvrid0.lv_r_it_req_ls_down egcp[0].egcp_struct_sigcvrid0.lv_r_it_det_ls_down egcp[0].egcp_struct_sigcvrid0.lv_vls_down_drv1_cdn_r_ls egcp[0].egcp_struct_sigcvrid0.lv_vls_down_rng_cdn_r_ls /end OUT_MEASUREMENT
/end FUNCTION
/begin FUNCTION EGCP_ls_ceramic_temperature "_ls_ceramic_temperature"
 /begin DEF_CHARACTERISTIC ldp_r_it_ls_up_ip_ttip_ls_up ip_ttip_mes_ls_up c_t_dly_ofs_adj_r_it_ls_up c_t_dly_fac_gain_r_it_ls_up c_t_dly_clc_r_it_ls_up c_t_dly_ofs_mes_r_it_ls_up c_t_max_v_ofs_adj_r_it_ls_up c_t_max_fac_gain_r_it_ls_up c_t_max_v_ofs_mes_r_it_ls_up c_v_dif_max_ofs_adj_r_it_ls_up c_v_dif_max_ofs_mes_r_it_ls_up lc_r_rng_req_ls_up_lsl_if lc_r_rng_req_swi_ls_up_lsl_if c_fac_gain_r_it_ls_up c_r_it_ref_ls_up c_fac_gain_h_dif_r_it_ls_up c_fac_gain_h_r_it_ls_up c_fac_gain_l_dif_r_it_ls_up c_fac_gain_l_r_it_ls_up c_v_ofs_ref_r_it_ls_up c_frq_r_it_osc_lsl_if lc_v_ref_r_it_ls_up /end DEF_CHARACTERISTIC
 /begin OUT_MEASUREMENT egcp[0].egcp_struct_sigcvtipa0.ttip_mes_ls_up egcp[0].egcp_struct_sigcvtipa0.r_it_ls_up egcp[0].egcp_struct_sigcvtipa0.tcc_v_ofs_mes_r_it_ls_up egcp[0].egcp_struct_sigcvtipa0.tcc_v_ofs_adj_r_it_ls_up egcp[0].egcp_struct_sigcvtipa0.tcc_fac_gain_h_r_it_ls_up egcp[0].egcp_struct_sigcvtipa0.tcc_fac_gain_l_r_it_ls_up egcp[0].egcp_struct_sigcvtipa0.tcc_err_v_ofs_mes_r_it_ls_up egcp[0].egcp_struct_sigcvtipa0.tcc_err_v_ofs_adj_r_it_ls_up egcp[0].egcp_struct_sigcvtipa0.tcc_err_fac_gain_h_r_ls_up egcp[0].egcp_struct_sigcvtipa0.tcc_err_fac_gain_l_r_ls_up egcp[0].egcp_struct_sigcvtipa0.v_ofs_adj_r_it_ls_up egcp[0].egcp_struct_sigcvtipa0.v_ofs_mes_r_it_ls_up egcp[0].egcp_struct_sigcvtipa0.fac_gain_h_r_it_ls_up egcp[0].egcp_struct_sigcvtipa0.fac_gain_l_r_it_ls_up egcp[0].egcp_struct_sigcvtipa0.frq_r_it_osc_lsl_if_spi_wr egcp[0].egcp_struct_sigcvtipa0.state_ttip_mes_ls_up egcp[0].egcp_struct_sigcvtipa0.lv_fac_gain_h_vld_r_it_ls_up egcp[0].egcp_struct_sigcvtipa0.lv_fac_gain_l_vld_r_it_ls_up egcp[0].egcp_struct_sigcvtipa0.lv_r_it_cal_ena_lsl_if egcp[0].egcp_struct_sigcvtipa0.lv_r_it_osc_ena_lsl_if egcp[0].egcp_struct_sigcvtipa0.lv_r_it_swi_rng_lsl_if egcp[0].egcp_struct_sigcvtipa0.lv_ttip_mes_vld_ls_up egcp[0].egcp_struct_sigcvtipa0.lv_v_ofs_adj_vld_r_it_ls_up egcp[0].egcp_struct_sigcvtipa0.lv_v_ofs_mes_vld_r_it_ls_up egcp[0].egcp_struct_sigcvtipa0.lv_v_ref_vld_r_it_ls_up egcp[0].egcp_struct_sigcvtipa0.lv_r_it_req_ls_up /end OUT_MEASUREMENT
/end FUNCTION
/begin FUNCTION EGCP_WRAF_IF_BSW_ASW_ATIC42 "_WRAF_IF_BSW_ASW_ATIC42" /begin DEF_CHARACTERISTIC c_state_lsl_if_spi_wr_ini c_state_lsl_if_conf_spi_wr_ini /end DEF_CHARACTERISTIC
 /begin OUT_MEASUREMENT egcp[0].egcp_struct_sigcvif2.state_lsl_if_spi_wr egcp[0].egcp_struct_sigcvif2.state_lsl_if_conf_spi_wr egcp[0].egcp_struct_sigcvif2.lv_lsl_if_spi_rst_end /end OUT_MEASUREMENT
/end FUNCTION
/begin FUNCTION EGCP_Appl_Inc_ATIC42_ASW_BSW_IF "_Appl_Inc_ATIC42_ASW_BSW_IF" /begin DEF_CHARACTERISTIC c_t_dly_di_lsl_if /end DEF_CHARACTERISTIC
 /begin OUT_MEASUREMENT egcp[0].egcp_struct_sigcvifi2.t_dly_di_lsl_if egcp[0].egcp_struct_sigcvifi2.lv_lsl_ena_lsl_if egcp[0].egcp_struct_sigcvifi2.lv_lsl_if_rst egcp[0].egcp_struct_sigcvifi2.lv_swi_gain_lsl_if egcp[0].egcp_struct_sigcvifi2.lv_lsl_ena_tmp_lsl_if /end OUT_MEASUREMENT
/end FUNCTION
/begin FUNCTION EGCP_Appl_Inc_ls_temperature "_Appl_Inc_ls_temperature" /begin OUT_MEASUREMENT egcp[0].egcp_struct_sigcvtipai0.lv_inh_ttip_ls_up /end OUT_MEASUREMENT /end FUNCTION
/begin FUNCTION EGCP_Appl_Inc_downst_ls_intern_R "_Appl_Inc_ls_internal_R" /end FUNCTION
/begin FUNCTION C_A_EGCP "C_A_EGCP"
 /begin SUB_FUNCTION EGCP_Upst_ls_heat_OBDI_diag EGCP_Downst_ls_sig_mon EGCP_Downst_ls_heat_OBDI_diag EGCP_Signal_plausibily_mon EGCP_HW_based_DIAG_ATIC42 EGCP_WRAF_sensor_ctl_DIAG EGCP_A_I_WRAF_sens_electric_DIAG EGCP_A_I_WRAF_sens_ctl_DIAG EGCP_A_I_upst_ls_heat_OBDI_DIAG EGCP_downst_ls_heat_OBDI_DIAG_AI EGCP_A_I_downst_ls_probe_DIAG /end SUB_FUNCTION
/end FUNCTION
/begin FUNCTION EGCP_Upst_ls_heat_OBDI_diag "_Upstream_ls_heat_OBDI_diag"
 /begin DEF_CHARACTERISTIC c_lshpwm_max_diag_lsh_up c_teg_dyn_min_diag_lsh_up c_lshpwm_min_diag_lsh_up /end DEF_CHARACTERISTIC
 /begin OUT_MEASUREMENT egcp[0].egcp_struct_outdglsh0.err_diag_lsh_up egcp[0].egcp_struct_outdglsh0.cdn_diag_lsh_up egcp[0].egcp_struct_outdglsh0.lv_lsh_scg_act_lsh_up lv_err_lsh_up_1 /end OUT_MEASUREMENT
/end FUNCTION
/begin FUNCTION EGCP_Downst_ls_sig_mon "_Downstream_ls_sig_mon"
 /begin DEF_CHARACTERISTIC c_ctr_min_diag_scg_ls_down c_maf_kgh_min_diag_scg_ls_down c_vls_thd_diag_scp_ls_down c_r_it_max_diag_scg_ls_down c_r_it_min_diag_oc_ls_down c_t_cdn_diag_oc_ls_down c_t_dly_diag_oc_ls_down c_t_dly_diag_scg_ls_down c_teg_cat_min_diag_oc_ls_down c_vls_thd_diag_scg_ls_down c_vls_afl_thd_diag_oc_ls_down c_vls_afr_thd_diag_oc_ls_down /end DEF_CHARACTERISTIC
 /begin OUT_MEASUREMENT egcp[0].egcp_struct_sigdglsd1.t_act_pls_diag_scg_ls_down egcp[0].egcp_struct_sigdglsd1.t_act_pls_diag_oc_ls_down egcp[0].egcp_struct_sigdglsd1.t_cdn_diag_oc_ls_down egcp[0].egcp_struct_sigdglsd1.ctr_r_upd_diag_scg_ls_down egcp[0].egcp_struct_sigdglsd1.ctr_r_upd_diag_oc_ls_down egcp[0].egcp_struct_sigdglsd1.ctr_sym_diag_scg_ls_down egcp[0].egcp_struct_sigdglsd1.lv_err_el_ls_down egcp[0].egcp_struct_sigdglsd1.lv_diag_act_req_ls_down egcp[0].egcp_struct_sigdglsd1.lv_r_it_vld_diag_oc_ls_down egcp[0].egcp_struct_sigdglsd1.lv_t_cdn_diag_oc_ls_down lv_err_scp_ls_down_1 lv_err_scg_ls_down_1 lv_err_oc_ls_down_1 /end OUT_MEASUREMENT
/end FUNCTION
/begin FUNCTION EGCP_Downst_ls_heat_OBDI_diag "_Downstream_ls_heat_OBDI_diag"
 /begin DEF_CHARACTERISTIC c_lshpwm_max_diag_lsh_down c_lshpwm_min_diag_lsh_down c_teg_cat_mdl_down_min_lsh_down /end DEF_CHARACTERISTIC
 /begin OUT_MEASUREMENT egcp[0].egcp_struct_outdglshd0.err_diag_lsh_down egcp[0].egcp_struct_outdglshd0.cdn_diag_lsh_down lv_err_lsh_down_1 /end OUT_MEASUREMENT
/end FUNCTION
/begin FUNCTION EGCP_Signal_plausibily_mon "_Signal_plausibily_mon"
 /begin DEF_CHARACTERISTIC c_maf_int_max_diag_puc_ls_down c_maf_int_max_diag_fl_ls_down c_maf_int_min_diag_puc_ls_down c_maf_int_min_diag_fl_ls_down c_vls_min_diag_puc_ls_down c_vls_max_diag_fl_ls_down /end DEF_CHARACTERISTIC
 /begin OUT_MEASUREMENT egcp[0].egcp_struct_pladglsd2.lv_diag_cdn_plaus_ls_down egcp[0].egcp_struct_pladglsd2.lv_err_plaus_ls_down lv_err_puc_ls_down_1 lv_err_fl_ls_down_1 maf_int_fl /end OUT_MEASUREMENT
/end FUNCTION
/begin FUNCTION EGCP_HW_based_DIAG_ATIC42 "_HW_based_DIAG_ATIC42"
 /begin DEF_CHARACTERISTIC c_ctr_iplsl_sym_diag_lsl_up c_lamb_sp_afr_iplsl_diag_lsl_up c_lamb_sp_afl_iplsl_diag_lsl_up c_t_oc_lsl_diag c_t_vls_up_min_diag_oc_lsl_up c_vls_up_min_diag_oc_lsl_up /end DEF_CHARACTERISTIC
 /begin OUT_MEASUREMENT egcp[0].egcp_struct_sigdglsla0.ctr_iplsl_sym_diag_lsl_up egcp[0].egcp_struct_sigdglsla0.t_diag_oc_lsl_up egcp[0].egcp_struct_sigdglsla0.t_vls_up_min_diag_oc_lsl_up egcp[0].egcp_struct_sigdglsla0.iplsl_sym_diag_lsl_up egcp[0].egcp_struct_sigdglsla0.state_err_el_lsl_up egcp[0].egcp_struct_sigdglsla0.state_diag_oc_lsl_up egcp[0].egcp_struct_sigdglsla0.lv_lsl_up_spi_com_inh egcp[0].egcp_struct_sigdglsla0.lv_diag_iplsl_sym_lsl_up egcp[0].egcp_struct_sigdglsla0.lv_diag_iplsl_cdn_lsl_up egcp[0].egcp_struct_sigdglsla0.lv_diag_oc_if_osc_di_lsl_up egcp[0].egcp_struct_sigdglsla0.lv_vls_up_min_diag_oc_lsl_up lv_err_el_lsl_up_1 lv_err_oc_lsl_up_1 /end OUT_MEASUREMENT
/end FUNCTION
/begin FUNCTION EGCP_WRAF_sensor_ctl_DIAG "_WRAF_sensor_controller_DIAG"
 /begin DEF_CHARACTERISTIC c_ctr_max_spi_com_lsl_up[0] c_t_rst_max_diag_lsl_up_if[0] c_t_end_diag_lsl_up_if[0] /end DEF_CHARACTERISTIC
 /begin OUT_MEASUREMENT egcp[0].egcp_struct_pladgspi0.ctr_err_save_diag_lsl_up_if lv_err_lsl_up_if_1 /end OUT_MEASUREMENT
/end FUNCTION
/end MODULE
/end PROJECT
