ASAP2_VERSION 1 41
/begin PROJECT SN0 "SIMOS PPD"
/begin HEADER "_default_HeaderComment" PROJECT_NO PRJ_NUM /end HEADER
/begin MODULE _default_ModuleName "_default_ModuleLongIdentifier"
/begin MOD_COMMON "_default_ModCommonComment" DEPOSIT ABSOLUTE BYTE_ORDER MSB_FIRST ALIGNMENT_BYTE 1 ALIGNMENT_WORD 2 ALIGNMENT_LONG 4 ALIGNMENT_FLOAT32_IEEE 4 ALIGNMENT_FLOAT64_IEEE 8 /end MOD_COMMON
/begin AXIS_PTS ldpm_n_ip_mf_pf "" 0x84331e n _REC_AXS_20_u2 6375. _CNV_A_R_LINEAR_____5_CM 24 0. 6375. FORMAT "%4.0" /end AXIS_PTS
/begin AXIS_PTS ldpm_n_ip_bpa_egr_sp_fil "" 0x842efe n _REC_AXS_20_u2 6375. _CNV_A_R_LINEAR_____5_CM 6 0. 6375. FORMAT "%4.0" /end AXIS_PTS
/begin MEASUREMENT maf_sp_bas_sub "basic air mass flow setpoint (inj. state GES = 1)" UWORD _CNV_A_R_LINEAR_____60_CM 1 0. 0. 1389. DISPLAY_IDENTIFIER MAF_SP_BAS_SUB ECU_ADDRESS 0x7fa8d8 BYTE_ORDER MSB_LAST FORMAT "%6.2" /end MEASUREMENT
/begin MEASUREMENT maf_sp_bas "basic air mass flow setpoint" UWORD _CNV_A_R_LINEAR_____60_CM 1 0. 0. 1389. DISPLAY_IDENTIFIER MAF_SP_BAS ECU_ADDRESS 0x7fa8da BYTE_ORDER MSB_LAST FORMAT "%6.2" /end MEASUREMENT
/begin MEASUREMENT maf_sp_bas_clc "basic air mass flow setpoint (inj. state GES = 1)" UWORD _CNV_A_R_LINEAR_____60_CM 1 0. 0. 1389. DISPLAY_IDENTIFIER MAF_SP_BAS_CLC ECU_ADDRESS 0x7fa8dc BYTE_ORDER MSB_LAST FORMAT "%6.2" /end MEASUREMENT
/begin MEASUREMENT maf_sp_bas_tco_0 "uncorrected basic air mass flow setpoint (inj. state GES = 0)" UWORD _CNV_A_R_LINEAR_____60_CM 1 0. 0. 1389. DISPLAY_IDENTIFIER MAF_SP_BAS_TCO_0 ECU_ADDRESS 0x7fa8de BYTE_ORDER MSB_LAST FORMAT "%6.2" /end MEASUREMENT
/begin MEASUREMENT maf_sp_bas_0 "basic air mass flow setpoint (inj. state GES = 0)" UWORD _CNV_A_R_LINEAR_____60_CM 1 0. 0. 1389. DISPLAY_IDENTIFIER MAF_SP_BAS_0 ECU_ADDRESS 0x7fa8e0 BYTE_ORDER MSB_LAST FORMAT "%6.2" /end MEASUREMENT
/begin MEASUREMENT maf_sp_bas_tco_1 "uncorrected basic air mass flow setpoint (inj. state GES = 1)" UWORD _CNV_A_R_LINEAR_____60_CM 1 0. 0. 1389. DISPLAY_IDENTIFIER MAF_SP_BAS_TCO_1 ECU_ADDRESS 0x7fa8e2 BYTE_ORDER MSB_LAST FORMAT "%6.2" /end MEASUREMENT
/begin MEASUREMENT maf_sp_bas_1 "basic air mass flow setpoint (inj. state GES = 1)" UWORD _CNV_A_R_LINEAR_____60_CM 1 0. 0. 1389. DISPLAY_IDENTIFIER MAF_SP_BAS_1 ECU_ADDRESS 0x7fa8e4 BYTE_ORDER MSB_LAST FORMAT "%6.2" /end MEASUREMENT
/begin MEASUREMENT maf_sp_rgn "basic air mass flow setpoint (inj. state GES = 1)" UWORD _CNV_A_R_LINEAR_____60_CM 1 0. 0. 1389. DISPLAY_IDENTIFIER MAF_SP_RGN ECU_ADDRESS 0x7fa8e6 BYTE_ORDER MSB_LAST FORMAT "%6.2" /end MEASUREMENT
/begin MEASUREMENT maf_sp_rgn_1 "basic air mass flow setpoint (inj. state GES = 1)" UWORD _CNV_A_R_LINEAR_____60_CM 1 0. 0. 1389. DISPLAY_IDENTIFIER MAF_SP_RGN_1 ECU_ADDRESS 0x7fa8e8 BYTE_ORDER MSB_LAST FORMAT "%6.2" /end MEASUREMENT
/begin MEASUREMENT maf_sp_rgn_2 "basic air mass flow setpoint (inj. state GES = 1)" UWORD _CNV_A_R_LINEAR_____60_CM 1 0. 0. 1389. DISPLAY_IDENTIFIER MAF_SP_RGN_2 ECU_ADDRESS 0x7fa8ea BYTE_ORDER MSB_LAST FORMAT "%6.2" /end MEASUREMENT
/begin MEASUREMENT maf_sp_gen "general MAF_SP without increasing at idle" UWORD _CNV_A_R_LINEAR_____60_CM 1 0. 0. 1389. DISPLAY_IDENTIFIER MAF_SP_GEN ECU_ADDRESS 0x7fa8ec BYTE_ORDER MSB_LAST FORMAT "%6.2" /end MEASUREMENT
/begin MEASUREMENT maf_sp_dyn "dynamic air mass setpoint" SWORD _CNV_A_R_LINEAR_____149_CM 1 0. -694.51 694.489 DISPLAY_IDENTIFIER MAF_SP_DYN ECU_ADDRESS 0x7fa8ee BYTE_ORDER MSB_LAST FORMAT "%5.2" /end MEASUREMENT
/begin MEASUREMENT maf_sp_clc_sub "air mass flow setpoint including idle correction" UWORD _CNV_A_R_LINEAR_____60_CM 1 0. 0. 1389. DISPLAY_IDENTIFIER MAF_SP_CLC_SUB ECU_ADDRESS 0x7fa8f0 BYTE_ORDER MSB_LAST FORMAT "%6.2" /end MEASUREMENT
/begin MEASUREMENT lv_act_maf_sp_is "active air mass flow setpoint during idle speed" UBYTE _CNV_S_2_RANGE______11_CM 1 0. 0. 1. DISPLAY_IDENTIFIER LV_ACT_MAF_SP_IS ECU_ADDRESS 0x7fb873 /end MEASUREMENT
/begin MEASUREMENT maf_sp_sub "air mass flow setpoint" UWORD _CNV_A_R_LINEAR_____60_CM 1 0. 0. 1389. DISPLAY_IDENTIFIER MAF_SP_SUB ECU_ADDRESS 0x7f997a BYTE_ORDER MSB_LAST FORMAT "%6.2" /end MEASUREMENT
/begin MEASUREMENT maf_sp_mmv_sub "moving mean value of the air mass flow setpoint" UWORD _CNV_A_R_LINEAR_____60_CM 1 0. 0. 1389. DISPLAY_IDENTIFIER MAF_SP_MMV_SUB ECU_ADDRESS 0x7f997c BYTE_ORDER MSB_LAST FORMAT "%6.2" /end MEASUREMENT
/begin MEASUREMENT lv_cdn_maf_on_dly "delayed MAF controller enable" UBYTE _CNV_S_2_RANGE______11_CM 1 0. 0. 1. DISPLAY_IDENTIFIER LV_CDN_MAF_ON_DLY ECU_ADDRESS 0x7fb874 /end MEASUREMENT
/begin CHARACTERISTIC c_maf_sp_cor_dev "basic air mass flow setpoint: add. value for development" VALUE 0x84fdbc _REC_VAL_20_s2 2777.957611 _CNV_A_R_LINEAR_____150_CM -1389. 1388.957611 DISPLAY_IDENTIFIER C_MAF_SP_COR_DEV FORMAT "%6.2" /end CHARACTERISTIC
/begin CHARACTERISTIC lc_maf_sp_dev "activation button for air mass flow setpoint correction" VALUE 0x850153 _REC_VAL_20_u1 1. _CNV_A_R_LINEAR_____0_CM 0. 1. DISPLAY_IDENTIFIER LC_MAF_SP_DEV FORMAT "%1.0" /end CHARACTERISTIC
/begin CHARACTERISTIC c_fac_maf_sp_dev "basic air mass flow setpoint: factor for development" VALUE 0x84fd30 _REC_VAL_20_u2 1.99996948242188 _CNV_A_R_LINEAR_____102_CM 0. 1.99996948242188 DISPLAY_IDENTIFIER C_FAC_MAF_SP_DEV FORMAT "%6.5" /end CHARACTERISTIC
/begin CHARACTERISTIC lc_maf_sp_dyn_on "button for dynamic MAF_SP" VALUE 0x850154 _REC_VAL_20_u1 1. _CNV_A_R_LINEAR_____0_CM 0. 1. DISPLAY_IDENTIFIER LC_MAF_SP_DYN_ON FORMAT "%1.0" /end CHARACTERISTIC
/begin CHARACTERISTIC c_maf_sp_thd_maf_sp_dyn "setpoint threshold for MAF_SP_DYN" VALUE 0x84fdc4 _REC_VAL_20_u2 1389. _CNV_A_R_LINEAR_____60_CM 0. 1389. DISPLAY_IDENTIFIER C_MAF_SP_THD_MAF_SP_DYN FORMAT "%6.2" /end CHARACTERISTIC
/begin CHARACTERISTIC c_t2_dt1_maf_sp "time value for dynamic MAF_SP calculation" VALUE 0x84ff18 _REC_VAL_20_u2 4.19424 _CNV_A_R_LINEAR_____64_CM 0. 4.19424 DISPLAY_IDENTIFIER C_T2_DT1_MAF_SP FORMAT "%6.5" /end CHARACTERISTIC
/begin CHARACTERISTIC c_maf_sp_dyn_max "maximum of the dynamic air mass flow setpoint" VALUE 0x84fdbe _REC_VAL_20_s2 1388.979 _CNV_A_R_LINEAR_____151_CM -694.5 694.479 DISPLAY_IDENTIFIER C_MAF_SP_DYN_MAX FORMAT "%5.2" /end CHARACTERISTIC
/begin CHARACTERISTIC c_maf_sp_dyn_min "minimum of the dynamic air mass flow setpoint" VALUE 0x84fdc0 _REC_VAL_20_s2 1388.979 _CNV_A_R_LINEAR_____151_CM -694.5 694.479 DISPLAY_IDENTIFIER C_MAF_SP_DYN_MIN FORMAT "%5.2" /end CHARACTERISTIC
/begin CHARACTERISTIC c_fac_maf_sp_is_fil "filter factor for MAF_SP increasing in idle" VALUE 0x84fd36 _REC_VAL_20_u2 0.9999847412109381 _CNV_A_R_LINEAR_____14_CM 0. 0.9999847412109381 DISPLAY_IDENTIFIER C_FAC_MAF_SP_IS_FIL FORMAT "%6.5" /end CHARACTERISTIC
/begin CHARACTERISTIC c_t_maf_sp_is "delay time for MAF_SP increasing in idle" VALUE 0x84ffb2 _REC_VAL_20_u2 6553.5 _CNV_A_R_LINEAR_____19_CM 0. 6553.5 DISPLAY_IDENTIFIER C_T_MAF_SP_IS FORMAT "%5.1" /end CHARACTERISTIC
/begin CHARACTERISTIC c_maf_sp_man "manual air mass flow setpoint" VALUE 0x84fdc2 _REC_VAL_20_u2 1389. _CNV_A_R_LINEAR_____60_CM 0. 1389. DISPLAY_IDENTIFIER C_MAF_SP_MAN FORMAT "%6.2" /end CHARACTERISTIC
/begin CHARACTERISTIC lc_maf_sp_man "button for manual MAF_SP" VALUE 0x850155 _REC_VAL_20_u1 1. _CNV_A_R_LINEAR_____0_CM 0. 1. DISPLAY_IDENTIFIER LC_MAF_SP_MAN FORMAT "%1.0" /end CHARACTERISTIC
/begin CHARACTERISTIC c_fac_maf_sp_fil "filter factor for MAF_SP" VALUE 0x84fd32 _REC_VAL_20_u2 0.9999847412109381 _CNV_A_R_LINEAR_____14_CM 0. 0.9999847412109381 DISPLAY_IDENTIFIER C_FAC_MAF_SP_FIL FORMAT "%6.5" /end CHARACTERISTIC
/begin CHARACTERISTIC c_fac_maf_sp_fil_ini "initial filter factor for MAF_SP" VALUE 0x84fd34 _REC_VAL_20_u2 0.9999847412109381 _CNV_A_R_LINEAR_____14_CM 0. 0.9999847412109381 DISPLAY_IDENTIFIER C_FAC_MAF_SP_FIL_INI FORMAT "%6.5" /end CHARACTERISTIC
/begin CHARACTERISTIC ip_fac_tran_maf_sp_0 "AGE_MSP: transition factor for the basic air mass flow setpoints (inj. region 0)" CURVE 0x848474 _REC_CUR_20_u2_u1 1.99996948242188 _CNV_A_R_LINEAR_____102_CM 0. 1.99996948242188 DISPLAY_IDENTIFIER IP_FAC_TRAN_MAF_SP_0 FORMAT "%6.5"
 /begin AXIS_DESCR COM_AXIS tco _CNV_A_R_LINEAR_____18_CM 8 -50. 205. FORMAT "%3.0" AXIS_PTS_REF ldp_tco_ip_fac_tran_maf_sp_0 /end AXIS_DESCR
/end CHARACTERISTIC
/begin AXIS_PTS ldp_tco_ip_fac_tran_maf_sp_0 "" 0x842341 tco _REC_AXS_20_u1 255. _CNV_A_R_LINEAR_____18_CM 8 -50. 205. FORMAT "%3.0" /end AXIS_PTS
/begin CHARACTERISTIC ip_fac_maf_sp_cor_amp_0 "AGE_MSP: air mass flow correction factor for ambient pressure (inj. region GES = 0)" CURVE 0x8480ee _REC_CUR_20_u2_u2 0.9999847412109381 _CNV_A_R_LINEAR_____14_CM 0. 0.9999847412109381 DISPLAY_IDENTIFIER IP_FAC_MAF_SP_COR_AMP_0 FORMAT "%6.5"
 /begin AXIS_DESCR COM_AXIS amp _CNV_A_R_LINEAR_____45_CM 8 0. 5434. FORMAT "%6.2" AXIS_PTS_REF ldp_amp_ip_fac_maf_sp_cor_0 /end AXIS_DESCR
/end CHARACTERISTIC
/begin AXIS_PTS ldp_amp_ip_fac_maf_sp_cor_0 "" 0x841106 amp _REC_AXS_20_u2 5434. _CNV_A_R_LINEAR_____45_CM 8 0. 5434. FORMAT "%6.2" /end AXIS_PTS
/begin CHARACTERISTIC ip_fac_maf_sp_cor_tgas_0 "AGE_MSP: air mass flow correction factor for temperature of the intake gas (inj. region GES = 0)" CURVE 0x848116 _REC_CUR_20_u2_u1 0.9999847412109381 _CNV_A_R_LINEAR_____14_CM 0. 0.9999847412109381 DISPLAY_IDENTIFIER IP_FAC_MAF_SP_COR_TGAS_0 FORMAT "%6.5"
 /begin AXIS_DESCR COM_AXIS tgas _CNV_A_R_LINEAR_____18_CM 8 -50. 205. FORMAT "%3.0" AXIS_PTS_REF ldp_tgas_ip_fac_maf_sp_cor_0 /end AXIS_DESCR
/end CHARACTERISTIC
/begin AXIS_PTS ldp_tgas_ip_fac_maf_sp_cor_0 "" 0x8424be tgas _REC_AXS_20_u1 255. _CNV_A_R_LINEAR_____18_CM 8 -50. 205. FORMAT "%3.0" /end AXIS_PTS
/begin CHARACTERISTIC ip_fac_tran_maf_sp_1 "AGE_MSP: transition factor for the basic air mass flow setpoints (inj. region 1)" CURVE 0x848484 _REC_CUR_20_u2_u1 1.99996948242188 _CNV_A_R_LINEAR_____102_CM 0. 1.99996948242188 DISPLAY_IDENTIFIER IP_FAC_TRAN_MAF_SP_1 FORMAT "%6.5"
 /begin AXIS_DESCR COM_AXIS tco _CNV_A_R_LINEAR_____18_CM 8 -50. 205. FORMAT "%3.0" AXIS_PTS_REF ldp_tco_ip_fac_tran_maf_sp_1 /end AXIS_DESCR
/end CHARACTERISTIC
/begin AXIS_PTS ldp_tco_ip_fac_tran_maf_sp_1 "" 0x84234a tco _REC_AXS_20_u1 255. _CNV_A_R_LINEAR_____18_CM 8 -50. 205. FORMAT "%3.0" /end AXIS_PTS
/begin CHARACTERISTIC ip_fac_maf_sp_cor_amp_1 "AGE_MSP: air mass flow correction factor for ambient pressure (inj. region GES = 1)" CURVE 0x8480fe _REC_CUR_20_u2_u2 0.9999847412109381 _CNV_A_R_LINEAR_____14_CM 0. 0.9999847412109381 DISPLAY_IDENTIFIER IP_FAC_MAF_SP_COR_AMP_1 FORMAT "%6.5"
 /begin AXIS_DESCR COM_AXIS amp _CNV_A_R_LINEAR_____45_CM 8 0. 5434. FORMAT "%6.2" AXIS_PTS_REF ldp_amp_ip_fac_maf_sp_cor_1 /end AXIS_DESCR
/end CHARACTERISTIC
/begin AXIS_PTS ldp_amp_ip_fac_maf_sp_cor_1 "" 0x841118 amp _REC_AXS_20_u2 5434. _CNV_A_R_LINEAR_____45_CM 8 0. 5434. FORMAT "%6.2" /end AXIS_PTS
/begin CHARACTERISTIC ip_fac_maf_sp_cor_tgas_1 "AGE_MSP: air mass flow correction factor for temperature of the intake gas (inj. region GES = 1)" CURVE 0x848126 _REC_CUR_20_u2_u1 0.9999847412109381 _CNV_A_R_LINEAR_____14_CM 0. 0.9999847412109381 DISPLAY_IDENTIFIER IP_FAC_MAF_SP_COR_TGAS_1 FORMAT "%6.5"
 /begin AXIS_DESCR COM_AXIS tgas _CNV_A_R_LINEAR_____18_CM 8 -50. 205. FORMAT "%3.0" AXIS_PTS_REF ldp_tgas_ip_fac_maf_sp_cor_1 /end AXIS_DESCR
/end CHARACTERISTIC
/begin AXIS_PTS ldp_tgas_ip_fac_maf_sp_cor_1 "" 0x8424c7 tgas _REC_AXS_20_u1 255. _CNV_A_R_LINEAR_____18_CM 8 -50. 205. FORMAT "%3.0" /end AXIS_PTS
/begin CHARACTERISTIC ip_fac_maf_sp_cor_amp_rgn_1 "AGE_MSP: amp correction for maf_sp during regeneration mode 1" CURVE 0x84810e _REC_CUR_20_u2_u2 0.9999847412109381 _CNV_A_R_LINEAR_____14_CM 0. 0.9999847412109381 DISPLAY_IDENTIFIER IP_FAC_MAF_SP_COR_AMP_RGN_1 FORMAT "%6.5"
 /begin AXIS_DESCR COM_AXIS amp _CNV_A_R_LINEAR_____45_CM 2 0. 5434. FORMAT "%6.2" AXIS_PTS_REF ldp_amp_ip_fac_maf_sp_cor_rgn_1 /end AXIS_DESCR
/end CHARACTERISTIC
/begin AXIS_PTS ldp_amp_ip_fac_maf_sp_cor_rgn_1 "" 0x84112a amp _REC_AXS_20_u2 5434. _CNV_A_R_LINEAR_____45_CM 2 0. 5434. FORMAT "%6.2" /end AXIS_PTS
/begin CHARACTERISTIC ip_fac_maf_sp_cor_amp_rgn_2 "AGE_MSP: amp correction for maf_sp during regeneration mode 2" CURVE 0x848112 _REC_CUR_20_u2_u2 0.9999847412109381 _CNV_A_R_LINEAR_____14_CM 0. 0.9999847412109381 DISPLAY_IDENTIFIER IP_FAC_MAF_SP_COR_AMP_RGN_2 FORMAT "%6.5"
 /begin AXIS_DESCR COM_AXIS amp _CNV_A_R_LINEAR_____45_CM 2 0. 5434. FORMAT "%6.2" AXIS_PTS_REF ldp_amp_ip_fac_maf_sp_cor_rgn_2 /end AXIS_DESCR
/end CHARACTERISTIC
/begin AXIS_PTS ldp_amp_ip_fac_maf_sp_cor_rgn_2 "" 0x841130 amp _REC_AXS_20_u2 5434. _CNV_A_R_LINEAR_____45_CM 2 0. 5434. FORMAT "%6.2" /end AXIS_PTS
/begin CHARACTERISTIC ip_kr_dt1_maf_sp_dyn "AGE_MSP: gain value for dynamic MAF_SP calculation" CURVE 0x8484e0 _REC_CUR_20_u2_u2 6.5535 _CNV_A_R_LINEAR_____152_CM -3.2768 3.2767 DISPLAY_IDENTIFIER IP_KR_DT1_MAF_SP_DYN FORMAT "%5.4"
 /begin AXIS_DESCR COM_AXIS tqi_grd_egr _CNV_A_R_LINEAR_____139_CM 6 -32768. 32767. FORMAT "%5.0" AXIS_PTS_REF ldp_tqi_grd_ip_kr_dt1_maf_sp /end AXIS_DESCR
/end CHARACTERISTIC
/begin AXIS_PTS ldp_tqi_grd_ip_kr_dt1_maf_sp "" 0x8425e4 tqi_grd_egr _REC_AXS_20_u2 65535. _CNV_A_R_LINEAR_____139_CM 6 -32768. 32767. FORMAT "%5.0" /end AXIS_PTS
/begin CHARACTERISTIC ip_fac_maf_sp_fil_tra__n "AGE_MSP: transition filter factor for air mass flow setpoint" CURVE 0x848136 _REC_CUR_20_u2_u2 0.9999847412109381 _CNV_A_R_LINEAR_____14_CM 0. 0.9999847412109381 DISPLAY_IDENTIFIER IP_FAC_MAF_SP_FIL_TRA__N FORMAT "%6.5"
 /begin AXIS_DESCR COM_AXIS n _CNV_A_R_LINEAR_____5_CM 6 0. 6375. FORMAT "%4.0" AXIS_PTS_REF ldpm_n_ip_bpa_egr_sp_fil /end AXIS_DESCR
/end CHARACTERISTIC
/begin CHARACTERISTIC ip_t_dly_maf_on__n "AGE_MSP: delay time for MAF-controller enable" CURVE 0x84edf0 _REC_CUR_20_u2_u2 4.19424 _CNV_A_R_LINEAR_____64_CM 0. 4.19424 DISPLAY_IDENTIFIER IP_T_DLY_MAF_ON__N FORMAT "%6.5"
 /begin AXIS_DESCR COM_AXIS n _CNV_A_R_LINEAR_____5_CM 6 0. 6375. FORMAT "%4.0" AXIS_PTS_REF ldp_n_ip_t_dly_maf_on /end AXIS_DESCR
/end CHARACTERISTIC
/begin AXIS_PTS ldp_n_ip_t_dly_maf_on "" 0x841e20 n _REC_AXS_20_u2 6375. _CNV_A_R_LINEAR_____5_CM 6 0. 6375. FORMAT "%4.0" /end AXIS_PTS
/begin CHARACTERISTIC ip_maf_sp_bas_0_0 "AGE_MSP: basic air mass flow setpoint for hot engine (inj. region GES = 0)" MAP 0x848d64 _REC_MAP_20_u2_u2_u2 1389. _CNV_A_R_LINEAR_____60_CM 0. 1389. DISPLAY_IDENTIFIER IP_MAF_SP_BAS_0_0 FORMAT "%6.2"
 /begin AXIS_DESCR COM_AXIS n _CNV_A_R_LINEAR_____5_CM 16 0. 6375. FORMAT "%4.0" AXIS_PTS_REF ldpm_n_ip_maf_sp_bas_0 /end AXIS_DESCR
 /begin AXIS_DESCR COM_AXIS tqi_grd_egr _CNV_A_R_LINEAR_____52_CM 16 0. 1023.96875 FORMAT "%6.2" AXIS_PTS_REF ldpm_tqi_ip_maf_sp_bas_0 /end AXIS_DESCR
/end CHARACTERISTIC
/begin AXIS_PTS ldpm_n_ip_maf_sp_bas_0 "" 0x84312a n _REC_AXS_20_u2 6375. _CNV_A_R_LINEAR_____5_CM 16 0. 6375. FORMAT "%4.0" /end AXIS_PTS
/begin AXIS_PTS ldpm_tqi_ip_maf_sp_bas_0 "" 0x84398e tqi_grd_egr _REC_AXS_20_u2 1023.96875 _CNV_A_R_LINEAR_____52_CM 16 0. 1023.96875 FORMAT "%6.2" /end AXIS_PTS
/begin CHARACTERISTIC ip_maf_sp_bas_0_1 "AGE_MSP: basic air mass flow setpoint for warm engine (inj. region GES = 0)" MAP 0x848f64 _REC_MAP_20_u2_u2_u2 1389. _CNV_A_R_LINEAR_____60_CM 0. 1389. DISPLAY_IDENTIFIER IP_MAF_SP_BAS_0_1 FORMAT "%6.2"
 /begin AXIS_DESCR COM_AXIS n _CNV_A_R_LINEAR_____5_CM 16 0. 6375. FORMAT "%4.0" AXIS_PTS_REF ldpm_n_ip_maf_sp_bas_0 /end AXIS_DESCR
 /begin AXIS_DESCR COM_AXIS tqi_grd_egr _CNV_A_R_LINEAR_____52_CM 16 0. 1023.96875 FORMAT "%6.2" AXIS_PTS_REF ldpm_tqi_ip_maf_sp_bas_0 /end AXIS_DESCR
/end CHARACTERISTIC
/begin CHARACTERISTIC ip_maf_sp_bas_0_2 "AGE_MSP: basic air mass flow setpoint for cold engine (inj. region GES = 0)" MAP 0x849164 _REC_MAP_20_u2_u2_u2 1389. _CNV_A_R_LINEAR_____60_CM 0. 1389. DISPLAY_IDENTIFIER IP_MAF_SP_BAS_0_2 FORMAT "%6.2"
 /begin AXIS_DESCR COM_AXIS n _CNV_A_R_LINEAR_____5_CM 16 0. 6375. FORMAT "%4.0" AXIS_PTS_REF ldpm_n_ip_maf_sp_bas_0 /end AXIS_DESCR
 /begin AXIS_DESCR COM_AXIS tqi_grd_egr _CNV_A_R_LINEAR_____52_CM 16 0. 1023.96875 FORMAT "%6.2" AXIS_PTS_REF ldpm_tqi_ip_maf_sp_bas_0 /end AXIS_DESCR
/end CHARACTERISTIC
/begin CHARACTERISTIC ip_maf_sp_cor_amp_0 "AGE_MSP: basic air mass flow setpoint correction map for ambient pressure (inj. region GES = 0)" MAP 0x849964 _REC_MAP_20_u2_u2_u2 1388.9788 _CNV_A_R_LINEAR_____153_CM -694.5 694.4788 DISPLAY_IDENTIFIER IP_MAF_SP_COR_AMP_0 FORMAT "%5.2"
 /begin AXIS_DESCR COM_AXIS n _CNV_A_R_LINEAR_____5_CM 8 0. 6375. FORMAT "%4.0" AXIS_PTS_REF ldp_n_ip_maf_sp_cor_amp_0 /end AXIS_DESCR
 /begin AXIS_DESCR COM_AXIS tqi_grd_egr _CNV_A_R_LINEAR_____52_CM 8 0. 1023.96875 FORMAT "%6.2" AXIS_PTS_REF ldp_tqi_ip_maf_sp_cor_amp_0 /end AXIS_DESCR
/end CHARACTERISTIC
/begin AXIS_PTS ldp_n_ip_maf_sp_cor_amp_0 "" 0x841b18 n _REC_AXS_20_u2 6375. _CNV_A_R_LINEAR_____5_CM 8 0. 6375. FORMAT "%4.0" /end AXIS_PTS
/begin AXIS_PTS ldp_tqi_ip_maf_sp_cor_amp_0 "" 0x8426b4 tqi_grd_egr _REC_AXS_20_u2 1023.96875 _CNV_A_R_LINEAR_____52_CM 8 0. 1023.96875 FORMAT "%6.2" /end AXIS_PTS
/begin CHARACTERISTIC ip_maf_sp_cor_tgas_0 "AGE_MSP: basic air mass flow setpoint correction map for temperature of the intake gas (inj. region GES = 0)" MAP 0x849e64 _REC_MAP_20_u2_u2_u2 1388.9788 _CNV_A_R_LINEAR_____153_CM -694.5 694.4788 DISPLAY_IDENTIFIER IP_MAF_SP_COR_TGAS_0 FORMAT "%5.2"
 /begin AXIS_DESCR COM_AXIS n _CNV_A_R_LINEAR_____5_CM 8 0. 6375. FORMAT "%4.0" AXIS_PTS_REF ldp_n_ip_maf_sp_cor_tgas_0 /end AXIS_DESCR
 /begin AXIS_DESCR COM_AXIS tqi_grd_egr _CNV_A_R_LINEAR_____52_CM 8 0. 1023.96875 FORMAT "%6.2" AXIS_PTS_REF ldp_tqi_ip_maf_sp_cor_tgas_0 /end AXIS_DESCR
/end CHARACTERISTIC
/begin AXIS_PTS ldp_n_ip_maf_sp_cor_tgas_0 "" 0x841b3c n _REC_AXS_20_u2 6375. _CNV_A_R_LINEAR_____5_CM 8 0. 6375. FORMAT "%4.0" /end AXIS_PTS
/begin AXIS_PTS ldp_tqi_ip_maf_sp_cor_tgas_0 "" 0x8426d8 tqi_grd_egr _REC_AXS_20_u2 1023.96875 _CNV_A_R_LINEAR_____52_CM 8 0. 1023.96875 FORMAT "%6.2" /end AXIS_PTS
/begin CHARACTERISTIC ip_maf_sp_cor_lih_0 "AGE_MSP: basic air mass flow setpoint correction map for limp home (inj. region GES = 0)" MAP 0x849a64 _REC_MAP_20_u2_u2_u2 1388.9788 _CNV_A_R_LINEAR_____153_CM -694.5 694.4788 DISPLAY_IDENTIFIER IP_MAF_SP_COR_LIH_0 FORMAT "%5.2"
 /begin AXIS_DESCR COM_AXIS n _CNV_A_R_LINEAR_____5_CM 16 0. 6375. FORMAT "%4.0" AXIS_PTS_REF ldpm_n_ip_maf_sp_bas_0 /end AXIS_DESCR
 /begin AXIS_DESCR COM_AXIS tqi_grd_egr _CNV_A_R_LINEAR_____52_CM 16 0. 1023.96875 FORMAT "%6.2" AXIS_PTS_REF ldpm_tqi_ip_maf_sp_bas_0 /end AXIS_DESCR
/end CHARACTERISTIC
/begin CHARACTERISTIC ip_maf_sp_bas_1_0 "AGE_MSP: basic air mass flow setpoint for hot engine (inj. region GES = 1)" MAP 0x849364 _REC_MAP_20_u2_u2_u2 1389. _CNV_A_R_LINEAR_____60_CM 0. 1389. DISPLAY_IDENTIFIER IP_MAF_SP_BAS_1_0 FORMAT "%6.2"
 /begin AXIS_DESCR COM_AXIS n _CNV_A_R_LINEAR_____5_CM 16 0. 6375. FORMAT "%4.0" AXIS_PTS_REF ldpm_n_ip_maf_sp_bas_1 /end AXIS_DESCR
 /begin AXIS_DESCR COM_AXIS tqi_grd_egr _CNV_A_R_LINEAR_____52_CM 16 0. 1023.96875 FORMAT "%6.2" AXIS_PTS_REF ldpm_tqi_ip_maf_sp_bas_1 /end AXIS_DESCR
/end CHARACTERISTIC
/begin AXIS_PTS ldpm_n_ip_maf_sp_bas_1 "" 0x84314c n _REC_AXS_20_u2 6375. _CNV_A_R_LINEAR_____5_CM 16 0. 6375. FORMAT "%4.0" /end AXIS_PTS
/begin AXIS_PTS ldpm_tqi_ip_maf_sp_bas_1 "" 0x8439b0 tqi_grd_egr _REC_AXS_20_u2 1023.96875 _CNV_A_R_LINEAR_____52_CM 16 0. 1023.96875 FORMAT "%6.2" /end AXIS_PTS
/begin CHARACTERISTIC ip_maf_sp_bas_1_1 "AGE_MSP: basic air mass flow setpoint for warm engine (inj. region GES = 1)" MAP 0x849564 _REC_MAP_20_u2_u2_u2 1389. _CNV_A_R_LINEAR_____60_CM 0. 1389. DISPLAY_IDENTIFIER IP_MAF_SP_BAS_1_1 FORMAT "%6.2"
 /begin AXIS_DESCR COM_AXIS n _CNV_A_R_LINEAR_____5_CM 16 0. 6375. FORMAT "%4.0" AXIS_PTS_REF ldpm_n_ip_maf_sp_bas_1 /end AXIS_DESCR
 /begin AXIS_DESCR COM_AXIS tqi_grd_egr _CNV_A_R_LINEAR_____52_CM 16 0. 1023.96875 FORMAT "%6.2" AXIS_PTS_REF ldpm_tqi_ip_maf_sp_bas_1 /end AXIS_DESCR
/end CHARACTERISTIC
/begin CHARACTERISTIC ip_maf_sp_bas_1_2 "AGE_MSP: basic air mass flow setpoint for cold engine (inj. region GES = 1)" MAP 0x849764 _REC_MAP_20_u2_u2_u2 1389. _CNV_A_R_LINEAR_____60_CM 0. 1389. DISPLAY_IDENTIFIER IP_MAF_SP_BAS_1_2 FORMAT "%6.2"
 /begin AXIS_DESCR COM_AXIS n _CNV_A_R_LINEAR_____5_CM 16 0. 6375. FORMAT "%4.0" AXIS_PTS_REF ldpm_n_ip_maf_sp_bas_1 /end AXIS_DESCR
 /begin AXIS_DESCR COM_AXIS tqi_grd_egr _CNV_A_R_LINEAR_____52_CM 16 0. 1023.96875 FORMAT "%6.2" AXIS_PTS_REF ldpm_tqi_ip_maf_sp_bas_1 /end AXIS_DESCR
/end CHARACTERISTIC
/begin CHARACTERISTIC ip_maf_sp_cor_tgas_1 "AGE_MSP: basic air mass flow setpoint correction map for temperature of the intake gas (inj. region GES = 1)" MAP 0x849ee4 _REC_MAP_20_u2_u2_u2 1388.9788 _CNV_A_R_LINEAR_____153_CM -694.5 694.4788 DISPLAY_IDENTIFIER IP_MAF_SP_COR_TGAS_1 FORMAT "%5.2"
 /begin AXIS_DESCR COM_AXIS n _CNV_A_R_LINEAR_____5_CM 8 0. 6375. FORMAT "%4.0" AXIS_PTS_REF ldp_n_ip_maf_sp_cor_tgas_1 /end AXIS_DESCR
 /begin AXIS_DESCR COM_AXIS tqi_grd_egr _CNV_A_R_LINEAR_____52_CM 8 0. 1023.96875 FORMAT "%6.2" AXIS_PTS_REF ldp_tqi_ip_maf_sp_cor_tgas_1 /end AXIS_DESCR
/end CHARACTERISTIC
/begin AXIS_PTS ldp_n_ip_maf_sp_cor_tgas_1 "" 0x841b4e n _REC_AXS_20_u2 6375. _CNV_A_R_LINEAR_____5_CM 8 0. 6375. FORMAT "%4.0" /end AXIS_PTS
/begin AXIS_PTS ldp_tqi_ip_maf_sp_cor_tgas_1 "" 0x8426ea tqi_grd_egr _REC_AXS_20_u2 1023.96875 _CNV_A_R_LINEAR_____52_CM 8 0. 1023.96875 FORMAT "%6.2" /end AXIS_PTS
/begin CHARACTERISTIC ip_maf_sp_cor_amp_1 "AGE_MSP: basic air mass flow setpoint correction map for ambient pressure (inj. region GES = 1)" MAP 0x8499e4 _REC_MAP_20_u2_u2_u2 1388.9788 _CNV_A_R_LINEAR_____153_CM -694.5 694.4788 DISPLAY_IDENTIFIER IP_MAF_SP_COR_AMP_1 FORMAT "%5.2"
 /begin AXIS_DESCR COM_AXIS n _CNV_A_R_LINEAR_____5_CM 8 0. 6375. FORMAT "%4.0" AXIS_PTS_REF ldp_n_ip_maf_sp_cor_amp_1 /end AXIS_DESCR
 /begin AXIS_DESCR COM_AXIS tqi_grd_egr _CNV_A_R_LINEAR_____52_CM 8 0. 1023.96875 FORMAT "%6.2" AXIS_PTS_REF ldp_tqi_ip_maf_sp_cor_amp_1 /end AXIS_DESCR
/end CHARACTERISTIC
/begin AXIS_PTS ldp_n_ip_maf_sp_cor_amp_1 "" 0x841b2a n _REC_AXS_20_u2 6375. _CNV_A_R_LINEAR_____5_CM 8 0. 6375. FORMAT "%4.0" /end AXIS_PTS
/begin AXIS_PTS ldp_tqi_ip_maf_sp_cor_amp_1 "" 0x8426c6 tqi_grd_egr _REC_AXS_20_u2 1023.96875 _CNV_A_R_LINEAR_____52_CM 8 0. 1023.96875 FORMAT "%6.2" /end AXIS_PTS
/begin CHARACTERISTIC ip_maf_sp_cor_lih_1 "AGE_MSP: basic air mass flow setpoint correction map for limp home (inj. region GES = 1)" MAP 0x849c64 _REC_MAP_20_u2_u2_u2 1388.9788 _CNV_A_R_LINEAR_____153_CM -694.5 694.4788 DISPLAY_IDENTIFIER IP_MAF_SP_COR_LIH_1 FORMAT "%5.2"
 /begin AXIS_DESCR COM_AXIS n _CNV_A_R_LINEAR_____5_CM 16 0. 6375. FORMAT "%4.0" AXIS_PTS_REF ldpm_n_ip_maf_sp_bas_1 /end AXIS_DESCR
 /begin AXIS_DESCR COM_AXIS tqi_grd_egr _CNV_A_R_LINEAR_____52_CM 16 0. 1023.96875 FORMAT "%6.2" AXIS_PTS_REF ldpm_tqi_ip_maf_sp_bas_1 /end AXIS_DESCR
/end CHARACTERISTIC
/begin CHARACTERISTIC ip_maf_sp_amp_h_rgn_1 "AGE_MSP: mass flow setpoint during regeneration mode 1, high ambient pressure" MAP 0x848564 _REC_MAP_20_u2_u2_u2 1389. _CNV_A_R_LINEAR_____60_CM 0. 1389. DISPLAY_IDENTIFIER IP_MAF_SP_AMP_H_RGN_1 FORMAT "%6.2"
 /begin AXIS_DESCR COM_AXIS n _CNV_A_R_LINEAR_____154_CM 16 0. 6375. FORMAT "%4.0" AXIS_PTS_REF ldpm_n_ip_maf_sp_amp_rgn_1 /end AXIS_DESCR
 /begin AXIS_DESCR COM_AXIS tqi_grd_egr _CNV_A_R_LINEAR_____52_CM 16 0. 1023.96875 FORMAT "%6.2" AXIS_PTS_REF ldpm_tqi_ip_maf_sp_amp_rgn_1 /end AXIS_DESCR
/end CHARACTERISTIC
/begin AXIS_PTS ldpm_n_ip_maf_sp_amp_rgn_1 "" 0x8430e6 n _REC_AXS_20_u2 6375. _CNV_A_R_LINEAR_____154_CM 16 0. 6375. FORMAT "%4.0" /end AXIS_PTS
/begin AXIS_PTS ldpm_tqi_ip_maf_sp_amp_rgn_1 "" 0x84394a tqi_grd_egr _REC_AXS_20_u2 1023.96875 _CNV_A_R_LINEAR_____52_CM 16 0. 1023.96875 FORMAT "%6.2" /end AXIS_PTS
/begin CHARACTERISTIC ip_maf_sp_amp_l_rgn_1 "AGE_MSP: mass flow setpoint during regeneration mode 1, low ambient pressure" MAP 0x848964 _REC_MAP_20_u2_u2_u2 1389. _CNV_A_R_LINEAR_____60_CM 0. 1389. DISPLAY_IDENTIFIER IP_MAF_SP_AMP_L_RGN_1 FORMAT "%6.2"
 /begin AXIS_DESCR COM_AXIS n _CNV_A_R_LINEAR_____154_CM 16 0. 6375. FORMAT "%4.0" AXIS_PTS_REF ldpm_n_ip_maf_sp_amp_rgn_1 /end AXIS_DESCR
 /begin AXIS_DESCR COM_AXIS tqi_grd_egr _CNV_A_R_LINEAR_____52_CM 16 0. 1023.96875 FORMAT "%6.2" AXIS_PTS_REF ldpm_tqi_ip_maf_sp_amp_rgn_1 /end AXIS_DESCR
/end CHARACTERISTIC
/begin CHARACTERISTIC ip_maf_sp_amp_h_rgn_2 "AGE_MSP: mass flow setpoint during regeneration mode 2, high ambient pressure" MAP 0x848764 _REC_MAP_20_u2_u2_u2 1389. _CNV_A_R_LINEAR_____60_CM 0. 1389. DISPLAY_IDENTIFIER IP_MAF_SP_AMP_H_RGN_2 FORMAT "%6.2"
 /begin AXIS_DESCR COM_AXIS n _CNV_A_R_LINEAR_____1_CM 16 0. 6375. FORMAT "%4.0" AXIS_PTS_REF ldpm_n_ip_maf_sp_amp_rgn_2 /end AXIS_DESCR
 /begin AXIS_DESCR COM_AXIS tqi_grd_egr _CNV_A_R_LINEAR_____52_CM 16 0. 1023.96875 FORMAT "%6.2" AXIS_PTS_REF ldpm_tqi_ip_maf_sp_amp_rgn_2 /end AXIS_DESCR
/end CHARACTERISTIC
/begin AXIS_PTS ldpm_n_ip_maf_sp_amp_rgn_2 "" 0x843108 n _REC_AXS_20_u2 6375. _CNV_A_R_LINEAR_____1_CM 16 0. 6375. FORMAT "%4.0" /end AXIS_PTS
/begin AXIS_PTS ldpm_tqi_ip_maf_sp_amp_rgn_2 "" 0x84396c tqi_grd_egr _REC_AXS_20_u2 1023.96875 _CNV_A_R_LINEAR_____52_CM 16 0. 1023.96875 FORMAT "%6.2" /end AXIS_PTS
/begin CHARACTERISTIC ip_maf_sp_amp_l_rgn_2 "AGE_MSP: maf setpoint during regeneration mode 2, low ambient pressure" MAP 0x848b64 _REC_MAP_20_u2_u2_u2 1389. _CNV_A_R_LINEAR_____155_CM 0. 1389. DISPLAY_IDENTIFIER IP_MAF_SP_AMP_L_RGN_2 FORMAT "%6.2"
 /begin AXIS_DESCR COM_AXIS n _CNV_A_R_LINEAR_____1_CM 16 0. 6375. FORMAT "%4.0" AXIS_PTS_REF ldpm_n_ip_maf_sp_amp_rgn_2 /end AXIS_DESCR
 /begin AXIS_DESCR COM_AXIS tqi_grd_egr _CNV_A_R_LINEAR_____52_CM 16 0. 1023.96875 FORMAT "%6.2" AXIS_PTS_REF ldpm_tqi_ip_maf_sp_amp_rgn_2 /end AXIS_DESCR
/end CHARACTERISTIC
/begin CHARACTERISTIC ip_maf_sp_is "AGE_MSP: air mass flow setpoint during IS" MAP 0x849f64 _REC_MAP_20_u2_u2_u1 1389. _CNV_A_R_LINEAR_____60_CM 0. 1389. DISPLAY_IDENTIFIER IP_MAF_SP_IS FORMAT "%6.2"
 /begin AXIS_DESCR COM_AXIS amp _CNV_A_R_LINEAR_____45_CM 8 0. 5434. FORMAT "%6.2" AXIS_PTS_REF ldp_amp_ip_maf_sp_is /end AXIS_DESCR
 /begin AXIS_DESCR COM_AXIS tgas _CNV_A_R_LINEAR_____18_CM 8 -50. 205. FORMAT "%3.0" AXIS_PTS_REF ldp_tgas_ip_maf_sp_is /end AXIS_DESCR
/end CHARACTERISTIC
/begin AXIS_PTS ldp_amp_ip_maf_sp_is "" 0x8412e8 amp _REC_AXS_20_u2 5434. _CNV_A_R_LINEAR_____45_CM 8 0. 5434. FORMAT "%6.2" /end AXIS_PTS
/begin AXIS_PTS ldp_tgas_ip_maf_sp_is "" 0x842550 tgas _REC_AXS_20_u1 255. _CNV_A_R_LINEAR_____18_CM 8 -50. 205. FORMAT "%3.0" /end AXIS_PTS
/begin MEASUREMENT lv_cdn_egr_cool_up_egrv_on_req "on/off-switch for egr-cooler up egr valve" UBYTE _CNV_S_2_RANGE______11_CM 1 0. 0. 1. DISPLAY_IDENTIFIER LV_CDN_EGR_COOL_UP_EGRV_ON_REQ ECU_ADDRESS 0x7fb867 /end MEASUREMENT
/begin MEASUREMENT lv_cdn_egr_cool_down_egrv_on_req "on/off-switch for egr-cooler up egr valve" UBYTE _CNV_S_2_RANGE______11_CM 1 0. 0. 1. DISPLAY_IDENTIFIER LV_CDN_EGR_COOL_DOWN_EGRV_ON_REQ ECU_ADDRESS 0x7fb868 /end MEASUREMENT
/begin MEASUREMENT lv_cdn_egr_cool_up_egrv_on_0 "on/off-switch for egr-cooler up egr valve" UBYTE _CNV_S_2_RANGE______11_CM 1 0. 0. 1. DISPLAY_IDENTIFIER LV_CDN_EGR_COOL_UP_EGRV_ON_0 ECU_ADDRESS 0x7fb869 /end MEASUREMENT
/begin MEASUREMENT lv_cdn_egr_cool_down_egrv_on_0 "on/off-switch for egr cooler down egr valve" UBYTE _CNV_S_2_RANGE______11_CM 1 0. 0. 1. DISPLAY_IDENTIFIER LV_CDN_EGR_COOL_DOWN_EGRV_ON_0 ECU_ADDRESS 0x7fb86a /end MEASUREMENT
/begin MEASUREMENT lv_cdn_egr_cool_up_egrv_on_1 "on/off-switch for egr-cooler up egr valve" UBYTE _CNV_S_2_RANGE______11_CM 1 0. 0. 1. DISPLAY_IDENTIFIER LV_CDN_EGR_COOL_UP_EGRV_ON_1 ECU_ADDRESS 0x7fb86b /end MEASUREMENT
/begin MEASUREMENT lv_cdn_egr_cool_down_egrv_on_1 "on/off-switch for egr cooler down egr valve" UBYTE _CNV_S_2_RANGE______11_CM 1 0. 0. 1. DISPLAY_IDENTIFIER LV_CDN_EGR_COOL_DOWN_EGRV_ON_1 ECU_ADDRESS 0x7fb86c /end MEASUREMENT
/begin CHARACTERISTIC c_tco_egr_cool_ena_0 "Enabling EGR-Cooler depending on TCO (inj. state GES = 0)" VALUE 0x85cca8 _REC_VAL_20_u1 255. _CNV_A_R_LINEAR_____156_CM -50. 205. DISPLAY_IDENTIFIER C_TCO_EGR_COOL_ENA_0 FORMAT "%3.0" /end CHARACTERISTIC
/begin CHARACTERISTIC c_temp_ex_egr_cool_ena_0 "enabling egr-cooler depending on TEMP_EX (inj. state GES = 0)" VALUE 0x85ccd6 _REC_VAL_20_u2 1023.984375 _CNV_A_R_LINEAR_____157_CM 0. 1023.984375 DISPLAY_IDENTIFIER C_TEMP_EX_EGR_COOL_ENA_0 FORMAT "%6.2" /end CHARACTERISTIC
/begin CHARACTERISTIC lc_egr_cool_on "button for egr cooler activation (inj. state GES = 0)" VALUE 0x85ce71 _REC_VAL_20_u1 1. _CNV_A_R_LINEAR_____0_CM 0. 1. DISPLAY_IDENTIFIER LC_EGR_COOL_ON FORMAT "%1.0" /end CHARACTERISTIC
/begin CHARACTERISTIC lc_egr_cool_up_down_swi "switching between egr cooler up or down egr valve (inj. state GES = 0)" VALUE 0x85ce72 _REC_VAL_20_u1 1. _CNV_A_R_LINEAR_____0_CM 0. 1. DISPLAY_IDENTIFIER LC_EGR_COOL_UP_DOWN_SWI FORMAT "%1.0" /end CHARACTERISTIC
/begin CHARACTERISTIC c_tco_egr_cool_di_0 "disabling egr-cooler depending on TCO (inj. state GES = 0)" VALUE 0x85cca6 _REC_VAL_20_u1 255. _CNV_A_R_LINEAR_____18_CM -50. 205. DISPLAY_IDENTIFIER C_TCO_EGR_COOL_DI_0 FORMAT "%3.0" /end CHARACTERISTIC
/begin CHARACTERISTIC c_temp_ex_egr_cool_di_0 "disabling egr-cooler depending on TEMP_EX (inj. state GES = 0)" VALUE 0x85ccd2 _REC_VAL_20_u2 1023.984375 _CNV_A_R_LINEAR_____157_CM 0. 1023.984375 DISPLAY_IDENTIFIER C_TEMP_EX_EGR_COOL_DI_0 FORMAT "%6.2" /end CHARACTERISTIC
/begin CHARACTERISTIC c_tco_egr_cool_di_1 "disabling egr-cooler depending on TCO (inj. state GES = 1)" VALUE 0x85cca7 _REC_VAL_20_u1 255. _CNV_A_R_LINEAR_____18_CM -50. 205. DISPLAY_IDENTIFIER C_TCO_EGR_COOL_DI_1 FORMAT "%3.0" /end CHARACTERISTIC
/begin CHARACTERISTIC c_tco_egr_cool_ena_1 "Enabling EGR-Cooler depending on TCO (inj. state GES = 1)" VALUE 0x85cca9 _REC_VAL_20_u1 255. _CNV_A_R_LINEAR_____156_CM -50. 205. DISPLAY_IDENTIFIER C_TCO_EGR_COOL_ENA_1 FORMAT "%3.0" /end CHARACTERISTIC
/begin CHARACTERISTIC c_temp_ex_egr_cool_di_1 "disabling egr-cooler depending on TEMP_EX (inj. state GES = 1)" VALUE 0x85ccd4 _REC_VAL_20_u2 1023.984375 _CNV_A_R_LINEAR_____157_CM 0. 1023.984375 DISPLAY_IDENTIFIER C_TEMP_EX_EGR_COOL_DI_1 FORMAT "%6.2" /end CHARACTERISTIC
/begin CHARACTERISTIC c_temp_ex_egr_cool_ena_1 "enabling egr-cooler depending on TEMP_EX (inj. state GES = 1)" VALUE 0x85ccd8 _REC_VAL_20_u2 1023.984375 _CNV_A_R_LINEAR_____157_CM 0. 1023.984375 DISPLAY_IDENTIFIER C_TEMP_EX_EGR_COOL_ENA_1 FORMAT "%6.2" /end CHARACTERISTIC
/begin CHARACTERISTIC ip_tqi_egr_cool_ena_0 "GE_COOL: torque threshold for EGR enable (inj. state GES = 0)" CURVE 0x85bff4 _REC_CUR_20_u2_u2 1023.96875 _CNV_A_R_LINEAR_____52_CM 0. 1023.96875 DISPLAY_IDENTIFIER IP_TQI_EGR_COOL_ENA_0 FORMAT "%6.2"
 /begin AXIS_DESCR COM_AXIS n _CNV_A_R_LINEAR_____5_CM 16 0. 6375. FORMAT "%4.0" AXIS_PTS_REF ldpm_n_ip_tqi_egr_cool_act_0 /end AXIS_DESCR
/end CHARACTERISTIC
/begin AXIS_PTS ldpm_n_ip_tqi_egr_cool_act_0 "" 0x843696 n _REC_AXS_20_u2 6375. _CNV_A_R_LINEAR_____5_CM 16 0. 6375. FORMAT "%4.0" /end AXIS_PTS
/begin CHARACTERISTIC ip_tqi_egr_cool_di_0 "GE_COOL: torque threshold for EGR disable (inj. state GES = 0)" CURVE 0x85bfb4 _REC_CUR_20_u2_u2 1023.96875 _CNV_A_R_LINEAR_____52_CM 0. 1023.96875 DISPLAY_IDENTIFIER IP_TQI_EGR_COOL_DI_0 FORMAT "%6.2"
 /begin AXIS_DESCR COM_AXIS n _CNV_A_R_LINEAR_____5_CM 16 0. 6375. FORMAT "%4.0" AXIS_PTS_REF ldpm_n_ip_tqi_egr_cool_act_0 /end AXIS_DESCR
/end CHARACTERISTIC
/begin CHARACTERISTIC ip_tqi_egr_cool_di_1 "GE_COOL: torque threshold for EGR disable (inj. state GES = 1)" CURVE 0x85bfd4 _REC_CUR_20_u2_u2 1023.96875 _CNV_A_R_LINEAR_____52_CM 0. 1023.96875 DISPLAY_IDENTIFIER IP_TQI_EGR_COOL_DI_1 FORMAT "%6.2"
 /begin AXIS_DESCR COM_AXIS n _CNV_A_R_LINEAR_____5_CM 16 0. 6375. FORMAT "%4.0" AXIS_PTS_REF ldpm_n_ip_tqi_egr_cool_act_1 /end AXIS_DESCR
/end CHARACTERISTIC
/begin AXIS_PTS ldpm_n_ip_tqi_egr_cool_act_1 "" 0x8436b8 n _REC_AXS_20_u2 6375. _CNV_A_R_LINEAR_____5_CM 16 0. 6375. FORMAT "%4.0" /end AXIS_PTS
/begin CHARACTERISTIC ip_tqi_egr_cool_ena_1 "GE_COOL: torque threshold for EGR enable (inj. state GES = 1)" CURVE 0x85c014 _REC_CUR_20_u2_u2 1023.96875 _CNV_A_R_LINEAR_____52_CM 0. 1023.96875 DISPLAY_IDENTIFIER IP_TQI_EGR_COOL_ENA_1 FORMAT "%6.2"
 /begin AXIS_DESCR COM_AXIS n _CNV_A_R_LINEAR_____5_CM 16 0. 6375. FORMAT "%4.0" AXIS_PTS_REF ldpm_n_ip_tqi_egr_cool_act_1 /end AXIS_DESCR
/end CHARACTERISTIC
/begin MEASUREMENT prs_ex "exhaust back pressure" UWORD _CNV_A_R_LINEAR_____45_CM 1 0. 0. 5434. DISPLAY_IDENTIFIER PRS_EX ECU_ADDRESS 0x7f9908 BYTE_ORDER MSB_LAST FORMAT "%6.2" /end MEASUREMENT
/begin MEASUREMENT temp_ex "exhaust gas temperature" UWORD _CNV_A_R_LINEAR_____157_CM 1 0. 0. 1023.984375 DISPLAY_IDENTIFIER TEMP_EX ECU_ADDRESS 0x7f990a BYTE_ORDER MSB_LAST FORMAT "%6.2" /end MEASUREMENT
/begin MEASUREMENT temp_ex_sp "estimated exhaust gas temperature" UWORD _CNV_A_R_LINEAR_____157_CM 1 0. 0. 1023.984375 DISPLAY_IDENTIFIER TEMP_EX_SP ECU_ADDRESS 0x7f990c BYTE_ORDER MSB_LAST FORMAT "%6.2" /end MEASUREMENT
/begin MEASUREMENT prs_ex_sp "estimated exhaust back pressure" UWORD _CNV_A_R_LINEAR_____45_CM 1 0. 0. 5434. DISPLAY_IDENTIFIER PRS_EX_SP ECU_ADDRESS 0x7f990e BYTE_ORDER MSB_LAST FORMAT "%6.2" /end MEASUREMENT
/begin MEASUREMENT w_ind "indicated work" UWORD _CNV_A_R_LINEAR_____163_CM 1 0. 0. 6553.5 DISPLAY_IDENTIFIER W_IND ECU_ADDRESS 0x7fa800 BYTE_ORDER MSB_LAST FORMAT "%5.1" /end MEASUREMENT
/begin MEASUREMENT temp_ex_gas_up_pf[0] "" UWORD _CNV_A_R_LINEAR_____157_CM 1 0. 0. 1023.984375 DISPLAY_IDENTIFIER TEMP_EX_GAS_UP_PF ECU_ADDRESS 0x7fa7b6 BYTE_ORDER MSB_LAST FORMAT "%6.2" /end MEASUREMENT
/begin MEASUREMENT temp_ex_gas_up_pf[1] "" UWORD _CNV_A_R_LINEAR_____157_CM 1 0. 0. 1023.984375 DISPLAY_IDENTIFIER TEMP_EX_GAS_UP_PF_SP ECU_ADDRESS 0x7fa7b8 BYTE_ORDER MSB_LAST FORMAT "%6.2" /end MEASUREMENT
/begin MEASUREMENT prs_ex_mdl[0] "" UWORD _CNV_A_R_LINEAR_____45_CM 1 0. 0. 5434. DISPLAY_IDENTIFIER PRS_EX_MDL ECU_ADDRESS 0x7fa802 BYTE_ORDER MSB_LAST FORMAT "%6.2" /end MEASUREMENT
/begin MEASUREMENT prs_ex_mdl[1] "" UWORD _CNV_A_R_LINEAR_____45_CM 1 0. 0. 5434. DISPLAY_IDENTIFIER PRS_EX_MDL_SP ECU_ADDRESS 0x7fa804 BYTE_ORDER MSB_LAST FORMAT "%6.2" /end MEASUREMENT
/begin MEASUREMENT maf_cmp_kgh[0] "" UWORD _CNV_A_R_LINEAR_____110_CM 1 0. 0. 1023.984375 DISPLAY_IDENTIFIER MAF_CMP_KGH ECU_ADDRESS 0x7f9958 BYTE_ORDER MSB_LAST FORMAT "%6.2" /end MEASUREMENT
/begin MEASUREMENT maf_cmp_kgh[1] "" UWORD _CNV_A_R_LINEAR_____110_CM 1 0. 0. 1023.984375 DISPLAY_IDENTIFIER MAF_CMP_KGH_SP ECU_ADDRESS 0x7f995a BYTE_ORDER MSB_LAST FORMAT "%6.2" /end MEASUREMENT
/begin MEASUREMENT dip_ico[0] "" UWORD _CNV_A_R_LINEAR_____45_CM 1 0. 0. 5434. DISPLAY_IDENTIFIER DIP_ICO ECU_ADDRESS 0x7fa7aa BYTE_ORDER MSB_LAST FORMAT "%6.2" /end MEASUREMENT
/begin MEASUREMENT dip_ico[1] "" UWORD _CNV_A_R_LINEAR_____45_CM 1 0. 0. 5434. DISPLAY_IDENTIFIER DIP_ICO_SP ECU_ADDRESS 0x7fa7ac BYTE_ORDER MSB_LAST FORMAT "%6.2" /end MEASUREMENT
/begin MEASUREMENT prs_up_cmp[0] "" UWORD _CNV_A_R_LINEAR_____45_CM 1 0. 0. 5434. DISPLAY_IDENTIFIER PRS_UP_CMP ECU_ADDRESS 0x7fa84c BYTE_ORDER MSB_LAST FORMAT "%6.2" /end MEASUREMENT
/begin MEASUREMENT prs_up_cmp[1] "" UWORD _CNV_A_R_LINEAR_____45_CM 1 0. 0. 5434. DISPLAY_IDENTIFIER PRS_UP_CMP_SP ECU_ADDRESS 0x7fa84e BYTE_ORDER MSB_LAST FORMAT "%6.2" /end MEASUREMENT
/begin MEASUREMENT eff_tcha[0] "" UWORD _CNV_A_R_LINEAR_____134_CM 1 0. 0. 100. DISPLAY_IDENTIFIER EFF_TCHA ECU_ADDRESS 0x7fa7b2 BYTE_ORDER MSB_LAST /end MEASUREMENT
/begin MEASUREMENT eff_tcha[1] "" UWORD _CNV_A_R_LINEAR_____134_CM 1 0. 0. 100. DISPLAY_IDENTIFIER EFF_TCHA_SP ECU_ADDRESS 0x7fa7b4 BYTE_ORDER MSB_LAST /end MEASUREMENT
/begin MEASUREMENT n_tcha[0] "" UWORD _CNV_A_R_LINEAR_____164_CM 1 0. 0. 255. DISPLAY_IDENTIFIER N_TCHA ECU_ADDRESS 0x7fa7ae BYTE_ORDER MSB_LAST /end MEASUREMENT
/begin MEASUREMENT n_tcha[1] "" UWORD _CNV_A_R_LINEAR_____164_CM 1 0. 0. 255. DISPLAY_IDENTIFIER N_TCHA_SP ECU_ADDRESS 0x7fa7b0 BYTE_ORDER MSB_LAST /end MEASUREMENT
/begin MEASUREMENT eff_tur[0] "" UWORD _CNV_A_R_LINEAR_____134_CM 1 0. 0. 100. DISPLAY_IDENTIFIER EFF_TUR ECU_ADDRESS 0x7fa80a BYTE_ORDER MSB_LAST /end MEASUREMENT
/begin MEASUREMENT eff_tur[1] "" UWORD _CNV_A_R_LINEAR_____134_CM 1 0. 0. 100. DISPLAY_IDENTIFIER EFF_TUR_SP ECU_ADDRESS 0x7fa80c BYTE_ORDER MSB_LAST /end MEASUREMENT
/begin MEASUREMENT eff_mec_tcha[0] "" UWORD _CNV_A_R_LINEAR_____134_CM 1 0. 0. 100. DISPLAY_IDENTIFIER EFF_MEC_TCHA ECU_ADDRESS 0x7fa80e BYTE_ORDER MSB_LAST /end MEASUREMENT
/begin MEASUREMENT eff_mec_tcha[1] "" UWORD _CNV_A_R_LINEAR_____134_CM 1 0. 0. 100. DISPLAY_IDENTIFIER EFF_MEC_TCHA_SP ECU_ADDRESS 0x7fa810 BYTE_ORDER MSB_LAST /end MEASUREMENT
/begin MEASUREMENT eff_tur_cor[0] "" UWORD _CNV_A_R_LINEAR_____165_CM 1 0. 0. 655.35 DISPLAY_IDENTIFIER EFF_TUR_COR ECU_ADDRESS 0x7fa812 BYTE_ORDER MSB_LAST /end MEASUREMENT
/begin MEASUREMENT eff_tur_cor[1] "" UWORD _CNV_A_R_LINEAR_____165_CM 1 0. 0. 655.35 DISPLAY_IDENTIFIER EFF_TUR_COR_SP ECU_ADDRESS 0x7fa814 BYTE_ORDER MSB_LAST /end MEASUREMENT
/begin MEASUREMENT prs_down_cmp[0] "" UWORD _CNV_A_R_LINEAR_____45_CM 1 0. 0. 5434. DISPLAY_IDENTIFIER PRS_DOWN_CMP ECU_ADDRESS 0x7fa816 BYTE_ORDER MSB_LAST FORMAT "%6.2" /end MEASUREMENT
/begin MEASUREMENT prs_down_cmp[1] "" UWORD _CNV_A_R_LINEAR_____45_CM 1 0. 0. 5434. DISPLAY_IDENTIFIER PRS_DOWN_CMP_SP ECU_ADDRESS 0x7fa818 BYTE_ORDER MSB_LAST FORMAT "%6.2" /end MEASUREMENT
/begin MEASUREMENT eff_cmp[0] "" UWORD _CNV_A_R_LINEAR_____14_CM 1 0. 0. 0.9999847412109381 DISPLAY_IDENTIFIER EFF_CMP ECU_ADDRESS 0x7fa81a BYTE_ORDER MSB_LAST FORMAT "%6.2" /end MEASUREMENT
/begin MEASUREMENT eff_cmp[1] "" UWORD _CNV_A_R_LINEAR_____14_CM 1 0. 0. 0.9999847412109381 DISPLAY_IDENTIFIER EFF_CMP_SP ECU_ADDRESS 0x7fa81c BYTE_ORDER MSB_LAST FORMAT "%6.2" /end MEASUREMENT
/begin MEASUREMENT temp_down_cmp[0] "" UWORD _CNV_A_R_LINEAR_____98_CM 1 0. 0. 4095.9375 DISPLAY_IDENTIFIER TEMP_DOWN_CMP ECU_ADDRESS 0x7fa81e BYTE_ORDER MSB_LAST FORMAT "%6.2" /end MEASUREMENT
/begin MEASUREMENT temp_down_cmp[1] "" UWORD _CNV_A_R_LINEAR_____98_CM 1 0. 0. 4095.9375 DISPLAY_IDENTIFIER TEMP_DOWN_CMP_SP ECU_ADDRESS 0x7fa820 BYTE_ORDER MSB_LAST FORMAT "%6.2" /end MEASUREMENT
/begin MEASUREMENT pq_cmp[0] "" UWORD _CNV_A_R_LINEAR_____166_CM 1 0. 0. 6.5535 DISPLAY_IDENTIFIER PQ_CMP ECU_ADDRESS 0x7fa822 BYTE_ORDER MSB_LAST FORMAT "%5.4" /end MEASUREMENT
/begin MEASUREMENT pq_cmp[1] "" UWORD _CNV_A_R_LINEAR_____166_CM 1 0. 0. 6.5535 DISPLAY_IDENTIFIER PQ_CMP_SP ECU_ADDRESS 0x7fa824 BYTE_ORDER MSB_LAST FORMAT "%5.4" /end MEASUREMENT
/begin MEASUREMENT maf_kgh_stnd[0] "" UWORD _CNV_A_R_LINEAR_____110_CM 1 0. 0. 1023.984375 DISPLAY_IDENTIFIER MAF_KGH_STND ECU_ADDRESS 0x7fa826 BYTE_ORDER MSB_LAST FORMAT "%6.2" /end MEASUREMENT
/begin MEASUREMENT maf_kgh_stnd[1] "" UWORD _CNV_A_R_LINEAR_____110_CM 1 0. 0. 1023.984375 DISPLAY_IDENTIFIER MAF_KGH_STND_SP ECU_ADDRESS 0x7fa828 BYTE_ORDER MSB_LAST FORMAT "%6.2" /end MEASUREMENT
/begin MEASUREMENT m_tur_kgh[0] "" UWORD _CNV_A_R_LINEAR_____110_CM 1 0. 0. 1023.984375 DISPLAY_IDENTIFIER M_TUR_KGH ECU_ADDRESS 0x7f9914 BYTE_ORDER MSB_LAST FORMAT "%6.2" /end MEASUREMENT
/begin MEASUREMENT m_tur_kgh[1] "" UWORD _CNV_A_R_LINEAR_____110_CM 1 0. 0. 1023.984375 DISPLAY_IDENTIFIER M_TUR_KGH_SP ECU_ADDRESS 0x7f9916 BYTE_ORDER MSB_LAST FORMAT "%6.2" /end MEASUREMENT
/begin MEASUREMENT m_tur[0] "" UWORD _CNV_A_R_LINEAR_____110_CM 1 0. 0. 1023.984375 DISPLAY_IDENTIFIER M_TUR ECU_ADDRESS 0x7f9918 BYTE_ORDER MSB_LAST FORMAT "%6.2" /end MEASUREMENT
/begin MEASUREMENT m_tur[1] "" UWORD _CNV_A_R_LINEAR_____110_CM 1 0. 0. 1023.984375 DISPLAY_IDENTIFIER M_TUR_SP ECU_ADDRESS 0x7f991a BYTE_ORDER MSB_LAST FORMAT "%6.2" /end MEASUREMENT
/begin MEASUREMENT m_tur_kgh_stnd[0] "" UWORD _CNV_A_R_LINEAR_____110_CM 1 0. 0. 1023.984375 DISPLAY_IDENTIFIER M_TUR_KGH_STND ECU_ADDRESS 0x7fa82a BYTE_ORDER MSB_LAST FORMAT "%6.2" /end MEASUREMENT
/begin MEASUREMENT m_tur_kgh_stnd[1] "" UWORD _CNV_A_R_LINEAR_____110_CM 1 0. 0. 1023.984375 DISPLAY_IDENTIFIER M_TUR_KGH_STND_SP ECU_ADDRESS 0x7fa82c BYTE_ORDER MSB_LAST FORMAT "%6.2" /end MEASUREMENT
/begin MEASUREMENT inv_div_prs_tur[0] "" UWORD _CNV_A_R_LINEAR_____144_CM 1 0. 0. 6.5535 DISPLAY_IDENTIFIER INV_DIV_PRS_TUR ECU_ADDRESS 0x7fa82e BYTE_ORDER MSB_LAST FORMAT "%5.4" /end MEASUREMENT
/begin MEASUREMENT inv_div_prs_tur[1] "" UWORD _CNV_A_R_LINEAR_____144_CM 1 0. 0. 6.5535 DISPLAY_IDENTIFIER INV_DIV_PRS_TUR_SP ECU_ADDRESS 0x7fa830 BYTE_ORDER MSB_LAST FORMAT "%5.4" /end MEASUREMENT
/begin MEASUREMENT n_tcha_stnd[0] "" UWORD _CNV_A_R_LINEAR_____14_CM 1 0. 0. 0.9999847412109381 DISPLAY_IDENTIFIER N_TCHA_STND ECU_ADDRESS 0x7f9954 BYTE_ORDER MSB_LAST FORMAT "%6.2" /end MEASUREMENT
/begin MEASUREMENT n_tcha_stnd[1] "" UWORD _CNV_A_R_LINEAR_____14_CM 1 0. 0. 0.9999847412109381 DISPLAY_IDENTIFIER N_TCHA_STND_SP ECU_ADDRESS 0x7f9956 BYTE_ORDER MSB_LAST FORMAT "%6.2" /end MEASUREMENT
/begin MEASUREMENT div_capa_heat_prs[0] "" UWORD _CNV_A_R_LINEAR_____48_CM 1 0. 0. 1.9999696 DISPLAY_IDENTIFIER DIV_CAPA_HEAT_PRS ECU_ADDRESS 0x7f991c BYTE_ORDER MSB_LAST FORMAT "%5.4" /end MEASUREMENT
/begin MEASUREMENT div_capa_heat_prs[1] "" UWORD _CNV_A_R_LINEAR_____48_CM 1 0. 0. 1.9999696 DISPLAY_IDENTIFIER DIV_CAPA_HEAT_PRS_SP ECU_ADDRESS 0x7f991e BYTE_ORDER MSB_LAST FORMAT "%5.4" /end MEASUREMENT
/begin MEASUREMENT div_temp[0] "" UWORD _CNV_A_R_LINEAR_____144_CM 1 0. 0. 6.5535 DISPLAY_IDENTIFIER DIV_TEMP ECU_ADDRESS 0x7f9920 BYTE_ORDER MSB_LAST FORMAT "%5.4" /end MEASUREMENT
/begin MEASUREMENT div_temp[1] "" UWORD _CNV_A_R_LINEAR_____144_CM 1 0. 0. 6.5535 DISPLAY_IDENTIFIER DIV_TEMP_SP ECU_ADDRESS 0x7f9922 BYTE_ORDER MSB_LAST FORMAT "%5.4" /end MEASUREMENT
/begin MEASUREMENT tcha_fac1[0] "" UWORD _CNV_A_R_LINEAR_____48_CM 1 0. 0. 1.9999696 DISPLAY_IDENTIFIER TCHA_FAC1 ECU_ADDRESS 0x7f9924 BYTE_ORDER MSB_LAST FORMAT "%6.2" /end MEASUREMENT
/begin MEASUREMENT tcha_fac1[1] "" UWORD _CNV_A_R_LINEAR_____48_CM 1 0. 0. 1.9999696 DISPLAY_IDENTIFIER TCHA_FAC1_SP ECU_ADDRESS 0x7f9926 BYTE_ORDER MSB_LAST FORMAT "%6.2" /end MEASUREMENT
/begin MEASUREMENT tcha_fac2[0] "" UWORD _CNV_A_R_LINEAR_____14_CM 1 0. 0. 0.9999847412109381 DISPLAY_IDENTIFIER TCHA_FAC2 ECU_ADDRESS 0x7f9928 BYTE_ORDER MSB_LAST FORMAT "%5.4" /end MEASUREMENT
/begin MEASUREMENT tcha_fac2[1] "" UWORD _CNV_A_R_LINEAR_____14_CM 1 0. 0. 0.9999847412109381 DISPLAY_IDENTIFIER TCHA_FAC2_SP ECU_ADDRESS 0x7f992a BYTE_ORDER MSB_LAST FORMAT "%5.4" /end MEASUREMENT
/begin MEASUREMENT tcha_fac3[0] "" UWORD _CNV_A_R_LINEAR_____59_CM 1 0. 0. 3.99998471 DISPLAY_IDENTIFIER TCHA_FAC3 ECU_ADDRESS 0x7f992c BYTE_ORDER MSB_LAST FORMAT "%6.5" /end MEASUREMENT
/begin MEASUREMENT tcha_fac3[1] "" UWORD _CNV_A_R_LINEAR_____59_CM 1 0. 0. 3.99998471 DISPLAY_IDENTIFIER TCHA_FAC3_SP ECU_ADDRESS 0x7f992e BYTE_ORDER MSB_LAST FORMAT "%6.5" /end MEASUREMENT
/begin MEASUREMENT tcha_fac4[0] "" UWORD _CNV_A_R_LINEAR_____167_CM 1 0. 0. 199.9969482 DISPLAY_IDENTIFIER TCHA_FAC4 ECU_ADDRESS 0x7f9930 BYTE_ORDER MSB_LAST /end MEASUREMENT
/begin MEASUREMENT tcha_fac4[1] "" UWORD _CNV_A_R_LINEAR_____167_CM 1 0. 0. 199.9969482 DISPLAY_IDENTIFIER TCHA_FAC4_SP ECU_ADDRESS 0x7f9932 BYTE_ORDER MSB_LAST /end MEASUREMENT
/begin MEASUREMENT tcha_fac5[0] "" UWORD _CNV_A_R_LINEAR_____167_CM 1 0. 0. 199.9969482 DISPLAY_IDENTIFIER TCHA_FAC5 ECU_ADDRESS 0x7f9934 BYTE_ORDER MSB_LAST /end MEASUREMENT
/begin MEASUREMENT tcha_fac5[1] "" UWORD _CNV_A_R_LINEAR_____167_CM 1 0. 0. 199.9969482 DISPLAY_IDENTIFIER TCHA_FAC5_SP ECU_ADDRESS 0x7f9936 BYTE_ORDER MSB_LAST /end MEASUREMENT
/begin MEASUREMENT tcha_fac6[0] "" UWORD _CNV_A_R_LINEAR_____128_CM 1 0. 0. 100. DISPLAY_IDENTIFIER TCHA_FAC6 ECU_ADDRESS 0x7f9938 BYTE_ORDER MSB_LAST /end MEASUREMENT
/begin MEASUREMENT tcha_fac6[1] "" UWORD _CNV_A_R_LINEAR_____128_CM 1 0. 0. 100. DISPLAY_IDENTIFIER TCHA_FAC6_SP ECU_ADDRESS 0x7f993a BYTE_ORDER MSB_LAST /end MEASUREMENT
/begin MEASUREMENT div_mass[0] "" UWORD _CNV_A_R_LINEAR_____48_CM 1 0. 0. 1.9999696 DISPLAY_IDENTIFIER DIV_MASS ECU_ADDRESS 0x7f993c BYTE_ORDER MSB_LAST FORMAT "%6.4" /end MEASUREMENT
/begin MEASUREMENT div_mass[1] "" UWORD _CNV_A_R_LINEAR_____48_CM 1 0. 0. 1.9999696 DISPLAY_IDENTIFIER DIV_MASS_SP ECU_ADDRESS 0x7f993e BYTE_ORDER MSB_LAST FORMAT "%6.4" /end MEASUREMENT
/begin MEASUREMENT prs_ex_gas_up_tur[0] "" UWORD _CNV_A_R_LINEAR_____45_CM 1 0. 0. 5434. DISPLAY_IDENTIFIER PRS_EX_GAS_UP_TUR ECU_ADDRESS 0x7f9940 BYTE_ORDER MSB_LAST FORMAT "%6.2" /end MEASUREMENT
/begin MEASUREMENT prs_ex_gas_up_tur[1] "" UWORD _CNV_A_R_LINEAR_____45_CM 1 0. 0. 5434. DISPLAY_IDENTIFIER PRS_EX_GAS_UP_TUR_SP ECU_ADDRESS 0x7f9942 BYTE_ORDER MSB_LAST FORMAT "%6.2" /end MEASUREMENT
/begin MEASUREMENT capa_heat_prs_ex[0] "" UWORD _CNV_A_R_LINEAR_____168_CM 1 0. 0. 2550. DISPLAY_IDENTIFIER CAPA_HEAT_PRS_EX ECU_ADDRESS 0x7f9944 BYTE_ORDER MSB_LAST FORMAT "%6.2" /end MEASUREMENT
/begin MEASUREMENT capa_heat_prs_ex[1] "" UWORD _CNV_A_R_LINEAR_____168_CM 1 0. 0. 2550. DISPLAY_IDENTIFIER CAPA_HEAT_PRS_EX_SP ECU_ADDRESS 0x7f9946 BYTE_ORDER MSB_LAST FORMAT "%6.2" /end MEASUREMENT
/begin MEASUREMENT kapa_ex[0] "" UWORD _CNV_A_R_LINEAR_____48_CM 1 0. 0. 1.9999696 DISPLAY_IDENTIFIER KAPA_EX ECU_ADDRESS 0x7f995c BYTE_ORDER MSB_LAST FORMAT "%6.4" /end MEASUREMENT
/begin MEASUREMENT kapa_ex[1] "" UWORD _CNV_A_R_LINEAR_____48_CM 1 0. 0. 1.9999696 DISPLAY_IDENTIFIER KAPA_EX_SP ECU_ADDRESS 0x7f995e BYTE_ORDER MSB_LAST FORMAT "%6.4" /end MEASUREMENT
/begin MEASUREMENT capa_heat_vol_ex_mwm[0] "" UWORD _CNV_A_R_LINEAR_____168_CM 1 0. 0. 2550. DISPLAY_IDENTIFIER CAPA_HEAT_VOL_EX_MWM ECU_ADDRESS 0x7f9948 BYTE_ORDER MSB_LAST FORMAT "%6.2" /end MEASUREMENT
/begin MEASUREMENT capa_heat_vol_ex_mwm[1] "" UWORD _CNV_A_R_LINEAR_____168_CM 1 0. 0. 2550. DISPLAY_IDENTIFIER CAPA_HEAT_VOL_EX_MWM_SP ECU_ADDRESS 0x7f994a BYTE_ORDER MSB_LAST FORMAT "%6.2" /end MEASUREMENT
/begin MEASUREMENT div_t_tur[0] "" UWORD _CNV_A_R_LINEAR_____14_CM 1 0. 0. 0.9999847412109381 DISPLAY_IDENTIFIER DIV_T_TUR ECU_ADDRESS 0x7f994c BYTE_ORDER MSB_LAST FORMAT "%6.4" /end MEASUREMENT
/begin MEASUREMENT div_t_tur[1] "" UWORD _CNV_A_R_LINEAR_____14_CM 1 0. 0. 0.9999847412109381 DISPLAY_IDENTIFIER DIV_T_TUR_SP ECU_ADDRESS 0x7f994e BYTE_ORDER MSB_LAST FORMAT "%6.4" /end MEASUREMENT
/begin MEASUREMENT bpa_psn[0] "" UWORD _CNV_A_R_LINEAR_____8_CM 1 0. 0. 99.99847412109381 DISPLAY_IDENTIFIER BPA_PSN ECU_ADDRESS 0x7f9950 BYTE_ORDER MSB_LAST /end MEASUREMENT
/begin MEASUREMENT bpa_psn[1] "" UWORD _CNV_A_R_LINEAR_____8_CM 1 0. 0. 99.99847412109381 DISPLAY_IDENTIFIER BPA_PSN_SP ECU_ADDRESS 0x7f9952 BYTE_ORDER MSB_LAST /end MEASUREMENT
/begin MEASUREMENT prs_ex_gas_down_pf[0] "" UWORD _CNV_A_R_LINEAR_____45_CM 1 0. 0. 5434. DISPLAY_IDENTIFIER PRS_EX_GAS_DOWN_PF ECU_ADDRESS 0x7fa7be BYTE_ORDER MSB_LAST FORMAT "%6.2" /end MEASUREMENT
/begin MEASUREMENT prs_ex_gas_down_pf[1] "" UWORD _CNV_A_R_LINEAR_____45_CM 1 0. 0. 5434. DISPLAY_IDENTIFIER PRS_EX_GAS_DOWN_PF_SP ECU_ADDRESS 0x7fa7c0 BYTE_ORDER MSB_LAST FORMAT "%6.2" /end MEASUREMENT
/begin MEASUREMENT prs_ex_gas_up_pf[0] "" UWORD _CNV_A_R_LINEAR_____45_CM 1 0. 0. 5434. DISPLAY_IDENTIFIER PRS_EX_GAS_UP_PF ECU_ADDRESS 0x7fa7ba BYTE_ORDER MSB_LAST FORMAT "%6.2" /end MEASUREMENT
/begin MEASUREMENT prs_ex_gas_up_pf[1] "" UWORD _CNV_A_R_LINEAR_____45_CM 1 0. 0. 5434. DISPLAY_IDENTIFIER PRS_EX_GAS_UP_PF_SP ECU_ADDRESS 0x7fa7bc BYTE_ORDER MSB_LAST FORMAT "%6.2" /end MEASUREMENT
/begin MEASUREMENT dip_out[0] "" UWORD _CNV_A_R_LINEAR_____45_CM 1 0. 0. 5434. DISPLAY_IDENTIFIER DIP_OUT ECU_ADDRESS 0x7fa832 BYTE_ORDER MSB_LAST FORMAT "%6.2" /end MEASUREMENT
/begin MEASUREMENT dip_out[1] "" UWORD _CNV_A_R_LINEAR_____45_CM 1 0. 0. 5434. DISPLAY_IDENTIFIER DIP_OUT_SP ECU_ADDRESS 0x7fa834 BYTE_ORDER MSB_LAST FORMAT "%6.2" /end MEASUREMENT
/begin MEASUREMENT heat_cyl_in[0] "" UWORD _CNV_A_R_LINEAR_____163_CM 1 0. 0. 6553.5 DISPLAY_IDENTIFIER HEAT_CYL_IN ECU_ADDRESS 0x7fa7c2 BYTE_ORDER MSB_LAST FORMAT "%5.1" /end MEASUREMENT
/begin MEASUREMENT heat_cyl_in[1] "" UWORD _CNV_A_R_LINEAR_____163_CM 1 0. 0. 6553.5 DISPLAY_IDENTIFIER HEAT_CYL_IN_SP ECU_ADDRESS 0x7fa7c4 BYTE_ORDER MSB_LAST FORMAT "%5.1" /end MEASUREMENT
/begin MEASUREMENT heat_cyl_out[0] "" UWORD _CNV_A_R_LINEAR_____163_CM 1 0. 0. 6553.5 DISPLAY_IDENTIFIER HEAT_CYL_OUT ECU_ADDRESS 0x7fa7ca BYTE_ORDER MSB_LAST FORMAT "%5.1" /end MEASUREMENT
/begin MEASUREMENT heat_cyl_out[1] "" UWORD _CNV_A_R_LINEAR_____163_CM 1 0. 0. 6553.5 DISPLAY_IDENTIFIER HEAT_CYL_OUT_SP ECU_ADDRESS 0x7fa7cc BYTE_ORDER MSB_LAST FORMAT "%5.1" /end MEASUREMENT
/begin MEASUREMENT temp_cyl_gas_out[0] "" UWORD _CNV_A_R_LINEAR_____98_CM 1 0. 0. 4095.9375 DISPLAY_IDENTIFIER TEMP_CYL_GAS_OUT ECU_ADDRESS 0x7fa7ce BYTE_ORDER MSB_LAST FORMAT "%6.2" /end MEASUREMENT
/begin MEASUREMENT temp_cyl_gas_out[1] "" UWORD _CNV_A_R_LINEAR_____98_CM 1 0. 0. 4095.9375 DISPLAY_IDENTIFIER TEMP_CYL_GAS_OUT_SP ECU_ADDRESS 0x7fa7d0 BYTE_ORDER MSB_LAST FORMAT "%6.2" /end MEASUREMENT
/begin MEASUREMENT heat_cyl_comb[0] "" UWORD _CNV_A_R_LINEAR_____163_CM 1 0. 0. 6553.5 DISPLAY_IDENTIFIER HEAT_CYL_COMB ECU_ADDRESS 0x7fa7d2 BYTE_ORDER MSB_LAST FORMAT "%5.1" /end MEASUREMENT
/begin MEASUREMENT heat_cyl_comb[1] "" UWORD _CNV_A_R_LINEAR_____163_CM 1 0. 0. 6553.5 DISPLAY_IDENTIFIER HEAT_CYL_COMB_SP ECU_ADDRESS 0x7fa7d4 BYTE_ORDER MSB_LAST FORMAT "%5.1" /end MEASUREMENT
/begin MEASUREMENT heat_cyl_wall[0] "" SWORD _CNV_A_R_LINEAR_____169_CM 1 0. -6553.6 6553.4 DISPLAY_IDENTIFIER HEAT_CYL_WALL ECU_ADDRESS 0x7fa7c6 BYTE_ORDER MSB_LAST FORMAT "%5.1" /end MEASUREMENT
/begin MEASUREMENT heat_cyl_wall[1] "" SWORD _CNV_A_R_LINEAR_____169_CM 1 0. -6553.6 6553.4 DISPLAY_IDENTIFIER HEAT_CYL_WALL_SP ECU_ADDRESS 0x7fa7c8 BYTE_ORDER MSB_LAST FORMAT "%5.1" /end MEASUREMENT
/begin MEASUREMENT temp_cyl_gas_cmp[0] "" UWORD _CNV_A_R_LINEAR_____98_CM 1 0. 0. 4095.9375 DISPLAY_IDENTIFIER TEMP_CYL_GAS_CMP ECU_ADDRESS 0x7fa7d6 BYTE_ORDER MSB_LAST FORMAT "%6.2" /end MEASUREMENT
/begin MEASUREMENT temp_cyl_gas_cmp[1] "" UWORD _CNV_A_R_LINEAR_____98_CM 1 0. 0. 4095.9375 DISPLAY_IDENTIFIER TEMP_CYL_GAS_CMP_SP ECU_ADDRESS 0x7fa7d8 BYTE_ORDER MSB_LAST FORMAT "%6.2" /end MEASUREMENT
/begin MEASUREMENT temp_cyl_gas_comb[0] "" UWORD _CNV_A_R_LINEAR_____98_CM 1 0. 0. 4095.9375 DISPLAY_IDENTIFIER TEMP_CYL_GAS_COMB ECU_ADDRESS 0x7fa7da BYTE_ORDER MSB_LAST FORMAT "%6.2" /end MEASUREMENT
/begin MEASUREMENT temp_cyl_gas_comb[1] "" UWORD _CNV_A_R_LINEAR_____98_CM 1 0. 0. 4095.9375 DISPLAY_IDENTIFIER TEMP_CYL_GAS_COMB_SP ECU_ADDRESS 0x7fa7dc BYTE_ORDER MSB_LAST FORMAT "%6.2" /end MEASUREMENT
/begin MEASUREMENT temp_cyl_gas_mvm[0] "" UWORD _CNV_A_R_LINEAR_____98_CM 1 0. 0. 4095.9375 DISPLAY_IDENTIFIER TEMP_CYL_GAS_MVM ECU_ADDRESS 0x7fa7de BYTE_ORDER MSB_LAST FORMAT "%6.2" /end MEASUREMENT
/begin MEASUREMENT temp_cyl_gas_mvm[1] "" UWORD _CNV_A_R_LINEAR_____98_CM 1 0. 0. 4095.9375 DISPLAY_IDENTIFIER TEMP_CYL_GAS_MVM_SP ECU_ADDRESS 0x7fa7e0 BYTE_ORDER MSB_LAST FORMAT "%6.2" /end MEASUREMENT
/begin MEASUREMENT temp_cyl_gas_exp[0] "" UWORD _CNV_A_R_LINEAR_____98_CM 1 0. 0. 4095.9375 DISPLAY_IDENTIFIER TEMP_CYL_GAS_EXP ECU_ADDRESS 0x7fa7e2 BYTE_ORDER MSB_LAST FORMAT "%6.2" /end MEASUREMENT
/begin MEASUREMENT temp_cyl_gas_exp[1] "" UWORD _CNV_A_R_LINEAR_____98_CM 1 0. 0. 4095.9375 DISPLAY_IDENTIFIER TEMP_CYL_GAS_EXP_SP ECU_ADDRESS 0x7fa7e4 BYTE_ORDER MSB_LAST FORMAT "%6.2" /end MEASUREMENT
/begin MEASUREMENT vel_air_eb "air speed flow around exhaust gas manifold" UWORD _CNV_A_R_LINEAR_____170_CM 1 0. 0. 100. DISPLAY_IDENTIFIER VEL_AIR_EB ECU_ADDRESS 0x7fa7e6 BYTE_ORDER MSB_LAST /end MEASUREMENT
/begin MEASUREMENT temp_air_eb "air temperature around exhasut gas manifold" UWORD _CNV_A_R_LINEAR_____157_CM 1 0. 0. 1023.984375 DISPLAY_IDENTIFIER TEMP_AIR_EB ECU_ADDRESS 0x7fa7e8 BYTE_ORDER MSB_LAST FORMAT "%6.2" /end MEASUREMENT
/begin MEASUREMENT diam_ex_port "characteristic manifold diameter" UWORD _CNV_A_R_LINEAR_____171_CM 1 0. 0. 65.535 DISPLAY_IDENTIFIER DIAM_EX_PORT ECU_ADDRESS 0x7fa836 BYTE_ORDER MSB_LAST FORMAT "%5.3" /end MEASUREMENT
/begin MEASUREMENT div_diam_len_ex_port "characteristic manifold diameter/length ratio" UWORD _CNV_A_R_LINEAR_____48_CM 1 0. 0. 1.9999696 DISPLAY_IDENTIFIER DIV_DIAM_LEN_EX_PORT ECU_ADDRESS 0x7fa838 BYTE_ORDER MSB_LAST FORMAT "%6.5" /end MEASUREMENT
/begin MEASUREMENT mass_ex_port "manifold weight" UWORD _CNV_A_R_LINEAR_____172_CM 1 0. 0. 65.535 DISPLAY_IDENTIFIER MASS_EX_PORT ECU_ADDRESS 0x7fa83a BYTE_ORDER MSB_LAST FORMAT "%5.3" /end MEASUREMENT
/begin MEASUREMENT temp_wall_ex_port[0] "" UWORD _CNV_A_R_LINEAR_____157_CM 1 0. 0. 1023.984375 DISPLAY_IDENTIFIER TEMP_WALL_EX_PORT ECU_ADDRESS 0x7fa7ea BYTE_ORDER MSB_LAST FORMAT "%6.2" /end MEASUREMENT
/begin MEASUREMENT temp_wall_ex_port[1] "" UWORD _CNV_A_R_LINEAR_____157_CM 1 0. 0. 1023.984375 DISPLAY_IDENTIFIER TEMP_WALL_EX_PORT_SP ECU_ADDRESS 0x7fa7ec BYTE_ORDER MSB_LAST FORMAT "%6.2" /end MEASUREMENT
/begin MEASUREMENT temp_ex_gas_up_tur_stat[0] "" UWORD _CNV_A_R_LINEAR_____157_CM 1 0. 0. 1023.984375 DISPLAY_IDENTIFIER TEMP_EX_GAS_UP_TUR_STAT ECU_ADDRESS 0x7fa7ee BYTE_ORDER MSB_LAST FORMAT "%6.2" /end MEASUREMENT
/begin MEASUREMENT temp_ex_gas_up_tur_stat[1] "" UWORD _CNV_A_R_LINEAR_____157_CM 1 0. 0. 1023.984375 DISPLAY_IDENTIFIER TEMP_EX_GAS_UP_TUR_STAT_SP ECU_ADDRESS 0x7fa7f0 BYTE_ORDER MSB_LAST FORMAT "%6.2" /end MEASUREMENT
/begin MEASUREMENT mass_ex_gas_ex_port[0] "" UWORD _CNV_A_R_LINEAR_____173_CM 1 0. 0. 65535. DISPLAY_IDENTIFIER MASS_EX_GAS_EX_PORT ECU_ADDRESS 0x7fa7fa BYTE_ORDER MSB_LAST FORMAT "%5.0" /end MEASUREMENT
/begin MEASUREMENT mass_ex_gas_ex_port[1] "" UWORD _CNV_A_R_LINEAR_____173_CM 1 0. 0. 65535. DISPLAY_IDENTIFIER MASS_EX_GAS_EX_PORT_SP ECU_ADDRESS 0x7fa7fc BYTE_ORDER MSB_LAST FORMAT "%5.0" /end MEASUREMENT
/begin MEASUREMENT stanton_it[0] "" UWORD _CNV_A_R_LINEAR_____174_CM 1 0. 0. 19.979695 DISPLAY_IDENTIFIER STANTON_IT ECU_ADDRESS 0x7fa83c BYTE_ORDER MSB_LAST FORMAT "%6.4" /end MEASUREMENT
/begin MEASUREMENT stanton_it[1] "" UWORD _CNV_A_R_LINEAR_____174_CM 1 0. 0. 19.979695 DISPLAY_IDENTIFIER STANTON_IT_SP ECU_ADDRESS 0x7fa83e BYTE_ORDER MSB_LAST FORMAT "%6.4" /end MEASUREMENT
/begin MEASUREMENT grd_temp_wall_ex_port[0] "" SWORD _CNV_A_R_LINEAR_____175_CM 1 0. -1024. 1023.96875 DISPLAY_IDENTIFIER GRD_TEMP_WALL_EX_PORT ECU_ADDRESS 0x7fa840 BYTE_ORDER MSB_LAST FORMAT "%6.2" /end MEASUREMENT
/begin MEASUREMENT grd_temp_wall_ex_port[1] "" SWORD _CNV_A_R_LINEAR_____175_CM 1 0. -1024. 1023.96875 DISPLAY_IDENTIFIER GRD_TEMP_WALL_EX_PORT_SP ECU_ADDRESS 0x7fa842 BYTE_ORDER MSB_LAST FORMAT "%6.2" /end MEASUREMENT
/begin MEASUREMENT temp_ex_mdl[0] "" UWORD _CNV_A_R_LINEAR_____157_CM 1 0. 0. 1023.984375 DISPLAY_IDENTIFIER TEMP_EX_MDL ECU_ADDRESS 0x7fa806 BYTE_ORDER MSB_LAST FORMAT "%6.2" /end MEASUREMENT
/begin MEASUREMENT temp_ex_mdl[1] "" UWORD _CNV_A_R_LINEAR_____157_CM 1 0. 0. 1023.984375 DISPLAY_IDENTIFIER TEMP_EX_MDL_SP ECU_ADDRESS 0x7fa808 BYTE_ORDER MSB_LAST FORMAT "%6.2" /end MEASUREMENT
/begin MEASUREMENT reynolds_it[0] "" UWORD _CNV_A_R_LINEAR_____176_CM 1 0. 0. 262.14 DISPLAY_IDENTIFIER REYNOLDS_IT ECU_ADDRESS 0x7fa844 BYTE_ORDER MSB_LAST /end MEASUREMENT
/begin MEASUREMENT reynolds_it[1] "" UWORD _CNV_A_R_LINEAR_____176_CM 1 0. 0. 262.14 DISPLAY_IDENTIFIER REYNOLDS_IT_SP ECU_ADDRESS 0x7fa846 BYTE_ORDER MSB_LAST /end MEASUREMENT
/begin MEASUREMENT fac_heat_tran_ex_port_it[0] "" UWORD _CNV_A_R_LINEAR_____177_CM 1 0. 0. 655.35 DISPLAY_IDENTIFIER FAC_HEAT_TRAN_EX_PORT_IT ECU_ADDRESS 0x7fa7f2 BYTE_ORDER MSB_LAST FORMAT "%5.2" /end MEASUREMENT
/begin MEASUREMENT fac_heat_tran_ex_port_it[1] "" UWORD _CNV_A_R_LINEAR_____177_CM 1 0. 0. 655.35 DISPLAY_IDENTIFIER FAC_HEAT_TRAN_EX_PORT_IT_SP ECU_ADDRESS 0x7fa7f4 BYTE_ORDER MSB_LAST FORMAT "%5.2" /end MEASUREMENT
/begin MEASUREMENT reynolds_ext[0] "" UWORD _CNV_A_R_LINEAR_____176_CM 1 0. 0. 262.14 DISPLAY_IDENTIFIER REYNOLDS_EXT ECU_ADDRESS 0x7fa848 BYTE_ORDER MSB_LAST /end MEASUREMENT
/begin MEASUREMENT reynolds_ext[1] "" UWORD _CNV_A_R_LINEAR_____176_CM 1 0. 0. 262.14 DISPLAY_IDENTIFIER REYNOLDS_EXT_SP ECU_ADDRESS 0x7fa84a BYTE_ORDER MSB_LAST /end MEASUREMENT
/begin MEASUREMENT fac_heat_tran_ex_port_ext[0] "" UWORD _CNV_A_R_LINEAR_____177_CM 1 0. 0. 655.35 DISPLAY_IDENTIFIER FAC_HEAT_TRAN_EX_PORT_EXT ECU_ADDRESS 0x7fa7f6 BYTE_ORDER MSB_LAST FORMAT "%5.2" /end MEASUREMENT
/begin MEASUREMENT fac_heat_tran_ex_port_ext[1] "" UWORD _CNV_A_R_LINEAR_____177_CM 1 0. 0. 655.35 DISPLAY_IDENTIFIER FAC_HEAT_TRAN_EX_PORT_EXT_SP ECU_ADDRESS 0x7fa7f8 BYTE_ORDER MSB_LAST FORMAT "%5.2" /end MEASUREMENT
/begin MEASUREMENT bpa_psn_mmv "filtered signal for turbocharger guide blades" UWORD _CNV_A_R_LINEAR_____134_CM 1 0. 0. 100. DISPLAY_IDENTIFIER BPA_PSN_MMV ECU_ADDRESS 0x7fa7fe BYTE_ORDER MSB_LAST FORMAT "%5.3" /end MEASUREMENT
/begin MEASUREMENT bpa_psn_sp_mmv "filtered signal for turbocharger guide blades (setpoint)" UWORD _CNV_A_R_LINEAR_____134_CM 1 0. 0. 100. DISPLAY_IDENTIFIER BPA_PSN_SP_MMV ECU_ADDRESS 0x7f9910 BYTE_ORDER MSB_LAST FORMAT "%5.3" /end MEASUREMENT
/begin CHARACTERISTIC lc_act_ex_clc_mpg "activation button for map_based-exhaust gas states calculation" VALUE 0x85ce47 _REC_VAL_20_u1 1. _CNV_A_R_LINEAR_____0_CM 0. 1. DISPLAY_IDENTIFIER LC_ACT_EX_CLC_MPG FORMAT "%1.0" /end CHARACTERISTIC
/begin CHARACTERISTIC c_pow_ecf_sub "substitute power for ECF" VALUE 0x85cb64 _REC_VAL_20_u2 65535. _CNV_A_R_LINEAR_____0_CM 0. 65535. DISPLAY_IDENTIFIER C_POW_ECF_SUB FORMAT "%5.0" /end CHARACTERISTIC
/begin CHARACTERISTIC c_fac_temp_ex_fil "filter factor for TEMP_EX" VALUE 0x85ca0c _REC_VAL_20_u2 0.9999847412109381 _CNV_A_R_LINEAR_____14_CM 0. 0.9999847412109381 DISPLAY_IDENTIFIER C_FAC_TEMP_EX_FIL FORMAT "%6.5" /end CHARACTERISTIC
/begin CHARACTERISTIC c_fac_dip_ico "factor for intercooler pressure difference" VALUE 0x85c9ce _REC_VAL_20_u2 6.5535 _CNV_A_R_LINEAR_____178_CM 0. 6.5535 DISPLAY_IDENTIFIER C_FAC_DIP_ICO FORMAT "%5.4" /end CHARACTERISTIC
/begin CHARACTERISTIC c_fac_rho_stnd_in "density factor of the intake air" VALUE 0x85c9fd _REC_VAL_20_u1 0.99609375 _CNV_A_R_LINEAR_____179_CM 0. 0.99609375 DISPLAY_IDENTIFIER C_FAC_RHO_STND_IN FORMAT "%4.3" /end CHARACTERISTIC
/begin CHARACTERISTIC c_n_tcha_stnd "max. n_tcha" VALUE 0x85cb48 _REC_VAL_20_u2 999.98474 _CNV_A_R_LINEAR_____180_CM 0. 999.98474 DISPLAY_IDENTIFIER C_N_TCHA_STND FORMAT "%5.2" /end CHARACTERISTIC
/begin CHARACTERISTIC c_fac_cmp_cor "correction for heat exchange through the compressor wall" VALUE 0x85c9c2 _REC_VAL_20_u2 6.5535 _CNV_A_R_LINEAR_____144_CM 0. 6.5535 DISPLAY_IDENTIFIER C_FAC_CMP_COR FORMAT "%5.4" /end CHARACTERISTIC
/begin CHARACTERISTIC c_fac_dip_out "factor for outlet pressure difference" VALUE 0x85c9d0 _REC_VAL_20_u2 6.5535 _CNV_A_R_LINEAR_____178_CM 0. 6.5535 DISPLAY_IDENTIFIER C_FAC_DIP_OUT FORMAT "%5.4" /end CHARACTERISTIC
/begin CHARACTERISTIC c_fac_rho_stnd_eg "density factor of the exhaust gas" VALUE 0x85c9fc _REC_VAL_20_u1 0.99609375 _CNV_A_R_LINEAR_____179_CM 0. 0.99609375 DISPLAY_IDENTIFIER C_FAC_RHO_STND_EG FORMAT "%4.3" /end CHARACTERISTIC
/begin CHARACTERISTIC c_dee "spezif. Heizwert des Brennstoffes" VALUE 0x85c97e _REC_VAL_20_u2 100. _CNV_A_R_LINEAR_____181_CM 0. 100. DISPLAY_IDENTIFIER C_DEE /end CHARACTERISTIC
/begin CHARACTERISTIC c_ar_heat_tran_cyl "mean value for inner surface of the comustion chamber" VALUE 0x85c8a4 _REC_VAL_20_u2 1023.984375 _CNV_A_R_LINEAR_____182_CM 0. 1023.984375 DISPLAY_IDENTIFIER C_AR_HEAT_TRAN_CYL FORMAT "%6.2" /end CHARACTERISTIC
/begin CHARACTERISTIC c_cmp_ratio "compression ratio of the cylinder" VALUE 0x85c8e8 _REC_VAL_20_u2 100. _CNV_A_R_LINEAR_____128_CM 0. 100. DISPLAY_IDENTIFIER C_CMP_RATIO /end CHARACTERISTIC
/begin CHARACTERISTIC c_diam_fan "fan diameter" VALUE 0x85c980 _REC_VAL_20_u2 0.9999847412109381 _CNV_A_R_LINEAR_____183_CM 0. 0.9999847412109381 DISPLAY_IDENTIFIER C_DIAM_FAN FORMAT "%6.5" /end CHARACTERISTIC
/begin CHARACTERISTIC c_ar_heat_tran_ex_port "heat exchange area of exh. gas manifold" VALUE 0x85c8a6 _REC_VAL_20_u2 65535. _CNV_A_R_LINEAR_____184_CM 0. 65535. DISPLAY_IDENTIFIER C_AR_HEAT_TRAN_EX_PORT FORMAT "%5.0" /end CHARACTERISTIC
/begin CHARACTERISTIC c_vol_ex_port "exh. manifold volume" VALUE 0x85ce2a _REC_VAL_20_u2 6.5535 _CNV_A_R_LINEAR_____185_CM 0. 6.5535 DISPLAY_IDENTIFIER C_VOL_EX_PORT FORMAT "%5.4" /end CHARACTERISTIC
/begin CHARACTERISTIC c_thkn_wall_ex_port "thickness of exh. gas manifold wall" VALUE 0x85cd04 _REC_VAL_20_u2 65.535 _CNV_A_R_LINEAR_____186_CM 0. 65.535 DISPLAY_IDENTIFIER C_THKN_WALL_EX_PORT FORMAT "%5.3" /end CHARACTERISTIC
/begin CHARACTERISTIC c_rho_ex_port "spec. weight of exh. manifold wall" VALUE 0x85cb8c _REC_VAL_20_u2 16776.96 _CNV_A_R_LINEAR_____187_CM 0. 16776.96 DISPLAY_IDENTIFIER C_RHO_EX_PORT FORMAT "%6.1" /end CHARACTERISTIC
/begin CHARACTERISTIC c_capa_heat_ex_port "spec. heat capacity of exh. manifold wall" VALUE 0x85c8da _REC_VAL_20_u2 5434. _CNV_A_R_LINEAR_____188_CM 0. 5434. DISPLAY_IDENTIFIER C_CAPA_HEAT_EX_PORT FORMAT "%6.2" /end CHARACTERISTIC
/begin CHARACTERISTIC c_fac_bpa_psn_fil "filter factor for turbocharger guide blades position" VALUE 0x85c9b4 _REC_VAL_20_u2 0.9999847412109381 _CNV_A_R_LINEAR_____14_CM 0. 0.9999847412109381 DISPLAY_IDENTIFIER C_FAC_BPA_PSN_FIL FORMAT "%6.5" /end CHARACTERISTIC
/begin CHARACTERISTIC ip_fac_temp_ex__tco "GE_EGPT: factor for exhaust temperature correction TCO" CURVE 0x852aae _REC_CUR_20_u2_u1 1.9999696 _CNV_A_R_LINEAR_____48_CM 0. 1.9999696 DISPLAY_IDENTIFIER IP_FAC_TEMP_EX__TCO FORMAT "%6.5"
 /begin AXIS_DESCR COM_AXIS tco _CNV_A_R_LINEAR_____18_CM 5 -50. 205. FORMAT "%3.0" AXIS_PTS_REF ldp_tco_ip_fac_temp_ex /end AXIS_DESCR
/end CHARACTERISTIC
/begin AXIS_PTS ldp_tco_ip_fac_temp_ex "factor for exhaust temperature correction TCO" 0x842317 tco _REC_AXS_20_u1 255. _CNV_A_R_LINEAR_____18_CM 5 -50. 205. FORMAT "%3.0" /end AXIS_PTS
/begin CHARACTERISTIC ip_fac_temp_ex__dip_pf "GE_EGPT: TEMP_EX correction for dif. pressure on particulate filter" CURVE 0x852a56 _REC_CUR_20_u2_u2 3.99998471 _CNV_A_R_LINEAR_____59_CM 0. 3.99998471 DISPLAY_IDENTIFIER IP_FAC_TEMP_EX__DIP_PF FORMAT "%6.5"
 /begin AXIS_DESCR COM_AXIS dip_pf _CNV_A_R_LINEAR_____45_CM 8 0. 5434. FORMAT "%6.2" AXIS_PTS_REF ldp_dip_pf_ip_fac_temp_ex /end AXIS_DESCR
/end CHARACTERISTIC
/begin AXIS_PTS ldp_dip_pf_ip_fac_temp_ex "TEMP_EX correction for dif. pressure on particulate filter" 0x841584 dip_pf _REC_AXS_20_u2 5434. _CNV_A_R_LINEAR_____45_CM 8 0. 5434. FORMAT "%6.2" /end AXIS_PTS
/begin CHARACTERISTIC ip_fac_prs_ex__tco "GE_EGPT: influence of tco on the expresure" CURVE 0x8528ea _REC_CUR_20_u2_u1 1.9999696 _CNV_A_R_LINEAR_____48_CM 0. 1.9999696 DISPLAY_IDENTIFIER IP_FAC_PRS_EX__TCO FORMAT "%6.5"
 /begin AXIS_DESCR COM_AXIS tco _CNV_A_R_LINEAR_____18_CM 5 -50. 205. FORMAT "%3.0" AXIS_PTS_REF ldp_tco_ip_fac_prs_ex /end AXIS_DESCR
/end CHARACTERISTIC
/begin AXIS_PTS ldp_tco_ip_fac_prs_ex "influence of tco on the expresure" 0x8422e3 tco _REC_AXS_20_u1 255. _CNV_A_R_LINEAR_____18_CM 5 -50. 205. FORMAT "%3.0" /end AXIS_PTS
/begin CHARACTERISTIC ip_maf_max__n "GE_EGPT: max maf as function on n" CURVE 0x853700 _REC_CUR_20_u2_u2 1389. _CNV_A_R_LINEAR_____60_CM 0. 1389. DISPLAY_IDENTIFIER IP_MAF_MAX__N FORMAT "%6.2"
 /begin AXIS_DESCR COM_AXIS n _CNV_A_R_LINEAR_____5_CM 9 0. 6375. FORMAT "%4.0" AXIS_PTS_REF ldp_n_ip_maf_max /end AXIS_DESCR
/end CHARACTERISTIC
/begin AXIS_PTS ldp_n_ip_maf_max "max maf as function on n" 0x841b04 n _REC_AXS_20_u2 6375. _CNV_A_R_LINEAR_____5_CM 9 0. 6375. FORMAT "%4.0" /end AXIS_PTS
/begin CHARACTERISTIC ip_tcha_fac1__pq_cmp "GE_EGPT: factor1 for turbocharger balance equation" CURVE 0x85b0e6 _REC_CUR_20_u2_u2 1.9999696 _CNV_A_R_LINEAR_____48_CM 0. 1.9999696 DISPLAY_IDENTIFIER IP_TCHA_FAC1__PQ_CMP FORMAT "%6.5"
 /begin AXIS_DESCR COM_AXIS pq_cmp[1] _CNV_A_R_LINEAR_____144_CM 12 0. 6.5535 FORMAT "%5.4" AXIS_PTS_REF ldp_pq_cmp_ip_tcha_fac1 /end AXIS_DESCR
/end CHARACTERISTIC
/begin AXIS_PTS ldp_pq_cmp_ip_tcha_fac1 "" 0x842040 pq_cmp[1] _REC_AXS_20_u2 6.5535 _CNV_A_R_LINEAR_____144_CM 12 0. 6.5535 FORMAT "%5.4" /end AXIS_PTS
/begin CHARACTERISTIC ip_tcha_fac2__tcha_bal "GE_EGPT: factor2 for turbocharger balance equation" CURVE 0x85b0fe _REC_CUR_20_u2_u2 0.9999847412109381 _CNV_A_R_LINEAR_____14_CM 0. 0.9999847412109381 DISPLAY_IDENTIFIER IP_TCHA_FAC2__TCHA_BAL FORMAT "%6.5"
 /begin AXIS_DESCR COM_AXIS online_dummy _CNV_A_R_LINEAR_____59_CM 12 0. 3.99998471 FORMAT "%6.5" AXIS_PTS_REF ldp_tcha_bal_ip_tcha_fac2 /end AXIS_DESCR
/end CHARACTERISTIC
/begin AXIS_PTS ldp_tcha_bal_ip_tcha_fac2 "factor2 for turbocharger balance equation" 0x842258 online_dummy _REC_AXS_20_u2 3.99998471 _CNV_A_R_LINEAR_____59_CM 12 0. 3.99998471 FORMAT "%6.5" /end AXIS_PTS
/begin CHARACTERISTIC ip_fac1_cmp__pq_cmp "GE_EGPT: ip_fac1_cmp__pq_cmp" CURVE 0x852362 _REC_CUR_20_u2_u2 6.5535 _CNV_A_R_LINEAR_____144_CM 0. 6.5535 DISPLAY_IDENTIFIER IP_FAC1_CMP__PQ_CMP FORMAT "%5.4"
 /begin AXIS_DESCR COM_AXIS pq_cmp[1] _CNV_A_R_LINEAR_____144_CM 8 0. 6.5535 FORMAT "%5.4" AXIS_PTS_REF ldp_pq_cmp_ip_fac1_cmp /end AXIS_DESCR
/end CHARACTERISTIC
/begin AXIS_PTS ldp_pq_cmp_ip_fac1_cmp "PQ_CMP_SP" 0x84200c pq_cmp[1] _REC_AXS_20_u2 6.5535 _CNV_A_R_LINEAR_____144_CM 8 0. 6.5535 FORMAT "%5.4" /end AXIS_PTS
/begin CHARACTERISTIC ip_eff_tcha_mec__n_tcha_stnd "GE_EGPT: non isentopic efficiency factor EFF_LOSS_TCHA" CURVE 0x851ff6 _REC_CUR_20_u2_u2 0.9999847412109381 _CNV_A_R_LINEAR_____14_CM 0. 0.9999847412109381 DISPLAY_IDENTIFIER IP_EFF_TCHA_MEC__N_TCHA_STND FORMAT "%6.5"
 /begin AXIS_DESCR COM_AXIS online_dummy _CNV_A_R_LINEAR_____14_CM 10 0. 0.9999847412109381 FORMAT "%6.5" AXIS_PTS_REF ldp_n_tcha_stnd_ip_eff_tcha_mec /end AXIS_DESCR
/end CHARACTERISTIC
/begin AXIS_PTS ldp_n_tcha_stnd_ip_eff_tcha_mec "non isentopic efficiency factor EFF_LOSS_TCHA" 0x841fa4 online_dummy _REC_AXS_20_u2 0.9999847412109381 _CNV_A_R_LINEAR_____14_CM 10 0. 0.9999847412109381 FORMAT "%6.5" /end AXIS_PTS
/begin CHARACTERISTIC ip_fac_exp__kapa "GE_EGPT: ip_fac_exp__kapa" CURVE 0x852416 _REC_CUR_20_u2_u2 100. _CNV_A_R_LINEAR_____128_CM 0. 100. DISPLAY_IDENTIFIER IP_FAC_EXP__KAPA
 /begin AXIS_DESCR COM_AXIS online_dummy _CNV_A_R_LINEAR_____48_CM 5 0. 1.9999696 FORMAT "%6.5" AXIS_PTS_REF ldp_kapa_ip_fac_exp /end AXIS_DESCR
/end CHARACTERISTIC
/begin AXIS_PTS ldp_kapa_ip_fac_exp "&nbsp;" 0x841728 online_dummy _REC_AXS_20_u2 1.9999696 _CNV_A_R_LINEAR_____48_CM 5 0. 1.9999696 FORMAT "%6.5" /end AXIS_PTS
/begin CHARACTERISTIC ip_fac_temp_eb__vel_air_eb "GE_EGPT: air flow influence of engine box temperature" CURVE 0x852a2a _REC_CUR_20_u2_u2 100. _CNV_A_R_LINEAR_____128_CM 0. 100. DISPLAY_IDENTIFIER IP_FAC_TEMP_EB__VEL_AIR_EB
 /begin AXIS_DESCR COM_AXIS online_dummy _CNV_A_R_LINEAR_____128_CM 10 0. 100. AXIS_PTS_REF ldp_vel_air_eb_ip_fac_temp_eb /end AXIS_DESCR
/end CHARACTERISTIC
/begin AXIS_PTS ldp_vel_air_eb_ip_fac_temp_eb "air flow influence of engine box temperature" 0x842aaa online_dummy _REC_AXS_20_u2 100. _CNV_A_R_LINEAR_____128_CM 10 0. 100. /end AXIS_PTS
/begin CHARACTERISTIC ip_vel_air_eb__vel_air_am "GE_EGPT: mean air flow velocity in engine bay" CURVE 0x85c64c _REC_CUR_20_u2_u2 100. _CNV_A_R_LINEAR_____170_CM 0. 100. DISPLAY_IDENTIFIER IP_VEL_AIR_EB__VEL_AIR_AM
 /begin AXIS_DESCR COM_AXIS online_dummy _CNV_A_R_LINEAR_____170_CM 10 0. 100. AXIS_PTS_REF ldp_vel_air_am_ip_vel_air_eb /end AXIS_DESCR
/end CHARACTERISTIC
/begin AXIS_PTS ldp_vel_air_am_ip_vel_air_eb "mean air flow velocity in engine bay" 0x842a94 online_dummy _REC_AXS_20_u2 100. _CNV_A_R_LINEAR_____170_CM 10 0. 100. /end AXIS_PTS
/begin CHARACTERISTIC ip_vel_fan__pow_fan "GE_EGPT: air velocity after fan" CURVE 0x85c660 _REC_CUR_20_u2_u2 100. _CNV_A_R_LINEAR_____170_CM 0. 100. DISPLAY_IDENTIFIER IP_VEL_FAN__POW_FAN
 /begin AXIS_DESCR COM_AXIS online_dummy _CNV_A_R_LINEAR_____189_CM 12 0. 65535. FORMAT "%5.0" AXIS_PTS_REF ldp_pow_fan_ip_vel_fan /end AXIS_DESCR
/end CHARACTERISTIC
/begin AXIS_PTS ldp_pow_fan_ip_vel_fan "" 0x841fd0 online_dummy _REC_AXS_20_u2 65535. _CNV_A_R_LINEAR_____189_CM 12 0. 65535. FORMAT "%5.0" /end AXIS_PTS
/begin CHARACTERISTIC ip_delta_temp_ex_port__fac "GE_EGPT: ratio of temperature differences (gas - wall, manifold entry/exit)" CURVE 0x851dae _REC_CUR_20_u2_u2 0.9999847412109381 _CNV_A_R_LINEAR_____14_CM 0. 0.9999847412109381 DISPLAY_IDENTIFIER IP_DELTA_TEMP_EX_PORT__FAC FORMAT "%6.5"
 /begin AXIS_DESCR COM_AXIS stanton_it[1] _CNV_A_R_LINEAR_____174_CM 12 0. 19.979695 FORMAT "%6.4" AXIS_PTS_REF ldp_fac_ip_delta_temp_ex_port /end AXIS_DESCR
/end CHARACTERISTIC
/begin AXIS_PTS ldp_fac_ip_delta_temp_ex_port "" 0x841692 stanton_it[1] _REC_AXS_20_u2 19.979695 _CNV_A_R_LINEAR_____174_CM 12 0. 19.979695 FORMAT "%6.4" /end AXIS_PTS
/begin CHARACTERISTIC ip_fac1_nu_it__rey "GE_EGPT: reynolds factor for internal nusselt number calculation" CURVE 0x8523a4 _REC_CUR_20_u2_u2 500. _CNV_A_R_LINEAR_____190_CM 0. 500. DISPLAY_IDENTIFIER IP_FAC1_NU_IT__REY
 /begin AXIS_DESCR COM_AXIS reynolds_ext[1] _CNV_A_R_LINEAR_____176_CM 6 0. 262.14 AXIS_PTS_REF ldp_rey_fac1_nu_it /end AXIS_DESCR
/end CHARACTERISTIC
/begin AXIS_PTS ldp_rey_fac1_nu_it "" 0x842128 reynolds_ext[1] _REC_AXS_20_u2 262.14 _CNV_A_R_LINEAR_____176_CM 6 0. 262.14 /end AXIS_PTS
/begin CHARACTERISTIC ip_fac2_nu_it__div_diam_len "GE_EGPT: length ratio factor for internal nusselt number calculation" CURVE 0x8523b0 _REC_CUR_20_u2_u2 2.88354 _CNV_A_R_LINEAR_____191_CM 0. 2.88354 DISPLAY_IDENTIFIER IP_FAC2_NU_IT__DIV_DIAM_LEN FORMAT "%6.5"
 /begin AXIS_DESCR COM_AXIS div_diam_len_ex_port _CNV_A_R_LINEAR_____48_CM 11 0. 1.9999696 FORMAT "%6.5" AXIS_PTS_REF ldp_div_diam_len_ip_fac2_nu_it /end AXIS_DESCR
/end CHARACTERISTIC
/begin AXIS_PTS ldp_div_diam_len_ip_fac2_nu_it "length ratio factor for internal nusselt number calculation" 0x841596 div_diam_len_ex_port _REC_AXS_20_u2 1.9999696 _CNV_A_R_LINEAR_____48_CM 11 0. 1.9999696 FORMAT "%6.5" /end AXIS_PTS
/begin CHARACTERISTIC ip_fac3_nu_it__div_visc "GE_EGPT: viscosity factor for internal nusselt number calculation" CURVE 0x8523c6 _REC_CUR_20_u1_u2 1.9921875 _CNV_A_R_LINEAR_____101_CM 0. 1.9921875 DISPLAY_IDENTIFIER IP_FAC3_NU_IT__DIV_VISC FORMAT "%4.3"
 /begin AXIS_DESCR COM_AXIS online_dummy _CNV_A_R_LINEAR_____192_CM 4 0. 2.509804 FORMAT "%6.5" AXIS_PTS_REF ldp_div_visc_ip_fac3_nu_it /end AXIS_DESCR
/end CHARACTERISTIC
/begin AXIS_PTS ldp_div_visc_ip_fac3_nu_it "viscosity factor for internal nusselt number calculation" 0x8415d0 online_dummy _REC_AXS_20_u2 2.509804 _CNV_A_R_LINEAR_____192_CM 4 0. 2.509804 FORMAT "%6.5" /end AXIS_PTS
/begin CHARACTERISTIC ip_nu_ext__rey "GE_EGPT: factor for external nusselt number calculation" CURVE 0x85805e _REC_CUR_20_u2_u2 2000. _CNV_A_R_LINEAR_____193_CM 0. 2000. DISPLAY_IDENTIFIER IP_NU_EXT__REY FORMAT "%6.2"
 /begin AXIS_DESCR COM_AXIS reynolds_ext[1] _CNV_A_R_LINEAR_____176_CM 6 0. 262.14 AXIS_PTS_REF ldp_rey_fac1_nu_it /end AXIS_DESCR
/end CHARACTERISTIC
/begin CHARACTERISTIC ip_div_t_tur__div_prs_tur "GE_EGPT: DIV_T_TUR as f(DIV_PRS_TUR, EFF_TUR)" CURVE 0x851dc6 _REC_CUR_20_u2_u2 0.9999847412109381 _CNV_A_R_LINEAR_____14_CM 0. 0.9999847412109381 DISPLAY_IDENTIFIER IP_DIV_T_TUR__DIV_PRS_TUR FORMAT "%6.5"
 /begin AXIS_DESCR COM_AXIS online_dummy _CNV_A_R_LINEAR_____144_CM 16 0. 6.5535 FORMAT "%5.4" AXIS_PTS_REF ldp_div_prs_tur_ip_div_t_tur /end AXIS_DESCR
/end CHARACTERISTIC
/begin AXIS_PTS ldp_div_prs_tur_ip_div_t_tur "DIV_T_TUR as f(DIV_PRS_TUR, EFF_TUR)" 0x8415ae online_dummy _REC_AXS_20_u2 6.5535 _CNV_A_R_LINEAR_____144_CM 16 0. 6.5535 FORMAT "%5.4" /end AXIS_PTS
/begin CHARACTERISTIC ip_amp_dec__maf_kgh "GE_EGPT: AMP correction after air filter" CURVE 0x850974 _REC_CUR_20_u2_u2 5434. _CNV_A_R_LINEAR_____45_CM 0. 5434. DISPLAY_IDENTIFIER IP_AMP_DEC__MAF_KGH FORMAT "%6.2"
 /begin AXIS_DESCR COM_AXIS online_dummy _CNV_A_R_LINEAR_____110_CM 5 0. 1023.984375 FORMAT "%6.2" AXIS_PTS_REF ldp_maf_kgh_ip_map_dec /end AXIS_DESCR
/end CHARACTERISTIC
/begin CHARACTERISTIC ip_temp_ex_bas__n__mf "GE_EGPT: basic exhaust gas temperature" MAP 0x85b16a _REC_MAP_20_u2_u2_u2 1023.984375 _CNV_A_R_LINEAR_____157_CM 0. 1023.984375 DISPLAY_IDENTIFIER IP_TEMP_EX_BAS__N__MF FORMAT "%6.2"
 /begin AXIS_DESCR COM_AXIS n _CNV_A_R_LINEAR_____5_CM 9 0. 6375. FORMAT "%4.0" AXIS_PTS_REF ldp_n_ip_temp_ex /end AXIS_DESCR
 /begin AXIS_DESCR COM_AXIS mf_bas _CNV_A_R_LINEAR_____38_CM 5 0. 262.14 AXIS_PTS_REF ldp_mf_ip_temp_ex /end AXIS_DESCR
/end CHARACTERISTIC
/begin AXIS_PTS ldp_n_ip_temp_ex "basic exhaust gas temperature" 0x841eac n _REC_AXS_20_u2 6375. _CNV_A_R_LINEAR_____5_CM 9 0. 6375. FORMAT "%4.0" /end AXIS_PTS
/begin AXIS_PTS ldp_mf_ip_temp_ex "basic exhaust gas temperature" 0x8418b6 mf_bas _REC_AXS_20_u2 262.14 _CNV_A_R_LINEAR_____38_CM 5 0. 262.14 /end AXIS_PTS
/begin CHARACTERISTIC ip_fac_temp_ex__maf_rel__egr "GE_EGPT: influence of MAF_REL and EGR on TEMP_EX" MAP 0x852a66 _REC_MAP_20_u2_u2_u2 1.9999696 _CNV_A_R_LINEAR_____48_CM 0. 1.9999696 DISPLAY_IDENTIFIER IP_FAC_TEMP_EX__MAF_REL__EGR FORMAT "%6.5"
 /begin AXIS_DESCR COM_AXIS maf_rel_sp _CNV_A_R_LINEAR_____134_CM 6 0. 100. FORMAT "%5.3" AXIS_PTS_REF ldp_maf_rel_ip_fac_temp_ex /end AXIS_DESCR
 /begin AXIS_DESCR COM_AXIS egr_sp _CNV_A_R_LINEAR_____134_CM 6 0. 100. FORMAT "%5.3" AXIS_PTS_REF ldp_egr_ip_fac_temp_ex /end AXIS_DESCR
/end CHARACTERISTIC
/begin AXIS_PTS ldp_maf_rel_ip_fac_temp_ex "influence of MAF_REL and EGR on TEMP_EX" 0x841792 maf_rel_sp _REC_AXS_20_u2 100. _CNV_A_R_LINEAR_____134_CM 6 0. 100. FORMAT "%5.3" /end AXIS_PTS
/begin AXIS_PTS ldp_egr_ip_fac_temp_ex "influence of MAF_REL and EGR on TEMP_EX" 0x841676 egr_sp _REC_AXS_20_u2 100. _CNV_A_R_LINEAR_____134_CM 6 0. 100. FORMAT "%5.3" /end AXIS_PTS
/begin AXIS_PTS ldp_n_ip_prs_ex "exhaust pressure" 0x841cd6 n _REC_AXS_20_u2 6375. _CNV_A_R_LINEAR_____5_CM 9 0. 6375. FORMAT "%4.0" /end AXIS_PTS
/begin AXIS_PTS ldp_mf_ip_prs_ex "exhaust pressure" 0x84189c mf_bas _REC_AXS_20_u2 262.14 _CNV_A_R_LINEAR_____38_CM 5 0. 262.14 /end AXIS_PTS
/begin CHARACTERISTIC ip_fac_prs_ex__maf_rel__egr "GE_EGPT: influence of mafrel and egr on the expressure" MAP 0x8528a2 _REC_MAP_20_u2_u2_u2 1.9999696 _CNV_A_R_LINEAR_____48_CM 0. 1.9999696 DISPLAY_IDENTIFIER IP_FAC_PRS_EX__MAF_REL__EGR FORMAT "%6.5"
 /begin AXIS_DESCR COM_AXIS maf_rel_sp _CNV_A_R_LINEAR_____134_CM 6 0. 100. FORMAT "%5.3" AXIS_PTS_REF ldp_maf_rel_ip_fac_prs_ex /end AXIS_DESCR
 /begin AXIS_DESCR COM_AXIS egr_sp _CNV_A_R_LINEAR_____134_CM 6 0. 100. FORMAT "%5.3" AXIS_PTS_REF ldp_egr_ip_fac_prs_ex /end AXIS_DESCR
/end CHARACTERISTIC
/begin AXIS_PTS ldp_maf_rel_ip_fac_prs_ex "influence of mafrel and egr on the expressure" 0x841784 maf_rel_sp _REC_AXS_20_u2 100. _CNV_A_R_LINEAR_____134_CM 6 0. 100. FORMAT "%5.3" /end AXIS_PTS
/begin AXIS_PTS ldp_egr_ip_fac_prs_ex "influence of mafrel and egr on the expressure" 0x841668 egr_sp _REC_AXS_20_u2 100. _CNV_A_R_LINEAR_____134_CM 6 0. 100. FORMAT "%5.3" /end AXIS_PTS
/begin CHARACTERISTIC ip_fac_mfw_tur__temp_ex__prs_ex "GE_EGPT: standardization factor for turbine mass flow" MAP 0x852870 _REC_MAP_20_u2_u2_u2 65.535 _CNV_A_R_LINEAR_____162_CM 0. 65.535 DISPLAY_IDENTIFIER IP_FAC_MFW_TUR__TEMP_EX__PRS_EX FORMAT "%5.3"
 /begin AXIS_DESCR COM_AXIS temp_ex_mdl[1] _CNV_A_R_LINEAR_____157_CM 5 0. 1023.984375 FORMAT "%6.2" AXIS_PTS_REF ldp_temp_ex_ip_fac_mfw_tur_stnd /end AXIS_DESCR
 /begin AXIS_DESCR COM_AXIS prs_ex_mdl[1] _CNV_A_R_LINEAR_____45_CM 5 0. 5434. FORMAT "%6.2" AXIS_PTS_REF ldp_prs_ex_ip_fac_mfw_tur_stnd /end AXIS_DESCR
/end CHARACTERISTIC
/begin AXIS_PTS ldp_temp_ex_ip_fac_mfw_tur_stnd "standardization factor for turbine mass flow" 0x842434 temp_ex_mdl[1] _REC_AXS_20_u2 1023.984375 _CNV_A_R_LINEAR_____157_CM 5 0. 1023.984375 FORMAT "%6.2" /end AXIS_PTS
/begin AXIS_PTS ldp_prs_ex_ip_fac_mfw_tur_stnd "" 0x8420b0 prs_ex_mdl[1] _REC_AXS_20_u2 5434. _CNV_A_R_LINEAR_____45_CM 5 0. 5434. FORMAT "%6.2" /end AXIS_PTS
/begin CHARACTERISTIC ip_fac1_maf_stnd__tia__amp "GE_EGPT: standardization factor for the air mass flow" MAP 0x852372 _REC_MAP_20_u2_u1_u2 65.535 _CNV_A_R_LINEAR_____162_CM 0. 65.535 DISPLAY_IDENTIFIER IP_FAC1_MAF_STND__TIA__AMP FORMAT "%5.3"
 /begin AXIS_DESCR COM_AXIS tia _CNV_A_R_LINEAR_____18_CM 5 -50. 205. FORMAT "%3.0" AXIS_PTS_REF ldp_tia_ip_fac1_maf_stnd /end AXIS_DESCR
 /begin AXIS_DESCR COM_AXIS prs_up_cmp[1] _CNV_A_R_LINEAR_____45_CM 5 0. 5434. FORMAT "%6.2" AXIS_PTS_REF ldp_amp_ip_fac1_maf_stnd /end AXIS_DESCR
/end CHARACTERISTIC
/begin AXIS_PTS ldp_tia_ip_fac1_maf_stnd "standardization factor for the air mass flow" 0x84257d tia _REC_AXS_20_u1 255. _CNV_A_R_LINEAR_____18_CM 5 -50. 205. FORMAT "%3.0" /end AXIS_PTS
/begin AXIS_PTS ldp_amp_ip_fac1_maf_stnd "" 0x8410a6 prs_up_cmp[1] _REC_AXS_20_u2 5434. _CNV_A_R_LINEAR_____45_CM 5 0. 5434. FORMAT "%6.2" /end AXIS_PTS
/begin CHARACTERISTIC ip_eff_cmp__maf_stnd__pq_cmp "GE_EGPT: EFF_CMP" MAP 0x851df6 _REC_MAP_20_u2_u2_u2 0.9999847412109381 _CNV_A_R_LINEAR_____14_CM 0. 0.9999847412109381 DISPLAY_IDENTIFIER IP_EFF_CMP__MAF_STND__PQ_CMP FORMAT "%6.5"
 /begin AXIS_DESCR COM_AXIS maf_kgh_stnd[1] _CNV_A_R_LINEAR_____110_CM 16 0. 1023.984375 FORMAT "%6.2" AXIS_PTS_REF ldp_maf_stnd_ip_eff_cmp /end AXIS_DESCR
 /begin AXIS_DESCR COM_AXIS pq_cmp[1] _CNV_A_R_LINEAR_____144_CM 16 0. 6.5535 FORMAT "%5.4" AXIS_PTS_REF ldp_pq_cmp_ip_eff_cmp /end AXIS_DESCR
/end CHARACTERISTIC
/begin AXIS_PTS ldp_maf_stnd_ip_eff_cmp "" 0x8417a0 maf_kgh_stnd[1] _REC_AXS_20_u2 1023.984375 _CNV_A_R_LINEAR_____110_CM 16 0. 1023.984375 FORMAT "%6.2" /end AXIS_PTS
/begin AXIS_PTS ldp_pq_cmp_ip_eff_cmp "PQ_CMP_SP" 0x841fea pq_cmp[1] _REC_AXS_20_u2 6.5535 _CNV_A_R_LINEAR_____144_CM 16 0. 6.5535 FORMAT "%5.4" /end AXIS_PTS
/begin CHARACTERISTIC ip_n_tcha_stnd__maf_stnd__pq "GE_EGPT: standarized speed of the turbo charger" MAP 0x857e5e _REC_MAP_20_u2_u2_u2 0.9999847412109381 _CNV_A_R_LINEAR_____14_CM 0. 0.9999847412109381 DISPLAY_IDENTIFIER IP_N_TCHA_STND__MAF_STND__PQ FORMAT "%6.5"
 /begin AXIS_DESCR COM_AXIS maf_kgh_stnd[1] _CNV_A_R_LINEAR_____110_CM 16 0. 1023.984375 FORMAT "%6.2" AXIS_PTS_REF ldp_maf_stnd_ip_n_tcha_stnd /end AXIS_DESCR
 /begin AXIS_DESCR COM_AXIS pq_cmp[1] _CNV_A_R_LINEAR_____144_CM 16 0. 6.5535 FORMAT "%5.4" AXIS_PTS_REF ldp_pq_cmp_ip_n_tcha_stnd /end AXIS_DESCR
/end CHARACTERISTIC
/begin AXIS_PTS ldp_maf_stnd_ip_n_tcha_stnd "" 0x8417c2 maf_kgh_stnd[1] _REC_AXS_20_u2 1023.984375 _CNV_A_R_LINEAR_____110_CM 16 0. 1023.984375 FORMAT "%6.2" /end AXIS_PTS
/begin AXIS_PTS ldp_pq_cmp_ip_n_tcha_stnd "" 0x84201e pq_cmp[1] _REC_AXS_20_u2 6.5535 _CNV_A_R_LINEAR_____144_CM 16 0. 6.5535 FORMAT "%5.4" /end AXIS_PTS
/begin CHARACTERISTIC ip_eff_tur__bpa_psn__mfw_tur "GE_EGPT: isentropic efficiency of the turbine" MAP 0x85200a _REC_MAP_20_u2_u2_u2 0.9999847412109381 _CNV_A_R_LINEAR_____14_CM 0. 0.9999847412109381 DISPLAY_IDENTIFIER IP_EFF_TUR__BPA_PSN__MFW_TUR FORMAT "%6.5"
 /begin AXIS_DESCR COM_AXIS bpa_psn_sp_mmv _CNV_A_R_LINEAR_____134_CM 16 0. 100. FORMAT "%5.3" AXIS_PTS_REF ldp_bpa_psn_ip_eff_tur /end AXIS_DESCR
 /begin AXIS_DESCR COM_AXIS m_tur_kgh_stnd[1] _CNV_A_R_LINEAR_____110_CM 16 0. 1023.984375 FORMAT "%6.2" AXIS_PTS_REF ldp_mfw_tur_ip_eff_tur /end AXIS_DESCR
/end CHARACTERISTIC
/begin AXIS_PTS ldp_bpa_psn_ip_eff_tur "isentropic efficiency of the turbine" 0x841444 bpa_psn_sp_mmv _REC_AXS_20_u2 100. _CNV_A_R_LINEAR_____134_CM 16 0. 100. FORMAT "%5.3" /end AXIS_PTS
/begin AXIS_PTS ldp_mfw_tur_ip_eff_tur "" 0x8418ce m_tur_kgh_stnd[1] _REC_AXS_20_u2 1023.984375 _CNV_A_R_LINEAR_____110_CM 16 0. 1023.984375 FORMAT "%6.2" /end AXIS_PTS
/begin CHARACTERISTIC ip_capa_heat_prs_ex__temp__lamb "GE_EGPT: spec. heat capacity exhaus gas (p=const.)" MAP 0x8519a6 _REC_MAP_20_u2_u2_u2 2550. _CNV_A_R_LINEAR_____168_CM 0. 2550. DISPLAY_IDENTIFIER IP_CAPA_HEAT_PRS_EX__TEMP__LAMB FORMAT "%6.2"
 /begin AXIS_DESCR COM_AXIS temp_ex_mdl[1] _CNV_A_R_LINEAR_____157_CM 15 0. 1023.984375 FORMAT "%6.2" AXIS_PTS_REF ldpm_temp_ip_capa_heat_prs_ex /end AXIS_DESCR
 /begin AXIS_DESCR COM_AXIS online_dummy _CNV_A_R_LINEAR_____194_CM 15 0. 31.99951171875 FORMAT "%6.4" AXIS_PTS_REF ldpm_lamb_ip_capa_heat_prs_ex /end AXIS_DESCR
/end CHARACTERISTIC
/begin AXIS_PTS ldpm_temp_ip_capa_heat_prs_ex "" 0x8437d4 temp_ex_mdl[1] _REC_AXS_20_u2 1023.984375 _CNV_A_R_LINEAR_____157_CM 15 0. 1023.984375 FORMAT "%6.2" /end AXIS_PTS
/begin AXIS_PTS ldpm_lamb_ip_capa_heat_prs_ex "" 0x842bae online_dummy _REC_AXS_20_u2 31.99951171875 _CNV_A_R_LINEAR_____194_CM 15 0. 31.99951171875 FORMAT "%6.4" /end AXIS_PTS
/begin CHARACTERISTIC ip_fac_heat_tran_cyl__n__mf "GE_EGPT: heat transmission coeff" MAP 0x852440 _REC_MAP_20_u2_u2_u2 1023.984375 _CNV_A_R_LINEAR_____195_CM 0. 1023.984375 DISPLAY_IDENTIFIER IP_FAC_HEAT_TRAN_CYL__N__MF FORMAT "%6.2"
 /begin AXIS_DESCR COM_AXIS n _CNV_A_R_LINEAR_____5_CM 16 0. 6375. FORMAT "%4.0" AXIS_PTS_REF ldp_n_ip_fac_heat_tran_cyl /end AXIS_DESCR
 /begin AXIS_DESCR COM_AXIS mf_tot _CNV_A_R_LINEAR_____38_CM 8 0. 262.14 AXIS_PTS_REF ldp_mf_ip_fac_heat_tran_cyl /end AXIS_DESCR
/end CHARACTERISTIC
/begin AXIS_PTS ldp_n_ip_fac_heat_tran_cyl "heat transmission coeff" 0x841a14 n _REC_AXS_20_u2 6375. _CNV_A_R_LINEAR_____5_CM 16 0. 6375. FORMAT "%4.0" /end AXIS_PTS
/begin AXIS_PTS ldp_mf_ip_fac_heat_tran_cyl "heat transmission coeff" 0x84186e mf_tot _REC_AXS_20_u2 262.14 _CNV_A_R_LINEAR_____38_CM 8 0. 262.14 /end AXIS_PTS
/begin CHARACTERISTIC ip_fac_temp_cmp__kappa__cmp "GE_EGPT: factor for final compression temperature calculation" MAP 0x8529ee _REC_MAP_20_u2_u2_u2 12.799805 _CNV_A_R_LINEAR_____196_CM 0. 12.799805 DISPLAY_IDENTIFIER IP_FAC_TEMP_CMP__KAPPA__CMP FORMAT "%6.4"
 /begin AXIS_DESCR COM_AXIS online_dummy _CNV_A_R_LINEAR_____48_CM 6 0. 1.9999696 FORMAT "%6.5" AXIS_PTS_REF ldp_kappa_ip_fac_temp_cmp /end AXIS_DESCR
 /begin AXIS_DESCR COM_AXIS online_dummy _CNV_A_R_LINEAR_____128_CM 5 0. 100. AXIS_PTS_REF ldp_cmp_ratio_ip_fac_temp_cmp /end AXIS_DESCR
/end CHARACTERISTIC
/begin AXIS_PTS ldp_kappa_ip_fac_temp_cmp "factor for final compression temperature calculation" 0x841734 online_dummy _REC_AXS_20_u2 1.9999696 _CNV_A_R_LINEAR_____48_CM 6 0. 1.9999696 FORMAT "%6.5" /end AXIS_PTS
/begin AXIS_PTS ldp_cmp_ratio_ip_fac_temp_cmp "factor for final compression temperature calculation" 0x841488 online_dummy _REC_AXS_20_u2 100. _CNV_A_R_LINEAR_____128_CM 5 0. 100. /end AXIS_PTS
/begin CHARACTERISTIC ip_visc_ex__temp__lamb "GE_EGPT: dynamic viscosity exhaust gas" MAP 0x85c678 _REC_MAP_20_u2_u2_u2 262.14 _CNV_A_R_LINEAR_____197_CM 0. 262.14 DISPLAY_IDENTIFIER IP_VISC_EX__TEMP__LAMB
 /begin AXIS_DESCR COM_AXIS temp_ex_mdl[1] _CNV_A_R_LINEAR_____157_CM 15 0. 1023.984375 FORMAT "%6.2" AXIS_PTS_REF ldpm_temp_ip_capa_heat_prs_ex /end AXIS_DESCR
 /begin AXIS_DESCR COM_AXIS online_dummy _CNV_A_R_LINEAR_____194_CM 15 0. 31.99951171875 FORMAT "%6.4" AXIS_PTS_REF ldpm_lamb_ip_capa_heat_prs_ex /end AXIS_DESCR
/end CHARACTERISTIC
/begin CHARACTERISTIC ip_heat_cond_ex__temp__lamb "GE_EGPT: thermal conductivity coefficient exhaust gas" MAP 0x853102 _REC_MAP_20_u2_u2_u2 262.14 _CNV_A_R_LINEAR_____198_CM 0. 262.14 DISPLAY_IDENTIFIER IP_HEAT_COND_EX__TEMP__LAMB
 /begin AXIS_DESCR COM_AXIS temp_ex_mdl[1] _CNV_A_R_LINEAR_____157_CM 15 0. 1023.984375 FORMAT "%6.2" AXIS_PTS_REF ldpm_temp_ip_capa_heat_prs_ex /end AXIS_DESCR
 /begin AXIS_DESCR COM_AXIS online_dummy _CNV_A_R_LINEAR_____194_CM 15 0. 31.99951171875 FORMAT "%6.4" AXIS_PTS_REF ldpm_lamb_ip_capa_heat_prs_ex /end AXIS_DESCR
/end CHARACTERISTIC
/begin CHARACTERISTIC ip_capa_heat_vol_ex__temp__lamb "GE_EGPT: spec. heat capacity exhaus gas (v=const.)" MAP 0x851b68 _REC_MAP_20_u2_u2_u2 2550. _CNV_A_R_LINEAR_____168_CM 0. 2550. DISPLAY_IDENTIFIER IP_CAPA_HEAT_VOL_EX__TEMP__LAMB FORMAT "%6.2"
 /begin AXIS_DESCR COM_AXIS temp_ex_mdl[1] _CNV_A_R_LINEAR_____157_CM 15 0. 1023.984375 FORMAT "%6.2" AXIS_PTS_REF ldpm_temp_ip_capa_heat_prs_ex /end AXIS_DESCR
 /begin AXIS_DESCR COM_AXIS online_dummy _CNV_A_R_LINEAR_____194_CM 15 0. 31.99951171875 FORMAT "%6.4" AXIS_PTS_REF ldpm_lamb_ip_capa_heat_prs_ex /end AXIS_DESCR
/end CHARACTERISTIC
/begin CHARACTERISTIC ip_bpa_psn__div_prs_tur__m_tur "GE_EGPT: Variable Nozzle Position" MAP 0x850982 _REC_MAP_20_u2_u2_u2 100. _CNV_A_R_LINEAR_____134_CM 0. 100. DISPLAY_IDENTIFIER IP_BPA_PSN__DIV_PRS_TUR__M_TUR FORMAT "%5.3"
 /begin AXIS_DESCR COM_AXIS inv_div_prs_tur[1] _CNV_A_R_LINEAR_____144_CM 16 0. 6.5535 FORMAT "%5.4" AXIS_PTS_REF ldp_pq_tur_ip_bpa_psn /end AXIS_DESCR
 /begin AXIS_DESCR COM_AXIS m_tur_kgh_stnd[1] _CNV_A_R_LINEAR_____110_CM 16 0. 1023.984375 FORMAT "%6.2" AXIS_PTS_REF ldpm_mfw_tur_ip_pq_tur /end AXIS_DESCR
/end CHARACTERISTIC
/begin AXIS_PTS ldp_pq_tur_ip_bpa_psn "" 0x84208e inv_div_prs_tur[1] _REC_AXS_20_u2 6.5535 _CNV_A_R_LINEAR_____144_CM 16 0. 6.5535 FORMAT "%5.4" /end AXIS_PTS
/begin AXIS_PTS ldpm_mfw_tur_ip_pq_tur "" 0x842cb2 m_tur_kgh_stnd[1] _REC_AXS_20_u2 1023.984375 _CNV_A_R_LINEAR_____110_CM 16 0. 1023.984375 FORMAT "%6.2" /end AXIS_PTS
/begin MEASUREMENT dip_air_fil "" UWORD _CNV_A_R_LINEAR_____45_CM 1 0. 0. 5434. DISPLAY_IDENTIFIER DIP_AIR_FIL ECU_ADDRESS 0x7fa7a8 BYTE_ORDER MSB_LAST FORMAT "%6.2" /end MEASUREMENT
/begin MEASUREMENT dip_air_fil_sp "" UWORD _CNV_A_R_LINEAR_____45_CM 1 0. 0. 5434. DISPLAY_IDENTIFIER DIP_AIR_FIL_SP ECU_ADDRESS 0x7f9912 BYTE_ORDER MSB_LAST FORMAT "%6.2" /end MEASUREMENT
/begin AXIS_PTS ldp_maf_kgh_ip_map_dec "" 0x841766 online_dummy _REC_AXS_20_u2 1023.984375 _CNV_A_R_LINEAR_____110_CM 5 0. 1023.984375 FORMAT "%6.2" /end AXIS_PTS
/begin CHARACTERISTIC ip_prs_ex_bas__n__mf "GE_EGPT: exhaust pressure" MAP 0x85810a _REC_MAP_20_u2_u2_u2 5434. _CNV_A_R_LINEAR_____45_CM 0. 5434. DISPLAY_IDENTIFIER IP_PRS_EX_BAS__N__MF FORMAT "%6.2"
 /begin AXIS_DESCR COM_AXIS n _CNV_A_R_LINEAR_____5_CM 9 0. 6375. FORMAT "%4.0" AXIS_PTS_REF ldp_n_ip_prs_ex /end AXIS_DESCR
 /begin AXIS_DESCR COM_AXIS mf_bas _CNV_A_R_LINEAR_____38_CM 5 0. 262.14 AXIS_PTS_REF ldp_mf_ip_prs_ex /end AXIS_DESCR
/end CHARACTERISTIC
/begin MEASUREMENT ar_thr_pctl_the "precontroller cross section of EGR- throttle" UWORD _CNV_A_R_LINEAR_____7_CM 1 0. 0. 78.08 DISPLAY_IDENTIFIER AR_THR_PCTL_THE ECU_ADDRESS 0x7f99b2 BYTE_ORDER MSB_LAST FORMAT "%5.3" /end MEASUREMENT
/begin MEASUREMENT mafpwm_max "max. MAFPWM" UWORD _CNV_A_R_LINEAR_____136_CM 1 0. 0. 99.9969482421875 DISPLAY_IDENTIFIER MAFPWM_MAX ECU_ADDRESS 0x7f99b4 BYTE_ORDER MSB_LAST FORMAT "%5.3" /end MEASUREMENT
/begin MEASUREMENT ar_thr_pctl_the_bas "theortic precontrol cross section of the EGR- throttle" UWORD _CNV_A_R_LINEAR_____7_CM 1 0. 0. 78.08 DISPLAY_IDENTIFIER AR_THR_PCTL_THE_BAS ECU_ADDRESS 0x7fa910 BYTE_ORDER MSB_LAST FORMAT "%5.3" /end MEASUREMENT
/begin MEASUREMENT pq_thr_sp "estimated pressure quotient via the throttle" UWORD _CNV_A_R_LINEAR_____59_CM 1 0. 0. 3.99998471 DISPLAY_IDENTIFIER PQ_THR_SP ECU_ADDRESS 0x7fa912 BYTE_ORDER MSB_LAST FORMAT "%6.5" /end MEASUREMENT
/begin MEASUREMENT map_sp_ref "ref. manifold pressure at opened throttle and BPA precontrolled" UWORD _CNV_A_R_LINEAR_____45_CM 1 0. 0. 5434. DISPLAY_IDENTIFIER MAP_SP_REF ECU_ADDRESS 0x7f99b6 BYTE_ORDER MSB_LAST FORMAT "%6.2" /end MEASUREMENT
/begin CHARACTERISTIC c_fac_ar_thr_pctl_fil "filter factor for AR_THR_PCTL" VALUE 0x85c9aa _REC_VAL_20_u2 0.9999847412109381 _CNV_A_R_LINEAR_____14_CM 0. 0.9999847412109381 DISPLAY_IDENTIFIER C_FAC_AR_THR_PCTL_FIL FORMAT "%6.5" /end CHARACTERISTIC
/begin CHARACTERISTIC lc_thr_pctl_on "button for throttle predrive activation" VALUE 0x85ceb5 _REC_VAL_20_u1 1. _CNV_A_R_LINEAR_____0_CM 0. 1. DISPLAY_IDENTIFIER LC_THR_PCTL_ON FORMAT "%1.0" /end CHARACTERISTIC
/begin CHARACTERISTIC ip_fac_mfw_the__temp_in "GE_TPRE: factor depending on temperature to calculate the mass flow through a valve" CURVE 0x852858 _REC_CUR_20_u2_u1 1.99997e-002 _CNV_A_R_LINEAR_____200_CM 0. 1.99997e-002 DISPLAY_IDENTIFIER IP_FAC_MFW_THE__TEMP_IN FORMAT "%8.7"
 /begin AXIS_DESCR COM_AXIS tba _CNV_A_R_LINEAR_____18_CM 12 -50. 205. FORMAT "%3.0" AXIS_PTS_REF ldp_temp_in_ip_fac_mfw_the /end AXIS_DESCR
/end CHARACTERISTIC
/begin AXIS_PTS ldp_temp_in_ip_fac_mfw_the "" 0x842440 tba _REC_AXS_20_u1 255. _CNV_A_R_LINEAR_____18_CM 12 -50. 205. FORMAT "%3.0" /end AXIS_PTS
/begin CHARACTERISTIC ip_fac_mfw_the__pq "GE_TPRE: factor depending on the pressure quotient to calculate the mass flow through a valve" CURVE 0x852828 _REC_CUR_20_u2_u2 1.9999696 _CNV_A_R_LINEAR_____48_CM 0. 1.9999696 DISPLAY_IDENTIFIER IP_FAC_MFW_THE__PQ FORMAT "%6.5"
 /begin AXIS_DESCR COM_AXIS pq_thr_sp _CNV_A_R_LINEAR_____59_CM 12 0. 3.99998471 FORMAT "%6.5" AXIS_PTS_REF ldp_pq_ip_fac_mfw_the /end AXIS_DESCR
/end CHARACTERISTIC
/begin AXIS_PTS ldp_pq_ip_fac_mfw_the "" 0x842074 pq_thr_sp _REC_AXS_20_u2 3.99998471 _CNV_A_R_LINEAR_____59_CM 12 0. 3.99998471 FORMAT "%6.5" /end AXIS_PTS
/begin CHARACTERISTIC ip_map_sp_ref_0 "GE_TPRE: pressure in front of the throttle, injetion state=0" MAP 0x85493a _REC_MAP_20_u2_u2_u2 5434. _CNV_A_R_LINEAR_____45_CM 0. 5434. DISPLAY_IDENTIFIER IP_MAP_SP_REF_0 FORMAT "%6.2"
 /begin AXIS_DESCR COM_AXIS n _CNV_A_R_LINEAR_____5_CM 24 0. 6375. FORMAT "%4.0" AXIS_PTS_REF ldpm_n_ip_mf_pf /end AXIS_DESCR
 /begin AXIS_DESCR COM_AXIS tqi_sp _CNV_A_R_LINEAR_____86_CM 20 -1024. 1023.96875 FORMAT "%6.2" AXIS_PTS_REF ldpm_tqi_sp_ip_mf_pf /end AXIS_DESCR
/end CHARACTERISTIC
/begin AXIS_PTS ldpm_tqi_sp_ip_mf_pf "" 0x843d24 tqi_sp _REC_AXS_20_u2 2047.96875 _CNV_A_R_LINEAR_____86_CM 20 -1024. 1023.96875 FORMAT "%6.2" /end AXIS_PTS
/begin CHARACTERISTIC ip_map_sp_ref_1 "GE_TPRE: pressure in front of the throttle, injection state=1" MAP 0x854cfa _REC_MAP_20_u2_u2_u2 5434. _CNV_A_R_LINEAR_____45_CM 0. 5434. DISPLAY_IDENTIFIER IP_MAP_SP_REF_1 FORMAT "%6.2"
 /begin AXIS_DESCR COM_AXIS n _CNV_A_R_LINEAR_____5_CM 24 0. 6375. FORMAT "%4.0" AXIS_PTS_REF ldpm_n_ip_mf_pf /end AXIS_DESCR
 /begin AXIS_DESCR COM_AXIS tqi_sp _CNV_A_R_LINEAR_____86_CM 20 -1024. 1023.96875 FORMAT "%6.2" AXIS_PTS_REF ldpm_tqi_sp_ip_mf_pf /end AXIS_DESCR
/end CHARACTERISTIC
/begin MEASUREMENT tqi_grd_egr "torque gradient used for EGR" SWORD _CNV_A_R_LINEAR_____94_CM 1 0. -32768. 32767. DISPLAY_IDENTIFIER TQI_GRD_EGR ECU_ADDRESS 0x7f998e BYTE_ORDER MSB_LAST FORMAT "%5.0" /end MEASUREMENT
/begin MEASUREMENT tqi_grd_bpa "torque gradient used for BPA" SWORD _CNV_A_R_LINEAR_____94_CM 1 0. -32768. 32767. DISPLAY_IDENTIFIER TQI_GRD_BPA ECU_ADDRESS 0x7f9990 BYTE_ORDER MSB_LAST FORMAT "%5.0" /end MEASUREMENT
/begin MEASUREMENT tqi_egr "Indicated engine torque input for EGR" UWORD _CNV_A_R_LINEAR_____52_CM 1 0. 0. 1023.96875 DISPLAY_IDENTIFIER TQI_EGR ECU_ADDRESS 0x7f9992 BYTE_ORDER MSB_LAST FORMAT "%6.2" /end MEASUREMENT
/begin MEASUREMENT tqi_egr_ctl "Indicated engine torque input for the EGR- controller" UWORD _CNV_A_R_LINEAR_____52_CM 1 0. 0. 1023.96875 DISPLAY_IDENTIFIER TQI_EGR_CTL ECU_ADDRESS 0x7f9994 BYTE_ORDER MSB_LAST FORMAT "%6.2" /end MEASUREMENT
/begin MEASUREMENT tqi_bpa "Indicated engine torque input for boost pressure adjustment" UWORD _CNV_A_R_LINEAR_____52_CM 1 0. 0. 1023.96875 DISPLAY_IDENTIFIER TQI_BPA ECU_ADDRESS 0x7f9996 BYTE_ORDER MSB_LAST FORMAT "%6.2" /end MEASUREMENT
/begin MEASUREMENT tqi_bpa_ctl "Indicated engine torque input for the boost pressure controller" UWORD _CNV_A_R_LINEAR_____52_CM 1 0. 0. 1023.96875 DISPLAY_IDENTIFIER TQI_BPA_CTL ECU_ADDRESS 0x7f9998 BYTE_ORDER MSB_LAST FORMAT "%6.2" /end MEASUREMENT
/begin MEASUREMENT tqi_bpa_bal "Indicated engine torque input for the BPA- balancing function" UWORD _CNV_A_R_LINEAR_____52_CM 1 0. 0. 1023.96875 DISPLAY_IDENTIFIER TQI_BPA_BAL ECU_ADDRESS 0x7f999a BYTE_ORDER MSB_LAST FORMAT "%6.2" /end MEASUREMENT
/begin MEASUREMENT tqi_port_in "Indicated engine torque input for the intake port flap function" UWORD _CNV_A_R_LINEAR_____52_CM 1 0. 0. 1023.96875 DISPLAY_IDENTIFIER TQI_PORT_IN ECU_ADDRESS 0x7f999c BYTE_ORDER MSB_LAST FORMAT "%6.2" /end MEASUREMENT
/begin MEASUREMENT prs_up_thr "pressure upstream of the throttle (unfiltered)" UWORD _CNV_A_R_LINEAR_____45_CM 1 0. 0. 5434. DISPLAY_IDENTIFIER PRS_UP_THR ECU_ADDRESS 0x7f999e BYTE_ORDER MSB_LAST FORMAT "%6.2" /end MEASUREMENT
/begin MEASUREMENT prs_down_thr "pressure downstream of the throttle (unfiltered)" UWORD _CNV_A_R_LINEAR_____45_CM 1 0. 0. 5434. DISPLAY_IDENTIFIER PRS_DOWN_THR ECU_ADDRESS 0x7f99a0 BYTE_ORDER MSB_LAST FORMAT "%6.2" /end MEASUREMENT
/begin MEASUREMENT prs_loss_thr "pressure loss via the throttle (unfiltered value)" UWORD _CNV_A_R_LINEAR_____45_CM 1 0. 0. 5434. DISPLAY_IDENTIFIER PRS_LOSS_THR ECU_ADDRESS 0x7fa8fc BYTE_ORDER MSB_LAST FORMAT "%6.2" /end MEASUREMENT
/begin MEASUREMENT prs_grd_up_thr "gradient of PRS_UP_THR (pressure upstream of the throttle)" SWORD _CNV_A_R_LINEAR_____207_CM 1 0. -2717. 2716.91708 DISPLAY_IDENTIFIER PRS_GRD_UP_THR ECU_ADDRESS 0x7f99a2 BYTE_ORDER MSB_LAST FORMAT "%6.2" /end MEASUREMENT
/begin MEASUREMENT prs_grd_down_thr "gradient of PRS_DOWN_THR (pressure downstream of the throttle)" SWORD _CNV_A_R_LINEAR_____207_CM 1 0. -2717. 2716.91708 DISPLAY_IDENTIFIER PRS_GRD_DOWN_THR ECU_ADDRESS 0x7f99a4 BYTE_ORDER MSB_LAST FORMAT "%6.2" /end MEASUREMENT
/begin MEASUREMENT prs_up_thr_mmv "pressure upstream of the throttle (filtered)" UWORD _CNV_A_R_LINEAR_____45_CM 1 0. 0. 5434. DISPLAY_IDENTIFIER PRS_UP_THR_MMV ECU_ADDRESS 0x7f99a6 BYTE_ORDER MSB_LAST FORMAT "%6.2" /end MEASUREMENT
/begin MEASUREMENT prs_down_thr_mmv "pressure downstream of the throttle (filtered)" UWORD _CNV_A_R_LINEAR_____45_CM 1 0. 0. 5434. DISPLAY_IDENTIFIER PRS_DOWN_THR_MMV ECU_ADDRESS 0x7f99a8 BYTE_ORDER MSB_LAST FORMAT "%6.2" /end MEASUREMENT
/begin MEASUREMENT prs_loss_thr_mmv "pressure loss via the throttle (filtered value)" UWORD _CNV_A_R_LINEAR_____45_CM 1 0. 0. 5434. DISPLAY_IDENTIFIER PRS_LOSS_THR_MMV ECU_ADDRESS 0x7fa8fe BYTE_ORDER MSB_LAST FORMAT "%6.2" /end MEASUREMENT
/begin MEASUREMENT fac_mgstk_kgh "factor to convert the unit mg/stk into kg/h" UWORD _CNV_A_R_LINEAR_____208_CM 1 0. 0. 2.94877 DISPLAY_IDENTIFIER FAC_MGSTK_KGH ECU_ADDRESS 0x7f99aa BYTE_ORDER MSB_LAST FORMAT "%6.5" /end MEASUREMENT
/begin CHARACTERISTIC c_conf_tqi_egr_ctl "TQI-switch for the EGR- controller" VALUE 0x85c8ed _REC_VAL_20_u1 2. _CNV_A_R_LINEAR_____0_CM 0. 2. DISPLAY_IDENTIFIER C_CONF_TQI_EGR_CTL FORMAT "%1.0" /end CHARACTERISTIC
/begin CHARACTERISTIC c_conf_tqi_bpa "TQI-switch for the boost pressure adjustment" VALUE 0x85c8ea _REC_VAL_20_u1 1. _CNV_A_R_LINEAR_____0_CM 0. 1. DISPLAY_IDENTIFIER C_CONF_TQI_BPA FORMAT "%1.0" /end CHARACTERISTIC
/begin CHARACTERISTIC c_conf_tqi_bpa_ctl "TQI-switch for the boost pressure controller" VALUE 0x85c8ec _REC_VAL_20_u1 2. _CNV_A_R_LINEAR_____0_CM 0. 2. DISPLAY_IDENTIFIER C_CONF_TQI_BPA_CTL FORMAT "%1.0" /end CHARACTERISTIC
/begin CHARACTERISTIC c_conf_tqi_bpa_bal "TQI-switch for the BPA- balancing strategy" VALUE 0x85c8eb _REC_VAL_20_u1 2. _CNV_A_R_LINEAR_____0_CM 0. 2. DISPLAY_IDENTIFIER C_CONF_TQI_BPA_BAL FORMAT "%1.0" /end CHARACTERISTIC
/begin CHARACTERISTIC c_conf_tqi_port_in "TQI-switch for the intake port deactivation function" VALUE 0x85c8ee _REC_VAL_20_u1 2. _CNV_A_R_LINEAR_____0_CM 0. 2. DISPLAY_IDENTIFIER C_CONF_TQI_PORT_IN FORMAT "%1.0" /end CHARACTERISTIC
/begin CHARACTERISTIC lc_map_up_thr_on "button for configuring the position of the map-sensor" VALUE 0x85ce8c _REC_VAL_20_u1 1. _CNV_A_R_LINEAR_____0_CM 0. 1. DISPLAY_IDENTIFIER LC_MAP_UP_THR_ON FORMAT "%1.0" /end CHARACTERISTIC
/begin CHARACTERISTIC lc_tcha_on "switching between turbocharged and natural aspirated engines" VALUE 0x85cead _REC_VAL_20_u1 1. _CNV_A_R_LINEAR_____0_CM 0. 1. DISPLAY_IDENTIFIER LC_TCHA_ON FORMAT "%1.0" /end CHARACTERISTIC
/begin CHARACTERISTIC ip_prs_loss_thr "GE_SYSV: pressure loss via the throttle" MAP 0x858164 _REC_MAP_20_u2_u2_u2 5434. _CNV_A_R_LINEAR_____45_CM 0. 5434. DISPLAY_IDENTIFIER IP_PRS_LOSS_THR FORMAT "%6.2"
 /begin AXIS_DESCR COM_AXIS maf_mmv _CNV_A_R_LINEAR_____110_CM 8 0. 1023.984375 FORMAT "%6.2" AXIS_PTS_REF ldp_maf_kgh_ip_prs_loss_thr /end AXIS_DESCR
 /begin AXIS_DESCR COM_AXIS thr_pwm[0] _CNV_A_R_LINEAR_____8_CM 8 0. 99.99847412109381 FORMAT "%5.3" AXIS_PTS_REF ldp_thr_pwm_ip_prs_loss_thr /end AXIS_DESCR
/end CHARACTERISTIC
/begin AXIS_PTS ldp_maf_kgh_ip_prs_loss_thr "" 0x841772 maf_mmv _REC_AXS_20_u2 1023.984375 _CNV_A_R_LINEAR_____110_CM 8 0. 1023.984375 FORMAT "%6.2" /end AXIS_PTS
/begin AXIS_PTS ldp_thr_pwm_ip_prs_loss_thr "" 0x842562 thr_pwm[0] _REC_AXS_20_u2 99.99847412109381 _CNV_A_R_LINEAR_____8_CM 8 0. 99.99847412109381 FORMAT "%5.3" /end AXIS_PTS
/begin MEASUREMENT ang_sp_bpa[0] "verified angle signal from ECU" UWORD _CNV_A_R_LINEAR_____8_CM 1 0. 0. 99.99847412109381 DISPLAY_IDENTIFIER ANG_SP_BPA_0_ ECU_ADDRESS 0x7f98c6 BYTE_ORDER MSB_LAST FORMAT "%5.3" /end MEASUREMENT
/begin MEASUREMENT test_bpa[0] "test signal for closed-loop positon control" UWORD _CNV_A_R_LINEAR_____8_CM 1 0. 0. 99.99847412109381 DISPLAY_IDENTIFIER TEST_BPA_0_ ECU_ADDRESS 0x7fa6d8 BYTE_ORDER MSB_LAST FORMAT "%5.3" /end MEASUREMENT
/begin MEASUREMENT ctl_dif_bpa[0] "controller deviation" SWORD _CNV_A_R_LINEAR_____12_CM 1 0. -100. 99.996948242 DISPLAY_IDENTIFIER CTL_DIF_BPA_0_ ECU_ADDRESS 0x7f98c8 BYTE_ORDER MSB_LAST FORMAT "%5.3" /end MEASUREMENT
/begin MEASUREMENT ctl_bpa[0] "controller output with pre-controller" SWORD _CNV_A_R_LINEAR_____402_CM 1 0. -200. 199.99389 DISPLAY_IDENTIFIER CTL_BPA_0_ ECU_ADDRESS 0x7fa6da BYTE_ORDER MSB_LAST /end MEASUREMENT
/begin MEASUREMENT pi_dt1_bpa[0] "output PI controller and DT1 function" SWORD _CNV_A_R_LINEAR_____402_CM 1 0. -200. 199.99389 DISPLAY_IDENTIFIER PI_DT1_BPA_0_ ECU_ADDRESS 0x7fa6de BYTE_ORDER MSB_LAST /end MEASUREMENT
/begin MEASUREMENT dt1_bpa[0] "output DT1 function" SWORD _CNV_A_R_LINEAR_____402_CM 1 0. -200. 199.99389 DISPLAY_IDENTIFIER DT1_BPA_0_ ECU_ADDRESS 0x7fa6dc BYTE_ORDER MSB_LAST /end MEASUREMENT
/begin MEASUREMENT pi_bpa[0] "output PI controller" SWORD _CNV_A_R_LINEAR_____402_CM 1 0. -200. 199.99389 DISPLAY_IDENTIFIER PI_BPA_0_ ECU_ADDRESS 0x7fa6e0 BYTE_ORDER MSB_LAST /end MEASUREMENT
/begin MEASUREMENT tq_mot_bpa[0] "torque of DC motor" UWORD _CNV_A_R_LINEAR_____403_CM 1 0. 0. 999.98474 DISPLAY_IDENTIFIER TQ_MOT_BPA_0_ ECU_ADDRESS 0x7fa6e2 BYTE_ORDER MSB_LAST FORMAT "%5.2" /end MEASUREMENT
/begin MEASUREMENT v_mot_bpa[0] "voltage DC motor of BPA_j" UWORD _CNV_A_R_LINEAR_____404_CM 1 0. 0. 99.99847412109381 DISPLAY_IDENTIFIER V_MOT_BPA_0_ ECU_ADDRESS 0x7fa6e4 BYTE_ORDER MSB_LAST FORMAT "%5.3" /end MEASUREMENT
/begin MEASUREMENT r_mot_cor_bpa[0] "corrected resistance of DC motor" UWORD _CNV_A_R_LINEAR_____405_CM 1 0. 0. 9.999874 DISPLAY_IDENTIFIER R_MOT_COR_BPA_0_ ECU_ADDRESS 0x7f98ca BYTE_ORDER MSB_LAST FORMAT "%5.4" /end MEASUREMENT
/begin MEASUREMENT pctl_bpa[0] "output of the pre-controller" SWORD _CNV_A_R_LINEAR_____402_CM 1 0. -200. 199.99389 DISPLAY_IDENTIFIER PCTL_BPA_0_ ECU_ADDRESS 0x7fa6e6 BYTE_ORDER MSB_LAST /end MEASUREMENT
/begin MEASUREMENT ctl_lim_bpa[0] "limited controller output" SWORD _CNV_A_R_LINEAR_____12_CM 1 0. -100. 99.996948242 DISPLAY_IDENTIFIER CTL_LIM_BPA_0_ ECU_ADDRESS 0x7f98cc BYTE_ORDER MSB_LAST FORMAT "%5.3" /end MEASUREMENT
/begin MEASUREMENT lim_dif_bpa[0] "difference between limited and unlimited controller output" SWORD _CNV_A_R_LINEAR_____12_CM 1 0. -100. 99.996948242 DISPLAY_IDENTIFIER LIM_DIF_BPA_0_ ECU_ADDRESS 0x7fa6e8 BYTE_ORDER MSB_LAST FORMAT "%5.3" /end MEASUREMENT
/begin MEASUREMENT ctl_lim_bas_bpa[0] "basic controller output" SWORD _CNV_A_R_LINEAR_____12_CM 1 0. -100. 99.996948242 DISPLAY_IDENTIFIER CTL_LIM_BAS_BPA_0_ ECU_ADDRESS 0x7fa6ea BYTE_ORDER MSB_LAST FORMAT "%5.3" /end MEASUREMENT
/begin CHARACTERISTIC lc_test_bpa[0] "" VALUE 0x85ceae _REC_VAL_20_u1 1. _CNV_A_R_LINEAR_____0_CM 0. 1. DISPLAY_IDENTIFIER LC_TEST_BPA_0_ FORMAT "%1.0" /end CHARACTERISTIC
/begin CHARACTERISTIC c_test_fac_bpa[0] "" VALUE 0x85ccf0 _REC_VAL_20_u2 99.99847412109381 _CNV_A_R_LINEAR_____8_CM 0. 99.99847412109381 DISPLAY_IDENTIFIER C_TEST_FAC_BPA_0_ FORMAT "%5.3" /end CHARACTERISTIC
/begin CHARACTERISTIC c_test_add_bpa[0] "" VALUE 0x85ccea _REC_VAL_20_u2 99.99847412109381 _CNV_A_R_LINEAR_____8_CM 0. 99.99847412109381 DISPLAY_IDENTIFIER C_TEST_ADD_BPA_0_ FORMAT "%5.3" /end CHARACTERISTIC
/begin CHARACTERISTIC lc_dt1_bpa_on[0] "" VALUE 0x85ce6c _REC_VAL_20_u1 1. _CNV_A_R_LINEAR_____0_CM 0. 1. DISPLAY_IDENTIFIER LC_DT1_BPA_ON_0_ FORMAT "%1.0" /end CHARACTERISTIC
/begin CHARACTERISTIC lc_pi_bpa_on[0] "" VALUE 0x85ce9c _REC_VAL_20_u1 1. _CNV_A_R_LINEAR_____0_CM 0. 1. DISPLAY_IDENTIFIER LC_PI_BPA_ON_0_ FORMAT "%1.0" /end CHARACTERISTIC
/begin CHARACTERISTIC c_bpa_ini[0] "" VALUE 0x85c8ae _REC_VAL_20_s2 399.99389 _CNV_A_R_LINEAR_____402_CM -200. 199.99389 DISPLAY_IDENTIFIER C_BPA_INI_0_ /end CHARACTERISTIC
/begin CHARACTERISTIC c_gear_trans_ratio_bpa "gear transition ratio" VALUE 0x85ca3a _REC_VAL_20_u2 99.99847412109381 _CNV_A_R_LINEAR_____406_CM 0. 99.99847412109381 DISPLAY_IDENTIFIER C_GEAR_TRANS_RATIO_BPA FORMAT "%5.3" /end CHARACTERISTIC
/begin CHARACTERISTIC c_fac_temp_cu_el "electrical temperatur coefficient of copper" VALUE 0x85ca0a _REC_VAL_20_u2 0.125 _CNV_A_R_LINEAR_____407_CM 0. 0.125 DISPLAY_IDENTIFIER C_FAC_TEMP_CU_EL FORMAT "%7.6" /end CHARACTERISTIC
/begin CHARACTERISTIC c_temp_mot_bpa_ref "reference temperature DC motor" VALUE 0x85ccdc _REC_VAL_20_u1 255. _CNV_A_R_LINEAR_____18_CM -50. 205. DISPLAY_IDENTIFIER C_TEMP_MOT_BPA_REF FORMAT "%3.0" /end CHARACTERISTIC
/begin CHARACTERISTIC c_r_mot_bpa "resistance DC motor" VALUE 0x85cb80 _REC_VAL_20_u2 9.999874 _CNV_A_R_LINEAR_____405_CM 0. 9.999874 DISPLAY_IDENTIFIER C_R_MOT_BPA FORMAT "%5.4" /end CHARACTERISTIC
/begin CHARACTERISTIC c_pctl_bpa_lih "precontrol value during LIH" VALUE 0x85cb5e _REC_VAL_20_s2 399.99389 _CNV_A_R_LINEAR_____402_CM -200. 199.99389 DISPLAY_IDENTIFIER C_PCTL_BPA_LIH /end CHARACTERISTIC
/begin CHARACTERISTIC lc_pctl_bpa_lih "indicates the used precontrol value during LIH" VALUE 0x85ce96 _REC_VAL_20_u1 1. _CNV_A_R_LINEAR_____0_CM 0. 1. DISPLAY_IDENTIFIER LC_PCTL_BPA_LIH FORMAT "%1.0" /end CHARACTERISTIC
/begin CHARACTERISTIC c_temp_mot_bpa[0] "" VALUE 0x85ccdb _REC_VAL_20_u1 255. _CNV_A_R_LINEAR_____18_CM -50. 205. DISPLAY_IDENTIFIER C_TEMP_MOT_BPA_0_ FORMAT "%3.0" /end CHARACTERISTIC
/begin CHARACTERISTIC lc_pctl_phys_bpa_on[0] "" VALUE 0x85ce98 _REC_VAL_20_u1 1. _CNV_A_R_LINEAR_____0_CM 0. 1. DISPLAY_IDENTIFIER LC_PCTL_PHYS_BPA_ON_0_ FORMAT "%1.0" /end CHARACTERISTIC
/begin CHARACTERISTIC c_ctl_lim_bpa_add "additive correction" VALUE 0x85c93c _REC_VAL_20_s2 199.996948242 _CNV_A_R_LINEAR_____12_CM -100. 99.996948242 DISPLAY_IDENTIFIER C_CTL_LIM_BPA_ADD FORMAT "%5.3" /end CHARACTERISTIC
/begin CHARACTERISTIC c_fac_ctl_lim_bpa "correction factor" VALUE 0x85c9c4 _REC_VAL_20_s2 3.999939 _CNV_A_R_LINEAR_____408_CM -2. 1.999939 DISPLAY_IDENTIFIER C_FAC_CTL_LIM_BPA FORMAT "%6.5" /end CHARACTERISTIC
/begin CHARACTERISTIC lc_ctl_lim_bpa_man "activation of the manual output for the BPA- position controller" VALUE 0x85ce5f _REC_VAL_20_u1 1. _CNV_A_R_LINEAR_____0_CM 0. 1. DISPLAY_IDENTIFIER LC_CTL_LIM_BPA_MAN FORMAT "%1.0" /end CHARACTERISTIC
/begin CHARACTERISTIC c_ctl_lim_bpa_man[0] "" VALUE 0x85c93e _REC_VAL_20_s2 199.996948242 _CNV_A_R_LINEAR_____12_CM -100. 99.996948242 DISPLAY_IDENTIFIER C_CTL_LIM_BPA_MAN_0_ FORMAT "%5.3" /end CHARACTERISTIC
/begin CHARACTERISTIC ip_kr_dt1_bpa__ctl_dif "GE_BCLP: gain for DT1 function" CURVE 0x8532c4 _REC_CUR_20_u2_u2 8.047560000000001 _CNV_A_R_LINEAR_____409_CM -4.02378 4.02378 DISPLAY_IDENTIFIER IP_KR_DT1_BPA__CTL_DIF FORMAT "%6.5"
 /begin AXIS_DESCR COM_AXIS ctl_dif_bpa[0] _CNV_A_R_LINEAR_____161_CM 8 -100. 99.99694820000001 FORMAT "%5.3" AXIS_PTS_REF ldp_ctl_dif__ip_kr_dt1_bpa /end AXIS_DESCR
/end CHARACTERISTIC
/begin AXIS_PTS ldp_ctl_dif__ip_kr_dt1_bpa "" 0x841494 ctl_dif_bpa[0] _REC_AXS_20_u2 199.9969482 _CNV_A_R_LINEAR_____161_CM 8 -100. 99.99694820000001 FORMAT "%5.3" /end AXIS_PTS
/begin CHARACTERISTIC ip_t1_dt1_bpa__ctl_dif "GE_BCLP: time value for DT1 function" CURVE 0x85b01a _REC_CUR_20_u2_u2 0.125 _CNV_A_R_LINEAR_____410_CM 0. 0.125 DISPLAY_IDENTIFIER IP_T1_DT1_BPA__CTL_DIF FORMAT "%7.6"
 /begin AXIS_DESCR COM_AXIS ctl_dif_bpa[0] _CNV_A_R_LINEAR_____161_CM 8 -100. 99.99694820000001 FORMAT "%5.3" AXIS_PTS_REF ldp_ctl_dif__ip_t1_dt1_bpa /end AXIS_DESCR
/end CHARACTERISTIC
/begin AXIS_PTS ldp_ctl_dif__ip_t1_dt1_bpa "" 0x84150c ctl_dif_bpa[0] _REC_AXS_20_u2 199.9969482 _CNV_A_R_LINEAR_____161_CM 8 -100. 99.99694820000001 FORMAT "%5.3" /end AXIS_PTS
/begin CHARACTERISTIC ip_kr_pi_bpa__ctl_dif "GE_BCLP: proportional value for PI contoller" CURVE 0x853494 _REC_CUR_20_u2_u2 15.999755 _CNV_A_R_LINEAR_____13_CM 0. 15.999755 DISPLAY_IDENTIFIER IP_KR_PI_BPA__CTL_DIF FORMAT "%6.4"
 /begin AXIS_DESCR COM_AXIS ctl_dif_bpa[0] _CNV_A_R_LINEAR_____161_CM 9 -100. 99.99694820000001 FORMAT "%5.3" AXIS_PTS_REF ldp_ctl_dif__ip_kr_pi_bpa /end AXIS_DESCR
/end CHARACTERISTIC
/begin AXIS_PTS ldp_ctl_dif__ip_kr_pi_bpa "" 0x8414ca ctl_dif_bpa[0] _REC_AXS_20_u2 199.9969482 _CNV_A_R_LINEAR_____161_CM 9 -100. 99.99694820000001 FORMAT "%5.3" /end AXIS_PTS
/begin CHARACTERISTIC ip_tn_pi_bpa__ctl_dif "GE_BCLP: integral value for PI contoller" CURVE 0x85b47c _REC_CUR_20_u2_u2 15.999755 _CNV_A_R_LINEAR_____411_CM 0. 15.999755 DISPLAY_IDENTIFIER IP_TN_PI_BPA__CTL_DIF FORMAT "%6.4"
 /begin AXIS_DESCR COM_AXIS ctl_dif_bpa[0] _CNV_A_R_LINEAR_____161_CM 9 -100. 99.99694820000001 FORMAT "%5.3" AXIS_PTS_REF ldp_ctl_dif__ip_tn_pi_bpa /end AXIS_DESCR
/end CHARACTERISTIC
/begin AXIS_PTS ldp_ctl_dif__ip_tn_pi_bpa "" 0x841542 ctl_dif_bpa[0] _REC_AXS_20_u2 199.9969482 _CNV_A_R_LINEAR_____161_CM 9 -100. 99.99694820000001 FORMAT "%5.3" /end AXIS_PTS
/begin CHARACTERISTIC ip_tq_spr_bpa__ang_sp_bpa "GE_BCLP: characteristic of spring" CURVE 0x85b82c _REC_CUR_20_u2_u2 999.98474 _CNV_A_R_LINEAR_____403_CM 0. 999.98474 DISPLAY_IDENTIFIER IP_TQ_SPR_BPA__ANG_SP_BPA FORMAT "%5.2"
 /begin AXIS_DESCR COM_AXIS ang_sp_bpa[0] _CNV_A_R_LINEAR_____8_CM 4 0. 99.99847412109381 FORMAT "%5.3" AXIS_PTS_REF ldp_ang_sp_bpa_ip_tq_spr_bpa /end AXIS_DESCR
/end CHARACTERISTIC
/begin AXIS_PTS ldp_ang_sp_bpa_ip_tq_spr_bpa "" 0x84137c ang_sp_bpa[0] _REC_AXS_20_u2 99.99847412109381 _CNV_A_R_LINEAR_____8_CM 4 0. 99.99847412109381 FORMAT "%5.3" /end AXIS_PTS
/begin CHARACTERISTIC ip_cur_mot_bpa__tq_mot "GE_BCLP: current of DC motor" CURVE 0x851d96 _REC_CUR_20_u2_u2 9.999874 _CNV_A_R_LINEAR_____412_CM 0. 9.999874 DISPLAY_IDENTIFIER IP_CUR_MOT_BPA__TQ_MOT FORMAT "%5.4"
 /begin AXIS_DESCR COM_AXIS tq_mot_bpa[0] _CNV_A_R_LINEAR_____403_CM 4 0. 999.98474 FORMAT "%5.2" AXIS_PTS_REF ldp_tq_mot_bpa__ip_cur_mot /end AXIS_DESCR
/end CHARACTERISTIC
/begin AXIS_PTS ldp_tq_mot_bpa__ip_cur_mot "" 0x8425a6 tq_mot_bpa[0] _REC_AXS_20_u2 999.98474 _CNV_A_R_LINEAR_____403_CM 4 0. 999.98474 FORMAT "%5.2" /end AXIS_PTS
/begin CHARACTERISTIC ip_pctl_bpa__v_mot_bpa "GE_BCLP: characteristic of power inverter" CURVE 0x85807a _REC_CUR_20_u2_u2 399.993897 _CNV_A_R_LINEAR_____413_CM -200. 199.993897 DISPLAY_IDENTIFIER IP_PCTL_BPA__V_MOT_BPA
 /begin AXIS_DESCR COM_AXIS v_mot_bpa[0] _CNV_A_R_LINEAR_____404_CM 4 0. 99.99847412109381 FORMAT "%5.3" AXIS_PTS_REF ldp_v_mot_bpa__ip_pctl_bpa /end AXIS_DESCR
/end CHARACTERISTIC
/begin AXIS_PTS ldp_v_mot_bpa__ip_pctl_bpa "" 0x8429d0 v_mot_bpa[0] _REC_AXS_20_u2 99.99847412109381 _CNV_A_R_LINEAR_____404_CM 4 0. 99.99847412109381 FORMAT "%5.3" /end AXIS_PTS
/begin CHARACTERISTIC ip_pctl_bpa__ang_sp_bpa "GE_BCLP: precontrol for BPA actuator" CURVE 0x85806a _REC_CUR_20_u2_u2 399.993897 _CNV_A_R_LINEAR_____413_CM -200. 199.993897 DISPLAY_IDENTIFIER IP_PCTL_BPA__ANG_SP_BPA
 /begin AXIS_DESCR COM_AXIS ang_sp_bpa[0] _CNV_A_R_LINEAR_____8_CM 8 0. 99.99847412109381 FORMAT "%5.3" AXIS_PTS_REF ldp_ang_sp_bpa_ip_pctl_bpa /end AXIS_DESCR
/end CHARACTERISTIC
/begin AXIS_PTS ldp_ang_sp_bpa_ip_pctl_bpa "" 0x84136a ang_sp_bpa[0] _REC_AXS_20_u2 99.99847412109381 _CNV_A_R_LINEAR_____8_CM 8 0. 99.99847412109381 FORMAT "%5.3" /end AXIS_PTS
/begin CHARACTERISTIC ip_ctl_max_bpa_0__temp "GE_BCLP: maximum limit of BPA_0 controller output" CURVE 0x851d4e _REC_CUR_20_u1_u1 199.21875 _CNV_A_R_LINEAR_____414_CM -100. 99.21875 DISPLAY_IDENTIFIER IP_CTL_MAX_BPA_0__TEMP FORMAT "%3.1"
 /begin AXIS_DESCR COM_AXIS tco _CNV_A_R_LINEAR_____18_CM 4 -50. 205. FORMAT "%3.0" AXIS_PTS_REF ldpm_temp__ip_ctl_bpa /end AXIS_DESCR
/end CHARACTERISTIC
/begin AXIS_PTS ldpm_temp__ip_ctl_bpa "" 0x8437c4 tco _REC_AXS_20_u1 255. _CNV_A_R_LINEAR_____18_CM 4 -50. 205. FORMAT "%3.0" /end AXIS_PTS
/begin CHARACTERISTIC ip_ctl_min_bpa_0__temp "GE_BCLP: minimum limit of BPA_0 controller output" CURVE 0x851d62 _REC_CUR_20_u1_u1 199.21875 _CNV_A_R_LINEAR_____414_CM -100. 99.21875 DISPLAY_IDENTIFIER IP_CTL_MIN_BPA_0__TEMP FORMAT "%3.1"
 /begin AXIS_DESCR COM_AXIS tco _CNV_A_R_LINEAR_____18_CM 4 -50. 205. FORMAT "%3.0" AXIS_PTS_REF ldpm_temp__ip_ctl_bpa /end AXIS_DESCR
/end CHARACTERISTIC
/begin MEASUREMENT fac_bpa_pwm_cor[0] "multipl. correction for the boost pressure actuator (j=0..NC_BPA_NR-1)" UWORD _CNV_A_R_LINEAR_____59_CM 1 0. 0. 3.99998471 DISPLAY_IDENTIFIER FAC_BPA_PWM_COR_0_ ECU_ADDRESS 0x7f98ce BYTE_ORDER MSB_LAST FORMAT "%6.5" /end MEASUREMENT
/begin MEASUREMENT bpa_pwm_cor[0] "additive correction for the boost pressure actuator (j=0..NC_BPA_NR-1)" SWORD _CNV_A_R_LINEAR_____12_CM 1 0. -100. 99.996948242 DISPLAY_IDENTIFIER BPA_PWM_COR_0_ ECU_ADDRESS 0x7f98d0 BYTE_ORDER MSB_LAST FORMAT "%5.3" /end MEASUREMENT
/begin CHARACTERISTIC c_fac_bpa_pwm_cor_man[0] "" VALUE 0x85c9b6 _REC_VAL_20_u2 3.99998471 _CNV_A_R_LINEAR_____59_CM 0. 3.99998471 DISPLAY_IDENTIFIER C_FAC_BPA_PWM_COR_MAN_0_ FORMAT "%6.5" /end CHARACTERISTIC
/begin CHARACTERISTIC c_bpa_pwm_cor_man[0] "" VALUE 0x85c8b0 _REC_VAL_20_s2 199.996948242 _CNV_A_R_LINEAR_____12_CM -100. 99.996948242 DISPLAY_IDENTIFIER C_BPA_PWM_COR_MAN_0_ FORMAT "%5.3" /end CHARACTERISTIC
/begin MEASUREMENT ctl_dif_egrv[0] "controller deviation" SWORD _CNV_A_R_LINEAR_____12_CM 1 0. -100. 99.996948242 DISPLAY_IDENTIFIER CTL_DIF_EGRV_0_ ECU_ADDRESS 0x7f99bc BYTE_ORDER MSB_LAST FORMAT "%5.3" /end MEASUREMENT
/begin MEASUREMENT ctl_egrv[0] "controller output with pre-controller" SWORD _CNV_A_R_LINEAR_____402_CM 1 0. -200. 199.99389 DISPLAY_IDENTIFIER CTL_EGRV_0_ ECU_ADDRESS 0x7fa92c BYTE_ORDER MSB_LAST /end MEASUREMENT
/begin MEASUREMENT pi_dt1_egrv[0] "output PI controller and DT1 function" SWORD _CNV_A_R_LINEAR_____402_CM 1 0. -200. 199.99389 DISPLAY_IDENTIFIER PI_DT1_EGRV_0_ ECU_ADDRESS 0x7fa930 BYTE_ORDER MSB_LAST /end MEASUREMENT
/begin MEASUREMENT lv_edge_ang_sp_egrv_intv[0] "edge detect of LV_ANG_SP_EGRV_INTV_j" UBYTE _CNV_S_2_RANGE______11_CM 1 0. 0. 1. DISPLAY_IDENTIFIER LV_EDGE_ANG_SP_EGRV_INTV_0_ ECU_ADDRESS 0x7fbe6f /end MEASUREMENT
/begin MEASUREMENT pi_egrv[0] "output PI controller" SWORD _CNV_A_R_LINEAR_____402_CM 1 0. -200. 199.99389 DISPLAY_IDENTIFIER PI_EGRV_0_ ECU_ADDRESS 0x7fa932 BYTE_ORDER MSB_LAST /end MEASUREMENT
/begin MEASUREMENT dt1_egrv[0] "output DT1 function" SWORD _CNV_A_R_LINEAR_____402_CM 1 0. -200. 199.99389 DISPLAY_IDENTIFIER DT1_EGRV_0_ ECU_ADDRESS 0x7fa92e BYTE_ORDER MSB_LAST /end MEASUREMENT
/begin MEASUREMENT pctl_egrv[0] "output of the pre-controller" SWORD _CNV_A_R_LINEAR_____402_CM 1 0. -200. 199.99389 DISPLAY_IDENTIFIER PCTL_EGRV_0_ ECU_ADDRESS 0x7fa934 BYTE_ORDER MSB_LAST /end MEASUREMENT
/begin MEASUREMENT t_ang_sp_egrv_close[0] "time since active closing precontrol is active" UWORD _CNV_A_R_LINEAR_____73_CM 1 0. 0. 65.535 DISPLAY_IDENTIFIER T_ANG_SP_EGRV_CLOSE_0_ ECU_ADDRESS 0x7fa93e BYTE_ORDER MSB_LAST FORMAT "%5.3" /end MEASUREMENT
/begin MEASUREMENT tq_mot_egrv[0] "torque of DC motor" UWORD _CNV_A_R_LINEAR_____403_CM 1 0. 0. 999.98474 DISPLAY_IDENTIFIER TQ_MOT_EGRV_0_ ECU_ADDRESS 0x7fa918 BYTE_ORDER MSB_LAST FORMAT "%5.2" /end MEASUREMENT
/begin MEASUREMENT v_mot_egrv[0] "voltage DC motor of EGRV_j" UWORD _CNV_A_R_LINEAR_____404_CM 1 0. 0. 99.99847412109381 DISPLAY_IDENTIFIER V_MOT_EGRV_0_ ECU_ADDRESS 0x7fa91a BYTE_ORDER MSB_LAST FORMAT "%5.3" /end MEASUREMENT
/begin MEASUREMENT r_mot_cor_egrv[0] "corrected resistance of DC motor" UWORD _CNV_A_R_LINEAR_____405_CM 1 0. 0. 9.999874 DISPLAY_IDENTIFIER R_MOT_COR_EGRV_0_ ECU_ADDRESS 0x7f99be BYTE_ORDER MSB_LAST FORMAT "%5.4" /end MEASUREMENT
/begin MEASUREMENT ctl_lim_bas_egrv[0] "limited controller output" SWORD _CNV_A_R_LINEAR_____12_CM 1 0. -100. 99.996948242 DISPLAY_IDENTIFIER CTL_LIM_BAS_EGRV_0_ ECU_ADDRESS 0x7fa924 BYTE_ORDER MSB_LAST FORMAT "%5.3" /end MEASUREMENT
/begin MEASUREMENT lim_dif_egrv[0] "difference between limited and unlimited controller output" SWORD _CNV_A_R_LINEAR_____12_CM 1 0. -100. 99.996948242 DISPLAY_IDENTIFIER LIM_DIF_EGRV_0_ ECU_ADDRESS 0x7fa936 BYTE_ORDER MSB_LAST FORMAT "%5.3" /end MEASUREMENT
/begin MEASUREMENT ctl_lim_egrv[0] "controller output" SWORD _CNV_A_R_LINEAR_____12_CM 1 0. -100. 99.996948242 DISPLAY_IDENTIFIER CTL_LIM_EGRV_0_ ECU_ADDRESS 0x7f99c0 BYTE_ORDER MSB_LAST FORMAT "%5.3" /end MEASUREMENT
/begin MEASUREMENT ctl_egrv_pre_lim[0] "EGRV control output before limitation" SWORD _CNV_A_R_LINEAR_____402_CM 1 0. -200. 199.99389 DISPLAY_IDENTIFIER CTL_EGRV_PRE_LIM_0_ ECU_ADDRESS 0x7fa93a BYTE_ORDER MSB_LAST /end MEASUREMENT
/begin MEASUREMENT ctl_dyn_lim_egrv[0] "Dynamic EGRV output limitation" SWORD _CNV_A_R_LINEAR_____402_CM 1 0. -200. 199.99389 DISPLAY_IDENTIFIER CTL_DYN_LIM_EGRV_0_ ECU_ADDRESS 0x7fa93c BYTE_ORDER MSB_LAST /end MEASUREMENT
/begin MEASUREMENT ang_sp_egrv_bas[0] "basic setpoint of position controller" UWORD _CNV_A_R_LINEAR_____8_CM 1 0. 0. 99.99847412109381 DISPLAY_IDENTIFIER ANG_SP_EGRV_BAS_0_ ECU_ADDRESS 0x7fa938 BYTE_ORDER MSB_LAST FORMAT "%5.3" /end MEASUREMENT
/begin MEASUREMENT test_egrv[0] "test signal for closed-loop positon control" UWORD _CNV_A_R_LINEAR_____8_CM 1 0. 0. 99.99847412109381 DISPLAY_IDENTIFIER TEST_EGRV_0_ ECU_ADDRESS 0x7fa92a BYTE_ORDER MSB_LAST FORMAT "%5.3" /end MEASUREMENT
/begin MEASUREMENT lv_ang_sp_egrv_close[0] "EGRV setpoint is closed" UBYTE _CNV_S_2_RANGE______11_CM 1 0. 0. 1. DISPLAY_IDENTIFIER LV_ANG_SP_EGRV_CLOSE_0_ ECU_ADDRESS 0x7fb87d /end MEASUREMENT
/begin MEASUREMENT ang_sp_egrv[0] "setpoint of position controller" UWORD _CNV_A_R_LINEAR_____8_CM 1 0. 0. 99.99847412109381 DISPLAY_IDENTIFIER ANG_SP_EGRV_0_ ECU_ADDRESS 0x7f99c2 BYTE_ORDER MSB_LAST FORMAT "%5.3" /end MEASUREMENT
/begin CHARACTERISTIC lc_pi_egrv_on[0] "" VALUE 0x85ce9d _REC_VAL_20_u1 1. _CNV_A_R_LINEAR_____0_CM 0. 1. DISPLAY_IDENTIFIER LC_PI_EGRV_ON_0_ FORMAT "%1.0" /end CHARACTERISTIC
/begin CHARACTERISTIC c_egrv_ini[0] "" VALUE 0x85c994 _REC_VAL_20_s2 399.99389 _CNV_A_R_LINEAR_____402_CM -200. 199.99389 DISPLAY_IDENTIFIER C_EGRV_INI_0_ /end CHARACTERISTIC
/begin CHARACTERISTIC lc_dt1_egrv_on[0] "" VALUE 0x85ce6d _REC_VAL_20_u1 1. _CNV_A_R_LINEAR_____0_CM 0. 1. DISPLAY_IDENTIFIER LC_DT1_EGRV_ON_0_ FORMAT "%1.0" /end CHARACTERISTIC
/begin CHARACTERISTIC lc_pctl_egrv_lih "indicates the used precontrol value during LIH" VALUE 0x85ce97 _REC_VAL_20_u1 1. _CNV_A_R_LINEAR_____0_CM 0. 1. DISPLAY_IDENTIFIER LC_PCTL_EGRV_LIH FORMAT "%1.0" /end CHARACTERISTIC
/begin CHARACTERISTIC c_pctl_egrv_lih "precontrol value during LIH" VALUE 0x85cb60 _REC_VAL_20_s2 399.99389 _CNV_A_R_LINEAR_____402_CM -200. 199.99389 DISPLAY_IDENTIFIER C_PCTL_EGRV_LIH /end CHARACTERISTIC
/begin CHARACTERISTIC c_fac_fil_ang_sp_close_egrv "filter factor for closed EGRV precontrol" VALUE 0x85c9dc _REC_VAL_20_u2 0.9999847412109381 _CNV_A_R_LINEAR_____14_CM 0. 0.9999847412109381 DISPLAY_IDENTIFIER C_FAC_FIL_ANG_SP_CLOSE_EGRV FORMAT "%6.5" /end CHARACTERISTIC
/begin CHARACTERISTIC lc_pctl_phys_egrv_on[0] "" VALUE 0x85ce99 _REC_VAL_20_u1 1. _CNV_A_R_LINEAR_____0_CM 0. 1. DISPLAY_IDENTIFIER LC_PCTL_PHYS_EGRV_ON_0_ FORMAT "%1.0" /end CHARACTERISTIC
/begin CHARACTERISTIC c_gear_trans_ratio_egrv "gear transition ratio" VALUE 0x85ca3c _REC_VAL_20_u2 99.99847412109381 _CNV_A_R_LINEAR_____406_CM 0. 99.99847412109381 DISPLAY_IDENTIFIER C_GEAR_TRANS_RATIO_EGRV FORMAT "%5.3" /end CHARACTERISTIC
/begin CHARACTERISTIC c_temp_mot_egrv_ref "reference temperature DC motor" VALUE 0x85ccde _REC_VAL_20_u1 255. _CNV_A_R_LINEAR_____18_CM -50. 205. DISPLAY_IDENTIFIER C_TEMP_MOT_EGRV_REF FORMAT "%3.0" /end CHARACTERISTIC
/begin CHARACTERISTIC c_r_mot_egrv "resistance DC motor" VALUE 0x85cb82 _REC_VAL_20_u2 9.999874 _CNV_A_R_LINEAR_____405_CM 0. 9.999874 DISPLAY_IDENTIFIER C_R_MOT_EGRV FORMAT "%5.4" /end CHARACTERISTIC
/begin CHARACTERISTIC c_temp_mot_egrv[0] "" VALUE 0x85ccdd _REC_VAL_20_u1 255. _CNV_A_R_LINEAR_____18_CM -50. 205. DISPLAY_IDENTIFIER C_TEMP_MOT_EGRV_0_ FORMAT "%3.0" /end CHARACTERISTIC
/begin CHARACTERISTIC lc_ctl_lim_egrv_man "activation of the manual output for the EGRV- position controller" VALUE 0x85ce61 _REC_VAL_20_u1 1. _CNV_A_R_LINEAR_____0_CM 0. 1. DISPLAY_IDENTIFIER LC_CTL_LIM_EGRV_MAN FORMAT "%1.0" /end CHARACTERISTIC
/begin CHARACTERISTIC lc_ctl_lim_egrv_diag "enable of the limitation for diagnosis" VALUE 0x85ce60 _REC_VAL_20_u1 1. _CNV_A_R_LINEAR_____0_CM 0. 1. DISPLAY_IDENTIFIER LC_CTL_LIM_EGRV_DIAG FORMAT "%1.0" /end CHARACTERISTIC
/begin CHARACTERISTIC c_fac_ctl_lim_egrv "correction factor" VALUE 0x85c9c6 _REC_VAL_20_s2 3.999939 _CNV_A_R_LINEAR_____408_CM -2. 1.999939 DISPLAY_IDENTIFIER C_FAC_CTL_LIM_EGRV FORMAT "%6.5" /end CHARACTERISTIC
/begin CHARACTERISTIC c_ctl_lim_egrv_add "additive correction" VALUE 0x85c940 _REC_VAL_20_s2 199.996948242 _CNV_A_R_LINEAR_____12_CM -100. 99.996948242 DISPLAY_IDENTIFIER C_CTL_LIM_EGRV_ADD FORMAT "%5.3" /end CHARACTERISTIC
/begin CHARACTERISTIC c_ctl_lim_egrv_man[0] "" VALUE 0x85c944 _REC_VAL_20_s2 199.996948242 _CNV_A_R_LINEAR_____12_CM -100. 99.996948242 DISPLAY_IDENTIFIER C_CTL_LIM_EGRV_MAN_0_ FORMAT "%5.3" /end CHARACTERISTIC
/begin CHARACTERISTIC c_lim_dyn_max_egr[0] "" VALUE 0x85ca89 _REC_VAL_20_u1 255. _CNV_A_R_LINEAR_____267_CM 0. 255. DISPLAY_IDENTIFIER C_LIM_DYN_MAX_EGR_0_ FORMAT "%3.0" /end CHARACTERISTIC
/begin CHARACTERISTIC c_t_lim_dyn_egr[0] "" VALUE 0x85cc50 _REC_VAL_20_u2 65535. _CNV_A_R_LINEAR_____417_CM 0. 65535. DISPLAY_IDENTIFIER C_T_LIM_DYN_EGR_0_ FORMAT "%5.0" /end CHARACTERISTIC
/begin CHARACTERISTIC lc_test_egrv[0] "" VALUE 0x85ceaf _REC_VAL_20_u1 1. _CNV_A_R_LINEAR_____0_CM 0. 1. DISPLAY_IDENTIFIER LC_TEST_EGRV_0_ FORMAT "%1.0" /end CHARACTERISTIC
/begin CHARACTERISTIC c_test_fac_egrv[0] "" VALUE 0x85ccf2 _REC_VAL_20_u2 99.99847412109381 _CNV_A_R_LINEAR_____8_CM 0. 99.99847412109381 DISPLAY_IDENTIFIER C_TEST_FAC_EGRV_0_ FORMAT "%5.3" /end CHARACTERISTIC
/begin CHARACTERISTIC c_test_add_egrv[0] "" VALUE 0x85ccec _REC_VAL_20_u2 99.99847412109381 _CNV_A_R_LINEAR_____8_CM 0. 99.99847412109381 DISPLAY_IDENTIFIER C_TEST_ADD_EGRV_0_ FORMAT "%5.3" /end CHARACTERISTIC
/begin CHARACTERISTIC c_ang_sp_egrv_close_tol[0] "" VALUE 0x85c898 _REC_VAL_20_u2 99.99847412109381 _CNV_A_R_LINEAR_____8_CM 0. 99.99847412109381 DISPLAY_IDENTIFIER C_ANG_SP_EGRV_CLOSE_TOL_0_ FORMAT "%5.3" /end CHARACTERISTIC
/begin CHARACTERISTIC c_ang_sp_egrv_thd_bol_grd "lower threshold for gradient limitation" VALUE 0x85c89a _REC_VAL_20_u2 99.99847412109381 _CNV_A_R_LINEAR_____8_CM 0. 99.99847412109381 DISPLAY_IDENTIFIER C_ANG_SP_EGRV_THD_BOL_GRD FORMAT "%5.3" /end CHARACTERISTIC
/begin CHARACTERISTIC c_ang_sp_egrv_bol_grd "maximum gradient for ANG_SP_EGRV (BOL)" VALUE 0x85c896 _REC_VAL_20_u2 99.99847412109381 _CNV_A_R_LINEAR_____418_CM 0. 99.99847412109381 DISPLAY_IDENTIFIER C_ANG_SP_EGRV_BOL_GRD FORMAT "%5.3" /end CHARACTERISTIC
/begin CHARACTERISTIC c_ang_sp_egrv_tol_grd "maximum gradient for ANG_SP_EGRV (TOL)" VALUE 0x85c89e _REC_VAL_20_u2 99.99847412109381 _CNV_A_R_LINEAR_____418_CM 0. 99.99847412109381 DISPLAY_IDENTIFIER C_ANG_SP_EGRV_TOL_GRD FORMAT "%5.3" /end CHARACTERISTIC
/begin CHARACTERISTIC c_fac_fil_ang_sp_egrv "filter factor (PT1) for EGR- valve position setpoint" VALUE 0x85c9de _REC_VAL_20_u2 0.9999847412109381 _CNV_A_R_LINEAR_____14_CM 0. 0.9999847412109381 DISPLAY_IDENTIFIER C_FAC_FIL_ANG_SP_EGRV FORMAT "%6.5" /end CHARACTERISTIC
/begin CHARACTERISTIC c_ang_sp_egrv_thd_tol_grd "upper threshold for gradient limitation" VALUE 0x85c89c _REC_VAL_20_u2 99.99847412109381 _CNV_A_R_LINEAR_____8_CM 0. 99.99847412109381 DISPLAY_IDENTIFIER C_ANG_SP_EGRV_THD_TOL_GRD FORMAT "%5.3" /end CHARACTERISTIC
/begin CHARACTERISTIC ip_kr_dt1_egrv__ctl_dif "GE_VCLP: gain for DT1 function" CURVE 0x853474 _REC_CUR_20_u2_u2 4.19424 _CNV_A_R_LINEAR_____419_CM 0. 4.19424 DISPLAY_IDENTIFIER IP_KR_DT1_EGRV__CTL_DIF FORMAT "%6.5"
 /begin AXIS_DESCR COM_AXIS ctl_dif_egrv[0] _CNV_A_R_LINEAR_____161_CM 8 -100. 99.99694820000001 FORMAT "%5.3" AXIS_PTS_REF ldp_ctl_dif__ip_kr_dt1_egrv /end AXIS_DESCR
/end CHARACTERISTIC
/begin AXIS_PTS ldp_ctl_dif__ip_kr_dt1_egrv "" 0x8414a6 ctl_dif_egrv[0] _REC_AXS_20_u2 199.9969482 _CNV_A_R_LINEAR_____161_CM 8 -100. 99.99694820000001 FORMAT "%5.3" /end AXIS_PTS
/begin CHARACTERISTIC ip_t1_dt1_egrv__ctl_dif "GE_VCLP: time value for DT1 function" CURVE 0x85b02a _REC_CUR_20_u2_u2 0.125 _CNV_A_R_LINEAR_____410_CM 0. 0.125 DISPLAY_IDENTIFIER IP_T1_DT1_EGRV__CTL_DIF FORMAT "%7.6"
 /begin AXIS_DESCR COM_AXIS ctl_dif_egrv[0] _CNV_A_R_LINEAR_____161_CM 8 -100. 99.99694820000001 FORMAT "%5.3" AXIS_PTS_REF ldp_ctl_dif__ip_t1_dt1_egrv /end AXIS_DESCR
/end CHARACTERISTIC
/begin AXIS_PTS ldp_ctl_dif__ip_t1_dt1_egrv "" 0x84151e ctl_dif_egrv[0] _REC_AXS_20_u2 199.9969482 _CNV_A_R_LINEAR_____161_CM 8 -100. 99.99694820000001 FORMAT "%5.3" /end AXIS_PTS
/begin CHARACTERISTIC ip_air_foc_egrv__ang_egrv "GE_VCLP: influence of EGRV angle on pressure over valve" CURVE 0x85094c _REC_CUR_20_u2_u2 100. _CNV_A_R_LINEAR_____128_CM 0. 100. DISPLAY_IDENTIFIER IP_AIR_FOC_EGRV__ANG_EGRV FORMAT "%5.3"
 /begin AXIS_DESCR COM_AXIS ang_sp_egrv[0] _CNV_A_R_LINEAR_____8_CM 8 0. 99.99847412109381 FORMAT "%5.3" AXIS_PTS_REF ldp_ang_egrv__ip_air_foc_egrv /end AXIS_DESCR
/end CHARACTERISTIC
/begin AXIS_PTS ldp_ang_egrv__ip_air_foc_egrv "" 0x84133c ang_sp_egrv[0] _REC_AXS_20_u2 99.99847412109381 _CNV_A_R_LINEAR_____8_CM 8 0. 99.99847412109381 FORMAT "%5.3" /end AXIS_PTS
/begin CHARACTERISTIC id_pctl_egrv__t_ang_sp_close_0 "GE_VCLP: precontrol values during closed EGRV" CURVE 0x850750 _REC_CUR_20_s2_u2 399.99389 _CNV_A_R_LINEAR_____402_CM -200. 199.99389 DISPLAY_IDENTIFIER ID_PCTL_EGRV__T_ANG_SP_CLOSE_0
 /begin AXIS_DESCR COM_AXIS t_ang_sp_egrv_close[0] _CNV_A_R_LINEAR_____73_CM 4 0. 65.535 FORMAT "%5.3" AXIS_PTS_REF ldp_t_ang_close__id_pctl_egrv /end AXIS_DESCR
/end CHARACTERISTIC
/begin AXIS_PTS ldp_t_ang_close__id_pctl_egrv "" 0x8421e4 t_ang_sp_egrv_close[0] _REC_AXS_20_u2 65.535 _CNV_A_R_LINEAR_____73_CM 4 0. 65.535 FORMAT "%5.3" /end AXIS_PTS
/begin CHARACTERISTIC ip_tq_spr_egrv__ang_sp_egrv "GE_VCLP: characteristic of spring" CURVE 0x85b834 _REC_CUR_20_u2_u2 999.98474 _CNV_A_R_LINEAR_____403_CM 0. 999.98474 DISPLAY_IDENTIFIER IP_TQ_SPR_EGRV__ANG_SP_EGRV FORMAT "%5.2"
 /begin AXIS_DESCR COM_AXIS ang_sp_egrv[0] _CNV_A_R_LINEAR_____8_CM 4 0. 99.99847412109381 FORMAT "%5.3" AXIS_PTS_REF ldp_ang_sp_egrv_ip_tq_spr_egrv /end AXIS_DESCR
/end CHARACTERISTIC
/begin AXIS_PTS ldp_ang_sp_egrv_ip_tq_spr_egrv "" 0x841398 ang_sp_egrv[0] _REC_AXS_20_u2 99.99847412109381 _CNV_A_R_LINEAR_____8_CM 4 0. 99.99847412109381 FORMAT "%5.3" /end AXIS_PTS
/begin CHARACTERISTIC ip_cur_mot_egrv__tq_mot "GE_VCLP: current of DC motor" CURVE 0x851d9e _REC_CUR_20_u2_u2 9.999874 _CNV_A_R_LINEAR_____412_CM 0. 9.999874 DISPLAY_IDENTIFIER IP_CUR_MOT_EGRV__TQ_MOT FORMAT "%5.4"
 /begin AXIS_DESCR COM_AXIS tq_mot_egrv[0] _CNV_A_R_LINEAR_____403_CM 4 0. 999.98474 FORMAT "%5.2" AXIS_PTS_REF ldp_tq_mot_egrv__ip_cur_mot /end AXIS_DESCR
/end CHARACTERISTIC
/begin AXIS_PTS ldp_tq_mot_egrv__ip_cur_mot "" 0x8425b0 tq_mot_egrv[0] _REC_AXS_20_u2 999.98474 _CNV_A_R_LINEAR_____403_CM 4 0. 999.98474 FORMAT "%5.2" /end AXIS_PTS
/begin CHARACTERISTIC ip_pctl_egrv__v_mot_egrv "GE_VCLP: characteristic of power inverter" CURVE 0x8580e2 _REC_CUR_20_u2_u2 399.993897 _CNV_A_R_LINEAR_____413_CM -200. 199.993897 DISPLAY_IDENTIFIER IP_PCTL_EGRV__V_MOT_EGRV
 /begin AXIS_DESCR COM_AXIS v_mot_egrv[0] _CNV_A_R_LINEAR_____404_CM 4 0. 99.99847412109381 FORMAT "%5.3" AXIS_PTS_REF ldp_v_mot_egrv__ip_pctl_egrv /end AXIS_DESCR
/end CHARACTERISTIC
/begin AXIS_PTS ldp_v_mot_egrv__ip_pctl_egrv "" 0x8429da v_mot_egrv[0] _REC_AXS_20_u2 99.99847412109381 _CNV_A_R_LINEAR_____404_CM 4 0. 99.99847412109381 FORMAT "%5.3" /end AXIS_PTS
/begin CHARACTERISTIC ip_ctl_max_egrv_0__temp "GE_VCLP: maximum limit of EGRV_0 controller output" CURVE 0x851d56 _REC_CUR_20_u1_u1 199.21875 _CNV_A_R_LINEAR_____414_CM -100. 99.21875 DISPLAY_IDENTIFIER IP_CTL_MAX_EGRV_0__TEMP FORMAT "%3.1"
 /begin AXIS_DESCR COM_AXIS tco _CNV_A_R_LINEAR_____18_CM 4 -50. 205. FORMAT "%3.0" AXIS_PTS_REF ldpm_temp__ip_ctl_egrv /end AXIS_DESCR
/end CHARACTERISTIC
/begin AXIS_PTS ldpm_temp__ip_ctl_egrv "" 0x8437c9 tco _REC_AXS_20_u1 255. _CNV_A_R_LINEAR_____18_CM 4 -50. 205. FORMAT "%3.0" /end AXIS_PTS
/begin CHARACTERISTIC ip_ctl_min_egrv_0__temp "GE_VCLP: minimum limit of EGRV_0 controller output" CURVE 0x851d6a _REC_CUR_20_u1_u1 199.21875 _CNV_A_R_LINEAR_____414_CM -100. 99.21875 DISPLAY_IDENTIFIER IP_CTL_MIN_EGRV_0__TEMP FORMAT "%3.1"
 /begin AXIS_DESCR COM_AXIS tco _CNV_A_R_LINEAR_____18_CM 4 -50. 205. FORMAT "%3.0" AXIS_PTS_REF ldpm_temp__ip_ctl_egrv /end AXIS_DESCR
/end CHARACTERISTIC
/begin CHARACTERISTIC ip_ctl_dyn_lim_egrv_0__temp "GE_VCLP: maximum limit of EGRV_0 controller output_a" CURVE 0x851d42 _REC_CUR_20_u1_u1 199.21875 _CNV_A_R_LINEAR_____414_CM -100. 99.21875 DISPLAY_IDENTIFIER IP_CTL_DYN_LIM_EGRV_0__TEMP FORMAT "%3.1"
 /begin AXIS_DESCR COM_AXIS tco _CNV_A_R_LINEAR_____18_CM 4 -50. 205. FORMAT "%3.0" AXIS_PTS_REF ldpm_temp__ip_ctl_egrv /end AXIS_DESCR
/end CHARACTERISTIC
/begin CHARACTERISTIC ip_kr_pi_egrv__ctl_dif__air_foc "GE_VCLP: proportional value for PI contoller" MAP 0x8534ee _REC_MAP_20_u2_u2_u2 15.999755 _CNV_A_R_LINEAR_____13_CM 0. 15.999755 DISPLAY_IDENTIFIER IP_KR_PI_EGRV__CTL_DIF__AIR_FOC FORMAT "%6.4"
 /begin AXIS_DESCR COM_AXIS ctl_dif_egrv[0] _CNV_A_R_LINEAR_____161_CM 12 -100. 99.99694820000001 FORMAT "%5.3" AXIS_PTS_REF ldp_ctl_dif__ip_kr_pi_egrv /end AXIS_DESCR
 /begin AXIS_DESCR COM_AXIS online_dummy _CNV_A_R_LINEAR_____406_CM 6 0. 99.99847412109381 FORMAT "%5.3" AXIS_PTS_REF ldpm_air_foc__ip_pi_egrv /end AXIS_DESCR
/end CHARACTERISTIC
/begin AXIS_PTS ldp_ctl_dif__ip_kr_pi_egrv "" 0x8414de ctl_dif_egrv[0] _REC_AXS_20_u2 199.9969482 _CNV_A_R_LINEAR_____161_CM 12 -100. 99.99694820000001 FORMAT "%5.3" /end AXIS_PTS
/begin AXIS_PTS ldpm_air_foc__ip_pi_egrv "" 0x842af8 online_dummy _REC_AXS_20_u2 99.99847412109381 _CNV_A_R_LINEAR_____406_CM 6 0. 99.99847412109381 FORMAT "%5.3" /end AXIS_PTS
/begin CHARACTERISTIC ip_tn_pi_egrv__ctl_dif__air_foc "GE_VCLP: integral value for PI contoller" MAP 0x85b4d6 _REC_MAP_20_u2_u2_u2 15.999755 _CNV_A_R_LINEAR_____411_CM 0. 15.999755 DISPLAY_IDENTIFIER IP_TN_PI_EGRV__CTL_DIF__AIR_FOC FORMAT "%6.4"
 /begin AXIS_DESCR COM_AXIS ctl_dif_egrv[0] _CNV_A_R_LINEAR_____161_CM 12 -100. 99.99694820000001 FORMAT "%5.3" AXIS_PTS_REF ldp_ctl_dif__ip_tn_pi_egrv /end AXIS_DESCR
 /begin AXIS_DESCR COM_AXIS online_dummy _CNV_A_R_LINEAR_____406_CM 6 0. 99.99847412109381 FORMAT "%5.3" AXIS_PTS_REF ldpm_air_foc__ip_pi_egrv /end AXIS_DESCR
/end CHARACTERISTIC
/begin AXIS_PTS ldp_ctl_dif__ip_tn_pi_egrv "" 0x841556 ctl_dif_egrv[0] _REC_AXS_20_u2 199.9969482 _CNV_A_R_LINEAR_____161_CM 12 -100. 99.99694820000001 FORMAT "%5.3" /end AXIS_PTS
/begin CHARACTERISTIC ip_pctl_egrv__ang_sp__air_foc "GE_VCLP: non-physical precontrol" MAP 0x858082 _REC_MAP_20_u2_u2_u2 399.993897 _CNV_A_R_LINEAR_____413_CM -200. 199.993897 DISPLAY_IDENTIFIER IP_PCTL_EGRV__ANG_SP__AIR_FOC
 /begin AXIS_DESCR COM_AXIS ang_sp_egrv[0] _CNV_A_R_LINEAR_____8_CM 8 0. 99.99847412109381 FORMAT "%5.3" AXIS_PTS_REF ldp_ang_sp_egrv_ip_pctl_egrv /end AXIS_DESCR
 /begin AXIS_DESCR COM_AXIS online_dummy _CNV_A_R_LINEAR_____406_CM 6 0. 99.99847412109381 FORMAT "%5.3" AXIS_PTS_REF ldpm_air_foc__ip_pi_egrv /end AXIS_DESCR
/end CHARACTERISTIC
/begin AXIS_PTS ldp_ang_sp_egrv_ip_pctl_egrv "" 0x841386 ang_sp_egrv[0] _REC_AXS_20_u2 99.99847412109381 _CNV_A_R_LINEAR_____8_CM 8 0. 99.99847412109381 FORMAT "%5.3" /end AXIS_PTS
/begin CHARACTERISTIC ip_air_foc__n__tqi_sp "GE_VCLP: indication of pressure over EGR valve" MAP 0x8508cc _REC_MAP_20_u2_u2_u2 1. _CNV_A_R_LINEAR_____375_CM 0. 1. DISPLAY_IDENTIFIER IP_AIR_FOC__N__TQI_SP FORMAT "%6.5"
 /begin AXIS_DESCR COM_AXIS n _CNV_A_R_LINEAR_____5_CM 8 0. 8160. FORMAT "%4.0" AXIS_PTS_REF ldp_n__ip_air_foc /end AXIS_DESCR
 /begin AXIS_DESCR COM_AXIS tqi_sp _CNV_A_R_LINEAR_____86_CM 8 -1024. 1023.96875 FORMAT "%6.2" AXIS_PTS_REF ldp_tqi_sp__ip_air_foc /end AXIS_DESCR
/end CHARACTERISTIC
/begin AXIS_PTS ldp_n__ip_air_foc "" 0x84192c n _REC_AXS_20_u2 8160. _CNV_A_R_LINEAR_____5_CM 8 0. 8160. FORMAT "%4.0" /end AXIS_PTS
/begin AXIS_PTS ldp_tqi_sp__ip_air_foc "" 0x8427b0 tqi_sp _REC_AXS_20_u2 2047.96875 _CNV_A_R_LINEAR_____86_CM 8 -1024. 1023.96875 FORMAT "%6.2" /end AXIS_PTS
/begin MEASUREMENT ang_sp_egrv_clean[0] "setpoint for EGR-valve cleaning procedure" UWORD _CNV_A_R_LINEAR_____136_CM 1 0. 0. 99.9969482421875 DISPLAY_IDENTIFIER ANG_SP_EGRV_CLEAN_0_ ECU_ADDRESS 0x7f9888 BYTE_ORDER MSB_LAST FORMAT "%5.3" /end MEASUREMENT
/begin MEASUREMENT lv_req_egr_pwl[0] "enable EGR valve cleaning procedure" UBYTE _CNV_S_2_RANGE______11_CM 1 0. 0. 1. DISPLAY_IDENTIFIER LV_REQ_EGR_PWL_0_ ECU_ADDRESS 0x7fb854 /end MEASUREMENT
/begin MEASUREMENT lv_cdn_egr_on_ext "EGR control Enable ext. int." UBYTE _CNV_S_2_RANGE______11_CM 1 0. 0. 1. DISPLAY_IDENTIFIER LV_CDN_EGR_ON_EXT ECU_ADDRESS 0x7fbe4d /end MEASUREMENT
/begin MEASUREMENT lv_cdn_egr_on_eng_state "EGR control Enable for engine states" UBYTE _CNV_S_2_RANGE______11_CM 1 0. 0. 1. DISPLAY_IDENTIFIER LV_CDN_EGR_ON_ENG_STATE ECU_ADDRESS 0x7fbe43 /end MEASUREMENT
/begin MEASUREMENT lv_cdn_egr_on_tco "logical variable EGR-enable for TCO-limits" UBYTE _CNV_S_2_RANGE______11_CM 1 0. 0. 1. DISPLAY_IDENTIFIER LV_CDN_EGR_ON_TCO ECU_ADDRESS 0x7fbe44 /end MEASUREMENT
/begin MEASUREMENT lv_cdn_egr_on_amp "EGR control enable for AMP-limits" UBYTE _CNV_S_2_RANGE______11_CM 1 0. 0. 1. DISPLAY_IDENTIFIER LV_CDN_EGR_ON_AMP ECU_ADDRESS 0x7fbe45 /end MEASUREMENT
/begin MEASUREMENT lv_cdn_egr_on_tia "EGR control enable for TIA-limits" UBYTE _CNV_S_2_RANGE______11_CM 1 0. 0. 1. DISPLAY_IDENTIFIER LV_CDN_EGR_ON_TIA ECU_ADDRESS 0x7fbe46 /end MEASUREMENT
/begin MEASUREMENT lv_cdn_egr_on_t_ast "EGR control enable for \"time after start\"" UBYTE _CNV_S_2_RANGE______11_CM 1 0. 0. 1. DISPLAY_IDENTIFIER LV_CDN_EGR_ON_T_AST ECU_ADDRESS 0x7fbe47 /end MEASUREMENT
/begin MEASUREMENT lv_cdn_egr_on_tqi "EGR control enable for TQI limits" UBYTE _CNV_S_2_RANGE______11_CM 1 0. 0. 1. DISPLAY_IDENTIFIER LV_CDN_EGR_ON_TQI ECU_ADDRESS 0x7fbe48 /end MEASUREMENT
/begin MEASUREMENT lv_cdn_egr_on_tqi_grd "EGR control enable for MF- gradient" UBYTE _CNV_S_2_RANGE______11_CM 1 0. 0. 1. DISPLAY_IDENTIFIER LV_CDN_EGR_ON_TQI_GRD ECU_ADDRESS 0x7fbe49 /end MEASUREMENT
/begin MEASUREMENT lv_cdn_egr_on_req_0 "EGR control enable (inj. state GES = 0)" UBYTE _CNV_S_2_RANGE______11_CM 1 0. 0. 1. DISPLAY_IDENTIFIER LV_CDN_EGR_ON_REQ_0 ECU_ADDRESS 0x7fbe4a /end MEASUREMENT
/begin MEASUREMENT lv_cdn_egr_on_req_1 "EGR control enable (inj. state GES = 1)" UBYTE _CNV_S_2_RANGE______11_CM 1 0. 0. 1. DISPLAY_IDENTIFIER LV_CDN_EGR_ON_REQ_1 ECU_ADDRESS 0x7fbe4b /end MEASUREMENT
/begin MEASUREMENT lv_cdn_egr_on_req "EGR control enable" UBYTE _CNV_S_2_RANGE______11_CM 1 0. 0. 1. DISPLAY_IDENTIFIER LV_CDN_EGR_ON_REQ ECU_ADDRESS 0x7fbe4c /end MEASUREMENT
/begin CHARACTERISTIC lc_egr_ctl_on "button for EGR-controller activation" VALUE 0x85ce73 _REC_VAL_20_u1 1. _CNV_A_R_LINEAR_____0_CM 0. 1. DISPLAY_IDENTIFIER LC_EGR_CTL_ON FORMAT "%1.0" /end CHARACTERISTIC
/begin CHARACTERISTIC c_tco_egr_max "max. EGR-activation limit for coolant temperature" VALUE 0x85ccaa _REC_VAL_20_u1 255. _CNV_A_R_LINEAR_____18_CM -50. 205. DISPLAY_IDENTIFIER C_TCO_EGR_MAX FORMAT "%3.0" /end CHARACTERISTIC
/begin CHARACTERISTIC c_tco_hys_egr "activation hysteresis for coolant temperature" VALUE 0x85ccb0 _REC_VAL_20_u1 255. _CNV_A_R_LINEAR_____20_CM 0. 255. DISPLAY_IDENTIFIER C_TCO_HYS_EGR FORMAT "%3.0" /end CHARACTERISTIC
/begin CHARACTERISTIC c_tco_egr_min "min. EGR-activation limit for coolant temperature" VALUE 0x85ccab _REC_VAL_20_u1 255. _CNV_A_R_LINEAR_____18_CM -50. 205. DISPLAY_IDENTIFIER C_TCO_EGR_MIN FORMAT "%3.0" /end CHARACTERISTIC
/begin CHARACTERISTIC c_amp_egr_min "min. EGR-activation limit for ambient pressure" VALUE 0x85c876 _REC_VAL_20_u2 5434. _CNV_A_R_LINEAR_____45_CM 0. 5434. DISPLAY_IDENTIFIER C_AMP_EGR_MIN FORMAT "%6.2" /end CHARACTERISTIC
/begin CHARACTERISTIC c_amp_hys_egr "activation hysteresis for ambient pressure" VALUE 0x85c878 _REC_VAL_20_u2 5434. _CNV_A_R_LINEAR_____45_CM 0. 5434. DISPLAY_IDENTIFIER C_AMP_HYS_EGR FORMAT "%6.2" /end CHARACTERISTIC
/begin CHARACTERISTIC c_tia_hys_egr "activation hysteresis for intake air temperature" VALUE 0x85cd21 _REC_VAL_20_u1 255. _CNV_A_R_LINEAR_____20_CM 0. 255. DISPLAY_IDENTIFIER C_TIA_HYS_EGR FORMAT "%3.0" /end CHARACTERISTIC
/begin CHARACTERISTIC c_tia_egr_max "max. EGR-activation limit for intake air temperature" VALUE 0x85cd1e _REC_VAL_20_u1 255. _CNV_A_R_LINEAR_____18_CM -50. 205. DISPLAY_IDENTIFIER C_TIA_EGR_MAX FORMAT "%3.0" /end CHARACTERISTIC
/begin CHARACTERISTIC c_t_dly_egr_di "delay time for EGR function reactivation" VALUE 0x85cc20 _REC_VAL_20_u2 1310.7 _CNV_A_R_LINEAR_____420_CM 0. 1310.7 DISPLAY_IDENTIFIER C_T_DLY_EGR_DI FORMAT "%6.2" /end CHARACTERISTIC
/begin CHARACTERISTIC c_tqi_grd_thd_egr_di "threshold for TQI-gradient for EGR-disable" VALUE 0x85cd36 _REC_VAL_20_s2 65535. _CNV_A_R_LINEAR_____94_CM -32768. 32767. DISPLAY_IDENTIFIER C_TQI_GRD_THD_EGR_DI FORMAT "%5.0" /end CHARACTERISTIC
/begin CHARACTERISTIC c_tqi_thd_egr_min "min. torque threshold for function activation" VALUE 0x85cd48 _REC_VAL_20_u2 1023.96875 _CNV_A_R_LINEAR_____52_CM 0. 1023.96875 DISPLAY_IDENTIFIER C_TQI_THD_EGR_MIN FORMAT "%6.2" /end CHARACTERISTIC
/begin CHARACTERISTIC ip_t_dly_egr_ast__tco "AGE_EACT: delay time for EGR enable after start" CURVE 0x85b060 _REC_CUR_20_u2_u1 6553.5 _CNV_A_R_LINEAR_____19_CM 0. 6553.5 DISPLAY_IDENTIFIER IP_T_DLY_EGR_AST__TCO FORMAT "%5.1"
 /begin AXIS_DESCR COM_AXIS tco _CNV_A_R_LINEAR_____18_CM 4 -50. 205. FORMAT "%3.0" AXIS_PTS_REF ldp_tco_ip_t_dly_egr_ast /end AXIS_DESCR
/end CHARACTERISTIC
/begin AXIS_PTS ldp_tco_ip_t_dly_egr_ast "delay time for EGR enable after start" 0x8423ca tco _REC_AXS_20_u1 255. _CNV_A_R_LINEAR_____18_CM 4 -50. 205. FORMAT "%3.0" /end AXIS_PTS
/begin CHARACTERISTIC ip_tqi_egr_ena_1 "AGE_EACT: torque threshold for EGR enable (inj. state GES = 1)" CURVE 0x85c094 _REC_CUR_20_u2_u2 1023.96875 _CNV_A_R_LINEAR_____52_CM 0. 1023.96875 DISPLAY_IDENTIFIER IP_TQI_EGR_ENA_1 FORMAT "%6.2"
 /begin AXIS_DESCR COM_AXIS n _CNV_A_R_LINEAR_____5_CM 16 0. 6375. FORMAT "%4.0" AXIS_PTS_REF ldpm_n_ip_tqi_egr_act_1 /end AXIS_DESCR
/end CHARACTERISTIC
/begin AXIS_PTS ldpm_n_ip_tqi_egr_act_1 "torque threshold for EGR enable (inj. state GES = 1)" 0x843674 n _REC_AXS_20_u2 6375. _CNV_A_R_LINEAR_____5_CM 16 0. 6375. FORMAT "%4.0" /end AXIS_PTS
/begin CHARACTERISTIC ip_tqi_egr_di_1 "AGE_EACT: torque threshold for EGR disable (inj. state GES = 1)" CURVE 0x85c054 _REC_CUR_20_u2_u2 1023.96875 _CNV_A_R_LINEAR_____52_CM 0. 1023.96875 DISPLAY_IDENTIFIER IP_TQI_EGR_DI_1 FORMAT "%6.2"
 /begin AXIS_DESCR COM_AXIS n _CNV_A_R_LINEAR_____5_CM 16 0. 6375. FORMAT "%4.0" AXIS_PTS_REF ldpm_n_ip_tqi_egr_act_1 /end AXIS_DESCR
/end CHARACTERISTIC
/begin CHARACTERISTIC ip_tqi_egr_ena_0 "AGE_EACT: torque threshold for EGR enable (inj. state GES = 0)" CURVE 0x85c074 _REC_CUR_20_u2_u2 1023.96875 _CNV_A_R_LINEAR_____52_CM 0. 1023.96875 DISPLAY_IDENTIFIER IP_TQI_EGR_ENA_0 FORMAT "%6.2"
 /begin AXIS_DESCR COM_AXIS n _CNV_A_R_LINEAR_____5_CM 16 0. 6375. FORMAT "%4.0" AXIS_PTS_REF ldpm_n_ip_tqi_egr_act_0 /end AXIS_DESCR
/end CHARACTERISTIC
/begin AXIS_PTS ldpm_n_ip_tqi_egr_act_0 "torque threshold for EGR enable (inj. state GES = 0)" 0x843652 n _REC_AXS_20_u2 6375. _CNV_A_R_LINEAR_____5_CM 16 0. 6375. FORMAT "%4.0" /end AXIS_PTS
/begin CHARACTERISTIC ip_tqi_egr_di_0 "AGE_EACT: torque threshold for EGR disable (inj. state GES = 0)" CURVE 0x85c034 _REC_CUR_20_u2_u2 1023.96875 _CNV_A_R_LINEAR_____52_CM 0. 1023.96875 DISPLAY_IDENTIFIER IP_TQI_EGR_DI_0 FORMAT "%6.2"
 /begin AXIS_DESCR COM_AXIS n _CNV_A_R_LINEAR_____5_CM 16 0. 6375. FORMAT "%4.0" AXIS_PTS_REF ldpm_n_ip_tqi_egr_act_0 /end AXIS_DESCR
/end CHARACTERISTIC
/begin MEASUREMENT lv_cdn_egr_on "EGR control Enable" UBYTE _CNV_S_2_RANGE______11_CM 1 0. 0. 1. DISPLAY_IDENTIFIER LV_CDN_EGR_ON ECU_ADDRESS 0x7fb85b /end MEASUREMENT
/begin MEASUREMENT lv_cdn_thr_on "activation flag for closed loop throttle control" UBYTE _CNV_S_2_RANGE______11_CM 1 0. 0. 1. DISPLAY_IDENTIFIER LV_CDN_THR_ON ECU_ADDRESS 0x7fb85c /end MEASUREMENT
/begin MEASUREMENT mafpwm_pctl_bas_tco_0 "uncorrected basic precontrol value for air mass flow regulation (inj. state GES=0)" UWORD _CNV_A_R_LINEAR_____204_CM 1 0. 0. 99.972117 DISPLAY_IDENTIFIER MAFPWM_PCTL_BAS_TCO_0 ECU_ADDRESS 0x7fa69a BYTE_ORDER MSB_LAST FORMAT "%5.3" /end MEASUREMENT
/begin MEASUREMENT mafpwm_pctl_bas_tco_1 "uncorrected basic precontrol value for air mass flow regulation (inj. state GES=1)" UWORD _CNV_A_R_LINEAR_____204_CM 1 0. 0. 99.972117 DISPLAY_IDENTIFIER MAFPWM_PCTL_BAS_TCO_1 ECU_ADDRESS 0x7fa69c BYTE_ORDER MSB_LAST FORMAT "%5.3" /end MEASUREMENT
/begin MEASUREMENT mafpwm_pctl_bas "basic precontrol value for air mass flow regulation" UWORD _CNV_A_R_LINEAR_____204_CM 1 0. 0. 99.972117 DISPLAY_IDENTIFIER MAFPWM_PCTL_BAS ECU_ADDRESS 0x7fa69e BYTE_ORDER MSB_LAST FORMAT "%5.3" /end MEASUREMENT
/begin MEASUREMENT mafpwm_pctl_bas_0 "basic precontrol value for air mass flow regulation (inj. state GES = 0)" UWORD _CNV_A_R_LINEAR_____204_CM 1 0. 0. 99.972117 DISPLAY_IDENTIFIER MAFPWM_PCTL_BAS_0 ECU_ADDRESS 0x7fa6a0 BYTE_ORDER MSB_LAST FORMAT "%5.3" /end MEASUREMENT
/begin MEASUREMENT mafpwm_pctl_bas_1 "basic precontrol value for air mass flow regulation (inj. state GES = 1)" UWORD _CNV_A_R_LINEAR_____204_CM 1 0. 0. 99.972117 DISPLAY_IDENTIFIER MAFPWM_PCTL_BAS_1 ECU_ADDRESS 0x7fa6a2 BYTE_ORDER MSB_LAST FORMAT "%5.3" /end MEASUREMENT
/begin MEASUREMENT mafpwm_pctl "MAF precontrol value before output filter" UWORD _CNV_A_R_LINEAR_____204_CM 1 0. 0. 99.972117 DISPLAY_IDENTIFIER MAFPWM_PCTL ECU_ADDRESS 0x7fa6a4 BYTE_ORDER MSB_LAST FORMAT "%5.3" /end MEASUREMENT
/begin MEASUREMENT mafpwm_pctl_clc "precontrol value for air mass flow regulation after intervention for idel speed" UWORD _CNV_A_R_LINEAR_____204_CM 1 0. 0. 99.972117 DISPLAY_IDENTIFIER MAFPWM_PCTL_CLC ECU_ADDRESS 0x7fa6a6 BYTE_ORDER MSB_LAST FORMAT "%5.3" /end MEASUREMENT
/begin MEASUREMENT mafpwm_pctl_mmv "filterd output of MAF precontroller" UWORD _CNV_A_R_LINEAR_____204_CM 1 0. 0. 99.972117 DISPLAY_IDENTIFIER MAFPWM_PCTL_MMV ECU_ADDRESS 0x7f9896 BYTE_ORDER MSB_LAST FORMAT "%5.3" /end MEASUREMENT
/begin CHARACTERISTIC c_mafpwm_pctl_man "manual value for the air mass flow prcontroller" VALUE 0x85caae _REC_VAL_20_u2 99.972117 _CNV_A_R_LINEAR_____204_CM 0. 99.972117 DISPLAY_IDENTIFIER C_MAFPWM_PCTL_MAN FORMAT "%5.3" /end CHARACTERISTIC
/begin CHARACTERISTIC lc_mafpwm_pctl_man "button for manual precontrol value for the air mass flow controller" VALUE 0x85ce89 _REC_VAL_20_u1 1. _CNV_A_R_LINEAR_____0_CM 0. 1. DISPLAY_IDENTIFIER LC_MAFPWM_PCTL_MAN FORMAT "%1.0" /end CHARACTERISTIC
/begin CHARACTERISTIC c_fac_mafpwm_pctl_is_fil "filter factor for MAF_SP increasing in idle" VALUE 0x85c9f2 _REC_VAL_20_u2 0.9999847412109381 _CNV_A_R_LINEAR_____14_CM 0. 0.9999847412109381 DISPLAY_IDENTIFIER C_FAC_MAFPWM_PCTL_IS_FIL FORMAT "%6.5" /end CHARACTERISTIC
/begin CHARACTERISTIC c_mafpwm_pctl_off "value for the air mass flow precontroller during disabed EGR regulation" VALUE 0x85cab0 _REC_VAL_20_u2 99.972117 _CNV_A_R_LINEAR_____204_CM 0. 99.972117 DISPLAY_IDENTIFIER C_MAFPWM_PCTL_OFF FORMAT "%5.3" /end CHARACTERISTIC
/begin CHARACTERISTIC c_fac_mafpwm_pctl_ini_fil "initial filter factor for the precontroller" VALUE 0x85c9f0 _REC_VAL_20_u2 0.9999847412109381 _CNV_A_R_LINEAR_____14_CM 0. 0.9999847412109381 DISPLAY_IDENTIFIER C_FAC_MAFPWM_PCTL_INI_FIL FORMAT "%6.5" /end CHARACTERISTIC
/begin CHARACTERISTIC lc_mafpwm_pctl_on "button for precontrol value for the air mass flow controller" VALUE 0x85ce8a _REC_VAL_20_u1 1. _CNV_A_R_LINEAR_____0_CM 0. 1. DISPLAY_IDENTIFIER LC_MAFPWM_PCTL_ON FORMAT "%1.0" /end CHARACTERISTIC
/begin CHARACTERISTIC ip_fac_mafpwm_pctl_cor_amp_0 "MAF_PRE: air mass flow precontrol correction factor for ambient pressure (inj. region GES = 0)" CURVE 0x85269e _REC_CUR_20_u2_u2 0.9999847412109381 _CNV_A_R_LINEAR_____14_CM 0. 0.9999847412109381 DISPLAY_IDENTIFIER IP_FAC_MAFPWM_PCTL_COR_AMP_0 FORMAT "%6.5"
 /begin AXIS_DESCR COM_AXIS amp _CNV_A_R_LINEAR_____45_CM 8 0. 5434. FORMAT "%6.2" AXIS_PTS_REF ldp_amp_ip_fac_mafpwm_pctl_0 /end AXIS_DESCR
/end CHARACTERISTIC
/begin AXIS_PTS ldp_amp_ip_fac_mafpwm_pctl_0 "" 0x841148 amp _REC_AXS_20_u2 5434. _CNV_A_R_LINEAR_____45_CM 8 0. 5434. FORMAT "%6.2" /end AXIS_PTS
/begin CHARACTERISTIC ip_fac_mafpwm_pctl_cor_tgas_0 "MAF_PRE: air mass flow precontrol correction factor for temperature of the intake gas (inj. region GES = 0)" CURVE 0x8526be _REC_CUR_20_u2_u1 0.9999847412109381 _CNV_A_R_LINEAR_____14_CM 0. 0.9999847412109381 DISPLAY_IDENTIFIER IP_FAC_MAFPWM_PCTL_COR_TGAS_0 FORMAT "%6.5"
 /begin AXIS_DESCR COM_AXIS tgas _CNV_A_R_LINEAR_____18_CM 8 -50. 205. FORMAT "%3.0" AXIS_PTS_REF ldp_tgas_ip_fac_mafpwm_pctl_0 /end AXIS_DESCR
/end CHARACTERISTIC
/begin AXIS_PTS ldp_tgas_ip_fac_mafpwm_pctl_0 "" 0x8424d0 tgas _REC_AXS_20_u1 255. _CNV_A_R_LINEAR_____18_CM 8 -50. 205. FORMAT "%3.0" /end AXIS_PTS
/begin CHARACTERISTIC ip_fac_tran_mafpwm_pctl_1 "MAF_PRE: transition factor for the basic air mass flow precontrol (inj. region 1)" CURVE 0x8530f2 _REC_CUR_20_u2_u1 1.9999696 _CNV_A_R_LINEAR_____48_CM 0. 1.9999696 DISPLAY_IDENTIFIER IP_FAC_TRAN_MAFPWM_PCTL_1 FORMAT "%6.5"
 /begin AXIS_DESCR COM_AXIS tco _CNV_A_R_LINEAR_____18_CM 8 -50. 205. FORMAT "%3.0" AXIS_PTS_REF ldp_tco_ip_fac_tran_mafpwm_1 /end AXIS_DESCR
/end CHARACTERISTIC
/begin AXIS_PTS ldp_tco_ip_fac_tran_mafpwm_1 "" 0x84235c tco _REC_AXS_20_u1 255. _CNV_A_R_LINEAR_____18_CM 8 -50. 205. FORMAT "%3.0" /end AXIS_PTS
/begin CHARACTERISTIC ip_fac_mafpwm_pctl_cor_amp_1 "MAF_PRE: air mass flow precontrol correction factor for ambient pressure (inj. region GES = 1)" CURVE 0x8526ae _REC_CUR_20_u2_u2 0.9999847412109381 _CNV_A_R_LINEAR_____14_CM 0. 0.9999847412109381 DISPLAY_IDENTIFIER IP_FAC_MAFPWM_PCTL_COR_AMP_1 FORMAT "%6.5"
 /begin AXIS_DESCR COM_AXIS amp _CNV_A_R_LINEAR_____45_CM 8 0. 5434. FORMAT "%6.2" AXIS_PTS_REF ldp_amp_ip_fac_mafpwm_pctl_1 /end AXIS_DESCR
/end CHARACTERISTIC
/begin AXIS_PTS ldp_amp_ip_fac_mafpwm_pctl_1 "" 0x84115a amp _REC_AXS_20_u2 5434. _CNV_A_R_LINEAR_____45_CM 8 0. 5434. FORMAT "%6.2" /end AXIS_PTS
/begin CHARACTERISTIC ip_fac_mafpwm_pctl_cor_tgas_1 "MAF_PRE: air mass flow precontrol correction factor for temperature of the intake gas (inj. region GES = 1)" CURVE 0x8526ce _REC_CUR_20_u2_u1 0.9999847412109381 _CNV_A_R_LINEAR_____14_CM 0. 0.9999847412109381 DISPLAY_IDENTIFIER IP_FAC_MAFPWM_PCTL_COR_TGAS_1 FORMAT "%6.5"
 /begin AXIS_DESCR COM_AXIS tgas _CNV_A_R_LINEAR_____18_CM 8 -50. 205. FORMAT "%3.0" AXIS_PTS_REF ldp_tgas_ip_fac_mafpwm_pctl_1 /end AXIS_DESCR
/end CHARACTERISTIC
/begin AXIS_PTS ldp_tgas_ip_fac_mafpwm_pctl_1 "" 0x8424d9 tgas _REC_AXS_20_u1 255. _CNV_A_R_LINEAR_____18_CM 8 -50. 205. FORMAT "%3.0" /end AXIS_PTS
/begin CHARACTERISTIC ip_mafpwm_pctl_bas_0_1 "MAF_PRE: basic air mass flow precontrol for warm engine (inj. region GES = 0)" MAP 0x853912 _REC_MAP_20_u2_u2_u2 100. _CNV_A_R_LINEAR_____134_CM 0. 100. DISPLAY_IDENTIFIER IP_MAFPWM_PCTL_BAS_0_1 FORMAT "%5.3"
 /begin AXIS_DESCR COM_AXIS n _CNV_A_R_LINEAR_____5_CM 16 0. 6375. FORMAT "%4.0" AXIS_PTS_REF ldpm_n_ip_mafpwm_pctl_bas_0 /end AXIS_DESCR
 /begin AXIS_DESCR COM_AXIS tqi_egr _CNV_A_R_LINEAR_____52_CM 16 0. 1023.96875 FORMAT "%6.2" AXIS_PTS_REF ldpm_tqi_ip_mafpwm_pctl_bas_0 /end AXIS_DESCR
/end CHARACTERISTIC
/begin AXIS_PTS ldpm_n_ip_mafpwm_pctl_bas_0 "" 0x84316e n _REC_AXS_20_u2 6375. _CNV_A_R_LINEAR_____5_CM 16 0. 6375. FORMAT "%4.0" /end AXIS_PTS
/begin AXIS_PTS ldpm_tqi_ip_mafpwm_pctl_bas_0 "" 0x8439d2 tqi_egr _REC_AXS_20_u2 1023.96875 _CNV_A_R_LINEAR_____52_CM 16 0. 1023.96875 FORMAT "%6.2" /end AXIS_PTS
/begin CHARACTERISTIC ip_mafpwm_pctl_bas_0_0 "MAF_PRE: basic air mass flow precontrol for hot engine (inj. region GES = 0)" MAP 0x853712 _REC_MAP_20_u2_u2_u2 100. _CNV_A_R_LINEAR_____134_CM 0. 100. DISPLAY_IDENTIFIER IP_MAFPWM_PCTL_BAS_0_0 FORMAT "%5.3"
 /begin AXIS_DESCR COM_AXIS n _CNV_A_R_LINEAR_____5_CM 16 0. 6375. FORMAT "%4.0" AXIS_PTS_REF ldpm_n_ip_mafpwm_pctl_bas_0 /end AXIS_DESCR
 /begin AXIS_DESCR COM_AXIS tqi_egr _CNV_A_R_LINEAR_____52_CM 16 0. 1023.96875 FORMAT "%6.2" AXIS_PTS_REF ldpm_tqi_ip_mafpwm_pctl_bas_0 /end AXIS_DESCR
/end CHARACTERISTIC
/begin CHARACTERISTIC ip_mafpwm_pctl_bas_0_2 "MAF_PRE: basic air mass flow precontrol for cold engine (inj. region GES = 0)" MAP 0x853b12 _REC_MAP_20_u2_u2_u2 100. _CNV_A_R_LINEAR_____134_CM 0. 100. DISPLAY_IDENTIFIER IP_MAFPWM_PCTL_BAS_0_2 FORMAT "%5.3"
 /begin AXIS_DESCR COM_AXIS n _CNV_A_R_LINEAR_____5_CM 1 0. 6375. FORMAT "%4.0" AXIS_PTS_REF ldpm_n_ip_mafpwm_pctl_bas_short /end AXIS_DESCR
 /begin AXIS_DESCR COM_AXIS tqi_egr _CNV_A_R_LINEAR_____52_CM 1 0. 1023.96875 FORMAT "%6.2" AXIS_PTS_REF ldpm_tqi_ip_mafpwm_pctl_bas_short /end AXIS_DESCR
/end CHARACTERISTIC
/begin CHARACTERISTIC ip_mafpwm_pctl_cor_tgas_0 "MAF_PRE: basic air mass flow precontrol correction map for intake gas temperature (inj. region GES = 0)" MAP 0x854016 _REC_MAP_20_u2_u2_u2 99.99847412 _CNV_A_R_LINEAR_____140_CM -50. 49.99847412 DISPLAY_IDENTIFIER IP_MAFPWM_PCTL_COR_TGAS_0 FORMAT "%5.3"
 /begin AXIS_DESCR COM_AXIS n _CNV_A_R_LINEAR_____5_CM 8 0. 6375. FORMAT "%4.0" AXIS_PTS_REF ldp_n_ip_mafpwm_pctl_tgas_0 /end AXIS_DESCR
 /begin AXIS_DESCR COM_AXIS tqi_egr _CNV_A_R_LINEAR_____52_CM 8 0. 1023.96875 FORMAT "%6.2" AXIS_PTS_REF ldp_tqi_ip_mafpwm_pctl_tgas_0 /end AXIS_DESCR
/end CHARACTERISTIC
/begin AXIS_PTS ldp_n_ip_mafpwm_pctl_tgas_0 "" 0x841b84 n _REC_AXS_20_u2 6375. _CNV_A_R_LINEAR_____5_CM 8 0. 6375. FORMAT "%4.0" /end AXIS_PTS
/begin AXIS_PTS ldp_tqi_ip_mafpwm_pctl_tgas_0 "" 0x842720 tqi_egr _REC_AXS_20_u2 1023.96875 _CNV_A_R_LINEAR_____52_CM 8 0. 1023.96875 FORMAT "%6.2" /end AXIS_PTS
/begin CHARACTERISTIC ip_mafpwm_pctl_cor_amp_0 "MAF_PRE: basic air mass flow precontrol correction map for ambient pressure (inj. region GES = 0)" MAP 0x853f16 _REC_MAP_20_u2_u2_u2 99.99847412 _CNV_A_R_LINEAR_____140_CM -50. 49.99847412 DISPLAY_IDENTIFIER IP_MAFPWM_PCTL_COR_AMP_0 FORMAT "%5.3"
 /begin AXIS_DESCR COM_AXIS n _CNV_A_R_LINEAR_____5_CM 8 0. 6375. FORMAT "%4.0" AXIS_PTS_REF ldp_n_ip_mafpwm_pctl_amp_0 /end AXIS_DESCR
 /begin AXIS_DESCR COM_AXIS tqi_egr _CNV_A_R_LINEAR_____52_CM 8 0. 1023.96875 FORMAT "%6.2" AXIS_PTS_REF ldp_tqi_ip_mafpwm_pctl_amp_0 /end AXIS_DESCR
/end CHARACTERISTIC
/begin AXIS_PTS ldp_n_ip_mafpwm_pctl_amp_0 "" 0x841b60 n _REC_AXS_20_u2 6375. _CNV_A_R_LINEAR_____5_CM 8 0. 6375. FORMAT "%4.0" /end AXIS_PTS
/begin AXIS_PTS ldp_tqi_ip_mafpwm_pctl_amp_0 "" 0x8426fc tqi_egr _REC_AXS_20_u2 1023.96875 _CNV_A_R_LINEAR_____52_CM 8 0. 1023.96875 FORMAT "%6.2" /end AXIS_PTS
/begin CHARACTERISTIC ip_mafpwm_pctl_bas_1_1 "MAF_PRE: basic air mass flow precontrol for warm engine (inj. region GES = 1)" MAP 0x853d14 _REC_MAP_20_u2_u2_u2 100. _CNV_A_R_LINEAR_____134_CM 0. 100. DISPLAY_IDENTIFIER IP_MAFPWM_PCTL_BAS_1_1 FORMAT "%5.3"
 /begin AXIS_DESCR COM_AXIS n _CNV_A_R_LINEAR_____5_CM 16 0. 6375. FORMAT "%4.0" AXIS_PTS_REF ldpm_n_ip_mafpwm_pctl_bas_1 /end AXIS_DESCR
 /begin AXIS_DESCR COM_AXIS tqi_egr _CNV_A_R_LINEAR_____52_CM 16 0. 1023.96875 FORMAT "%6.2" AXIS_PTS_REF ldpm_tqi_ip_mafpwm_pctl_bas_1 /end AXIS_DESCR
/end CHARACTERISTIC
/begin AXIS_PTS ldpm_n_ip_mafpwm_pctl_bas_1 "" 0x843190 n _REC_AXS_20_u2 6375. _CNV_A_R_LINEAR_____5_CM 16 0. 6375. FORMAT "%4.0" /end AXIS_PTS
/begin AXIS_PTS ldpm_tqi_ip_mafpwm_pctl_bas_1 "" 0x8439f4 tqi_egr _REC_AXS_20_u2 1023.96875 _CNV_A_R_LINEAR_____52_CM 16 0. 1023.96875 FORMAT "%6.2" /end AXIS_PTS
/begin CHARACTERISTIC ip_mafpwm_pctl_bas_1_0 "MAF_PRE: basic air mass flow precontrol for hot engine (inj. region GES = 1)" MAP 0x853b14 _REC_MAP_20_u2_u2_u2 100. _CNV_A_R_LINEAR_____134_CM 0. 100. DISPLAY_IDENTIFIER IP_MAFPWM_PCTL_BAS_1_0 FORMAT "%5.3"
 /begin AXIS_DESCR COM_AXIS n _CNV_A_R_LINEAR_____5_CM 16 0. 6375. FORMAT "%4.0" AXIS_PTS_REF ldpm_n_ip_mafpwm_pctl_bas_1 /end AXIS_DESCR
 /begin AXIS_DESCR COM_AXIS tqi_egr _CNV_A_R_LINEAR_____52_CM 16 0. 1023.96875 FORMAT "%6.2" AXIS_PTS_REF ldpm_tqi_ip_mafpwm_pctl_bas_1 /end AXIS_DESCR
/end CHARACTERISTIC
/begin CHARACTERISTIC ip_mafpwm_pctl_bas_1_2 "MAF_PRE: basic air mass flow precontrol for cold engine (inj. region GES = 1)" MAP 0x853f14 _REC_MAP_20_u2_u2_u2 100. _CNV_A_R_LINEAR_____134_CM 0. 100. DISPLAY_IDENTIFIER IP_MAFPWM_PCTL_BAS_1_2 FORMAT "%5.3"
 /begin AXIS_DESCR COM_AXIS n _CNV_A_R_LINEAR_____5_CM 1 0. 6375. FORMAT "%4.0" AXIS_PTS_REF ldpm_n_ip_mafpwm_pctl_bas_short /end AXIS_DESCR
 /begin AXIS_DESCR COM_AXIS tqi_egr _CNV_A_R_LINEAR_____52_CM 1 0. 1023.96875 FORMAT "%6.2" AXIS_PTS_REF ldpm_tqi_ip_mafpwm_pctl_bas_short /end AXIS_DESCR
/end CHARACTERISTIC
/begin CHARACTERISTIC ip_mafpwm_pctl_cor_tgas_1 "MAF_PRE: basic air mass flow precontrol correction map for intake gas temperature (inj. region GES = 1)" MAP 0x854096 _REC_MAP_20_u2_u2_u2 99.99847412 _CNV_A_R_LINEAR_____140_CM -50. 49.99847412 DISPLAY_IDENTIFIER IP_MAFPWM_PCTL_COR_TGAS_1 FORMAT "%5.3"
 /begin AXIS_DESCR COM_AXIS n _CNV_A_R_LINEAR_____5_CM 8 0. 6375. FORMAT "%4.0" AXIS_PTS_REF ldp_n_ip_mafpwm_pctl_tgas_1 /end AXIS_DESCR
 /begin AXIS_DESCR COM_AXIS tqi_egr _CNV_A_R_LINEAR_____52_CM 8 0. 1023.96875 FORMAT "%6.2" AXIS_PTS_REF ldp_tqi_ip_mafpwm_pctl_tgas_1 /end AXIS_DESCR
/end CHARACTERISTIC
/begin AXIS_PTS ldp_n_ip_mafpwm_pctl_tgas_1 "" 0x841b96 n _REC_AXS_20_u2 6375. _CNV_A_R_LINEAR_____5_CM 8 0. 6375. FORMAT "%4.0" /end AXIS_PTS
/begin AXIS_PTS ldp_tqi_ip_mafpwm_pctl_tgas_1 "" 0x842732 tqi_egr _REC_AXS_20_u2 1023.96875 _CNV_A_R_LINEAR_____52_CM 8 0. 1023.96875 FORMAT "%6.2" /end AXIS_PTS
/begin CHARACTERISTIC ip_mafpwm_pctl_cor_amp_1 "MAF_PRE: basic air mass flow precontrol correction map for ambient pressure (inj. region GES = 1)" MAP 0x853f96 _REC_MAP_20_u2_u2_u2 99.99847412 _CNV_A_R_LINEAR_____140_CM -50. 49.99847412 DISPLAY_IDENTIFIER IP_MAFPWM_PCTL_COR_AMP_1 FORMAT "%5.3"
 /begin AXIS_DESCR COM_AXIS n _CNV_A_R_LINEAR_____5_CM 8 0. 6375. FORMAT "%4.0" AXIS_PTS_REF ldp_n_ip_mafpwm_pctl_amp_1 /end AXIS_DESCR
 /begin AXIS_DESCR COM_AXIS tqi_egr _CNV_A_R_LINEAR_____52_CM 8 0. 1023.96875 FORMAT "%6.2" AXIS_PTS_REF ldp_tqi_ip_mafpwm_pctl_amp_1 /end AXIS_DESCR
/end CHARACTERISTIC
/begin AXIS_PTS ldp_n_ip_mafpwm_pctl_amp_1 "" 0x841b72 n _REC_AXS_20_u2 6375. _CNV_A_R_LINEAR_____5_CM 8 0. 6375. FORMAT "%4.0" /end AXIS_PTS
/begin AXIS_PTS ldp_tqi_ip_mafpwm_pctl_amp_1 "" 0x84270e tqi_egr _REC_AXS_20_u2 1023.96875 _CNV_A_R_LINEAR_____52_CM 8 0. 1023.96875 FORMAT "%6.2" /end AXIS_PTS
/begin CHARACTERISTIC ip_mafpwm_pctl_is "MAF_PRE: precontrol value for MAF controller during IS" MAP 0x854116 _REC_MAP_20_u2_u2_u1 99.972117 _CNV_A_R_LINEAR_____204_CM 0. 99.972117 DISPLAY_IDENTIFIER IP_MAFPWM_PCTL_IS FORMAT "%5.3"
 /begin AXIS_DESCR COM_AXIS amp _CNV_A_R_LINEAR_____45_CM 8 0. 5434. FORMAT "%6.2" AXIS_PTS_REF ldp_amp_ip_mafpwm_pctl_is /end AXIS_DESCR
 /begin AXIS_DESCR COM_AXIS tgas _CNV_A_R_LINEAR_____18_CM 8 -50. 205. FORMAT "%3.0" AXIS_PTS_REF ldp_tgas_ip_mafpwm_pctl_is /end AXIS_DESCR
/end CHARACTERISTIC
/begin AXIS_PTS ldp_amp_ip_mafpwm_pctl_is "" 0x8412fa amp _REC_AXS_20_u2 5434. _CNV_A_R_LINEAR_____45_CM 8 0. 5434. FORMAT "%6.2" /end AXIS_PTS
/begin AXIS_PTS ldp_tgas_ip_mafpwm_pctl_is "" 0x842559 tgas _REC_AXS_20_u1 255. _CNV_A_R_LINEAR_____18_CM 8 -50. 205. FORMAT "%3.0" /end AXIS_PTS
/begin CHARACTERISTIC ip_fac_tran_mafpwm_pctl_0 "MAF_PRE: transition factor for the basic air mass flow precontrol (inj. region 0)" CURVE 0x8530e2 _REC_CUR_20_u2_u1 1.9999696 _CNV_A_R_LINEAR_____48_CM 0. 1.9999696 DISPLAY_IDENTIFIER IP_FAC_TRAN_MAFPWM_PCTL_0 FORMAT "%6.5"
 /begin AXIS_DESCR COM_AXIS tco _CNV_A_R_LINEAR_____18_CM 8 -50. 205. FORMAT "%3.0" AXIS_PTS_REF ldp_tco_ip_fac_tran_mafpwm_0 /end AXIS_DESCR
/end CHARACTERISTIC
/begin AXIS_PTS ldp_tco_ip_fac_tran_mafpwm_0 "" 0x842353 tco _REC_AXS_20_u1 255. _CNV_A_R_LINEAR_____18_CM 8 -50. 205. FORMAT "%3.0" /end AXIS_PTS
/begin AXIS_PTS ldpm_n_ip_mafpwm_pctl_bas_short "" 0x8431b2 n _REC_AXS_20_u2 6375. _CNV_A_R_LINEAR_____5_CM 1 0. 6375. FORMAT "%4.0" /end AXIS_PTS
/begin AXIS_PTS ldpm_tqi_ip_mafpwm_pctl_bas_short "" 0x843a16 tqi_egr _REC_AXS_20_u2 1023.96875 _CNV_A_R_LINEAR_____52_CM 1 0. 1023.96875 FORMAT "%6.2" /end AXIS_PTS
/begin MEASUREMENT lv_cdn_bpa_ctl_on "activation condition for closed loop bpa" UBYTE _CNV_S_2_RANGE______11_CM 1 0. 0. 1. DISPLAY_IDENTIFIER LV_CDN_BPA_CTL_ON ECU_ADDRESS 0x7fb85d /end MEASUREMENT
/begin MEASUREMENT lv_cdn_bpa_ctl_on_req "activation condition N and TQI for closed loop BPA" UBYTE _CNV_S_2_RANGE______11_CM 1 0. 0. 1. DISPLAY_IDENTIFIER LV_CDN_BPA_CTL_ON_REQ ECU_ADDRESS 0x7fbe4e /end MEASUREMENT
/begin MEASUREMENT lv_cdn_bpa_ctl_ena_0 "activation conditions for TQI (inj. state GES = 0)" UBYTE _CNV_S_2_RANGE______11_CM 1 0. 0. 1. DISPLAY_IDENTIFIER LV_CDN_BPA_CTL_ENA_0 ECU_ADDRESS 0x7fbe4f /end MEASUREMENT
/begin MEASUREMENT lv_cdn_bpa_ctl_ena_1 "activation conditions for TQI (inj. state GES = 1)" UBYTE _CNV_S_2_RANGE______11_CM 1 0. 0. 1. DISPLAY_IDENTIFIER LV_CDN_BPA_CTL_ENA_1 ECU_ADDRESS 0x7fbe50 /end MEASUREMENT
/begin MEASUREMENT lv_cdn_bpa_ctl_ena "activation conditions for TQI" UBYTE _CNV_S_2_RANGE______11_CM 1 0. 0. 1. DISPLAY_IDENTIFIER LV_CDN_BPA_CTL_ENA ECU_ADDRESS 0x7fbe51 /end MEASUREMENT
/begin CHARACTERISTIC lc_bpa_ctl_on "button for BPA controller activation" VALUE 0x85ce4e _REC_VAL_20_u1 1. _CNV_A_R_LINEAR_____0_CM 0. 1. DISPLAY_IDENTIFIER LC_BPA_CTL_ON FORMAT "%1.0" /end CHARACTERISTIC
/begin CHARACTERISTIC lc_bpa_ctl_on_dev "activation flag for boost pressure activation during development" VALUE 0x85ce4f _REC_VAL_20_u1 1. _CNV_A_R_LINEAR_____0_CM 0. 1. DISPLAY_IDENTIFIER LC_BPA_CTL_ON_DEV FORMAT "%1.0" /end CHARACTERISTIC
/begin CHARACTERISTIC lc_cdn_bpa_ctl_on_dev "boost pressure activation during development" VALUE 0x85ce5c _REC_VAL_20_u1 1. _CNV_A_R_LINEAR_____0_CM 0. 1. DISPLAY_IDENTIFIER LC_CDN_BPA_CTL_ON_DEV FORMAT "%1.0" /end CHARACTERISTIC
/begin CHARACTERISTIC ip_tqi_bpa_cll_ena_0 "AGE_BACT: torque threshold for closed loop BPA enable (inj. state GES = 0)" CURVE 0x85bb84 _REC_CUR_20_u2_u2 1023.96875 _CNV_A_R_LINEAR_____52_CM 0. 1023.96875 DISPLAY_IDENTIFIER IP_TQI_BPA_CLL_ENA_0 FORMAT "%6.2"
 /begin AXIS_DESCR COM_AXIS n _CNV_A_R_LINEAR_____5_CM 16 0. 6375. FORMAT "%4.0" AXIS_PTS_REF ldpm_n_ip_tqi_bpa_act_0 /end AXIS_DESCR
/end CHARACTERISTIC
/begin AXIS_PTS ldpm_n_ip_tqi_bpa_act_0 "torque threshold for closed loop BPA enable (inj. state GES = 0)" 0x8435f4 n _REC_AXS_20_u2 6375. _CNV_A_R_LINEAR_____5_CM 16 0. 6375. FORMAT "%4.0" /end AXIS_PTS
/begin CHARACTERISTIC ip_tqi_bpa_cll_di_0 "AGE_BACT: torque threshold for closed loop BPA disable (inj. state GES = 0)" CURVE 0x85bb44 _REC_CUR_20_u2_u2 1023.96875 _CNV_A_R_LINEAR_____52_CM 0. 1023.96875 DISPLAY_IDENTIFIER IP_TQI_BPA_CLL_DI_0 FORMAT "%6.2"
 /begin AXIS_DESCR COM_AXIS n _CNV_A_R_LINEAR_____5_CM 16 0. 6375. FORMAT "%4.0" AXIS_PTS_REF ldpm_n_ip_tqi_bpa_act_0 /end AXIS_DESCR
/end CHARACTERISTIC
/begin CHARACTERISTIC ip_tqi_bpa_cll_ena_1 "AGE_BACT: torque threshold for closed loop BPA enable (inj. state GES = 1)" CURVE 0x85bba4 _REC_CUR_20_u2_u2 1023.96875 _CNV_A_R_LINEAR_____52_CM 0. 1023.96875 DISPLAY_IDENTIFIER IP_TQI_BPA_CLL_ENA_1 FORMAT "%6.2"
 /begin AXIS_DESCR COM_AXIS n _CNV_A_R_LINEAR_____5_CM 16 0. 6375. FORMAT "%4.0" AXIS_PTS_REF ldpm_n_ip_tqi_bpa_act_1 /end AXIS_DESCR
/end CHARACTERISTIC
/begin AXIS_PTS ldpm_n_ip_tqi_bpa_act_1 "torque threshold for closed loop BPA enable (inj. state GES = 1)" 0x843616 n _REC_AXS_20_u2 6375. _CNV_A_R_LINEAR_____5_CM 16 0. 6375. FORMAT "%4.0" /end AXIS_PTS
/begin CHARACTERISTIC ip_tqi_bpa_cll_di_1 "AGE_BACT: torque threshold for closed loop BPA disable (inj. state GES = 1)" CURVE 0x85bb64 _REC_CUR_20_u2_u2 1023.96875 _CNV_A_R_LINEAR_____52_CM 0. 1023.96875 DISPLAY_IDENTIFIER IP_TQI_BPA_CLL_DI_1 FORMAT "%6.2"
 /begin AXIS_DESCR COM_AXIS n _CNV_A_R_LINEAR_____5_CM 16 0. 6375. FORMAT "%4.0" AXIS_PTS_REF ldpm_n_ip_tqi_bpa_act_1 /end AXIS_DESCR
/end CHARACTERISTIC
/begin COMPU_METHOD _CNV_A_R_LINEAR_____0_CM "" RAT_FUNC "%6.3" "[-]" COEFFS 0 1. 0. 0 0 1 /end COMPU_METHOD
/begin COMPU_METHOD _CNV_A_R_LINEAR_____1_CM "" RAT_FUNC "%6.3" "-" COEFFS 0 1. 0. 0 0 1 /end COMPU_METHOD
/begin COMPU_METHOD _CNV_A_R_LINEAR_____5_CM "" RAT_FUNC "%6.3" "[rpm]" COEFFS 0 1. 0. 0 0 1 /end COMPU_METHOD
/begin COMPU_METHOD _CNV_A_R_LINEAR_____7_CM "" RAT_FUNC "%6.3" "[cm^2]" COEFFS 0 839.3314549180328 0. 0 0 1 /end COMPU_METHOD
/begin COMPU_METHOD _CNV_A_R_LINEAR_____8_CM "" RAT_FUNC "%6.3" "[%]" COEFFS 0 655.3599999999997 0. 0 0 1 /end COMPU_METHOD
/begin COMPU_METHOD _CNV_S_2_RANGE______11_CM "" TAB_VERB "%6.3" "[-]" COMPU_TAB_REF _CNV_S_2_RANGE______11 /end COMPU_METHOD
/begin COMPU_VTAB _CNV_S_2_RANGE______11 "" TAB_VERB 2 0 "0" 1 "1" /end COMPU_VTAB
/begin COMPU_METHOD _CNV_A_R_LINEAR_____12_CM "" RAT_FUNC "%6.3" "[%]" COEFFS 0 327.6800000003072 3.071909304708242e-008 0 0 1 /end COMPU_METHOD
/begin COMPU_METHOD _CNV_A_R_LINEAR_____13_CM "" RAT_FUNC "%6.3" "[-]" COEFFS 0 4096.000220003369 0. 0 0 1 /end COMPU_METHOD
/begin COMPU_METHOD _CNV_A_R_LINEAR_____14_CM "" RAT_FUNC "%6.3" "[-]" COEFFS 0 65535.99999999996 0. 0 0 1 /end COMPU_METHOD
/begin COMPU_METHOD _CNV_A_R_LINEAR_____18_CM "" RAT_FUNC "%6.3" "[°C]" COEFFS 0 1. 50. 0 0 1 /end COMPU_METHOD
/begin COMPU_METHOD _CNV_A_R_LINEAR_____19_CM "" RAT_FUNC "%6.3" "[s]" COEFFS 0 10. 0. 0 0 1 /end COMPU_METHOD
/begin COMPU_METHOD _CNV_A_R_LINEAR_____20_CM "" RAT_FUNC "%6.3" "[°C]" COEFFS 0 1. 0. 0 0 1 /end COMPU_METHOD
/begin COMPU_METHOD _CNV_A_R_LINEAR_____38_CM "" RAT_FUNC "%6.3" "[mg/stk]" COEFFS 0 250. 0. 0 0 1 /end COMPU_METHOD
/begin COMPU_METHOD _CNV_A_R_LINEAR_____45_CM "" RAT_FUNC "%6.3" "[hPa]" COEFFS 0 12.06017666543982 0. 0 0 1 /end COMPU_METHOD
/begin COMPU_METHOD _CNV_A_R_LINEAR_____48_CM "" RAT_FUNC "%6.3" "[-]" COEFFS 0 32767.99807357072 0. 0 0 1 /end COMPU_METHOD
/begin COMPU_METHOD _CNV_A_R_LINEAR_____52_CM "" RAT_FUNC "%6.3" "[Nm]" COEFFS 0 32. 0. 0 0 1 /end COMPU_METHOD
/begin COMPU_METHOD _CNV_A_R_LINEAR_____59_CM "" RAT_FUNC "%6.3" "[-]" COEFFS 0 16383.81262712377 0. 0 0 1 /end COMPU_METHOD
/begin COMPU_METHOD _CNV_A_R_LINEAR_____60_CM "" RAT_FUNC "%6.3" "[mg/stk]" COEFFS 0 47.18142548596112 0. 0 0 1 /end COMPU_METHOD
/begin COMPU_METHOD _CNV_A_R_LINEAR_____64_CM "" RAT_FUNC "%6.3" "[s]" COEFFS 0 15625. 0. 0 0 1 /end COMPU_METHOD
/begin COMPU_METHOD _CNV_A_R_LINEAR_____73_CM "" RAT_FUNC "%6.3" "[s]" COEFFS 0 1000. 0. 0 0 1 /end COMPU_METHOD
/begin COMPU_METHOD _CNV_A_R_LINEAR_____86_CM "" RAT_FUNC "%6.3" "[Nm]" COEFFS 0 32. 32768. 0 0 1 /end COMPU_METHOD
/begin COMPU_METHOD _CNV_A_R_LINEAR_____94_CM "" RAT_FUNC "%6.3" "[Nm/s]" COEFFS 0 1. 0. 0 0 1 /end COMPU_METHOD
/begin COMPU_METHOD _CNV_A_R_LINEAR_____98_CM "" RAT_FUNC "%6.3" "[°C]" COEFFS 0 16. 0. 0 0 1 /end COMPU_METHOD
/begin COMPU_METHOD _CNV_A_R_LINEAR_____101_CM "" RAT_FUNC "%6.3" "[-]" COEFFS 0 128. 0. 0 0 1 /end COMPU_METHOD
/begin COMPU_METHOD _CNV_A_R_LINEAR_____102_CM "" RAT_FUNC "%6.3" "[-]" COEFFS 0 32767.99999999992 0. 0 0 1 /end COMPU_METHOD
/begin COMPU_METHOD _CNV_A_R_LINEAR_____110_CM "" RAT_FUNC "%6.3" "[kg/h]" COEFFS 0 64. 0. 0 0 1 /end COMPU_METHOD
/begin COMPU_METHOD _CNV_A_R_LINEAR_____128_CM "" RAT_FUNC "%6.3" "[-]" COEFFS 0 655.35 0. 0 0 1 /end COMPU_METHOD
/begin COMPU_METHOD _CNV_A_R_LINEAR_____134_CM "" RAT_FUNC "%6.3" "[%]" COEFFS 0 655.35 0. 0 0 1 /end COMPU_METHOD
/begin COMPU_METHOD _CNV_A_R_LINEAR_____136_CM "" RAT_FUNC "%6.3" "[%]" COEFFS 0 327.68 0. 0 0 1 /end COMPU_METHOD
/begin COMPU_METHOD _CNV_A_R_LINEAR_____139_CM "" RAT_FUNC "%6.3" "[Nm/s]" COEFFS 0 1. 32768. 0 0 1 /end COMPU_METHOD
/begin COMPU_METHOD _CNV_A_R_LINEAR_____140_CM "" RAT_FUNC "%6.3" "[%]" COEFFS 0 655.3600000071681 32768.00000035841 0 0 1 /end COMPU_METHOD
/begin COMPU_METHOD _CNV_A_R_LINEAR_____144_CM "" RAT_FUNC "%6.3" "[-]" COEFFS 0 10000. 0. 0 0 1 /end COMPU_METHOD
/begin COMPU_METHOD _CNV_A_R_LINEAR_____149_CM "" RAT_FUNC "%6.3" "[mg/stk]" COEFFS 0 47.1814594538945 -4.594675734551856e-003 0 0 1 /end COMPU_METHOD
/begin COMPU_METHOD _CNV_A_R_LINEAR_____150_CM "" RAT_FUNC "%6.3" "[mg/stk]" COEFFS 0 23.59107271489608 9.906580089591444e-007 0 0 1 /end COMPU_METHOD
/begin COMPU_METHOD _CNV_A_R_LINEAR_____151_CM "" RAT_FUNC "%6.3" "[mg/stk]" COEFFS 0 47.18213882283317 -4.587542360241059e-003 0 0 1 /end COMPU_METHOD
/begin COMPU_METHOD _CNV_A_R_LINEAR_____152_CM "" RAT_FUNC "%6.3" "[(mg/stk)*s/(N*m)]" COEFFS 0 10000. 32768. 0 0 1 /end COMPU_METHOD
/begin COMPU_METHOD _CNV_A_R_LINEAR_____153_CM "" RAT_FUNC "%6.3" "[mg/stk]" COEFFS 0 47.18214561662137 32768.00013074354 0 0 1 /end COMPU_METHOD
/begin COMPU_METHOD _CNV_A_R_LINEAR_____154_CM "" RAT_FUNC "%6.3" "rpm" COEFFS 0 1. 0. 0 0 1 /end COMPU_METHOD
/begin COMPU_METHOD _CNV_A_R_LINEAR_____155_CM "" RAT_FUNC "%6.3" "[hPa]" COEFFS 0 47.18142548596112 0. 0 0 1 /end COMPU_METHOD
/begin COMPU_METHOD _CNV_A_R_LINEAR_____156_CM "" RAT_FUNC "%6.3" "[-]" COEFFS 0 1. 50. 0 0 1 /end COMPU_METHOD
/begin COMPU_METHOD _CNV_A_R_LINEAR_____157_CM "" RAT_FUNC "%6.3" "[°C]" COEFFS 0 64. 0. 0 0 1 /end COMPU_METHOD
/begin COMPU_METHOD _CNV_A_R_LINEAR_____161_CM "" RAT_FUNC "%6.3" "[%]" COEFFS 0 327.680000069121 32768.0000069121 0 0 1 /end COMPU_METHOD
/begin COMPU_METHOD _CNV_A_R_LINEAR_____162_CM "" RAT_FUNC "%6.3" "[-]" COEFFS 0 1000. 0. 0 0 1 /end COMPU_METHOD
/begin COMPU_METHOD _CNV_A_R_LINEAR_____163_CM "" RAT_FUNC "%6.3" "[J/stk]" COEFFS 0 10. 0. 0 0 1 /end COMPU_METHOD
/begin COMPU_METHOD _CNV_A_R_LINEAR_____164_CM "" RAT_FUNC "%6.3" "[1000 rpm]" COEFFS 0 257. 0. 0 0 1 /end COMPU_METHOD
/begin COMPU_METHOD _CNV_A_R_LINEAR_____165_CM "" RAT_FUNC "%6.3" "[%]" COEFFS 0 100. 0. 0 0 1 /end COMPU_METHOD
/begin COMPU_METHOD _CNV_A_R_LINEAR_____166_CM "" RAT_FUNC "%6.3" "[hPa]" COEFFS 0 10000. 0. 0 0 1 /end COMPU_METHOD
/begin COMPU_METHOD _CNV_A_R_LINEAR_____167_CM "" RAT_FUNC "%6.3" "[-]" COEFFS 0 327.6800000691211 0. 0 0 1 /end COMPU_METHOD
/begin COMPU_METHOD _CNV_A_R_LINEAR_____168_CM "" RAT_FUNC "%6.3" "[J/(kg*K)]" COEFFS 0 25.6 0. 0 0 1 /end COMPU_METHOD
/begin COMPU_METHOD _CNV_A_R_LINEAR_____169_CM "" RAT_FUNC "%6.3" "[J/stk]" COEFFS 0 5. 0. 0 0 1 /end COMPU_METHOD
/begin COMPU_METHOD _CNV_A_R_LINEAR_____170_CM "" RAT_FUNC "%6.3" "[m/s]" COEFFS 0 655.35 0. 0 0 1 /end COMPU_METHOD
/begin COMPU_METHOD _CNV_A_R_LINEAR_____171_CM "" RAT_FUNC "%6.3" "[m]" COEFFS 0 1000. 0. 0 0 1 /end COMPU_METHOD
/begin COMPU_METHOD _CNV_A_R_LINEAR_____172_CM "" RAT_FUNC "%6.3" "[kg]" COEFFS 0 1000. 0. 0 0 1 /end COMPU_METHOD
/begin COMPU_METHOD _CNV_A_R_LINEAR_____173_CM "" RAT_FUNC "%6.3" "[mg]" COEFFS 0 1. 0. 0 0 1 /end COMPU_METHOD
/begin COMPU_METHOD _CNV_A_R_LINEAR_____174_CM "" RAT_FUNC "%6.3" "[-]" COEFFS 0 3280.080101322868 0. 0 0 1 /end COMPU_METHOD
/begin COMPU_METHOD _CNV_A_R_LINEAR_____175_CM "" RAT_FUNC "%6.3" "[°C/s]" COEFFS 0 32. 0. 0 0 1 /end COMPU_METHOD
/begin COMPU_METHOD _CNV_A_R_LINEAR_____176_CM "" RAT_FUNC "%6.3" "[-]" COEFFS 0 250. 0. 0 0 1 /end COMPU_METHOD
/begin COMPU_METHOD _CNV_A_R_LINEAR_____177_CM "" RAT_FUNC "%6.3" "[W/(m^2*K)]" COEFFS 0 100. 0. 0 0 1 /end COMPU_METHOD
/begin COMPU_METHOD _CNV_A_R_LINEAR_____178_CM "" RAT_FUNC "%6.3" "[hPa*h^2/(kg*m^3)]" COEFFS 0 10000. 0. 0 0 1 /end COMPU_METHOD
/begin COMPU_METHOD _CNV_A_R_LINEAR_____179_CM "" RAT_FUNC "%6.3" "[kg*K/(m^3*hPa)]" COEFFS 0 256. 0. 0 0 1 /end COMPU_METHOD
/begin COMPU_METHOD _CNV_A_R_LINEAR_____180_CM "" RAT_FUNC "%6.3" "[rpm/1000]" COEFFS 0 65.53600007936122 0. 0 0 1 /end COMPU_METHOD
/begin COMPU_METHOD _CNV_A_R_LINEAR_____181_CM "" RAT_FUNC "%6.3" "[MJ/kg]" COEFFS 0 655.35 0. 0 0 1 /end COMPU_METHOD
/begin COMPU_METHOD _CNV_A_R_LINEAR_____182_CM "" RAT_FUNC "%6.3" "[cm^2]" COEFFS 0 64. 0. 0 0 1 /end COMPU_METHOD
/begin COMPU_METHOD _CNV_A_R_LINEAR_____183_CM "" RAT_FUNC "%6.3" "[m]" COEFFS 0 65535.99999999996 0. 0 0 1 /end COMPU_METHOD
/begin COMPU_METHOD _CNV_A_R_LINEAR_____184_CM "" RAT_FUNC "%6.3" "[cm^2]" COEFFS 0 1. 0. 0 0 1 /end COMPU_METHOD
/begin COMPU_METHOD _CNV_A_R_LINEAR_____185_CM "" RAT_FUNC "%6.3" "[dm^3]" COEFFS 0 10000. 0. 0 0 1 /end COMPU_METHOD
/begin COMPU_METHOD _CNV_A_R_LINEAR_____186_CM "" RAT_FUNC "%6.3" "[mm]" COEFFS 0 1000. 0. 0 0 1 /end COMPU_METHOD
/begin COMPU_METHOD _CNV_A_R_LINEAR_____187_CM "" RAT_FUNC "%6.3" "[kg/m^3]" COEFFS 0 3.90625 0. 0 0 1 /end COMPU_METHOD
/begin COMPU_METHOD _CNV_A_R_LINEAR_____188_CM "" RAT_FUNC "%6.3" "[J/(kg*K)]" COEFFS 0 12.06017666543982 0. 0 0 1 /end COMPU_METHOD
/begin COMPU_METHOD _CNV_A_R_LINEAR_____189_CM "" RAT_FUNC "%6.3" "[(m/s)^3]" COEFFS 0 1. 0. 0 0 1 /end COMPU_METHOD
/begin COMPU_METHOD _CNV_A_R_LINEAR_____190_CM "" RAT_FUNC "%6.3" "[-]" COEFFS 0 131.07 0. 0 0 1 /end COMPU_METHOD
/begin COMPU_METHOD _CNV_A_R_LINEAR_____191_CM "" RAT_FUNC "%6.3" "[-]" COEFFS 0 22727.27272727273 0. 0 0 1 /end COMPU_METHOD
/begin COMPU_METHOD _CNV_A_R_LINEAR_____192_CM "" RAT_FUNC "%6.3" "[-]" COEFFS 0 26111.60074651248 0. 0 0 1 /end COMPU_METHOD
/begin COMPU_METHOD _CNV_A_R_LINEAR_____193_CM "" RAT_FUNC "%6.3" "[-]" COEFFS 0 32.7675 0. 0 0 1 /end COMPU_METHOD
/begin COMPU_METHOD _CNV_A_R_LINEAR_____194_CM "" RAT_FUNC "%6.3" "[-]" COEFFS 0 2048. 0. 0 0 1 /end COMPU_METHOD
/begin COMPU_METHOD _CNV_A_R_LINEAR_____195_CM "" RAT_FUNC "%6.3" "[W/(m^2*K)]" COEFFS 0 64. 0. 0 0 1 /end COMPU_METHOD
/begin COMPU_METHOD _CNV_A_R_LINEAR_____196_CM "" RAT_FUNC "%6.3" "[-]" COEFFS 0 5119.999874998096 0. 0 0 1 /end COMPU_METHOD
/begin COMPU_METHOD _CNV_A_R_LINEAR_____197_CM "" RAT_FUNC "%6.3" "[1e-6 * kg/(m*s)]" COEFFS 0 250. 0. 0 0 1 /end COMPU_METHOD
/begin COMPU_METHOD _CNV_A_R_LINEAR_____198_CM "" RAT_FUNC "%6.3" "[1e-3 * W/(m*K)]" COEFFS 0 250. 0. 0 0 1 /end COMPU_METHOD
/begin COMPU_METHOD _CNV_A_R_LINEAR_____200_CM "" RAT_FUNC "%6.3" "[s/m]" COEFFS 0 3276799.15198728 0. 0 0 1 /end COMPU_METHOD
/begin COMPU_METHOD _CNV_A_R_LINEAR_____204_CM "" RAT_FUNC "%6.3" "[%]" COEFFS 0 327.7613897082924 0. 0 0 1 /end COMPU_METHOD
/begin COMPU_METHOD _CNV_A_R_LINEAR_____207_CM "" RAT_FUNC "%6.3" "[hPa/s]" COEFFS 0 12.06036070024094 2.255463186884299e-005 0 0 1 /end COMPU_METHOD
/begin COMPU_METHOD _CNV_A_R_LINEAR_____208_CM "" RAT_FUNC "%6.3" "[-]" COEFFS 0 22224.52073237316 0. 0 0 1 /end COMPU_METHOD
/begin COMPU_METHOD _CNV_A_R_LINEAR_____267_CM "" RAT_FUNC "%6.3" "[%]" COEFFS 0 1. 0. 0 0 1 /end COMPU_METHOD
/begin COMPU_METHOD _CNV_A_R_LINEAR_____375_CM "" RAT_FUNC "%6.3" "[-]" COEFFS 0 65535. 0. 0 0 1 /end COMPU_METHOD
/begin COMPU_METHOD _CNV_A_R_LINEAR_____402_CM "" RAT_FUNC "%6.3" "[%]" COEFFS 0 163.8400026560406 5.312081193551421e-004 0 0 1 /end COMPU_METHOD
/begin COMPU_METHOD _CNV_A_R_LINEAR_____403_CM "" RAT_FUNC "%6.3" "[mNm]" COEFFS 0 65.53600007936122 0. 0 0 1 /end COMPU_METHOD
/begin COMPU_METHOD _CNV_A_R_LINEAR_____404_CM "" RAT_FUNC "%6.3" "[V]" COEFFS 0 655.3599999999997 0. 0 0 1 /end COMPU_METHOD
/begin COMPU_METHOD _CNV_A_R_LINEAR_____405_CM "" RAT_FUNC "%6.3" "[ohm]" COEFFS 0 6553.582575140446 0. 0 0 1 /end COMPU_METHOD
/begin COMPU_METHOD _CNV_A_R_LINEAR_____406_CM "" RAT_FUNC "%6.3" "[-]" COEFFS 0 655.3599999999997 0. 0 0 1 /end COMPU_METHOD
/begin COMPU_METHOD _CNV_A_R_LINEAR_____407_CM "" RAT_FUNC "%6.3" "[1/K]" COEFFS 0 524280. 0. 0 0 1 /end COMPU_METHOD
/begin COMPU_METHOD _CNV_A_R_LINEAR_____408_CM "" RAT_FUNC "%6.3" "[-]" COEFFS 0 16383.99985599781 -2.880043903132901e-004 0 0 1 /end COMPU_METHOD
/begin COMPU_METHOD _CNV_A_R_LINEAR_____409_CM "" RAT_FUNC "%6.3" "[s]" COEFFS 0 8143.462117710212 32767.5 0 0 1 /end COMPU_METHOD
/begin COMPU_METHOD _CNV_A_R_LINEAR_____410_CM "" RAT_FUNC "%6.3" "[s]" COEFFS 0 524280. 0. 0 0 1 /end COMPU_METHOD
/begin COMPU_METHOD _CNV_A_R_LINEAR_____411_CM "" RAT_FUNC "%6.3" "[s]" COEFFS 0 4096.000220003369 0. 0 0 1 /end COMPU_METHOD
/begin COMPU_METHOD _CNV_A_R_LINEAR_____412_CM "" RAT_FUNC "%6.3" "[A]" COEFFS 0 6553.582575140446 0. 0 0 1 /end COMPU_METHOD
/begin COMPU_METHOD _CNV_A_R_LINEAR_____413_CM "" RAT_FUNC "%6.3" "[%]" COEFFS 0 163.8399997887968 32767.99995775936 0 0 1 /end COMPU_METHOD
/begin COMPU_METHOD _CNV_A_R_LINEAR_____414_CM "" RAT_FUNC "%6.3" "[%]" COEFFS 0 1.28 128. 0 0 1 /end COMPU_METHOD
/begin COMPU_METHOD _CNV_A_R_LINEAR_____417_CM "" RAT_FUNC "%6.3" "[ms]" COEFFS 0 1. 0. 0 0 1 /end COMPU_METHOD
/begin COMPU_METHOD _CNV_A_R_LINEAR_____418_CM "" RAT_FUNC "%6.3" "[%/5ms]" COEFFS 0 655.3599999999997 0. 0 0 1 /end COMPU_METHOD
/begin COMPU_METHOD _CNV_A_R_LINEAR_____419_CM "" RAT_FUNC "%6.3" "[-]" COEFFS 0 15625. 0. 0 0 1 /end COMPU_METHOD
/begin COMPU_METHOD _CNV_A_R_LINEAR_____420_CM "" RAT_FUNC "%6.3" "[s]" COEFFS 0 50. 0. 0 0 1 /end COMPU_METHOD
/begin RECORD_LAYOUT _REC_VAL_20_u1 FNC_VALUES 1 UBYTE COLUMN_DIR DIRECT /end RECORD_LAYOUT
/begin RECORD_LAYOUT _REC_AXS_20_u2 NO_AXIS_PTS_X 1 UWORD AXIS_PTS_X 2 UWORD INDEX_INCR DIRECT /end RECORD_LAYOUT
/begin RECORD_LAYOUT _REC_MAP_20_u2_u2_u2 FNC_VALUES 1 UWORD COLUMN_DIR DIRECT /end RECORD_LAYOUT
/begin RECORD_LAYOUT _REC_VAL_20_u2 FNC_VALUES 1 UWORD COLUMN_DIR DIRECT /end RECORD_LAYOUT
/begin RECORD_LAYOUT _REC_VAL_20_s2 FNC_VALUES 1 SWORD COLUMN_DIR DIRECT /end RECORD_LAYOUT
/begin RECORD_LAYOUT _REC_AXS_20_u1 NO_AXIS_PTS_X 1 UBYTE AXIS_PTS_X 2 UBYTE INDEX_INCR DIRECT /end RECORD_LAYOUT
/begin RECORD_LAYOUT _REC_CUR_20_u2_u2 FNC_VALUES 1 UWORD COLUMN_DIR DIRECT /end RECORD_LAYOUT
/begin RECORD_LAYOUT _REC_CUR_20_u2_u1 FNC_VALUES 1 UWORD COLUMN_DIR DIRECT /end RECORD_LAYOUT
/begin RECORD_LAYOUT _REC_MAP_20_u2_u2_u1 FNC_VALUES 1 UWORD COLUMN_DIR DIRECT /end RECORD_LAYOUT
/begin RECORD_LAYOUT _REC_CUR_20_u1_u2 FNC_VALUES 1 UBYTE COLUMN_DIR DIRECT /end RECORD_LAYOUT
/begin RECORD_LAYOUT _REC_CUR_20_u1_u1 FNC_VALUES 1 UBYTE COLUMN_DIR DIRECT /end RECORD_LAYOUT
/begin RECORD_LAYOUT _REC_MAP_20_u2_u1_u2 FNC_VALUES 1 UWORD COLUMN_DIR DIRECT /end RECORD_LAYOUT
/begin RECORD_LAYOUT _REC_CUR_20_s2_u2 FNC_VALUES 1 SWORD COLUMN_DIR DIRECT /end RECORD_LAYOUT
/begin FUNCTION GES_AGE_MSP ""
 /begin DEF_CHARACTERISTIC c_maf_sp_cor_dev lc_maf_sp_dev c_fac_maf_sp_dev lc_maf_sp_dyn_on c_maf_sp_thd_maf_sp_dyn c_t2_dt1_maf_sp c_maf_sp_dyn_max c_maf_sp_dyn_min c_fac_maf_sp_is_fil c_t_maf_sp_is c_maf_sp_man lc_maf_sp_man c_fac_maf_sp_fil c_fac_maf_sp_fil_ini ip_fac_tran_maf_sp_0 ldp_tco_ip_fac_tran_maf_sp_0 ip_fac_maf_sp_cor_amp_0 ldp_amp_ip_fac_maf_sp_cor_0 ip_fac_maf_sp_cor_tgas_0 ldp_tgas_ip_fac_maf_sp_cor_0 ip_fac_tran_maf_sp_1 ldp_tco_ip_fac_tran_maf_sp_1 ip_fac_maf_sp_cor_amp_1 ldp_amp_ip_fac_maf_sp_cor_1 ip_fac_maf_sp_cor_tgas_1 ldp_tgas_ip_fac_maf_sp_cor_1 ip_fac_maf_sp_cor_amp_rgn_1 ldp_amp_ip_fac_maf_sp_cor_rgn_1 ip_fac_maf_sp_cor_amp_rgn_2 ldp_amp_ip_fac_maf_sp_cor_rgn_2 ip_kr_dt1_maf_sp_dyn ldp_tqi_grd_ip_kr_dt1_maf_sp ip_fac_maf_sp_fil_tra__n ip_t_dly_maf_on__n ldp_n_ip_t_dly_maf_on ip_maf_sp_bas_0_0 ldpm_n_ip_maf_sp_bas_0 ldpm_tqi_ip_maf_sp_bas_0 ip_maf_sp_bas_0_1 ip_maf_sp_bas_0_2 ip_maf_sp_cor_amp_0 ldp_n_ip_maf_sp_cor_amp_0 ldp_tqi_ip_maf_sp_cor_amp_0 ip_maf_sp_cor_tgas_0 ldp_n_ip_maf_sp_cor_tgas_0 ldp_tqi_ip_maf_sp_cor_tgas_0 ip_maf_sp_cor_lih_0 ip_maf_sp_bas_1_0 ldpm_n_ip_maf_sp_bas_1 ldpm_tqi_ip_maf_sp_bas_1 ip_maf_sp_bas_1_1 ip_maf_sp_bas_1_2 ip_maf_sp_cor_tgas_1 ldp_n_ip_maf_sp_cor_tgas_1 ldp_tqi_ip_maf_sp_cor_tgas_1 ip_maf_sp_cor_amp_1 ldp_n_ip_maf_sp_cor_amp_1 ldp_tqi_ip_maf_sp_cor_amp_1 ip_maf_sp_cor_lih_1 ip_maf_sp_amp_h_rgn_1 ldpm_n_ip_maf_sp_amp_rgn_1 ldpm_tqi_ip_maf_sp_amp_rgn_1 ip_maf_sp_amp_l_rgn_1 ip_maf_sp_amp_h_rgn_2 ldpm_n_ip_maf_sp_amp_rgn_2 ldpm_tqi_ip_maf_sp_amp_rgn_2 ip_maf_sp_amp_l_rgn_2 ip_maf_sp_is ldp_amp_ip_maf_sp_is ldp_tgas_ip_maf_sp_is /end DEF_CHARACTERISTIC
 /begin OUT_MEASUREMENT maf_sp_bas_sub maf_sp_bas maf_sp_bas_clc maf_sp_bas_tco_0 maf_sp_bas_0 maf_sp_bas_tco_1 maf_sp_bas_1 maf_sp_rgn maf_sp_rgn_1 maf_sp_rgn_2 maf_sp_gen maf_sp_dyn maf_sp_clc_sub lv_act_maf_sp_is maf_sp_sub maf_sp_mmv_sub lv_cdn_maf_on_dly /end OUT_MEASUREMENT
/end FUNCTION
/begin FUNCTION GES_AGE_COOL ""
 /begin DEF_CHARACTERISTIC c_tco_egr_cool_ena_0 c_temp_ex_egr_cool_ena_0 lc_egr_cool_on lc_egr_cool_up_down_swi c_tco_egr_cool_di_0 c_temp_ex_egr_cool_di_0 c_tco_egr_cool_di_1 c_tco_egr_cool_ena_1 c_temp_ex_egr_cool_di_1 c_temp_ex_egr_cool_ena_1 ip_tqi_egr_cool_ena_0 ldpm_n_ip_tqi_egr_cool_act_0 ip_tqi_egr_cool_di_0 ip_tqi_egr_cool_di_1 ldpm_n_ip_tqi_egr_cool_act_1 ip_tqi_egr_cool_ena_1 /end DEF_CHARACTERISTIC
 /begin OUT_MEASUREMENT lv_cdn_egr_cool_up_egrv_on_req lv_cdn_egr_cool_down_egrv_on_req lv_cdn_egr_cool_up_egrv_on_0 lv_cdn_egr_cool_down_egrv_on_0 lv_cdn_egr_cool_up_egrv_on_1 lv_cdn_egr_cool_down_egrv_on_1 /end OUT_MEASUREMENT
/end FUNCTION
/begin FUNCTION GES_AGE_SYSV ""
 /begin DEF_CHARACTERISTIC c_conf_tqi_egr_ctl c_conf_tqi_bpa c_conf_tqi_bpa_ctl c_conf_tqi_bpa_bal c_conf_tqi_port_in lc_map_up_thr_on lc_tcha_on ip_prs_loss_thr ldp_maf_kgh_ip_prs_loss_thr ldp_thr_pwm_ip_prs_loss_thr /end DEF_CHARACTERISTIC
 /begin OUT_MEASUREMENT tqi_grd_egr tqi_grd_bpa tqi_egr tqi_egr_ctl tqi_bpa tqi_bpa_ctl tqi_bpa_bal tqi_port_in prs_up_thr prs_down_thr prs_loss_thr prs_grd_up_thr prs_grd_down_thr prs_up_thr_mmv prs_down_thr_mmv prs_loss_thr_mmv fac_mgstk_kgh /end OUT_MEASUREMENT
/end FUNCTION
/begin FUNCTION GES_EGPT ""
 /begin DEF_CHARACTERISTIC lc_act_ex_clc_mpg c_pow_ecf_sub c_fac_temp_ex_fil c_fac_dip_ico c_fac_rho_stnd_in c_n_tcha_stnd c_fac_cmp_cor c_fac_dip_out c_fac_rho_stnd_eg c_dee c_ar_heat_tran_cyl c_cmp_ratio c_diam_fan c_ar_heat_tran_ex_port c_vol_ex_port c_thkn_wall_ex_port c_rho_ex_port c_capa_heat_ex_port c_fac_bpa_psn_fil ip_fac_temp_ex__tco ldp_tco_ip_fac_temp_ex ip_fac_temp_ex__dip_pf ldp_dip_pf_ip_fac_temp_ex ip_fac_prs_ex__tco ldp_tco_ip_fac_prs_ex ip_maf_max__n ldp_n_ip_maf_max ip_tcha_fac1__pq_cmp ldp_pq_cmp_ip_tcha_fac1 ip_tcha_fac2__tcha_bal ldp_tcha_bal_ip_tcha_fac2 ip_fac1_cmp__pq_cmp ldp_pq_cmp_ip_fac1_cmp ip_eff_tcha_mec__n_tcha_stnd ldp_n_tcha_stnd_ip_eff_tcha_mec ip_fac_exp__kapa ldp_kapa_ip_fac_exp ip_fac_temp_eb__vel_air_eb ldp_vel_air_eb_ip_fac_temp_eb ip_vel_air_eb__vel_air_am ldp_vel_air_am_ip_vel_air_eb ip_vel_fan__pow_fan ldp_pow_fan_ip_vel_fan ip_delta_temp_ex_port__fac ldp_fac_ip_delta_temp_ex_port ip_fac1_nu_it__rey ldp_rey_fac1_nu_it ip_fac2_nu_it__div_diam_len ldp_div_diam_len_ip_fac2_nu_it ip_fac3_nu_it__div_visc ldp_div_visc_ip_fac3_nu_it ip_nu_ext__rey ip_div_t_tur__div_prs_tur ldp_div_prs_tur_ip_div_t_tur ip_amp_dec__maf_kgh ip_temp_ex_bas__n__mf ldp_n_ip_temp_ex ldp_mf_ip_temp_ex ip_fac_temp_ex__maf_rel__egr ldp_maf_rel_ip_fac_temp_ex ldp_egr_ip_fac_temp_ex ldp_n_ip_prs_ex ldp_mf_ip_prs_ex ip_fac_prs_ex__maf_rel__egr ldp_maf_rel_ip_fac_prs_ex ldp_egr_ip_fac_prs_ex ip_fac_mfw_tur__temp_ex__prs_ex ldp_temp_ex_ip_fac_mfw_tur_stnd ldp_prs_ex_ip_fac_mfw_tur_stnd ip_fac1_maf_stnd__tia__amp ldp_tia_ip_fac1_maf_stnd ldp_amp_ip_fac1_maf_stnd ip_eff_cmp__maf_stnd__pq_cmp ldp_maf_stnd_ip_eff_cmp ldp_pq_cmp_ip_eff_cmp ip_n_tcha_stnd__maf_stnd__pq ldp_maf_stnd_ip_n_tcha_stnd ldp_pq_cmp_ip_n_tcha_stnd ip_eff_tur__bpa_psn__mfw_tur ldp_bpa_psn_ip_eff_tur ldp_mfw_tur_ip_eff_tur ip_capa_heat_prs_ex__temp__lamb ldpm_temp_ip_capa_heat_prs_ex ldpm_lamb_ip_capa_heat_prs_ex ip_fac_heat_tran_cyl__n__mf ldp_n_ip_fac_heat_tran_cyl ldp_mf_ip_fac_heat_tran_cyl ip_fac_temp_cmp__kappa__cmp ldp_kappa_ip_fac_temp_cmp ldp_cmp_ratio_ip_fac_temp_cmp ip_visc_ex__temp__lamb ip_heat_cond_ex__temp__lamb ip_capa_heat_vol_ex__temp__lamb ip_bpa_psn__div_prs_tur__m_tur ldp_pq_tur_ip_bpa_psn ldpm_mfw_tur_ip_pq_tur ldp_maf_kgh_ip_map_dec ip_prs_ex_bas__n__mf /end DEF_CHARACTERISTIC
 /begin OUT_MEASUREMENT prs_ex temp_ex temp_ex_sp prs_ex_sp w_ind temp_ex_gas_up_pf[0] temp_ex_gas_up_pf[1] prs_ex_mdl[0] prs_ex_mdl[1] maf_cmp_kgh[0] maf_cmp_kgh[1] dip_ico[0] dip_ico[1] prs_up_cmp[0] prs_up_cmp[1] eff_tcha[0] eff_tcha[1] n_tcha[0] n_tcha[1] eff_tur[0] eff_tur[1] eff_mec_tcha[0] eff_mec_tcha[1] eff_tur_cor[0] eff_tur_cor[1] prs_down_cmp[0] prs_down_cmp[1] eff_cmp[0] eff_cmp[1] temp_down_cmp[0] temp_down_cmp[1] pq_cmp[0] pq_cmp[1] maf_kgh_stnd[0] maf_kgh_stnd[1] m_tur_kgh[0] m_tur_kgh[1] m_tur[0] m_tur[1] m_tur_kgh_stnd[0] m_tur_kgh_stnd[1] inv_div_prs_tur[0] inv_div_prs_tur[1] n_tcha_stnd[0] n_tcha_stnd[1] div_capa_heat_prs[0] div_capa_heat_prs[1] div_temp[0] div_temp[1] tcha_fac1[0] tcha_fac1[1] tcha_fac2[0] tcha_fac2[1] tcha_fac3[0] tcha_fac3[1] tcha_fac4[0] tcha_fac4[1] tcha_fac5[0] tcha_fac5[1] tcha_fac6[0] tcha_fac6[1] div_mass[0] div_mass[1] prs_ex_gas_up_tur[0] prs_ex_gas_up_tur[1] capa_heat_prs_ex[0] capa_heat_prs_ex[1] kapa_ex[0] kapa_ex[1] capa_heat_vol_ex_mwm[0] capa_heat_vol_ex_mwm[1] div_t_tur[0] div_t_tur[1] bpa_psn[0] bpa_psn[1] prs_ex_gas_down_pf[0] prs_ex_gas_down_pf[1] prs_ex_gas_up_pf[0] prs_ex_gas_up_pf[1] dip_out[0] dip_out[1] heat_cyl_in[0] heat_cyl_in[1] heat_cyl_out[0] heat_cyl_out[1] temp_cyl_gas_out[0] temp_cyl_gas_out[1] heat_cyl_comb[0] heat_cyl_comb[1] heat_cyl_wall[0] heat_cyl_wall[1] temp_cyl_gas_cmp[0] temp_cyl_gas_cmp[1] temp_cyl_gas_comb[0] temp_cyl_gas_comb[1] temp_cyl_gas_mvm[0] temp_cyl_gas_mvm[1] temp_cyl_gas_exp[0] temp_cyl_gas_exp[1] vel_air_eb temp_air_eb diam_ex_port div_diam_len_ex_port mass_ex_port temp_wall_ex_port[0] temp_wall_ex_port[1] temp_ex_gas_up_tur_stat[0] temp_ex_gas_up_tur_stat[1] mass_ex_gas_ex_port[0] mass_ex_gas_ex_port[1] stanton_it[0] stanton_it[1] grd_temp_wall_ex_port[0] grd_temp_wall_ex_port[1] temp_ex_mdl[0] temp_ex_mdl[1] reynolds_it[0] reynolds_it[1] fac_heat_tran_ex_port_it[0] fac_heat_tran_ex_port_it[1] reynolds_ext[0] reynolds_ext[1] fac_heat_tran_ex_port_ext[0] fac_heat_tran_ex_port_ext[1] bpa_psn_mmv bpa_psn_sp_mmv dip_air_fil dip_air_fil_sp /end OUT_MEASUREMENT
/end FUNCTION
/begin FUNCTION GES_AGE_BACT ""
 /begin DEF_CHARACTERISTIC lc_bpa_ctl_on lc_bpa_ctl_on_dev lc_cdn_bpa_ctl_on_dev ip_tqi_bpa_cll_ena_0 ldpm_n_ip_tqi_bpa_act_0 ip_tqi_bpa_cll_di_0 ip_tqi_bpa_cll_ena_1 ldpm_n_ip_tqi_bpa_act_1 ip_tqi_bpa_cll_di_1 /end DEF_CHARACTERISTIC
 /begin OUT_MEASUREMENT lv_cdn_bpa_ctl_on lv_cdn_bpa_ctl_on_req lv_cdn_bpa_ctl_ena_0 lv_cdn_bpa_ctl_ena_1 lv_cdn_bpa_ctl_ena /end OUT_MEASUREMENT
/end FUNCTION
/begin FUNCTION GES_AGE_MPRE ""
 /begin DEF_CHARACTERISTIC c_mafpwm_pctl_man lc_mafpwm_pctl_man c_fac_mafpwm_pctl_is_fil c_mafpwm_pctl_off c_fac_mafpwm_pctl_ini_fil lc_mafpwm_pctl_on ip_fac_mafpwm_pctl_cor_amp_0 ldp_amp_ip_fac_mafpwm_pctl_0 ip_fac_mafpwm_pctl_cor_tgas_0 ldp_tgas_ip_fac_mafpwm_pctl_0 ip_fac_tran_mafpwm_pctl_1 ldp_tco_ip_fac_tran_mafpwm_1 ip_fac_mafpwm_pctl_cor_amp_1 ldp_amp_ip_fac_mafpwm_pctl_1 ip_fac_mafpwm_pctl_cor_tgas_1 ldp_tgas_ip_fac_mafpwm_pctl_1 ip_mafpwm_pctl_bas_0_1 ldpm_n_ip_mafpwm_pctl_bas_0 ldpm_tqi_ip_mafpwm_pctl_bas_0 ip_mafpwm_pctl_bas_0_0 ip_mafpwm_pctl_bas_0_2 ip_mafpwm_pctl_cor_tgas_0 ldp_n_ip_mafpwm_pctl_tgas_0 ldp_tqi_ip_mafpwm_pctl_tgas_0 ip_mafpwm_pctl_cor_amp_0 ldp_n_ip_mafpwm_pctl_amp_0 ldp_tqi_ip_mafpwm_pctl_amp_0 ip_mafpwm_pctl_bas_1_1 ldpm_n_ip_mafpwm_pctl_bas_1 ldpm_tqi_ip_mafpwm_pctl_bas_1 ip_mafpwm_pctl_bas_1_0 ip_mafpwm_pctl_bas_1_2 ip_mafpwm_pctl_cor_tgas_1 ldp_n_ip_mafpwm_pctl_tgas_1 ldp_tqi_ip_mafpwm_pctl_tgas_1 ip_mafpwm_pctl_cor_amp_1 ldp_n_ip_mafpwm_pctl_amp_1 ldp_tqi_ip_mafpwm_pctl_amp_1 ip_mafpwm_pctl_is ldp_amp_ip_mafpwm_pctl_is ldp_tgas_ip_mafpwm_pctl_is ip_fac_tran_mafpwm_pctl_0 ldp_tco_ip_fac_tran_mafpwm_0 ldpm_n_ip_mafpwm_pctl_bas_short ldpm_tqi_ip_mafpwm_pctl_bas_short /end DEF_CHARACTERISTIC
 /begin OUT_MEASUREMENT mafpwm_pctl_bas_tco_0 mafpwm_pctl_bas_tco_1 mafpwm_pctl_bas mafpwm_pctl_bas_0 mafpwm_pctl_bas_1 mafpwm_pctl mafpwm_pctl_clc mafpwm_pctl_mmv /end OUT_MEASUREMENT
/end FUNCTION
/begin FUNCTION GES_AGE_EACT ""
 /begin DEF_CHARACTERISTIC lc_egr_ctl_on c_tco_egr_max c_tco_hys_egr c_tco_egr_min c_amp_egr_min c_amp_hys_egr c_tia_hys_egr c_tia_egr_max c_t_dly_egr_di c_tqi_grd_thd_egr_di c_tqi_thd_egr_min ip_t_dly_egr_ast__tco ldp_tco_ip_t_dly_egr_ast ip_tqi_egr_ena_1 ldpm_n_ip_tqi_egr_act_1 ip_tqi_egr_di_1 ip_tqi_egr_ena_0 ldpm_n_ip_tqi_egr_act_0 ip_tqi_egr_di_0 /end DEF_CHARACTERISTIC
 /begin OUT_MEASUREMENT lv_cdn_egr_on_ext lv_cdn_egr_on_eng_state lv_cdn_egr_on_tco lv_cdn_egr_on_amp lv_cdn_egr_on_tia lv_cdn_egr_on_t_ast lv_cdn_egr_on_tqi lv_cdn_egr_on_tqi_grd lv_cdn_egr_on_req_0 lv_cdn_egr_on_req_1 lv_cdn_egr_on_req lv_cdn_egr_on lv_cdn_thr_on /end OUT_MEASUREMENT
/end FUNCTION
/begin FUNCTION GES_AGE_VCLN "" /begin OUT_MEASUREMENT ang_sp_egrv_clean[0] lv_req_egr_pwl[0] /end OUT_MEASUREMENT /end FUNCTION
/begin FUNCTION GES_AGE_VCLP ""
 /begin DEF_CHARACTERISTIC lc_pi_egrv_on[0] c_egrv_ini[0] lc_dt1_egrv_on[0] lc_pctl_egrv_lih c_pctl_egrv_lih c_fac_fil_ang_sp_close_egrv lc_pctl_phys_egrv_on[0] c_gear_trans_ratio_egrv c_temp_mot_egrv_ref c_r_mot_egrv c_temp_mot_egrv[0] lc_ctl_lim_egrv_man lc_ctl_lim_egrv_diag c_fac_ctl_lim_egrv c_ctl_lim_egrv_add c_ctl_lim_egrv_man[0] c_lim_dyn_max_egr[0] c_t_lim_dyn_egr[0] lc_test_egrv[0] c_test_fac_egrv[0] c_test_add_egrv[0] c_ang_sp_egrv_close_tol[0] c_ang_sp_egrv_thd_bol_grd c_ang_sp_egrv_bol_grd c_ang_sp_egrv_tol_grd c_fac_fil_ang_sp_egrv c_ang_sp_egrv_thd_tol_grd ip_kr_dt1_egrv__ctl_dif ldp_ctl_dif__ip_kr_dt1_egrv ip_t1_dt1_egrv__ctl_dif ldp_ctl_dif__ip_t1_dt1_egrv ip_air_foc_egrv__ang_egrv ldp_ang_egrv__ip_air_foc_egrv id_pctl_egrv__t_ang_sp_close_0 ldp_t_ang_close__id_pctl_egrv ip_tq_spr_egrv__ang_sp_egrv ldp_ang_sp_egrv_ip_tq_spr_egrv ip_cur_mot_egrv__tq_mot ldp_tq_mot_egrv__ip_cur_mot ip_pctl_egrv__v_mot_egrv ldp_v_mot_egrv__ip_pctl_egrv ip_ctl_max_egrv_0__temp ldpm_temp__ip_ctl_egrv ip_ctl_min_egrv_0__temp ip_ctl_dyn_lim_egrv_0__temp ip_kr_pi_egrv__ctl_dif__air_foc ldp_ctl_dif__ip_kr_pi_egrv ldpm_air_foc__ip_pi_egrv ip_tn_pi_egrv__ctl_dif__air_foc ldp_ctl_dif__ip_tn_pi_egrv ip_pctl_egrv__ang_sp__air_foc ldp_ang_sp_egrv_ip_pctl_egrv ip_air_foc__n__tqi_sp ldp_n__ip_air_foc ldp_tqi_sp__ip_air_foc /end DEF_CHARACTERISTIC
 /begin OUT_MEASUREMENT ctl_dif_egrv[0] ctl_egrv[0] pi_dt1_egrv[0] lv_edge_ang_sp_egrv_intv[0] pi_egrv[0] dt1_egrv[0] pctl_egrv[0] t_ang_sp_egrv_close[0] tq_mot_egrv[0] v_mot_egrv[0] r_mot_cor_egrv[0] ctl_lim_bas_egrv[0] lim_dif_egrv[0] ctl_lim_egrv[0] ctl_egrv_pre_lim[0] ctl_dyn_lim_egrv[0] ang_sp_egrv_bas[0] test_egrv[0] lv_ang_sp_egrv_close[0] ang_sp_egrv[0] /end OUT_MEASUREMENT
/end FUNCTION
/begin FUNCTION GES_AGE_BCOR "" /begin DEF_CHARACTERISTIC c_fac_bpa_pwm_cor_man[0] c_bpa_pwm_cor_man[0] /end DEF_CHARACTERISTIC /begin OUT_MEASUREMENT fac_bpa_pwm_cor[0] bpa_pwm_cor[0] /end OUT_MEASUREMENT /end FUNCTION
/begin FUNCTION GES_AGE_BCLP ""
 /begin DEF_CHARACTERISTIC lc_test_bpa[0] c_test_fac_bpa[0] c_test_add_bpa[0] lc_dt1_bpa_on[0] lc_pi_bpa_on[0] c_bpa_ini[0] c_gear_trans_ratio_bpa c_fac_temp_cu_el c_temp_mot_bpa_ref c_r_mot_bpa c_pctl_bpa_lih lc_pctl_bpa_lih c_temp_mot_bpa[0] lc_pctl_phys_bpa_on[0] c_ctl_lim_bpa_add c_fac_ctl_lim_bpa lc_ctl_lim_bpa_man c_ctl_lim_bpa_man[0] ip_kr_dt1_bpa__ctl_dif ldp_ctl_dif__ip_kr_dt1_bpa ip_t1_dt1_bpa__ctl_dif ldp_ctl_dif__ip_t1_dt1_bpa ip_kr_pi_bpa__ctl_dif ldp_ctl_dif__ip_kr_pi_bpa ip_tn_pi_bpa__ctl_dif ldp_ctl_dif__ip_tn_pi_bpa ip_tq_spr_bpa__ang_sp_bpa ldp_ang_sp_bpa_ip_tq_spr_bpa ip_cur_mot_bpa__tq_mot ldp_tq_mot_bpa__ip_cur_mot ip_pctl_bpa__v_mot_bpa ldp_v_mot_bpa__ip_pctl_bpa ip_pctl_bpa__ang_sp_bpa ldp_ang_sp_bpa_ip_pctl_bpa ip_ctl_max_bpa_0__temp ldpm_temp__ip_ctl_bpa ip_ctl_min_bpa_0__temp /end DEF_CHARACTERISTIC
 /begin OUT_MEASUREMENT ang_sp_bpa[0] test_bpa[0] ctl_dif_bpa[0] ctl_bpa[0] pi_dt1_bpa[0] dt1_bpa[0] pi_bpa[0] tq_mot_bpa[0] v_mot_bpa[0] r_mot_cor_bpa[0] pctl_bpa[0] ctl_lim_bpa[0] lim_dif_bpa[0] ctl_lim_bas_bpa[0] /end OUT_MEASUREMENT
/end FUNCTION
/begin FUNCTION GES_AGE_TPRE ""
 /begin DEF_CHARACTERISTIC c_fac_ar_thr_pctl_fil lc_thr_pctl_on ip_fac_mfw_the__temp_in ldp_temp_in_ip_fac_mfw_the ip_fac_mfw_the__pq ldp_pq_ip_fac_mfw_the ip_map_sp_ref_0 ldpm_tqi_sp_ip_mf_pf ip_map_sp_ref_1 /end DEF_CHARACTERISTIC
 /begin OUT_MEASUREMENT ar_thr_pctl_the mafpwm_max ar_thr_pctl_the_bas pq_thr_sp map_sp_ref /end OUT_MEASUREMENT
/end FUNCTION
/end MODULE
/end PROJECT
