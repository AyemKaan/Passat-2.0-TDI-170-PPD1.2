ASAP2_VERSION 1 41
/begin PROJECT SN0 "SIMOS PPD"
/begin HEADER "_default_HeaderComment" PROJECT_NO PRJ_NUM /end HEADER
/begin MODULE _default_ModuleName "_default_ModuleLongIdentifier"
/begin MOD_COMMON "_default_ModCommonComment" DEPOSIT ABSOLUTE BYTE_ORDER MSB_FIRST ALIGNMENT_BYTE 1 ALIGNMENT_WORD 2 ALIGNMENT_LONG 4 ALIGNMENT_FLOAT32_IEEE 4 ALIGNMENT_FLOAT64_IEEE 8 /end MOD_COMMON
/begin MEASUREMENT lv_err_maf_kgh_plaus "Error flag of diagnosis instance MAF_KGH_PLAUS" UBYTE _CNV_S_2_RANGE______23_CM 1 0. 0. 1. DISPLAY_IDENTIFIER LV_ERR_MAF_KGH_PLAUS ECU_ADDRESS 0x7fb8d1 /end MEASUREMENT
/begin MEASUREMENT fmy_stat_maf_kgh_plaus.ctr_abc "anti bounce counter for diagnosis instance MAF_KGH_PLAUS" UBYTE _CNV_A_R_LINEAR_____1_CM 1 0. 0. 255. DISPLAY_IDENTIFIER CTR_ABC_MAF_KGH_PLAUS ECU_ADDRESS 0x7f9a87 FORMAT "%3.0" /end MEASUREMENT
/begin MEASUREMENT fmy_stat_maf_kgh_plaus.ctr_end_diag "counter for end of diagnosis for diagnosis instance MAF_KGH_PLAUS" UBYTE _CNV_A_R_LINEAR_____1_CM 1 0. 0. 255. DISPLAY_IDENTIFIER CTR_ABC_END_DIAG_MAF_KGH_PLAUS ECU_ADDRESS 0x7f9a86 FORMAT "%3.0" /end MEASUREMENT
/begin MEASUREMENT fmy_stat_maf_kgh_plaus.err_info_stat.reserved "" UWORD _CNV_A_R_LINEAR_____0_CM 1 0. 0. 65535. DISPLAY_IDENTIFIER FMY_STAT_MAF_KGH_PLAUS_ERR_INFO_STAT_RESERVED ECU_ADDRESS 0x7f9a84 BYTE_ORDER MSB_LAST BIT_MASK 0xF800 /end MEASUREMENT
/begin MEASUREMENT fmy_stat_maf_kgh_plaus.err_info_stat.lv_cdn_diag_stc "Statistical flag for condition of diagnosis of the diagnosis instance MAF_KGH_PLAUS" UWORD _CNV_S_2_RANGE______383_CM 1 0. 0. 1. DISPLAY_IDENTIFIER LV_CDN_DIAG_STC_MAF_KGH_PLAUS ECU_ADDRESS 0x7f9a84 BYTE_ORDER MSB_LAST BIT_MASK 0x400 /end MEASUREMENT
/begin MEASUREMENT fmy_stat_maf_kgh_plaus.err_info_stat.lv_lock_diag "lock flag (CPU load optimisation) of the diagnosis instance MAF_KGH_PLAUS" UWORD _CNV_S_2_RANGE______383_CM 1 0. 0. 1. DISPLAY_IDENTIFIER LV_LOCK_DIAG_MAF_KGH_PLAUS ECU_ADDRESS 0x7f9a84 BYTE_ORDER MSB_LAST BIT_MASK 0x200 /end MEASUREMENT
/begin MEASUREMENT fmy_stat_maf_kgh_plaus.err_info_stat.lv_err_mem "storage in dynamic failure memory of the diagnosis instance MAF_KGH_PLAUS" UWORD _CNV_S_2_RANGE______383_CM 1 0. 0. 1. DISPLAY_IDENTIFIER LV_ERR_MEM_MAF_KGH_PLAUS ECU_ADDRESS 0x7f9a84 BYTE_ORDER MSB_LAST BIT_MASK 0x80 /end MEASUREMENT
/begin MEASUREMENT fmy_stat_maf_kgh_plaus.err_info_stat.lv_ready "readiness status of the diagnosis instance MAF_KGH_PLAUS" UWORD _CNV_S_2_RANGE______383_CM 1 0. 0. 1. DISPLAY_IDENTIFIER LV_READY_MAF_KGH_PLAUS ECU_ADDRESS 0x7f9a84 BYTE_ORDER MSB_LAST BIT_MASK 0x40 /end MEASUREMENT
/begin MEASUREMENT fmy_stat_maf_kgh_plaus.err_info_stat.lv_end_diag "end of diagnosis of the diagnosis instance MAF_KGH_PLAUS" UWORD _CNV_S_2_RANGE______383_CM 1 0. 0. 1. DISPLAY_IDENTIFIER LV_END_DIAG_MAF_KGH_PLAUS ECU_ADDRESS 0x7f9a84 BYTE_ORDER MSB_LAST BIT_MASK 0x20 /end MEASUREMENT
/begin MEASUREMENT fmy_stat_maf_kgh_plaus.err_info_stat.lv_cdn_diag "diagnosis condition of the diagnosis instance MAF_KGH_PLAUS" UWORD _CNV_S_2_RANGE______383_CM 1 0. 0. 1. DISPLAY_IDENTIFIER LV_CDN_DIAG_MAF_KGH_PLAUS ECU_ADDRESS 0x7f9a84 BYTE_ORDER MSB_LAST BIT_MASK 0x10 /end MEASUREMENT
/begin MEASUREMENT fmy_stat_maf_kgh_plaus.err_info_stat.err_sym "symptoms of the diagnosis instance MAF_KGH_PLAUS" UWORD _CNV_S_6_CONV_ERRM__22_CM 1 0. 0. 15. DISPLAY_IDENTIFIER ERR_SYM_MAF_KGH_PLAUS ECU_ADDRESS 0x7f9a84 BYTE_ORDER MSB_LAST BIT_MASK 0xF /end MEASUREMENT
/begin MEASUREMENT lv_err_maf_0_rng "Error flag of diagnosis instance MAF_0_RNG" UBYTE _CNV_S_2_RANGE______23_CM 1 0. 0. 1. DISPLAY_IDENTIFIER LV_ERR_MAF_0_RNG ECU_ADDRESS 0x7fb8d2 /end MEASUREMENT
/begin MEASUREMENT fmy_stat_maf_0_rng.ctr_abc "anti bounce counter for diagnosis instance MAF_0_RNG" UBYTE _CNV_A_R_LINEAR_____1_CM 1 0. 0. 255. DISPLAY_IDENTIFIER CTR_ABC_MAF_0_RNG ECU_ADDRESS 0x7f9a8b FORMAT "%3.0" /end MEASUREMENT
/begin MEASUREMENT fmy_stat_maf_0_rng.ctr_end_diag "counter for end of diagnosis for diagnosis instance MAF_0_RNG" UBYTE _CNV_A_R_LINEAR_____1_CM 1 0. 0. 255. DISPLAY_IDENTIFIER CTR_ABC_END_DIAG_MAF_0_RNG ECU_ADDRESS 0x7f9a8a FORMAT "%3.0" /end MEASUREMENT
/begin MEASUREMENT fmy_stat_maf_0_rng.err_info_stat.reserved "" UWORD _CNV_A_R_LINEAR_____0_CM 1 0. 0. 65535. DISPLAY_IDENTIFIER FMY_STAT_MAF_0_RNG_ERR_INFO_STAT_RESERVED ECU_ADDRESS 0x7f9a88 BYTE_ORDER MSB_LAST BIT_MASK 0xF800 /end MEASUREMENT
/begin MEASUREMENT fmy_stat_maf_0_rng.err_info_stat.lv_cdn_diag_stc "Statistical flag for condition of diagnosis of the diagnosis instance MAF_0_RNG" UWORD _CNV_S_2_RANGE______383_CM 1 0. 0. 1. DISPLAY_IDENTIFIER LV_CDN_DIAG_STC_MAF_0_RNG ECU_ADDRESS 0x7f9a88 BYTE_ORDER MSB_LAST BIT_MASK 0x400 /end MEASUREMENT
/begin MEASUREMENT fmy_stat_maf_0_rng.err_info_stat.lv_lock_diag "lock flag (CPU load optimisation) of the diagnosis instance MAF_0_RNG" UWORD _CNV_S_2_RANGE______383_CM 1 0. 0. 1. DISPLAY_IDENTIFIER LV_LOCK_DIAG_MAF_0_RNG ECU_ADDRESS 0x7f9a88 BYTE_ORDER MSB_LAST BIT_MASK 0x200 /end MEASUREMENT
/begin MEASUREMENT fmy_stat_maf_0_rng.err_info_stat.lv_err_mem "storage in dynamic failure memory of the diagnosis instance MAF_0_RNG" UWORD _CNV_S_2_RANGE______383_CM 1 0. 0. 1. DISPLAY_IDENTIFIER LV_ERR_MEM_MAF_0_RNG ECU_ADDRESS 0x7f9a88 BYTE_ORDER MSB_LAST BIT_MASK 0x80 /end MEASUREMENT
/begin MEASUREMENT fmy_stat_maf_0_rng.err_info_stat.lv_ready "readiness status of the diagnosis instance MAF_0_RNG" UWORD _CNV_S_2_RANGE______383_CM 1 0. 0. 1. DISPLAY_IDENTIFIER LV_READY_MAF_0_RNG ECU_ADDRESS 0x7f9a88 BYTE_ORDER MSB_LAST BIT_MASK 0x40 /end MEASUREMENT
/begin MEASUREMENT fmy_stat_maf_0_rng.err_info_stat.lv_end_diag "end of diagnosis of the diagnosis instance MAF_0_RNG" UWORD _CNV_S_2_RANGE______383_CM 1 0. 0. 1. DISPLAY_IDENTIFIER LV_END_DIAG_MAF_0_RNG ECU_ADDRESS 0x7f9a88 BYTE_ORDER MSB_LAST BIT_MASK 0x20 /end MEASUREMENT
/begin MEASUREMENT fmy_stat_maf_0_rng.err_info_stat.lv_cdn_diag "diagnosis condition of the diagnosis instance MAF_0_RNG" UWORD _CNV_S_2_RANGE______383_CM 1 0. 0. 1. DISPLAY_IDENTIFIER LV_CDN_DIAG_MAF_0_RNG ECU_ADDRESS 0x7f9a88 BYTE_ORDER MSB_LAST BIT_MASK 0x10 /end MEASUREMENT
/begin MEASUREMENT fmy_stat_maf_0_rng.err_info_stat.err_sym "symptoms of the diagnosis instance MAF_0_RNG" UWORD _CNV_S_6_CONV_ERRM__22_CM 1 0. 0. 15. DISPLAY_IDENTIFIER ERR_SYM_MAF_0_RNG ECU_ADDRESS 0x7f9a88 BYTE_ORDER MSB_LAST BIT_MASK 0xF /end MEASUREMENT
/begin MEASUREMENT lv_err_v_tpc_rng "Error flag of diagnosis instance V_TPC_RNG" UBYTE _CNV_S_2_RANGE______23_CM 1 0. 0. 1. DISPLAY_IDENTIFIER LV_ERR_V_TPC_RNG ECU_ADDRESS 0x7fb8d3 /end MEASUREMENT
/begin MEASUREMENT fmy_stat_v_tpc_rng.ctr_abc "anti bounce counter for diagnosis instance V_TPC_RNG" UBYTE _CNV_A_R_LINEAR_____1_CM 1 0. 0. 255. DISPLAY_IDENTIFIER CTR_ABC_V_TPC_RNG ECU_ADDRESS 0x7f9a8f FORMAT "%3.0" /end MEASUREMENT
/begin MEASUREMENT fmy_stat_v_tpc_rng.ctr_end_diag "counter for end of diagnosis for diagnosis instance V_TPC_RNG" UBYTE _CNV_A_R_LINEAR_____1_CM 1 0. 0. 255. DISPLAY_IDENTIFIER CTR_ABC_END_DIAG_V_TPC_RNG ECU_ADDRESS 0x7f9a8e FORMAT "%3.0" /end MEASUREMENT
/begin MEASUREMENT fmy_stat_v_tpc_rng.err_info_stat.reserved "" UWORD _CNV_A_R_LINEAR_____0_CM 1 0. 0. 65535. DISPLAY_IDENTIFIER FMY_STAT_V_TPC_RNG_ERR_INFO_STAT_RESERVED ECU_ADDRESS 0x7f9a8c BYTE_ORDER MSB_LAST BIT_MASK 0xF800 /end MEASUREMENT
/begin MEASUREMENT fmy_stat_v_tpc_rng.err_info_stat.lv_cdn_diag_stc "Statistical flag for condition of diagnosis of the diagnosis instance V_TPC_RNG" UWORD _CNV_S_2_RANGE______383_CM 1 0. 0. 1. DISPLAY_IDENTIFIER LV_CDN_DIAG_STC_V_TPC_RNG ECU_ADDRESS 0x7f9a8c BYTE_ORDER MSB_LAST BIT_MASK 0x400 /end MEASUREMENT
/begin MEASUREMENT fmy_stat_v_tpc_rng.err_info_stat.lv_lock_diag "lock flag (CPU load optimisation) of the diagnosis instance V_TPC_RNG" UWORD _CNV_S_2_RANGE______383_CM 1 0. 0. 1. DISPLAY_IDENTIFIER LV_LOCK_DIAG_V_TPC_RNG ECU_ADDRESS 0x7f9a8c BYTE_ORDER MSB_LAST BIT_MASK 0x200 /end MEASUREMENT
/begin MEASUREMENT fmy_stat_v_tpc_rng.err_info_stat.lv_err_mem "storage in dynamic failure memory of the diagnosis instance V_TPC_RNG" UWORD _CNV_S_2_RANGE______383_CM 1 0. 0. 1. DISPLAY_IDENTIFIER LV_ERR_MEM_V_TPC_RNG ECU_ADDRESS 0x7f9a8c BYTE_ORDER MSB_LAST BIT_MASK 0x80 /end MEASUREMENT
/begin MEASUREMENT fmy_stat_v_tpc_rng.err_info_stat.lv_ready "readiness status of the diagnosis instance V_TPC_RNG" UWORD _CNV_S_2_RANGE______383_CM 1 0. 0. 1. DISPLAY_IDENTIFIER LV_READY_V_TPC_RNG ECU_ADDRESS 0x7f9a8c BYTE_ORDER MSB_LAST BIT_MASK 0x40 /end MEASUREMENT
/begin MEASUREMENT fmy_stat_v_tpc_rng.err_info_stat.lv_end_diag "end of diagnosis of the diagnosis instance V_TPC_RNG" UWORD _CNV_S_2_RANGE______383_CM 1 0. 0. 1. DISPLAY_IDENTIFIER LV_END_DIAG_V_TPC_RNG ECU_ADDRESS 0x7f9a8c BYTE_ORDER MSB_LAST BIT_MASK 0x20 /end MEASUREMENT
/begin MEASUREMENT fmy_stat_v_tpc_rng.err_info_stat.lv_cdn_diag "diagnosis condition of the diagnosis instance V_TPC_RNG" UWORD _CNV_S_2_RANGE______383_CM 1 0. 0. 1. DISPLAY_IDENTIFIER LV_CDN_DIAG_V_TPC_RNG ECU_ADDRESS 0x7f9a8c BYTE_ORDER MSB_LAST BIT_MASK 0x10 /end MEASUREMENT
/begin MEASUREMENT fmy_stat_v_tpc_rng.err_info_stat.err_sym "symptoms of the diagnosis instance V_TPC_RNG" UWORD _CNV_S_6_CONV_ERRM__22_CM 1 0. 0. 15. DISPLAY_IDENTIFIER ERR_SYM_V_TPC_RNG ECU_ADDRESS 0x7f9a8c BYTE_ORDER MSB_LAST BIT_MASK 0xF /end MEASUREMENT
/begin MEASUREMENT lv_err_tpc_mes_plaus "Error flag of diagnosis instance TPC_MES_PLAUS" UBYTE _CNV_S_2_RANGE______23_CM 1 0. 0. 1. DISPLAY_IDENTIFIER LV_ERR_TPC_MES_PLAUS ECU_ADDRESS 0x7fb8d4 /end MEASUREMENT
/begin MEASUREMENT fmy_stat_tpc_mes_plaus.ctr_abc "anti bounce counter for diagnosis instance TPC_MES_PLAUS" UBYTE _CNV_A_R_LINEAR_____1_CM 1 0. 0. 255. DISPLAY_IDENTIFIER CTR_ABC_TPC_MES_PLAUS ECU_ADDRESS 0x7f9a93 FORMAT "%3.0" /end MEASUREMENT
/begin MEASUREMENT fmy_stat_tpc_mes_plaus.ctr_end_diag "counter for end of diagnosis for diagnosis instance TPC_MES_PLAUS" UBYTE _CNV_A_R_LINEAR_____1_CM 1 0. 0. 255. DISPLAY_IDENTIFIER CTR_ABC_END_DIAG_TPC_MES_PLAUS ECU_ADDRESS 0x7f9a92 FORMAT "%3.0" /end MEASUREMENT
/begin MEASUREMENT fmy_stat_tpc_mes_plaus.err_info_stat.reserved "" UWORD _CNV_A_R_LINEAR_____0_CM 1 0. 0. 65535. DISPLAY_IDENTIFIER FMY_STAT_TPC_MES_PLAUS_ERR_INFO_STAT_RESERVED ECU_ADDRESS 0x7f9a90 BYTE_ORDER MSB_LAST BIT_MASK 0xF800 /end MEASUREMENT
/begin MEASUREMENT fmy_stat_tpc_mes_plaus.err_info_stat.lv_cdn_diag_stc "Statistical flag for condition of diagnosis of the diagnosis instance TPC_MES_PLAUS" UWORD _CNV_S_2_RANGE______383_CM 1 0. 0. 1. DISPLAY_IDENTIFIER LV_CDN_DIAG_STC_TPC_MES_PLAUS ECU_ADDRESS 0x7f9a90 BYTE_ORDER MSB_LAST BIT_MASK 0x400 /end MEASUREMENT
/begin MEASUREMENT fmy_stat_tpc_mes_plaus.err_info_stat.lv_lock_diag "lock flag (CPU load optimisation) of the diagnosis instance TPC_MES_PLAUS" UWORD _CNV_S_2_RANGE______383_CM 1 0. 0. 1. DISPLAY_IDENTIFIER LV_LOCK_DIAG_TPC_MES_PLAUS ECU_ADDRESS 0x7f9a90 BYTE_ORDER MSB_LAST BIT_MASK 0x200 /end MEASUREMENT
/begin MEASUREMENT fmy_stat_tpc_mes_plaus.err_info_stat.lv_err_mem "storage in dynamic failure memory of the diagnosis instance TPC_MES_PLAUS" UWORD _CNV_S_2_RANGE______383_CM 1 0. 0. 1. DISPLAY_IDENTIFIER LV_ERR_MEM_TPC_MES_PLAUS ECU_ADDRESS 0x7f9a90 BYTE_ORDER MSB_LAST BIT_MASK 0x80 /end MEASUREMENT
/begin MEASUREMENT fmy_stat_tpc_mes_plaus.err_info_stat.lv_ready "readiness status of the diagnosis instance TPC_MES_PLAUS" UWORD _CNV_S_2_RANGE______383_CM 1 0. 0. 1. DISPLAY_IDENTIFIER LV_READY_TPC_MES_PLAUS ECU_ADDRESS 0x7f9a90 BYTE_ORDER MSB_LAST BIT_MASK 0x40 /end MEASUREMENT
/begin MEASUREMENT fmy_stat_tpc_mes_plaus.err_info_stat.lv_end_diag "end of diagnosis of the diagnosis instance TPC_MES_PLAUS" UWORD _CNV_S_2_RANGE______383_CM 1 0. 0. 1. DISPLAY_IDENTIFIER LV_END_DIAG_TPC_MES_PLAUS ECU_ADDRESS 0x7f9a90 BYTE_ORDER MSB_LAST BIT_MASK 0x20 /end MEASUREMENT
/begin MEASUREMENT fmy_stat_tpc_mes_plaus.err_info_stat.lv_cdn_diag "diagnosis condition of the diagnosis instance TPC_MES_PLAUS" UWORD _CNV_S_2_RANGE______383_CM 1 0. 0. 1. DISPLAY_IDENTIFIER LV_CDN_DIAG_TPC_MES_PLAUS ECU_ADDRESS 0x7f9a90 BYTE_ORDER MSB_LAST BIT_MASK 0x10 /end MEASUREMENT
/begin MEASUREMENT fmy_stat_tpc_mes_plaus.err_info_stat.err_sym "symptoms of the diagnosis instance TPC_MES_PLAUS" UWORD _CNV_S_6_CONV_ERRM__22_CM 1 0. 0. 15. DISPLAY_IDENTIFIER ERR_SYM_TPC_MES_PLAUS ECU_ADDRESS 0x7f9a90 BYTE_ORDER MSB_LAST BIT_MASK 0xF /end MEASUREMENT
/begin MEASUREMENT lv_err_v_tac_rng "Error flag of diagnosis instance V_TAC_RNG" UBYTE _CNV_S_2_RANGE______23_CM 1 0. 0. 1. DISPLAY_IDENTIFIER LV_ERR_V_TAC_RNG ECU_ADDRESS 0x7fb8d5 /end MEASUREMENT
/begin MEASUREMENT fmy_stat_v_tac_rng.ctr_abc "anti bounce counter for diagnosis instance V_TAC_RNG" UBYTE _CNV_A_R_LINEAR_____1_CM 1 0. 0. 255. DISPLAY_IDENTIFIER CTR_ABC_V_TAC_RNG ECU_ADDRESS 0x7f9a97 FORMAT "%3.0" /end MEASUREMENT
/begin MEASUREMENT fmy_stat_v_tac_rng.ctr_end_diag "counter for end of diagnosis for diagnosis instance V_TAC_RNG" UBYTE _CNV_A_R_LINEAR_____1_CM 1 0. 0. 255. DISPLAY_IDENTIFIER CTR_ABC_END_DIAG_V_TAC_RNG ECU_ADDRESS 0x7f9a96 FORMAT "%3.0" /end MEASUREMENT
/begin MEASUREMENT fmy_stat_v_tac_rng.err_info_stat.reserved "" UWORD _CNV_A_R_LINEAR_____0_CM 1 0. 0. 65535. DISPLAY_IDENTIFIER FMY_STAT_V_TAC_RNG_ERR_INFO_STAT_RESERVED ECU_ADDRESS 0x7f9a94 BYTE_ORDER MSB_LAST BIT_MASK 0xF800 /end MEASUREMENT
/begin MEASUREMENT fmy_stat_v_tac_rng.err_info_stat.lv_cdn_diag_stc "Statistical flag for condition of diagnosis of the diagnosis instance V_TAC_RNG" UWORD _CNV_S_2_RANGE______383_CM 1 0. 0. 1. DISPLAY_IDENTIFIER LV_CDN_DIAG_STC_V_TAC_RNG ECU_ADDRESS 0x7f9a94 BYTE_ORDER MSB_LAST BIT_MASK 0x400 /end MEASUREMENT
/begin MEASUREMENT fmy_stat_v_tac_rng.err_info_stat.lv_lock_diag "lock flag (CPU load optimisation) of the diagnosis instance V_TAC_RNG" UWORD _CNV_S_2_RANGE______383_CM 1 0. 0. 1. DISPLAY_IDENTIFIER LV_LOCK_DIAG_V_TAC_RNG ECU_ADDRESS 0x7f9a94 BYTE_ORDER MSB_LAST BIT_MASK 0x200 /end MEASUREMENT
/begin MEASUREMENT fmy_stat_v_tac_rng.err_info_stat.lv_err_mem "storage in dynamic failure memory of the diagnosis instance V_TAC_RNG" UWORD _CNV_S_2_RANGE______383_CM 1 0. 0. 1. DISPLAY_IDENTIFIER LV_ERR_MEM_V_TAC_RNG ECU_ADDRESS 0x7f9a94 BYTE_ORDER MSB_LAST BIT_MASK 0x80 /end MEASUREMENT
/begin MEASUREMENT fmy_stat_v_tac_rng.err_info_stat.lv_ready "readiness status of the diagnosis instance V_TAC_RNG" UWORD _CNV_S_2_RANGE______383_CM 1 0. 0. 1. DISPLAY_IDENTIFIER LV_READY_V_TAC_RNG ECU_ADDRESS 0x7f9a94 BYTE_ORDER MSB_LAST BIT_MASK 0x40 /end MEASUREMENT
/begin MEASUREMENT fmy_stat_v_tac_rng.err_info_stat.lv_end_diag "end of diagnosis of the diagnosis instance V_TAC_RNG" UWORD _CNV_S_2_RANGE______383_CM 1 0. 0. 1. DISPLAY_IDENTIFIER LV_END_DIAG_V_TAC_RNG ECU_ADDRESS 0x7f9a94 BYTE_ORDER MSB_LAST BIT_MASK 0x20 /end MEASUREMENT
/begin MEASUREMENT fmy_stat_v_tac_rng.err_info_stat.lv_cdn_diag "diagnosis condition of the diagnosis instance V_TAC_RNG" UWORD _CNV_S_2_RANGE______383_CM 1 0. 0. 1. DISPLAY_IDENTIFIER LV_CDN_DIAG_V_TAC_RNG ECU_ADDRESS 0x7f9a94 BYTE_ORDER MSB_LAST BIT_MASK 0x10 /end MEASUREMENT
/begin MEASUREMENT fmy_stat_v_tac_rng.err_info_stat.err_sym "symptoms of the diagnosis instance V_TAC_RNG" UWORD _CNV_S_6_CONV_ERRM__22_CM 1 0. 0. 15. DISPLAY_IDENTIFIER ERR_SYM_V_TAC_RNG ECU_ADDRESS 0x7f9a94 BYTE_ORDER MSB_LAST BIT_MASK 0xF /end MEASUREMENT
/begin MEASUREMENT lv_err_tac_mes_grd "Error flag of diagnosis instance TAC_MES_GRD" UBYTE _CNV_S_2_RANGE______23_CM 1 0. 0. 1. DISPLAY_IDENTIFIER LV_ERR_TAC_MES_GRD ECU_ADDRESS 0x7fb8d6 /end MEASUREMENT
/begin MEASUREMENT fmy_stat_tac_mes_grd.ctr_abc "anti bounce counter for diagnosis instance TAC_MES_GRD" UBYTE _CNV_A_R_LINEAR_____1_CM 1 0. 0. 255. DISPLAY_IDENTIFIER CTR_ABC_TAC_MES_GRD ECU_ADDRESS 0x7f9a9b FORMAT "%3.0" /end MEASUREMENT
/begin MEASUREMENT fmy_stat_tac_mes_grd.ctr_end_diag "counter for end of diagnosis for diagnosis instance TAC_MES_GRD" UBYTE _CNV_A_R_LINEAR_____1_CM 1 0. 0. 255. DISPLAY_IDENTIFIER CTR_ABC_END_DIAG_TAC_MES_GRD ECU_ADDRESS 0x7f9a9a FORMAT "%3.0" /end MEASUREMENT
/begin MEASUREMENT fmy_stat_tac_mes_grd.err_info_stat.reserved "" UWORD _CNV_A_R_LINEAR_____0_CM 1 0. 0. 65535. DISPLAY_IDENTIFIER FMY_STAT_TAC_MES_GRD_ERR_INFO_STAT_RESERVED ECU_ADDRESS 0x7f9a98 BYTE_ORDER MSB_LAST BIT_MASK 0xF800 /end MEASUREMENT
/begin MEASUREMENT fmy_stat_tac_mes_grd.err_info_stat.lv_cdn_diag_stc "Statistical flag for condition of diagnosis of the diagnosis instance TAC_MES_GRD" UWORD _CNV_S_2_RANGE______383_CM 1 0. 0. 1. DISPLAY_IDENTIFIER LV_CDN_DIAG_STC_TAC_MES_GRD ECU_ADDRESS 0x7f9a98 BYTE_ORDER MSB_LAST BIT_MASK 0x400 /end MEASUREMENT
/begin MEASUREMENT fmy_stat_tac_mes_grd.err_info_stat.lv_lock_diag "lock flag (CPU load optimisation) of the diagnosis instance TAC_MES_GRD" UWORD _CNV_S_2_RANGE______383_CM 1 0. 0. 1. DISPLAY_IDENTIFIER LV_LOCK_DIAG_TAC_MES_GRD ECU_ADDRESS 0x7f9a98 BYTE_ORDER MSB_LAST BIT_MASK 0x200 /end MEASUREMENT
/begin MEASUREMENT fmy_stat_tac_mes_grd.err_info_stat.lv_err_mem "storage in dynamic failure memory of the diagnosis instance TAC_MES_GRD" UWORD _CNV_S_2_RANGE______383_CM 1 0. 0. 1. DISPLAY_IDENTIFIER LV_ERR_MEM_TAC_MES_GRD ECU_ADDRESS 0x7f9a98 BYTE_ORDER MSB_LAST BIT_MASK 0x80 /end MEASUREMENT
/begin MEASUREMENT fmy_stat_tac_mes_grd.err_info_stat.lv_ready "readiness status of the diagnosis instance TAC_MES_GRD" UWORD _CNV_S_2_RANGE______383_CM 1 0. 0. 1. DISPLAY_IDENTIFIER LV_READY_TAC_MES_GRD ECU_ADDRESS 0x7f9a98 BYTE_ORDER MSB_LAST BIT_MASK 0x40 /end MEASUREMENT
/begin MEASUREMENT fmy_stat_tac_mes_grd.err_info_stat.lv_end_diag "end of diagnosis of the diagnosis instance TAC_MES_GRD" UWORD _CNV_S_2_RANGE______383_CM 1 0. 0. 1. DISPLAY_IDENTIFIER LV_END_DIAG_TAC_MES_GRD ECU_ADDRESS 0x7f9a98 BYTE_ORDER MSB_LAST BIT_MASK 0x20 /end MEASUREMENT
/begin MEASUREMENT fmy_stat_tac_mes_grd.err_info_stat.lv_cdn_diag "diagnosis condition of the diagnosis instance TAC_MES_GRD" UWORD _CNV_S_2_RANGE______383_CM 1 0. 0. 1. DISPLAY_IDENTIFIER LV_CDN_DIAG_TAC_MES_GRD ECU_ADDRESS 0x7f9a98 BYTE_ORDER MSB_LAST BIT_MASK 0x10 /end MEASUREMENT
/begin MEASUREMENT fmy_stat_tac_mes_grd.err_info_stat.err_sym "symptoms of the diagnosis instance TAC_MES_GRD" UWORD _CNV_S_6_CONV_ERRM__22_CM 1 0. 0. 15. DISPLAY_IDENTIFIER ERR_SYM_TAC_MES_GRD ECU_ADDRESS 0x7f9a98 BYTE_ORDER MSB_LAST BIT_MASK 0xF /end MEASUREMENT
/begin MEASUREMENT lv_err_mf_is_obd "Error flag of diagnosis instance MF_IS_OBD" UBYTE _CNV_S_2_RANGE______23_CM 1 0. 0. 1. DISPLAY_IDENTIFIER LV_ERR_MF_IS_OBD ECU_ADDRESS 0x7fb8d7 /end MEASUREMENT
/begin MEASUREMENT fmy_stat_mf_is_obd.ctr_abc "anti bounce counter for diagnosis instance MF_IS_OBD" UBYTE _CNV_A_R_LINEAR_____1_CM 1 0. 0. 255. DISPLAY_IDENTIFIER CTR_ABC_MF_IS_OBD ECU_ADDRESS 0x7f9a9f FORMAT "%3.0" /end MEASUREMENT
/begin MEASUREMENT fmy_stat_mf_is_obd.ctr_end_diag "counter for end of diagnosis for diagnosis instance MF_IS_OBD" UBYTE _CNV_A_R_LINEAR_____1_CM 1 0. 0. 255. DISPLAY_IDENTIFIER CTR_ABC_END_DIAG_MF_IS_OBD ECU_ADDRESS 0x7f9a9e FORMAT "%3.0" /end MEASUREMENT
/begin MEASUREMENT fmy_stat_mf_is_obd.err_info_stat.reserved "" UWORD _CNV_A_R_LINEAR_____0_CM 1 0. 0. 65535. DISPLAY_IDENTIFIER FMY_STAT_MF_IS_OBD_ERR_INFO_STAT_RESERVED ECU_ADDRESS 0x7f9a9c BYTE_ORDER MSB_LAST BIT_MASK 0xF800 /end MEASUREMENT
/begin MEASUREMENT fmy_stat_mf_is_obd.err_info_stat.lv_cdn_diag_stc "Statistical flag for condition of diagnosis of the diagnosis instance MF_IS_OBD" UWORD _CNV_S_2_RANGE______383_CM 1 0. 0. 1. DISPLAY_IDENTIFIER LV_CDN_DIAG_STC_MF_IS_OBD ECU_ADDRESS 0x7f9a9c BYTE_ORDER MSB_LAST BIT_MASK 0x400 /end MEASUREMENT
/begin MEASUREMENT fmy_stat_mf_is_obd.err_info_stat.lv_lock_diag "lock flag (CPU load optimisation) of the diagnosis instance MF_IS_OBD" UWORD _CNV_S_2_RANGE______383_CM 1 0. 0. 1. DISPLAY_IDENTIFIER LV_LOCK_DIAG_MF_IS_OBD ECU_ADDRESS 0x7f9a9c BYTE_ORDER MSB_LAST BIT_MASK 0x200 /end MEASUREMENT
/begin MEASUREMENT fmy_stat_mf_is_obd.err_info_stat.lv_err_mem "storage in dynamic failure memory of the diagnosis instance MF_IS_OBD" UWORD _CNV_S_2_RANGE______383_CM 1 0. 0. 1. DISPLAY_IDENTIFIER LV_ERR_MEM_MF_IS_OBD ECU_ADDRESS 0x7f9a9c BYTE_ORDER MSB_LAST BIT_MASK 0x80 /end MEASUREMENT
/begin MEASUREMENT fmy_stat_mf_is_obd.err_info_stat.lv_ready "readiness status of the diagnosis instance MF_IS_OBD" UWORD _CNV_S_2_RANGE______383_CM 1 0. 0. 1. DISPLAY_IDENTIFIER LV_READY_MF_IS_OBD ECU_ADDRESS 0x7f9a9c BYTE_ORDER MSB_LAST BIT_MASK 0x40 /end MEASUREMENT
/begin MEASUREMENT fmy_stat_mf_is_obd.err_info_stat.lv_end_diag "end of diagnosis of the diagnosis instance MF_IS_OBD" UWORD _CNV_S_2_RANGE______383_CM 1 0. 0. 1. DISPLAY_IDENTIFIER LV_END_DIAG_MF_IS_OBD ECU_ADDRESS 0x7f9a9c BYTE_ORDER MSB_LAST BIT_MASK 0x20 /end MEASUREMENT
/begin MEASUREMENT fmy_stat_mf_is_obd.err_info_stat.lv_cdn_diag "diagnosis condition of the diagnosis instance MF_IS_OBD" UWORD _CNV_S_2_RANGE______383_CM 1 0. 0. 1. DISPLAY_IDENTIFIER LV_CDN_DIAG_MF_IS_OBD ECU_ADDRESS 0x7f9a9c BYTE_ORDER MSB_LAST BIT_MASK 0x10 /end MEASUREMENT
/begin MEASUREMENT fmy_stat_mf_is_obd.err_info_stat.err_sym "symptoms of the diagnosis instance MF_IS_OBD" UWORD _CNV_S_6_CONV_ERRM__22_CM 1 0. 0. 15. DISPLAY_IDENTIFIER ERR_SYM_MF_IS_OBD ECU_ADDRESS 0x7f9a9c BYTE_ORDER MSB_LAST BIT_MASK 0xF /end MEASUREMENT
/begin MEASUREMENT lv_err_cyl_bal_0 "Error flag of diagnosis instance CYL_BAL_0" UBYTE _CNV_S_2_RANGE______23_CM 1 0. 0. 1. DISPLAY_IDENTIFIER LV_ERR_CYL_BAL_0 ECU_ADDRESS 0x7fb8d8 /end MEASUREMENT
/begin MEASUREMENT fmy_stat_cyl_bal_0.ctr_abc "anti bounce counter for diagnosis instance CYL_BAL_0" UBYTE _CNV_A_R_LINEAR_____1_CM 1 0. 0. 255. DISPLAY_IDENTIFIER CTR_ABC_CYL_BAL_0 ECU_ADDRESS 0x7f9aa3 FORMAT "%3.0" /end MEASUREMENT
/begin MEASUREMENT fmy_stat_cyl_bal_0.ctr_end_diag "counter for end of diagnosis for diagnosis instance CYL_BAL_0" UBYTE _CNV_A_R_LINEAR_____1_CM 1 0. 0. 255. DISPLAY_IDENTIFIER CTR_ABC_END_DIAG_CYL_BAL_0 ECU_ADDRESS 0x7f9aa2 FORMAT "%3.0" /end MEASUREMENT
/begin MEASUREMENT fmy_stat_cyl_bal_0.err_info_stat.reserved "" UWORD _CNV_A_R_LINEAR_____0_CM 1 0. 0. 65535. DISPLAY_IDENTIFIER FMY_STAT_CYL_BAL_0_ERR_INFO_STAT_RESERVED ECU_ADDRESS 0x7f9aa0 BYTE_ORDER MSB_LAST BIT_MASK 0xF800 /end MEASUREMENT
/begin MEASUREMENT fmy_stat_cyl_bal_0.err_info_stat.lv_cdn_diag_stc "Statistical flag for condition of diagnosis of the diagnosis instance CYL_BAL_0" UWORD _CNV_S_2_RANGE______383_CM 1 0. 0. 1. DISPLAY_IDENTIFIER LV_CDN_DIAG_STC_CYL_BAL_0 ECU_ADDRESS 0x7f9aa0 BYTE_ORDER MSB_LAST BIT_MASK 0x400 /end MEASUREMENT
/begin MEASUREMENT fmy_stat_cyl_bal_0.err_info_stat.lv_lock_diag "lock flag (CPU load optimisation) of the diagnosis instance CYL_BAL_0" UWORD _CNV_S_2_RANGE______383_CM 1 0. 0. 1. DISPLAY_IDENTIFIER LV_LOCK_DIAG_CYL_BAL_0 ECU_ADDRESS 0x7f9aa0 BYTE_ORDER MSB_LAST BIT_MASK 0x200 /end MEASUREMENT
/begin MEASUREMENT fmy_stat_cyl_bal_0.err_info_stat.lv_err_mem "storage in dynamic failure memory of the diagnosis instance CYL_BAL_0" UWORD _CNV_S_2_RANGE______383_CM 1 0. 0. 1. DISPLAY_IDENTIFIER LV_ERR_MEM_CYL_BAL_0 ECU_ADDRESS 0x7f9aa0 BYTE_ORDER MSB_LAST BIT_MASK 0x80 /end MEASUREMENT
/begin MEASUREMENT fmy_stat_cyl_bal_0.err_info_stat.lv_ready "readiness status of the diagnosis instance CYL_BAL_0" UWORD _CNV_S_2_RANGE______383_CM 1 0. 0. 1. DISPLAY_IDENTIFIER LV_READY_CYL_BAL_0 ECU_ADDRESS 0x7f9aa0 BYTE_ORDER MSB_LAST BIT_MASK 0x40 /end MEASUREMENT
/begin MEASUREMENT fmy_stat_cyl_bal_0.err_info_stat.lv_end_diag "end of diagnosis of the diagnosis instance CYL_BAL_0" UWORD _CNV_S_2_RANGE______383_CM 1 0. 0. 1. DISPLAY_IDENTIFIER LV_END_DIAG_CYL_BAL_0 ECU_ADDRESS 0x7f9aa0 BYTE_ORDER MSB_LAST BIT_MASK 0x20 /end MEASUREMENT
/begin MEASUREMENT fmy_stat_cyl_bal_0.err_info_stat.lv_cdn_diag "diagnosis condition of the diagnosis instance CYL_BAL_0" UWORD _CNV_S_2_RANGE______383_CM 1 0. 0. 1. DISPLAY_IDENTIFIER LV_CDN_DIAG_CYL_BAL_0 ECU_ADDRESS 0x7f9aa0 BYTE_ORDER MSB_LAST BIT_MASK 0x10 /end MEASUREMENT
/begin MEASUREMENT fmy_stat_cyl_bal_0.err_info_stat.err_sym "symptoms of the diagnosis instance CYL_BAL_0" UWORD _CNV_S_6_CONV_ERRM__22_CM 1 0. 0. 15. DISPLAY_IDENTIFIER ERR_SYM_CYL_BAL_0 ECU_ADDRESS 0x7f9aa0 BYTE_ORDER MSB_LAST BIT_MASK 0xF /end MEASUREMENT
/begin MEASUREMENT lv_err_cyl_bal_1 "Error flag of diagnosis instance CYL_BAL_1" UBYTE _CNV_S_2_RANGE______23_CM 1 0. 0. 1. DISPLAY_IDENTIFIER LV_ERR_CYL_BAL_1 ECU_ADDRESS 0x7fb8d9 /end MEASUREMENT
/begin MEASUREMENT fmy_stat_cyl_bal_1.ctr_abc "anti bounce counter for diagnosis instance CYL_BAL_1" UBYTE _CNV_A_R_LINEAR_____1_CM 1 0. 0. 255. DISPLAY_IDENTIFIER CTR_ABC_CYL_BAL_1 ECU_ADDRESS 0x7f9aa7 FORMAT "%3.0" /end MEASUREMENT
/begin MEASUREMENT fmy_stat_cyl_bal_1.ctr_end_diag "counter for end of diagnosis for diagnosis instance CYL_BAL_1" UBYTE _CNV_A_R_LINEAR_____1_CM 1 0. 0. 255. DISPLAY_IDENTIFIER CTR_ABC_END_DIAG_CYL_BAL_1 ECU_ADDRESS 0x7f9aa6 FORMAT "%3.0" /end MEASUREMENT
/begin MEASUREMENT fmy_stat_cyl_bal_1.err_info_stat.reserved "" UWORD _CNV_A_R_LINEAR_____0_CM 1 0. 0. 65535. DISPLAY_IDENTIFIER FMY_STAT_CYL_BAL_1_ERR_INFO_STAT_RESERVED ECU_ADDRESS 0x7f9aa4 BYTE_ORDER MSB_LAST BIT_MASK 0xF800 /end MEASUREMENT
/begin MEASUREMENT fmy_stat_cyl_bal_1.err_info_stat.lv_cdn_diag_stc "Statistical flag for condition of diagnosis of the diagnosis instance CYL_BAL_1" UWORD _CNV_S_2_RANGE______383_CM 1 0. 0. 1. DISPLAY_IDENTIFIER LV_CDN_DIAG_STC_CYL_BAL_1 ECU_ADDRESS 0x7f9aa4 BYTE_ORDER MSB_LAST BIT_MASK 0x400 /end MEASUREMENT
/begin MEASUREMENT fmy_stat_cyl_bal_1.err_info_stat.lv_lock_diag "lock flag (CPU load optimisation) of the diagnosis instance CYL_BAL_1" UWORD _CNV_S_2_RANGE______383_CM 1 0. 0. 1. DISPLAY_IDENTIFIER LV_LOCK_DIAG_CYL_BAL_1 ECU_ADDRESS 0x7f9aa4 BYTE_ORDER MSB_LAST BIT_MASK 0x200 /end MEASUREMENT
/begin MEASUREMENT fmy_stat_cyl_bal_1.err_info_stat.lv_err_mem "storage in dynamic failure memory of the diagnosis instance CYL_BAL_1" UWORD _CNV_S_2_RANGE______383_CM 1 0. 0. 1. DISPLAY_IDENTIFIER LV_ERR_MEM_CYL_BAL_1 ECU_ADDRESS 0x7f9aa4 BYTE_ORDER MSB_LAST BIT_MASK 0x80 /end MEASUREMENT
/begin MEASUREMENT fmy_stat_cyl_bal_1.err_info_stat.lv_ready "readiness status of the diagnosis instance CYL_BAL_1" UWORD _CNV_S_2_RANGE______383_CM 1 0. 0. 1. DISPLAY_IDENTIFIER LV_READY_CYL_BAL_1 ECU_ADDRESS 0x7f9aa4 BYTE_ORDER MSB_LAST BIT_MASK 0x40 /end MEASUREMENT
/begin MEASUREMENT fmy_stat_cyl_bal_1.err_info_stat.lv_end_diag "end of diagnosis of the diagnosis instance CYL_BAL_1" UWORD _CNV_S_2_RANGE______383_CM 1 0. 0. 1. DISPLAY_IDENTIFIER LV_END_DIAG_CYL_BAL_1 ECU_ADDRESS 0x7f9aa4 BYTE_ORDER MSB_LAST BIT_MASK 0x20 /end MEASUREMENT
/begin MEASUREMENT fmy_stat_cyl_bal_1.err_info_stat.lv_cdn_diag "diagnosis condition of the diagnosis instance CYL_BAL_1" UWORD _CNV_S_2_RANGE______383_CM 1 0. 0. 1. DISPLAY_IDENTIFIER LV_CDN_DIAG_CYL_BAL_1 ECU_ADDRESS 0x7f9aa4 BYTE_ORDER MSB_LAST BIT_MASK 0x10 /end MEASUREMENT
/begin MEASUREMENT fmy_stat_cyl_bal_1.err_info_stat.err_sym "symptoms of the diagnosis instance CYL_BAL_1" UWORD _CNV_S_6_CONV_ERRM__22_CM 1 0. 0. 15. DISPLAY_IDENTIFIER ERR_SYM_CYL_BAL_1 ECU_ADDRESS 0x7f9aa4 BYTE_ORDER MSB_LAST BIT_MASK 0xF /end MEASUREMENT
/begin MEASUREMENT lv_err_cyl_bal_2 "Error flag of diagnosis instance CYL_BAL_2" UBYTE _CNV_S_2_RANGE______23_CM 1 0. 0. 1. DISPLAY_IDENTIFIER LV_ERR_CYL_BAL_2 ECU_ADDRESS 0x7fb8da /end MEASUREMENT
/begin MEASUREMENT fmy_stat_cyl_bal_2.ctr_abc "anti bounce counter for diagnosis instance CYL_BAL_2" UBYTE _CNV_A_R_LINEAR_____1_CM 1 0. 0. 255. DISPLAY_IDENTIFIER CTR_ABC_CYL_BAL_2 ECU_ADDRESS 0x7f9aab FORMAT "%3.0" /end MEASUREMENT
/begin MEASUREMENT fmy_stat_cyl_bal_2.ctr_end_diag "counter for end of diagnosis for diagnosis instance CYL_BAL_2" UBYTE _CNV_A_R_LINEAR_____1_CM 1 0. 0. 255. DISPLAY_IDENTIFIER CTR_ABC_END_DIAG_CYL_BAL_2 ECU_ADDRESS 0x7f9aaa FORMAT "%3.0" /end MEASUREMENT
/begin MEASUREMENT fmy_stat_cyl_bal_2.err_info_stat.reserved "" UWORD _CNV_A_R_LINEAR_____0_CM 1 0. 0. 65535. DISPLAY_IDENTIFIER FMY_STAT_CYL_BAL_2_ERR_INFO_STAT_RESERVED ECU_ADDRESS 0x7f9aa8 BYTE_ORDER MSB_LAST BIT_MASK 0xF800 /end MEASUREMENT
/begin MEASUREMENT fmy_stat_cyl_bal_2.err_info_stat.lv_cdn_diag_stc "Statistical flag for condition of diagnosis of the diagnosis instance CYL_BAL_2" UWORD _CNV_S_2_RANGE______383_CM 1 0. 0. 1. DISPLAY_IDENTIFIER LV_CDN_DIAG_STC_CYL_BAL_2 ECU_ADDRESS 0x7f9aa8 BYTE_ORDER MSB_LAST BIT_MASK 0x400 /end MEASUREMENT
/begin MEASUREMENT fmy_stat_cyl_bal_2.err_info_stat.lv_lock_diag "lock flag (CPU load optimisation) of the diagnosis instance CYL_BAL_2" UWORD _CNV_S_2_RANGE______383_CM 1 0. 0. 1. DISPLAY_IDENTIFIER LV_LOCK_DIAG_CYL_BAL_2 ECU_ADDRESS 0x7f9aa8 BYTE_ORDER MSB_LAST BIT_MASK 0x200 /end MEASUREMENT
/begin MEASUREMENT fmy_stat_cyl_bal_2.err_info_stat.lv_err_mem "storage in dynamic failure memory of the diagnosis instance CYL_BAL_2" UWORD _CNV_S_2_RANGE______383_CM 1 0. 0. 1. DISPLAY_IDENTIFIER LV_ERR_MEM_CYL_BAL_2 ECU_ADDRESS 0x7f9aa8 BYTE_ORDER MSB_LAST BIT_MASK 0x80 /end MEASUREMENT
/begin MEASUREMENT fmy_stat_cyl_bal_2.err_info_stat.lv_ready "readiness status of the diagnosis instance CYL_BAL_2" UWORD _CNV_S_2_RANGE______383_CM 1 0. 0. 1. DISPLAY_IDENTIFIER LV_READY_CYL_BAL_2 ECU_ADDRESS 0x7f9aa8 BYTE_ORDER MSB_LAST BIT_MASK 0x40 /end MEASUREMENT
/begin MEASUREMENT fmy_stat_cyl_bal_2.err_info_stat.lv_end_diag "end of diagnosis of the diagnosis instance CYL_BAL_2" UWORD _CNV_S_2_RANGE______383_CM 1 0. 0. 1. DISPLAY_IDENTIFIER LV_END_DIAG_CYL_BAL_2 ECU_ADDRESS 0x7f9aa8 BYTE_ORDER MSB_LAST BIT_MASK 0x20 /end MEASUREMENT
/begin MEASUREMENT fmy_stat_cyl_bal_2.err_info_stat.lv_cdn_diag "diagnosis condition of the diagnosis instance CYL_BAL_2" UWORD _CNV_S_2_RANGE______383_CM 1 0. 0. 1. DISPLAY_IDENTIFIER LV_CDN_DIAG_CYL_BAL_2 ECU_ADDRESS 0x7f9aa8 BYTE_ORDER MSB_LAST BIT_MASK 0x10 /end MEASUREMENT
/begin MEASUREMENT fmy_stat_cyl_bal_2.err_info_stat.err_sym "symptoms of the diagnosis instance CYL_BAL_2" UWORD _CNV_S_6_CONV_ERRM__22_CM 1 0. 0. 15. DISPLAY_IDENTIFIER ERR_SYM_CYL_BAL_2 ECU_ADDRESS 0x7f9aa8 BYTE_ORDER MSB_LAST BIT_MASK 0xF /end MEASUREMENT
/begin MEASUREMENT lv_err_cyl_bal_3 "Error flag of diagnosis instance CYL_BAL_3" UBYTE _CNV_S_2_RANGE______23_CM 1 0. 0. 1. DISPLAY_IDENTIFIER LV_ERR_CYL_BAL_3 ECU_ADDRESS 0x7fb8db /end MEASUREMENT
/begin MEASUREMENT fmy_stat_cyl_bal_3.ctr_abc "anti bounce counter for diagnosis instance CYL_BAL_3" UBYTE _CNV_A_R_LINEAR_____1_CM 1 0. 0. 255. DISPLAY_IDENTIFIER CTR_ABC_CYL_BAL_3 ECU_ADDRESS 0x7f9aaf FORMAT "%3.0" /end MEASUREMENT
/begin MEASUREMENT fmy_stat_cyl_bal_3.ctr_end_diag "counter for end of diagnosis for diagnosis instance CYL_BAL_3" UBYTE _CNV_A_R_LINEAR_____1_CM 1 0. 0. 255. DISPLAY_IDENTIFIER CTR_ABC_END_DIAG_CYL_BAL_3 ECU_ADDRESS 0x7f9aae FORMAT "%3.0" /end MEASUREMENT
/begin MEASUREMENT fmy_stat_cyl_bal_3.err_info_stat.reserved "" UWORD _CNV_A_R_LINEAR_____0_CM 1 0. 0. 65535. DISPLAY_IDENTIFIER FMY_STAT_CYL_BAL_3_ERR_INFO_STAT_RESERVED ECU_ADDRESS 0x7f9aac BYTE_ORDER MSB_LAST BIT_MASK 0xF800 /end MEASUREMENT
/begin MEASUREMENT fmy_stat_cyl_bal_3.err_info_stat.lv_cdn_diag_stc "Statistical flag for condition of diagnosis of the diagnosis instance CYL_BAL_3" UWORD _CNV_S_2_RANGE______383_CM 1 0. 0. 1. DISPLAY_IDENTIFIER LV_CDN_DIAG_STC_CYL_BAL_3 ECU_ADDRESS 0x7f9aac BYTE_ORDER MSB_LAST BIT_MASK 0x400 /end MEASUREMENT
/begin MEASUREMENT fmy_stat_cyl_bal_3.err_info_stat.lv_lock_diag "lock flag (CPU load optimisation) of the diagnosis instance CYL_BAL_3" UWORD _CNV_S_2_RANGE______383_CM 1 0. 0. 1. DISPLAY_IDENTIFIER LV_LOCK_DIAG_CYL_BAL_3 ECU_ADDRESS 0x7f9aac BYTE_ORDER MSB_LAST BIT_MASK 0x200 /end MEASUREMENT
/begin MEASUREMENT fmy_stat_cyl_bal_3.err_info_stat.lv_err_mem "storage in dynamic failure memory of the diagnosis instance CYL_BAL_3" UWORD _CNV_S_2_RANGE______383_CM 1 0. 0. 1. DISPLAY_IDENTIFIER LV_ERR_MEM_CYL_BAL_3 ECU_ADDRESS 0x7f9aac BYTE_ORDER MSB_LAST BIT_MASK 0x80 /end MEASUREMENT
/begin MEASUREMENT fmy_stat_cyl_bal_3.err_info_stat.lv_ready "readiness status of the diagnosis instance CYL_BAL_3" UWORD _CNV_S_2_RANGE______383_CM 1 0. 0. 1. DISPLAY_IDENTIFIER LV_READY_CYL_BAL_3 ECU_ADDRESS 0x7f9aac BYTE_ORDER MSB_LAST BIT_MASK 0x40 /end MEASUREMENT
/begin MEASUREMENT fmy_stat_cyl_bal_3.err_info_stat.lv_end_diag "end of diagnosis of the diagnosis instance CYL_BAL_3" UWORD _CNV_S_2_RANGE______383_CM 1 0. 0. 1. DISPLAY_IDENTIFIER LV_END_DIAG_CYL_BAL_3 ECU_ADDRESS 0x7f9aac BYTE_ORDER MSB_LAST BIT_MASK 0x20 /end MEASUREMENT
/begin MEASUREMENT fmy_stat_cyl_bal_3.err_info_stat.lv_cdn_diag "diagnosis condition of the diagnosis instance CYL_BAL_3" UWORD _CNV_S_2_RANGE______383_CM 1 0. 0. 1. DISPLAY_IDENTIFIER LV_CDN_DIAG_CYL_BAL_3 ECU_ADDRESS 0x7f9aac BYTE_ORDER MSB_LAST BIT_MASK 0x10 /end MEASUREMENT
/begin MEASUREMENT fmy_stat_cyl_bal_3.err_info_stat.err_sym "symptoms of the diagnosis instance CYL_BAL_3" UWORD _CNV_S_6_CONV_ERRM__22_CM 1 0. 0. 15. DISPLAY_IDENTIFIER ERR_SYM_CYL_BAL_3 ECU_ADDRESS 0x7f9aac BYTE_ORDER MSB_LAST BIT_MASK 0xF /end MEASUREMENT
/begin MEASUREMENT lv_err_egrv_0_ctl "Error flag of diagnosis instance EGRV_0_CTL" UBYTE _CNV_S_2_RANGE______23_CM 1 0. 0. 1. DISPLAY_IDENTIFIER LV_ERR_EGRV_0_CTL ECU_ADDRESS 0x7fb8dc /end MEASUREMENT
/begin MEASUREMENT fmy_stat_egrv_0_ctl.ctr_abc "anti bounce counter for diagnosis instance EGRV_0_CTL" UBYTE _CNV_A_R_LINEAR_____1_CM 1 0. 0. 255. DISPLAY_IDENTIFIER CTR_ABC_EGRV_0_CTL ECU_ADDRESS 0x7f9ab3 FORMAT "%3.0" /end MEASUREMENT
/begin MEASUREMENT fmy_stat_egrv_0_ctl.ctr_end_diag "counter for end of diagnosis for diagnosis instance EGRV_0_CTL" UBYTE _CNV_A_R_LINEAR_____1_CM 1 0. 0. 255. DISPLAY_IDENTIFIER CTR_ABC_END_DIAG_EGRV_0_CTL ECU_ADDRESS 0x7f9ab2 FORMAT "%3.0" /end MEASUREMENT
/begin MEASUREMENT fmy_stat_egrv_0_ctl.err_info_stat.reserved "" UWORD _CNV_A_R_LINEAR_____0_CM 1 0. 0. 65535. DISPLAY_IDENTIFIER FMY_STAT_EGRV_0_CTL_ERR_INFO_STAT_RESERVED ECU_ADDRESS 0x7f9ab0 BYTE_ORDER MSB_LAST BIT_MASK 0xF800 /end MEASUREMENT
/begin MEASUREMENT fmy_stat_egrv_0_ctl.err_info_stat.lv_cdn_diag_stc "Statistical flag for condition of diagnosis of the diagnosis instance EGRV_0_CTL" UWORD _CNV_S_2_RANGE______383_CM 1 0. 0. 1. DISPLAY_IDENTIFIER LV_CDN_DIAG_STC_EGRV_0_CTL ECU_ADDRESS 0x7f9ab0 BYTE_ORDER MSB_LAST BIT_MASK 0x400 /end MEASUREMENT
/begin MEASUREMENT fmy_stat_egrv_0_ctl.err_info_stat.lv_lock_diag "lock flag (CPU load optimisation) of the diagnosis instance EGRV_0_CTL" UWORD _CNV_S_2_RANGE______383_CM 1 0. 0. 1. DISPLAY_IDENTIFIER LV_LOCK_DIAG_EGRV_0_CTL ECU_ADDRESS 0x7f9ab0 BYTE_ORDER MSB_LAST BIT_MASK 0x200 /end MEASUREMENT
/begin MEASUREMENT fmy_stat_egrv_0_ctl.err_info_stat.lv_err_mem "storage in dynamic failure memory of the diagnosis instance EGRV_0_CTL" UWORD _CNV_S_2_RANGE______383_CM 1 0. 0. 1. DISPLAY_IDENTIFIER LV_ERR_MEM_EGRV_0_CTL ECU_ADDRESS 0x7f9ab0 BYTE_ORDER MSB_LAST BIT_MASK 0x80 /end MEASUREMENT
/begin MEASUREMENT fmy_stat_egrv_0_ctl.err_info_stat.lv_ready "readiness status of the diagnosis instance EGRV_0_CTL" UWORD _CNV_S_2_RANGE______383_CM 1 0. 0. 1. DISPLAY_IDENTIFIER LV_READY_EGRV_0_CTL ECU_ADDRESS 0x7f9ab0 BYTE_ORDER MSB_LAST BIT_MASK 0x40 /end MEASUREMENT
/begin MEASUREMENT fmy_stat_egrv_0_ctl.err_info_stat.lv_end_diag "end of diagnosis of the diagnosis instance EGRV_0_CTL" UWORD _CNV_S_2_RANGE______383_CM 1 0. 0. 1. DISPLAY_IDENTIFIER LV_END_DIAG_EGRV_0_CTL ECU_ADDRESS 0x7f9ab0 BYTE_ORDER MSB_LAST BIT_MASK 0x20 /end MEASUREMENT
/begin MEASUREMENT fmy_stat_egrv_0_ctl.err_info_stat.lv_cdn_diag "diagnosis condition of the diagnosis instance EGRV_0_CTL" UWORD _CNV_S_2_RANGE______383_CM 1 0. 0. 1. DISPLAY_IDENTIFIER LV_CDN_DIAG_EGRV_0_CTL ECU_ADDRESS 0x7f9ab0 BYTE_ORDER MSB_LAST BIT_MASK 0x10 /end MEASUREMENT
/begin MEASUREMENT fmy_stat_egrv_0_ctl.err_info_stat.err_sym "symptoms of the diagnosis instance EGRV_0_CTL" UWORD _CNV_S_6_CONV_ERRM__22_CM 1 0. 0. 15. DISPLAY_IDENTIFIER ERR_SYM_EGRV_0_CTL ECU_ADDRESS 0x7f9ab0 BYTE_ORDER MSB_LAST BIT_MASK 0xF /end MEASUREMENT
/begin MEASUREMENT lv_err_v_egrv_0_bol_ad "Error flag of diagnosis instance V_EGRV_0_BOL_AD" UBYTE _CNV_S_2_RANGE______23_CM 1 0. 0. 1. DISPLAY_IDENTIFIER LV_ERR_V_EGRV_0_BOL_AD ECU_ADDRESS 0x7fb8dd /end MEASUREMENT
/begin MEASUREMENT fmy_stat_v_egrv_0_bol_ad.ctr_abc "anti bounce counter for diagnosis instance V_EGRV_0_BOL_AD" UBYTE _CNV_A_R_LINEAR_____1_CM 1 0. 0. 255. DISPLAY_IDENTIFIER CTR_ABC_V_EGRV_0_BOL_AD ECU_ADDRESS 0x7f9ab7 FORMAT "%3.0" /end MEASUREMENT
/begin MEASUREMENT fmy_stat_v_egrv_0_bol_ad.ctr_end_diag "counter for end of diagnosis for diagnosis instance V_EGRV_0_BOL_AD" UBYTE _CNV_A_R_LINEAR_____1_CM 1 0. 0. 255. DISPLAY_IDENTIFIER CTR_ABC_END_DIAG_V_EGRV_0_BOL_AD ECU_ADDRESS 0x7f9ab6 FORMAT "%3.0" /end MEASUREMENT
/begin MEASUREMENT fmy_stat_v_egrv_0_bol_ad.err_info_stat.reserved "" UWORD _CNV_A_R_LINEAR_____0_CM 1 0. 0. 65535. DISPLAY_IDENTIFIER FMY_STAT_V_EGRV_0_BOL_AD_ERR_INFO_STAT_RESERVED ECU_ADDRESS 0x7f9ab4 BYTE_ORDER MSB_LAST BIT_MASK 0xF800 /end MEASUREMENT
/begin MEASUREMENT fmy_stat_v_egrv_0_bol_ad.err_info_stat.lv_cdn_diag_stc "Statistical flag for condition of diagnosis of the diagnosis instance V_EGRV_0_BOL_AD" UWORD _CNV_S_2_RANGE______383_CM 1 0. 0. 1. DISPLAY_IDENTIFIER LV_CDN_DIAG_STC_V_EGRV_0_BOL_AD ECU_ADDRESS 0x7f9ab4 BYTE_ORDER MSB_LAST BIT_MASK 0x400 /end MEASUREMENT
/begin MEASUREMENT fmy_stat_v_egrv_0_bol_ad.err_info_stat.lv_lock_diag "lock flag (CPU load optimisation) of the diagnosis instance V_EGRV_0_BOL_AD" UWORD _CNV_S_2_RANGE______383_CM 1 0. 0. 1. DISPLAY_IDENTIFIER LV_LOCK_DIAG_V_EGRV_0_BOL_AD ECU_ADDRESS 0x7f9ab4 BYTE_ORDER MSB_LAST BIT_MASK 0x200 /end MEASUREMENT
/begin MEASUREMENT fmy_stat_v_egrv_0_bol_ad.err_info_stat.lv_err_mem "storage in dynamic failure memory of the diagnosis instance V_EGRV_0_BOL_AD" UWORD _CNV_S_2_RANGE______383_CM 1 0. 0. 1. DISPLAY_IDENTIFIER LV_ERR_MEM_V_EGRV_0_BOL_AD ECU_ADDRESS 0x7f9ab4 BYTE_ORDER MSB_LAST BIT_MASK 0x80 /end MEASUREMENT
/begin MEASUREMENT fmy_stat_v_egrv_0_bol_ad.err_info_stat.lv_ready "readiness status of the diagnosis instance V_EGRV_0_BOL_AD" UWORD _CNV_S_2_RANGE______383_CM 1 0. 0. 1. DISPLAY_IDENTIFIER LV_READY_V_EGRV_0_BOL_AD ECU_ADDRESS 0x7f9ab4 BYTE_ORDER MSB_LAST BIT_MASK 0x40 /end MEASUREMENT
/begin MEASUREMENT fmy_stat_v_egrv_0_bol_ad.err_info_stat.lv_end_diag "end of diagnosis of the diagnosis instance V_EGRV_0_BOL_AD" UWORD _CNV_S_2_RANGE______383_CM 1 0. 0. 1. DISPLAY_IDENTIFIER LV_END_DIAG_V_EGRV_0_BOL_AD ECU_ADDRESS 0x7f9ab4 BYTE_ORDER MSB_LAST BIT_MASK 0x20 /end MEASUREMENT
/begin MEASUREMENT fmy_stat_v_egrv_0_bol_ad.err_info_stat.lv_cdn_diag "diagnosis condition of the diagnosis instance V_EGRV_0_BOL_AD" UWORD _CNV_S_2_RANGE______383_CM 1 0. 0. 1. DISPLAY_IDENTIFIER LV_CDN_DIAG_V_EGRV_0_BOL_AD ECU_ADDRESS 0x7f9ab4 BYTE_ORDER MSB_LAST BIT_MASK 0x10 /end MEASUREMENT
/begin MEASUREMENT fmy_stat_v_egrv_0_bol_ad.err_info_stat.err_sym "symptoms of the diagnosis instance V_EGRV_0_BOL_AD" UWORD _CNV_S_6_CONV_ERRM__22_CM 1 0. 0. 15. DISPLAY_IDENTIFIER ERR_SYM_V_EGRV_0_BOL_AD ECU_ADDRESS 0x7f9ab4 BYTE_ORDER MSB_LAST BIT_MASK 0xF /end MEASUREMENT
/begin MEASUREMENT lv_err_thr_0_ctl "Error flag of diagnosis instance THR_0_CTL" UBYTE _CNV_S_2_RANGE______23_CM 1 0. 0. 1. DISPLAY_IDENTIFIER LV_ERR_THR_0_CTL ECU_ADDRESS 0x7fb8de /end MEASUREMENT
/begin MEASUREMENT fmy_stat_thr_0_ctl.ctr_abc "anti bounce counter for diagnosis instance THR_0_CTL" UBYTE _CNV_A_R_LINEAR_____1_CM 1 0. 0. 255. DISPLAY_IDENTIFIER CTR_ABC_THR_0_CTL ECU_ADDRESS 0x7f9abb FORMAT "%3.0" /end MEASUREMENT
/begin MEASUREMENT fmy_stat_thr_0_ctl.ctr_end_diag "counter for end of diagnosis for diagnosis instance THR_0_CTL" UBYTE _CNV_A_R_LINEAR_____1_CM 1 0. 0. 255. DISPLAY_IDENTIFIER CTR_ABC_END_DIAG_THR_0_CTL ECU_ADDRESS 0x7f9aba FORMAT "%3.0" /end MEASUREMENT
/begin MEASUREMENT fmy_stat_thr_0_ctl.err_info_stat.reserved "" UWORD _CNV_A_R_LINEAR_____0_CM 1 0. 0. 65535. DISPLAY_IDENTIFIER FMY_STAT_THR_0_CTL_ERR_INFO_STAT_RESERVED ECU_ADDRESS 0x7f9ab8 BYTE_ORDER MSB_LAST BIT_MASK 0xF800 /end MEASUREMENT
/begin MEASUREMENT fmy_stat_thr_0_ctl.err_info_stat.lv_cdn_diag_stc "Statistical flag for condition of diagnosis of the diagnosis instance THR_0_CTL" UWORD _CNV_S_2_RANGE______383_CM 1 0. 0. 1. DISPLAY_IDENTIFIER LV_CDN_DIAG_STC_THR_0_CTL ECU_ADDRESS 0x7f9ab8 BYTE_ORDER MSB_LAST BIT_MASK 0x400 /end MEASUREMENT
/begin MEASUREMENT fmy_stat_thr_0_ctl.err_info_stat.lv_lock_diag "lock flag (CPU load optimisation) of the diagnosis instance THR_0_CTL" UWORD _CNV_S_2_RANGE______383_CM 1 0. 0. 1. DISPLAY_IDENTIFIER LV_LOCK_DIAG_THR_0_CTL ECU_ADDRESS 0x7f9ab8 BYTE_ORDER MSB_LAST BIT_MASK 0x200 /end MEASUREMENT
/begin MEASUREMENT fmy_stat_thr_0_ctl.err_info_stat.lv_err_mem "storage in dynamic failure memory of the diagnosis instance THR_0_CTL" UWORD _CNV_S_2_RANGE______383_CM 1 0. 0. 1. DISPLAY_IDENTIFIER LV_ERR_MEM_THR_0_CTL ECU_ADDRESS 0x7f9ab8 BYTE_ORDER MSB_LAST BIT_MASK 0x80 /end MEASUREMENT
/begin MEASUREMENT fmy_stat_thr_0_ctl.err_info_stat.lv_ready "readiness status of the diagnosis instance THR_0_CTL" UWORD _CNV_S_2_RANGE______383_CM 1 0. 0. 1. DISPLAY_IDENTIFIER LV_READY_THR_0_CTL ECU_ADDRESS 0x7f9ab8 BYTE_ORDER MSB_LAST BIT_MASK 0x40 /end MEASUREMENT
/begin MEASUREMENT fmy_stat_thr_0_ctl.err_info_stat.lv_end_diag "end of diagnosis of the diagnosis instance THR_0_CTL" UWORD _CNV_S_2_RANGE______383_CM 1 0. 0. 1. DISPLAY_IDENTIFIER LV_END_DIAG_THR_0_CTL ECU_ADDRESS 0x7f9ab8 BYTE_ORDER MSB_LAST BIT_MASK 0x20 /end MEASUREMENT
/begin MEASUREMENT fmy_stat_thr_0_ctl.err_info_stat.lv_cdn_diag "diagnosis condition of the diagnosis instance THR_0_CTL" UWORD _CNV_S_2_RANGE______383_CM 1 0. 0. 1. DISPLAY_IDENTIFIER LV_CDN_DIAG_THR_0_CTL ECU_ADDRESS 0x7f9ab8 BYTE_ORDER MSB_LAST BIT_MASK 0x10 /end MEASUREMENT
/begin MEASUREMENT fmy_stat_thr_0_ctl.err_info_stat.err_sym "symptoms of the diagnosis instance THR_0_CTL" UWORD _CNV_S_6_CONV_ERRM__22_CM 1 0. 0. 15. DISPLAY_IDENTIFIER ERR_SYM_THR_0_CTL ECU_ADDRESS 0x7f9ab8 BYTE_ORDER MSB_LAST BIT_MASK 0xF /end MEASUREMENT
/begin MEASUREMENT lv_err_v_thr_0_bol_ad "Error flag of diagnosis instance V_THR_0_BOL_AD" UBYTE _CNV_S_2_RANGE______23_CM 1 0. 0. 1. DISPLAY_IDENTIFIER LV_ERR_V_THR_0_BOL_AD ECU_ADDRESS 0x7fb8df /end MEASUREMENT
/begin MEASUREMENT fmy_stat_v_thr_0_bol_ad.ctr_abc "anti bounce counter for diagnosis instance V_THR_0_BOL_AD" UBYTE _CNV_A_R_LINEAR_____1_CM 1 0. 0. 255. DISPLAY_IDENTIFIER CTR_ABC_V_THR_0_BOL_AD ECU_ADDRESS 0x7f9abf FORMAT "%3.0" /end MEASUREMENT
/begin MEASUREMENT fmy_stat_v_thr_0_bol_ad.ctr_end_diag "counter for end of diagnosis for diagnosis instance V_THR_0_BOL_AD" UBYTE _CNV_A_R_LINEAR_____1_CM 1 0. 0. 255. DISPLAY_IDENTIFIER CTR_ABC_END_DIAG_V_THR_0_BOL_AD ECU_ADDRESS 0x7f9abe FORMAT "%3.0" /end MEASUREMENT
/begin MEASUREMENT fmy_stat_v_thr_0_bol_ad.err_info_stat.reserved "" UWORD _CNV_A_R_LINEAR_____0_CM 1 0. 0. 65535. DISPLAY_IDENTIFIER FMY_STAT_V_THR_0_BOL_AD_ERR_INFO_STAT_RESERVED ECU_ADDRESS 0x7f9abc BYTE_ORDER MSB_LAST BIT_MASK 0xF800 /end MEASUREMENT
/begin MEASUREMENT fmy_stat_v_thr_0_bol_ad.err_info_stat.lv_cdn_diag_stc "Statistical flag for condition of diagnosis of the diagnosis instance V_THR_0_BOL_AD" UWORD _CNV_S_2_RANGE______383_CM 1 0. 0. 1. DISPLAY_IDENTIFIER LV_CDN_DIAG_STC_V_THR_0_BOL_AD ECU_ADDRESS 0x7f9abc BYTE_ORDER MSB_LAST BIT_MASK 0x400 /end MEASUREMENT
/begin MEASUREMENT fmy_stat_v_thr_0_bol_ad.err_info_stat.lv_lock_diag "lock flag (CPU load optimisation) of the diagnosis instance V_THR_0_BOL_AD" UWORD _CNV_S_2_RANGE______383_CM 1 0. 0. 1. DISPLAY_IDENTIFIER LV_LOCK_DIAG_V_THR_0_BOL_AD ECU_ADDRESS 0x7f9abc BYTE_ORDER MSB_LAST BIT_MASK 0x200 /end MEASUREMENT
/begin MEASUREMENT fmy_stat_v_thr_0_bol_ad.err_info_stat.lv_err_mem "storage in dynamic failure memory of the diagnosis instance V_THR_0_BOL_AD" UWORD _CNV_S_2_RANGE______383_CM 1 0. 0. 1. DISPLAY_IDENTIFIER LV_ERR_MEM_V_THR_0_BOL_AD ECU_ADDRESS 0x7f9abc BYTE_ORDER MSB_LAST BIT_MASK 0x80 /end MEASUREMENT
/begin MEASUREMENT fmy_stat_v_thr_0_bol_ad.err_info_stat.lv_ready "readiness status of the diagnosis instance V_THR_0_BOL_AD" UWORD _CNV_S_2_RANGE______383_CM 1 0. 0. 1. DISPLAY_IDENTIFIER LV_READY_V_THR_0_BOL_AD ECU_ADDRESS 0x7f9abc BYTE_ORDER MSB_LAST BIT_MASK 0x40 /end MEASUREMENT
/begin MEASUREMENT fmy_stat_v_thr_0_bol_ad.err_info_stat.lv_end_diag "end of diagnosis of the diagnosis instance V_THR_0_BOL_AD" UWORD _CNV_S_2_RANGE______383_CM 1 0. 0. 1. DISPLAY_IDENTIFIER LV_END_DIAG_V_THR_0_BOL_AD ECU_ADDRESS 0x7f9abc BYTE_ORDER MSB_LAST BIT_MASK 0x20 /end MEASUREMENT
/begin MEASUREMENT fmy_stat_v_thr_0_bol_ad.err_info_stat.lv_cdn_diag "diagnosis condition of the diagnosis instance V_THR_0_BOL_AD" UWORD _CNV_S_2_RANGE______383_CM 1 0. 0. 1. DISPLAY_IDENTIFIER LV_CDN_DIAG_V_THR_0_BOL_AD ECU_ADDRESS 0x7f9abc BYTE_ORDER MSB_LAST BIT_MASK 0x10 /end MEASUREMENT
/begin MEASUREMENT fmy_stat_v_thr_0_bol_ad.err_info_stat.err_sym "symptoms of the diagnosis instance V_THR_0_BOL_AD" UWORD _CNV_S_6_CONV_ERRM__22_CM 1 0. 0. 15. DISPLAY_IDENTIFIER ERR_SYM_V_THR_0_BOL_AD ECU_ADDRESS 0x7f9abc BYTE_ORDER MSB_LAST BIT_MASK 0xF /end MEASUREMENT
/begin MEASUREMENT lv_err_bpa_0_ctl "Error flag of diagnosis instance BPA_0_CTL" UBYTE _CNV_S_2_RANGE______23_CM 1 0. 0. 1. DISPLAY_IDENTIFIER LV_ERR_BPA_0_CTL ECU_ADDRESS 0x7fb8e0 /end MEASUREMENT
/begin MEASUREMENT fmy_stat_bpa_0_ctl.ctr_abc "anti bounce counter for diagnosis instance BPA_0_CTL" UBYTE _CNV_A_R_LINEAR_____1_CM 1 0. 0. 255. DISPLAY_IDENTIFIER CTR_ABC_BPA_0_CTL ECU_ADDRESS 0x7f9ac3 FORMAT "%3.0" /end MEASUREMENT
/begin MEASUREMENT fmy_stat_bpa_0_ctl.ctr_end_diag "counter for end of diagnosis for diagnosis instance BPA_0_CTL" UBYTE _CNV_A_R_LINEAR_____1_CM 1 0. 0. 255. DISPLAY_IDENTIFIER CTR_ABC_END_DIAG_BPA_0_CTL ECU_ADDRESS 0x7f9ac2 FORMAT "%3.0" /end MEASUREMENT
/begin MEASUREMENT fmy_stat_bpa_0_ctl.err_info_stat.reserved "" UWORD _CNV_A_R_LINEAR_____0_CM 1 0. 0. 65535. DISPLAY_IDENTIFIER FMY_STAT_BPA_0_CTL_ERR_INFO_STAT_RESERVED ECU_ADDRESS 0x7f9ac0 BYTE_ORDER MSB_LAST BIT_MASK 0xF800 /end MEASUREMENT
/begin MEASUREMENT fmy_stat_bpa_0_ctl.err_info_stat.lv_cdn_diag_stc "Statistical flag for condition of diagnosis of the diagnosis instance BPA_0_CTL" UWORD _CNV_S_2_RANGE______383_CM 1 0. 0. 1. DISPLAY_IDENTIFIER LV_CDN_DIAG_STC_BPA_0_CTL ECU_ADDRESS 0x7f9ac0 BYTE_ORDER MSB_LAST BIT_MASK 0x400 /end MEASUREMENT
/begin MEASUREMENT fmy_stat_bpa_0_ctl.err_info_stat.lv_lock_diag "lock flag (CPU load optimisation) of the diagnosis instance BPA_0_CTL" UWORD _CNV_S_2_RANGE______383_CM 1 0. 0. 1. DISPLAY_IDENTIFIER LV_LOCK_DIAG_BPA_0_CTL ECU_ADDRESS 0x7f9ac0 BYTE_ORDER MSB_LAST BIT_MASK 0x200 /end MEASUREMENT
/begin MEASUREMENT fmy_stat_bpa_0_ctl.err_info_stat.lv_err_mem "storage in dynamic failure memory of the diagnosis instance BPA_0_CTL" UWORD _CNV_S_2_RANGE______383_CM 1 0. 0. 1. DISPLAY_IDENTIFIER LV_ERR_MEM_BPA_0_CTL ECU_ADDRESS 0x7f9ac0 BYTE_ORDER MSB_LAST BIT_MASK 0x80 /end MEASUREMENT
/begin MEASUREMENT fmy_stat_bpa_0_ctl.err_info_stat.lv_ready "readiness status of the diagnosis instance BPA_0_CTL" UWORD _CNV_S_2_RANGE______383_CM 1 0. 0. 1. DISPLAY_IDENTIFIER LV_READY_BPA_0_CTL ECU_ADDRESS 0x7f9ac0 BYTE_ORDER MSB_LAST BIT_MASK 0x40 /end MEASUREMENT
/begin MEASUREMENT fmy_stat_bpa_0_ctl.err_info_stat.lv_end_diag "end of diagnosis of the diagnosis instance BPA_0_CTL" UWORD _CNV_S_2_RANGE______383_CM 1 0. 0. 1. DISPLAY_IDENTIFIER LV_END_DIAG_BPA_0_CTL ECU_ADDRESS 0x7f9ac0 BYTE_ORDER MSB_LAST BIT_MASK 0x20 /end MEASUREMENT
/begin MEASUREMENT fmy_stat_bpa_0_ctl.err_info_stat.lv_cdn_diag "diagnosis condition of the diagnosis instance BPA_0_CTL" UWORD _CNV_S_2_RANGE______383_CM 1 0. 0. 1. DISPLAY_IDENTIFIER LV_CDN_DIAG_BPA_0_CTL ECU_ADDRESS 0x7f9ac0 BYTE_ORDER MSB_LAST BIT_MASK 0x10 /end MEASUREMENT
/begin MEASUREMENT fmy_stat_bpa_0_ctl.err_info_stat.err_sym "symptoms of the diagnosis instance BPA_0_CTL" UWORD _CNV_S_6_CONV_ERRM__22_CM 1 0. 0. 15. DISPLAY_IDENTIFIER ERR_SYM_BPA_0_CTL ECU_ADDRESS 0x7f9ac0 BYTE_ORDER MSB_LAST BIT_MASK 0xF /end MEASUREMENT
/begin MEASUREMENT lv_err_v_bpa_0_bol_ad "Error flag of diagnosis instance V_BPA_0_BOL_AD" UBYTE _CNV_S_2_RANGE______23_CM 1 0. 0. 1. DISPLAY_IDENTIFIER LV_ERR_V_BPA_0_BOL_AD ECU_ADDRESS 0x7fb8e1 /end MEASUREMENT
/begin MEASUREMENT fmy_stat_v_bpa_0_bol_ad.ctr_abc "anti bounce counter for diagnosis instance V_BPA_0_BOL_AD" UBYTE _CNV_A_R_LINEAR_____1_CM 1 0. 0. 255. DISPLAY_IDENTIFIER CTR_ABC_V_BPA_0_BOL_AD ECU_ADDRESS 0x7f9ac7 FORMAT "%3.0" /end MEASUREMENT
/begin MEASUREMENT fmy_stat_v_bpa_0_bol_ad.ctr_end_diag "counter for end of diagnosis for diagnosis instance V_BPA_0_BOL_AD" UBYTE _CNV_A_R_LINEAR_____1_CM 1 0. 0. 255. DISPLAY_IDENTIFIER CTR_ABC_END_DIAG_V_BPA_0_BOL_AD ECU_ADDRESS 0x7f9ac6 FORMAT "%3.0" /end MEASUREMENT
/begin MEASUREMENT fmy_stat_v_bpa_0_bol_ad.err_info_stat.reserved "" UWORD _CNV_A_R_LINEAR_____0_CM 1 0. 0. 65535. DISPLAY_IDENTIFIER FMY_STAT_V_BPA_0_BOL_AD_ERR_INFO_STAT_RESERVED ECU_ADDRESS 0x7f9ac4 BYTE_ORDER MSB_LAST BIT_MASK 0xF800 /end MEASUREMENT
/begin MEASUREMENT fmy_stat_v_bpa_0_bol_ad.err_info_stat.lv_cdn_diag_stc "Statistical flag for condition of diagnosis of the diagnosis instance V_BPA_0_BOL_AD" UWORD _CNV_S_2_RANGE______383_CM 1 0. 0. 1. DISPLAY_IDENTIFIER LV_CDN_DIAG_STC_V_BPA_0_BOL_AD ECU_ADDRESS 0x7f9ac4 BYTE_ORDER MSB_LAST BIT_MASK 0x400 /end MEASUREMENT
/begin MEASUREMENT fmy_stat_v_bpa_0_bol_ad.err_info_stat.lv_lock_diag "lock flag (CPU load optimisation) of the diagnosis instance V_BPA_0_BOL_AD" UWORD _CNV_S_2_RANGE______383_CM 1 0. 0. 1. DISPLAY_IDENTIFIER LV_LOCK_DIAG_V_BPA_0_BOL_AD ECU_ADDRESS 0x7f9ac4 BYTE_ORDER MSB_LAST BIT_MASK 0x200 /end MEASUREMENT
/begin MEASUREMENT fmy_stat_v_bpa_0_bol_ad.err_info_stat.lv_err_mem "storage in dynamic failure memory of the diagnosis instance V_BPA_0_BOL_AD" UWORD _CNV_S_2_RANGE______383_CM 1 0. 0. 1. DISPLAY_IDENTIFIER LV_ERR_MEM_V_BPA_0_BOL_AD ECU_ADDRESS 0x7f9ac4 BYTE_ORDER MSB_LAST BIT_MASK 0x80 /end MEASUREMENT
/begin MEASUREMENT fmy_stat_v_bpa_0_bol_ad.err_info_stat.lv_ready "readiness status of the diagnosis instance V_BPA_0_BOL_AD" UWORD _CNV_S_2_RANGE______383_CM 1 0. 0. 1. DISPLAY_IDENTIFIER LV_READY_V_BPA_0_BOL_AD ECU_ADDRESS 0x7f9ac4 BYTE_ORDER MSB_LAST BIT_MASK 0x40 /end MEASUREMENT
/begin MEASUREMENT fmy_stat_v_bpa_0_bol_ad.err_info_stat.lv_end_diag "end of diagnosis of the diagnosis instance V_BPA_0_BOL_AD" UWORD _CNV_S_2_RANGE______383_CM 1 0. 0. 1. DISPLAY_IDENTIFIER LV_END_DIAG_V_BPA_0_BOL_AD ECU_ADDRESS 0x7f9ac4 BYTE_ORDER MSB_LAST BIT_MASK 0x20 /end MEASUREMENT
/begin MEASUREMENT fmy_stat_v_bpa_0_bol_ad.err_info_stat.lv_cdn_diag "diagnosis condition of the diagnosis instance V_BPA_0_BOL_AD" UWORD _CNV_S_2_RANGE______383_CM 1 0. 0. 1. DISPLAY_IDENTIFIER LV_CDN_DIAG_V_BPA_0_BOL_AD ECU_ADDRESS 0x7f9ac4 BYTE_ORDER MSB_LAST BIT_MASK 0x10 /end MEASUREMENT
/begin MEASUREMENT fmy_stat_v_bpa_0_bol_ad.err_info_stat.err_sym "symptoms of the diagnosis instance V_BPA_0_BOL_AD" UWORD _CNV_S_6_CONV_ERRM__22_CM 1 0. 0. 15. DISPLAY_IDENTIFIER ERR_SYM_V_BPA_0_BOL_AD ECU_ADDRESS 0x7f9ac4 BYTE_ORDER MSB_LAST BIT_MASK 0xF /end MEASUREMENT
/begin MEASUREMENT lv_err_byp_0_ctl "Error flag of diagnosis instance BYP_0_CTL" UBYTE _CNV_S_2_RANGE______23_CM 1 0. 0. 1. DISPLAY_IDENTIFIER LV_ERR_BYP_0_CTL ECU_ADDRESS 0x7fb8e2 /end MEASUREMENT
/begin MEASUREMENT fmy_stat_byp_0_ctl.ctr_abc "anti bounce counter for diagnosis instance BYP_0_CTL" UBYTE _CNV_A_R_LINEAR_____1_CM 1 0. 0. 255. DISPLAY_IDENTIFIER CTR_ABC_BYP_0_CTL ECU_ADDRESS 0x7f9acb FORMAT "%3.0" /end MEASUREMENT
/begin MEASUREMENT fmy_stat_byp_0_ctl.ctr_end_diag "counter for end of diagnosis for diagnosis instance BYP_0_CTL" UBYTE _CNV_A_R_LINEAR_____1_CM 1 0. 0. 255. DISPLAY_IDENTIFIER CTR_ABC_END_DIAG_BYP_0_CTL ECU_ADDRESS 0x7f9aca FORMAT "%3.0" /end MEASUREMENT
/begin MEASUREMENT fmy_stat_byp_0_ctl.err_info_stat.reserved "" UWORD _CNV_A_R_LINEAR_____0_CM 1 0. 0. 65535. DISPLAY_IDENTIFIER FMY_STAT_BYP_0_CTL_ERR_INFO_STAT_RESERVED ECU_ADDRESS 0x7f9ac8 BYTE_ORDER MSB_LAST BIT_MASK 0xF800 /end MEASUREMENT
/begin MEASUREMENT fmy_stat_byp_0_ctl.err_info_stat.lv_cdn_diag_stc "Statistical flag for condition of diagnosis of the diagnosis instance BYP_0_CTL" UWORD _CNV_S_2_RANGE______383_CM 1 0. 0. 1. DISPLAY_IDENTIFIER LV_CDN_DIAG_STC_BYP_0_CTL ECU_ADDRESS 0x7f9ac8 BYTE_ORDER MSB_LAST BIT_MASK 0x400 /end MEASUREMENT
/begin MEASUREMENT fmy_stat_byp_0_ctl.err_info_stat.lv_lock_diag "lock flag (CPU load optimisation) of the diagnosis instance BYP_0_CTL" UWORD _CNV_S_2_RANGE______383_CM 1 0. 0. 1. DISPLAY_IDENTIFIER LV_LOCK_DIAG_BYP_0_CTL ECU_ADDRESS 0x7f9ac8 BYTE_ORDER MSB_LAST BIT_MASK 0x200 /end MEASUREMENT
/begin MEASUREMENT fmy_stat_byp_0_ctl.err_info_stat.lv_err_mem "storage in dynamic failure memory of the diagnosis instance BYP_0_CTL" UWORD _CNV_S_2_RANGE______383_CM 1 0. 0. 1. DISPLAY_IDENTIFIER LV_ERR_MEM_BYP_0_CTL ECU_ADDRESS 0x7f9ac8 BYTE_ORDER MSB_LAST BIT_MASK 0x80 /end MEASUREMENT
/begin MEASUREMENT fmy_stat_byp_0_ctl.err_info_stat.lv_ready "readiness status of the diagnosis instance BYP_0_CTL" UWORD _CNV_S_2_RANGE______383_CM 1 0. 0. 1. DISPLAY_IDENTIFIER LV_READY_BYP_0_CTL ECU_ADDRESS 0x7f9ac8 BYTE_ORDER MSB_LAST BIT_MASK 0x40 /end MEASUREMENT
/begin MEASUREMENT fmy_stat_byp_0_ctl.err_info_stat.lv_end_diag "end of diagnosis of the diagnosis instance BYP_0_CTL" UWORD _CNV_S_2_RANGE______383_CM 1 0. 0. 1. DISPLAY_IDENTIFIER LV_END_DIAG_BYP_0_CTL ECU_ADDRESS 0x7f9ac8 BYTE_ORDER MSB_LAST BIT_MASK 0x20 /end MEASUREMENT
/begin MEASUREMENT fmy_stat_byp_0_ctl.err_info_stat.lv_cdn_diag "diagnosis condition of the diagnosis instance BYP_0_CTL" UWORD _CNV_S_2_RANGE______383_CM 1 0. 0. 1. DISPLAY_IDENTIFIER LV_CDN_DIAG_BYP_0_CTL ECU_ADDRESS 0x7f9ac8 BYTE_ORDER MSB_LAST BIT_MASK 0x10 /end MEASUREMENT
/begin MEASUREMENT fmy_stat_byp_0_ctl.err_info_stat.err_sym "symptoms of the diagnosis instance BYP_0_CTL" UWORD _CNV_S_6_CONV_ERRM__22_CM 1 0. 0. 15. DISPLAY_IDENTIFIER ERR_SYM_BYP_0_CTL ECU_ADDRESS 0x7f9ac8 BYTE_ORDER MSB_LAST BIT_MASK 0xF /end MEASUREMENT
/begin MEASUREMENT lv_err_v_byp_0_bol_ad "Error flag of diagnosis instance V_BYP_0_BOL_AD" UBYTE _CNV_S_2_RANGE______23_CM 1 0. 0. 1. DISPLAY_IDENTIFIER LV_ERR_V_BYP_0_BOL_AD ECU_ADDRESS 0x7fb8e3 /end MEASUREMENT
/begin MEASUREMENT fmy_stat_v_byp_0_bol_ad.ctr_abc "anti bounce counter for diagnosis instance V_BYP_0_BOL_AD" UBYTE _CNV_A_R_LINEAR_____1_CM 1 0. 0. 255. DISPLAY_IDENTIFIER CTR_ABC_V_BYP_0_BOL_AD ECU_ADDRESS 0x7f9acf FORMAT "%3.0" /end MEASUREMENT
/begin MEASUREMENT fmy_stat_v_byp_0_bol_ad.ctr_end_diag "counter for end of diagnosis for diagnosis instance V_BYP_0_BOL_AD" UBYTE _CNV_A_R_LINEAR_____1_CM 1 0. 0. 255. DISPLAY_IDENTIFIER CTR_ABC_END_DIAG_V_BYP_0_BOL_AD ECU_ADDRESS 0x7f9ace FORMAT "%3.0" /end MEASUREMENT
/begin MEASUREMENT fmy_stat_v_byp_0_bol_ad.err_info_stat.reserved "" UWORD _CNV_A_R_LINEAR_____0_CM 1 0. 0. 65535. DISPLAY_IDENTIFIER FMY_STAT_V_BYP_0_BOL_AD_ERR_INFO_STAT_RESERVED ECU_ADDRESS 0x7f9acc BYTE_ORDER MSB_LAST BIT_MASK 0xF800 /end MEASUREMENT
/begin MEASUREMENT fmy_stat_v_byp_0_bol_ad.err_info_stat.lv_cdn_diag_stc "Statistical flag for condition of diagnosis of the diagnosis instance V_BYP_0_BOL_AD" UWORD _CNV_S_2_RANGE______383_CM 1 0. 0. 1. DISPLAY_IDENTIFIER LV_CDN_DIAG_STC_V_BYP_0_BOL_AD ECU_ADDRESS 0x7f9acc BYTE_ORDER MSB_LAST BIT_MASK 0x400 /end MEASUREMENT
/begin MEASUREMENT fmy_stat_v_byp_0_bol_ad.err_info_stat.lv_lock_diag "lock flag (CPU load optimisation) of the diagnosis instance V_BYP_0_BOL_AD" UWORD _CNV_S_2_RANGE______383_CM 1 0. 0. 1. DISPLAY_IDENTIFIER LV_LOCK_DIAG_V_BYP_0_BOL_AD ECU_ADDRESS 0x7f9acc BYTE_ORDER MSB_LAST BIT_MASK 0x200 /end MEASUREMENT
/begin MEASUREMENT fmy_stat_v_byp_0_bol_ad.err_info_stat.lv_err_mem "storage in dynamic failure memory of the diagnosis instance V_BYP_0_BOL_AD" UWORD _CNV_S_2_RANGE______383_CM 1 0. 0. 1. DISPLAY_IDENTIFIER LV_ERR_MEM_V_BYP_0_BOL_AD ECU_ADDRESS 0x7f9acc BYTE_ORDER MSB_LAST BIT_MASK 0x80 /end MEASUREMENT
/begin MEASUREMENT fmy_stat_v_byp_0_bol_ad.err_info_stat.lv_ready "readiness status of the diagnosis instance V_BYP_0_BOL_AD" UWORD _CNV_S_2_RANGE______383_CM 1 0. 0. 1. DISPLAY_IDENTIFIER LV_READY_V_BYP_0_BOL_AD ECU_ADDRESS 0x7f9acc BYTE_ORDER MSB_LAST BIT_MASK 0x40 /end MEASUREMENT
/begin MEASUREMENT fmy_stat_v_byp_0_bol_ad.err_info_stat.lv_end_diag "end of diagnosis of the diagnosis instance V_BYP_0_BOL_AD" UWORD _CNV_S_2_RANGE______383_CM 1 0. 0. 1. DISPLAY_IDENTIFIER LV_END_DIAG_V_BYP_0_BOL_AD ECU_ADDRESS 0x7f9acc BYTE_ORDER MSB_LAST BIT_MASK 0x20 /end MEASUREMENT
/begin MEASUREMENT fmy_stat_v_byp_0_bol_ad.err_info_stat.lv_cdn_diag "diagnosis condition of the diagnosis instance V_BYP_0_BOL_AD" UWORD _CNV_S_2_RANGE______383_CM 1 0. 0. 1. DISPLAY_IDENTIFIER LV_CDN_DIAG_V_BYP_0_BOL_AD ECU_ADDRESS 0x7f9acc BYTE_ORDER MSB_LAST BIT_MASK 0x10 /end MEASUREMENT
/begin MEASUREMENT fmy_stat_v_byp_0_bol_ad.err_info_stat.err_sym "symptoms of the diagnosis instance V_BYP_0_BOL_AD" UWORD _CNV_S_6_CONV_ERRM__22_CM 1 0. 0. 15. DISPLAY_IDENTIFIER ERR_SYM_V_BYP_0_BOL_AD ECU_ADDRESS 0x7f9acc BYTE_ORDER MSB_LAST BIT_MASK 0xF /end MEASUREMENT
/begin MEASUREMENT lv_err_map_ctl_min "Error flag of diagnosis instance MAP_CTL_MIN" UBYTE _CNV_S_2_RANGE______23_CM 1 0. 0. 1. DISPLAY_IDENTIFIER LV_ERR_MAP_CTL_MIN ECU_ADDRESS 0x7fb8e4 /end MEASUREMENT
/begin MEASUREMENT fmy_stat_map_ctl_min.ctr_abc "anti bounce counter for diagnosis instance MAP_CTL_MIN" UBYTE _CNV_A_R_LINEAR_____1_CM 1 0. 0. 255. DISPLAY_IDENTIFIER CTR_ABC_MAP_CTL_MIN ECU_ADDRESS 0x7f9ad3 FORMAT "%3.0" /end MEASUREMENT
/begin MEASUREMENT fmy_stat_map_ctl_min.ctr_end_diag "counter for end of diagnosis for diagnosis instance MAP_CTL_MIN" UBYTE _CNV_A_R_LINEAR_____1_CM 1 0. 0. 255. DISPLAY_IDENTIFIER CTR_ABC_END_DIAG_MAP_CTL_MIN ECU_ADDRESS 0x7f9ad2 FORMAT "%3.0" /end MEASUREMENT
/begin MEASUREMENT fmy_stat_map_ctl_min.err_info_stat.reserved "" UWORD _CNV_A_R_LINEAR_____0_CM 1 0. 0. 65535. DISPLAY_IDENTIFIER FMY_STAT_MAP_CTL_MIN_ERR_INFO_STAT_RESERVED ECU_ADDRESS 0x7f9ad0 BYTE_ORDER MSB_LAST BIT_MASK 0xF800 /end MEASUREMENT
/begin MEASUREMENT fmy_stat_map_ctl_min.err_info_stat.lv_cdn_diag_stc "Statistical flag for condition of diagnosis of the diagnosis instance MAP_CTL_MIN" UWORD _CNV_S_2_RANGE______383_CM 1 0. 0. 1. DISPLAY_IDENTIFIER LV_CDN_DIAG_STC_MAP_CTL_MIN ECU_ADDRESS 0x7f9ad0 BYTE_ORDER MSB_LAST BIT_MASK 0x400 /end MEASUREMENT
/begin MEASUREMENT fmy_stat_map_ctl_min.err_info_stat.lv_lock_diag "lock flag (CPU load optimisation) of the diagnosis instance MAP_CTL_MIN" UWORD _CNV_S_2_RANGE______383_CM 1 0. 0. 1. DISPLAY_IDENTIFIER LV_LOCK_DIAG_MAP_CTL_MIN ECU_ADDRESS 0x7f9ad0 BYTE_ORDER MSB_LAST BIT_MASK 0x200 /end MEASUREMENT
/begin MEASUREMENT fmy_stat_map_ctl_min.err_info_stat.lv_err_mem "storage in dynamic failure memory of the diagnosis instance MAP_CTL_MIN" UWORD _CNV_S_2_RANGE______383_CM 1 0. 0. 1. DISPLAY_IDENTIFIER LV_ERR_MEM_MAP_CTL_MIN ECU_ADDRESS 0x7f9ad0 BYTE_ORDER MSB_LAST BIT_MASK 0x80 /end MEASUREMENT
/begin MEASUREMENT fmy_stat_map_ctl_min.err_info_stat.lv_ready "readiness status of the diagnosis instance MAP_CTL_MIN" UWORD _CNV_S_2_RANGE______383_CM 1 0. 0. 1. DISPLAY_IDENTIFIER LV_READY_MAP_CTL_MIN ECU_ADDRESS 0x7f9ad0 BYTE_ORDER MSB_LAST BIT_MASK 0x40 /end MEASUREMENT
/begin MEASUREMENT fmy_stat_map_ctl_min.err_info_stat.lv_end_diag "end of diagnosis of the diagnosis instance MAP_CTL_MIN" UWORD _CNV_S_2_RANGE______383_CM 1 0. 0. 1. DISPLAY_IDENTIFIER LV_END_DIAG_MAP_CTL_MIN ECU_ADDRESS 0x7f9ad0 BYTE_ORDER MSB_LAST BIT_MASK 0x20 /end MEASUREMENT
/begin MEASUREMENT fmy_stat_map_ctl_min.err_info_stat.lv_cdn_diag "diagnosis condition of the diagnosis instance MAP_CTL_MIN" UWORD _CNV_S_2_RANGE______383_CM 1 0. 0. 1. DISPLAY_IDENTIFIER LV_CDN_DIAG_MAP_CTL_MIN ECU_ADDRESS 0x7f9ad0 BYTE_ORDER MSB_LAST BIT_MASK 0x10 /end MEASUREMENT
/begin MEASUREMENT fmy_stat_map_ctl_min.err_info_stat.err_sym "symptoms of the diagnosis instance MAP_CTL_MIN" UWORD _CNV_S_6_CONV_ERRM__22_CM 1 0. 0. 15. DISPLAY_IDENTIFIER ERR_SYM_MAP_CTL_MIN ECU_ADDRESS 0x7f9ad0 BYTE_ORDER MSB_LAST BIT_MASK 0xF /end MEASUREMENT
/begin MEASUREMENT lv_err_map_ctl_max "Error flag of diagnosis instance MAP_CTL_MAX" UBYTE _CNV_S_2_RANGE______23_CM 1 0. 0. 1. DISPLAY_IDENTIFIER LV_ERR_MAP_CTL_MAX ECU_ADDRESS 0x7fb8e5 /end MEASUREMENT
/begin MEASUREMENT fmy_stat_map_ctl_max.ctr_abc "anti bounce counter for diagnosis instance MAP_CTL_MAX" UBYTE _CNV_A_R_LINEAR_____1_CM 1 0. 0. 255. DISPLAY_IDENTIFIER CTR_ABC_MAP_CTL_MAX ECU_ADDRESS 0x7f9ad7 FORMAT "%3.0" /end MEASUREMENT
/begin MEASUREMENT fmy_stat_map_ctl_max.ctr_end_diag "counter for end of diagnosis for diagnosis instance MAP_CTL_MAX" UBYTE _CNV_A_R_LINEAR_____1_CM 1 0. 0. 255. DISPLAY_IDENTIFIER CTR_ABC_END_DIAG_MAP_CTL_MAX ECU_ADDRESS 0x7f9ad6 FORMAT "%3.0" /end MEASUREMENT
/begin MEASUREMENT fmy_stat_map_ctl_max.err_info_stat.reserved "" UWORD _CNV_A_R_LINEAR_____0_CM 1 0. 0. 65535. DISPLAY_IDENTIFIER FMY_STAT_MAP_CTL_MAX_ERR_INFO_STAT_RESERVED ECU_ADDRESS 0x7f9ad4 BYTE_ORDER MSB_LAST BIT_MASK 0xF800 /end MEASUREMENT
/begin MEASUREMENT fmy_stat_map_ctl_max.err_info_stat.lv_cdn_diag_stc "Statistical flag for condition of diagnosis of the diagnosis instance MAP_CTL_MAX" UWORD _CNV_S_2_RANGE______383_CM 1 0. 0. 1. DISPLAY_IDENTIFIER LV_CDN_DIAG_STC_MAP_CTL_MAX ECU_ADDRESS 0x7f9ad4 BYTE_ORDER MSB_LAST BIT_MASK 0x400 /end MEASUREMENT
/begin MEASUREMENT fmy_stat_map_ctl_max.err_info_stat.lv_lock_diag "lock flag (CPU load optimisation) of the diagnosis instance MAP_CTL_MAX" UWORD _CNV_S_2_RANGE______383_CM 1 0. 0. 1. DISPLAY_IDENTIFIER LV_LOCK_DIAG_MAP_CTL_MAX ECU_ADDRESS 0x7f9ad4 BYTE_ORDER MSB_LAST BIT_MASK 0x200 /end MEASUREMENT
/begin MEASUREMENT fmy_stat_map_ctl_max.err_info_stat.lv_err_mem "storage in dynamic failure memory of the diagnosis instance MAP_CTL_MAX" UWORD _CNV_S_2_RANGE______383_CM 1 0. 0. 1. DISPLAY_IDENTIFIER LV_ERR_MEM_MAP_CTL_MAX ECU_ADDRESS 0x7f9ad4 BYTE_ORDER MSB_LAST BIT_MASK 0x80 /end MEASUREMENT
/begin MEASUREMENT fmy_stat_map_ctl_max.err_info_stat.lv_ready "readiness status of the diagnosis instance MAP_CTL_MAX" UWORD _CNV_S_2_RANGE______383_CM 1 0. 0. 1. DISPLAY_IDENTIFIER LV_READY_MAP_CTL_MAX ECU_ADDRESS 0x7f9ad4 BYTE_ORDER MSB_LAST BIT_MASK 0x40 /end MEASUREMENT
/begin MEASUREMENT fmy_stat_map_ctl_max.err_info_stat.lv_end_diag "end of diagnosis of the diagnosis instance MAP_CTL_MAX" UWORD _CNV_S_2_RANGE______383_CM 1 0. 0. 1. DISPLAY_IDENTIFIER LV_END_DIAG_MAP_CTL_MAX ECU_ADDRESS 0x7f9ad4 BYTE_ORDER MSB_LAST BIT_MASK 0x20 /end MEASUREMENT
/begin MEASUREMENT fmy_stat_map_ctl_max.err_info_stat.lv_cdn_diag "diagnosis condition of the diagnosis instance MAP_CTL_MAX" UWORD _CNV_S_2_RANGE______383_CM 1 0. 0. 1. DISPLAY_IDENTIFIER LV_CDN_DIAG_MAP_CTL_MAX ECU_ADDRESS 0x7f9ad4 BYTE_ORDER MSB_LAST BIT_MASK 0x10 /end MEASUREMENT
/begin MEASUREMENT fmy_stat_map_ctl_max.err_info_stat.err_sym "symptoms of the diagnosis instance MAP_CTL_MAX" UWORD _CNV_S_6_CONV_ERRM__22_CM 1 0. 0. 15. DISPLAY_IDENTIFIER ERR_SYM_MAP_CTL_MAX ECU_ADDRESS 0x7f9ad4 BYTE_ORDER MSB_LAST BIT_MASK 0xF /end MEASUREMENT
/begin MEASUREMENT lv_err_egr_is_slow_obd "Error flag of diagnosis instance EGR_IS_SLOW_OBD" UBYTE _CNV_S_2_RANGE______23_CM 1 0. 0. 1. DISPLAY_IDENTIFIER LV_ERR_EGR_IS_SLOW_OBD ECU_ADDRESS 0x7fb8e6 /end MEASUREMENT
/begin MEASUREMENT fmy_stat_egr_is_slow_obd.ctr_abc "anti bounce counter for diagnosis instance EGR_IS_SLOW_OBD" UBYTE _CNV_A_R_LINEAR_____1_CM 1 0. 0. 255. DISPLAY_IDENTIFIER CTR_ABC_EGR_IS_SLOW_OBD ECU_ADDRESS 0x7f9adb FORMAT "%3.0" /end MEASUREMENT
/begin MEASUREMENT fmy_stat_egr_is_slow_obd.ctr_end_diag "counter for end of diagnosis for diagnosis instance EGR_IS_SLOW_OBD" UBYTE _CNV_A_R_LINEAR_____1_CM 1 0. 0. 255. DISPLAY_IDENTIFIER CTR_ABC_END_DIAG_EGR_IS_SLOW_OBD ECU_ADDRESS 0x7f9ada FORMAT "%3.0" /end MEASUREMENT
/begin MEASUREMENT fmy_stat_egr_is_slow_obd.err_info_stat.reserved "" UWORD _CNV_A_R_LINEAR_____0_CM 1 0. 0. 65535. DISPLAY_IDENTIFIER FMY_STAT_EGR_IS_SLOW_OBD_ERR_INFO_STAT_RESERVED ECU_ADDRESS 0x7f9ad8 BYTE_ORDER MSB_LAST BIT_MASK 0xF800 /end MEASUREMENT
/begin MEASUREMENT fmy_stat_egr_is_slow_obd.err_info_stat.lv_cdn_diag_stc "Statistical flag for condition of diagnosis of the diagnosis instance EGR_IS_SLOW_OBD" UWORD _CNV_S_2_RANGE______383_CM 1 0. 0. 1. DISPLAY_IDENTIFIER LV_CDN_DIAG_STC_EGR_IS_SLOW_OBD ECU_ADDRESS 0x7f9ad8 BYTE_ORDER MSB_LAST BIT_MASK 0x400 /end MEASUREMENT
/begin MEASUREMENT fmy_stat_egr_is_slow_obd.err_info_stat.lv_lock_diag "lock flag (CPU load optimisation) of the diagnosis instance EGR_IS_SLOW_OBD" UWORD _CNV_S_2_RANGE______383_CM 1 0. 0. 1. DISPLAY_IDENTIFIER LV_LOCK_DIAG_EGR_IS_SLOW_OBD ECU_ADDRESS 0x7f9ad8 BYTE_ORDER MSB_LAST BIT_MASK 0x200 /end MEASUREMENT
/begin MEASUREMENT fmy_stat_egr_is_slow_obd.err_info_stat.lv_err_mem "storage in dynamic failure memory of the diagnosis instance EGR_IS_SLOW_OBD" UWORD _CNV_S_2_RANGE______383_CM 1 0. 0. 1. DISPLAY_IDENTIFIER LV_ERR_MEM_EGR_IS_SLOW_OBD ECU_ADDRESS 0x7f9ad8 BYTE_ORDER MSB_LAST BIT_MASK 0x80 /end MEASUREMENT
/begin MEASUREMENT fmy_stat_egr_is_slow_obd.err_info_stat.lv_ready "readiness status of the diagnosis instance EGR_IS_SLOW_OBD" UWORD _CNV_S_2_RANGE______383_CM 1 0. 0. 1. DISPLAY_IDENTIFIER LV_READY_EGR_IS_SLOW_OBD ECU_ADDRESS 0x7f9ad8 BYTE_ORDER MSB_LAST BIT_MASK 0x40 /end MEASUREMENT
/begin MEASUREMENT fmy_stat_egr_is_slow_obd.err_info_stat.lv_end_diag "end of diagnosis of the diagnosis instance EGR_IS_SLOW_OBD" UWORD _CNV_S_2_RANGE______383_CM 1 0. 0. 1. DISPLAY_IDENTIFIER LV_END_DIAG_EGR_IS_SLOW_OBD ECU_ADDRESS 0x7f9ad8 BYTE_ORDER MSB_LAST BIT_MASK 0x20 /end MEASUREMENT
/begin MEASUREMENT fmy_stat_egr_is_slow_obd.err_info_stat.lv_cdn_diag "diagnosis condition of the diagnosis instance EGR_IS_SLOW_OBD" UWORD _CNV_S_2_RANGE______383_CM 1 0. 0. 1. DISPLAY_IDENTIFIER LV_CDN_DIAG_EGR_IS_SLOW_OBD ECU_ADDRESS 0x7f9ad8 BYTE_ORDER MSB_LAST BIT_MASK 0x10 /end MEASUREMENT
/begin MEASUREMENT fmy_stat_egr_is_slow_obd.err_info_stat.err_sym "symptoms of the diagnosis instance EGR_IS_SLOW_OBD" UWORD _CNV_S_6_CONV_ERRM__22_CM 1 0. 0. 15. DISPLAY_IDENTIFIER ERR_SYM_EGR_IS_SLOW_OBD ECU_ADDRESS 0x7f9ad8 BYTE_ORDER MSB_LAST BIT_MASK 0xF /end MEASUREMENT
/begin MEASUREMENT lv_err_maf_egr_thr_obd "Error flag of diagnosis instance MAF_EGR_THR_OBD" UBYTE _CNV_S_2_RANGE______23_CM 1 0. 0. 1. DISPLAY_IDENTIFIER LV_ERR_MAF_EGR_THR_OBD ECU_ADDRESS 0x7fb8e7 /end MEASUREMENT
/begin MEASUREMENT fmy_stat_maf_egr_thr_obd.ctr_abc "anti bounce counter for diagnosis instance MAF_EGR_THR_OBD" UBYTE _CNV_A_R_LINEAR_____1_CM 1 0. 0. 255. DISPLAY_IDENTIFIER CTR_ABC_MAF_EGR_THR_OBD ECU_ADDRESS 0x7f9adf FORMAT "%3.0" /end MEASUREMENT
/begin MEASUREMENT fmy_stat_maf_egr_thr_obd.ctr_end_diag "counter for end of diagnosis for diagnosis instance MAF_EGR_THR_OBD" UBYTE _CNV_A_R_LINEAR_____1_CM 1 0. 0. 255. DISPLAY_IDENTIFIER CTR_ABC_END_DIAG_MAF_EGR_THR_OBD ECU_ADDRESS 0x7f9ade FORMAT "%3.0" /end MEASUREMENT
/begin MEASUREMENT fmy_stat_maf_egr_thr_obd.err_info_stat.reserved "" UWORD _CNV_A_R_LINEAR_____0_CM 1 0. 0. 65535. DISPLAY_IDENTIFIER FMY_STAT_MAF_EGR_THR_OBD_ERR_INFO_STAT_RESERVED ECU_ADDRESS 0x7f9adc BYTE_ORDER MSB_LAST BIT_MASK 0xF800 /end MEASUREMENT
/begin MEASUREMENT fmy_stat_maf_egr_thr_obd.err_info_stat.lv_cdn_diag_stc "Statistical flag for condition of diagnosis of the diagnosis instance MAF_EGR_THR_OBD" UWORD _CNV_S_2_RANGE______383_CM 1 0. 0. 1. DISPLAY_IDENTIFIER LV_CDN_DIAG_STC_MAF_EGR_THR_OBD ECU_ADDRESS 0x7f9adc BYTE_ORDER MSB_LAST BIT_MASK 0x400 /end MEASUREMENT
/begin MEASUREMENT fmy_stat_maf_egr_thr_obd.err_info_stat.lv_lock_diag "lock flag (CPU load optimisation) of the diagnosis instance MAF_EGR_THR_OBD" UWORD _CNV_S_2_RANGE______383_CM 1 0. 0. 1. DISPLAY_IDENTIFIER LV_LOCK_DIAG_MAF_EGR_THR_OBD ECU_ADDRESS 0x7f9adc BYTE_ORDER MSB_LAST BIT_MASK 0x200 /end MEASUREMENT
/begin MEASUREMENT fmy_stat_maf_egr_thr_obd.err_info_stat.lv_err_mem "storage in dynamic failure memory of the diagnosis instance MAF_EGR_THR_OBD" UWORD _CNV_S_2_RANGE______383_CM 1 0. 0. 1. DISPLAY_IDENTIFIER LV_ERR_MEM_MAF_EGR_THR_OBD ECU_ADDRESS 0x7f9adc BYTE_ORDER MSB_LAST BIT_MASK 0x80 /end MEASUREMENT
/begin MEASUREMENT fmy_stat_maf_egr_thr_obd.err_info_stat.lv_ready "readiness status of the diagnosis instance MAF_EGR_THR_OBD" UWORD _CNV_S_2_RANGE______383_CM 1 0. 0. 1. DISPLAY_IDENTIFIER LV_READY_MAF_EGR_THR_OBD ECU_ADDRESS 0x7f9adc BYTE_ORDER MSB_LAST BIT_MASK 0x40 /end MEASUREMENT
/begin MEASUREMENT fmy_stat_maf_egr_thr_obd.err_info_stat.lv_end_diag "end of diagnosis of the diagnosis instance MAF_EGR_THR_OBD" UWORD _CNV_S_2_RANGE______383_CM 1 0. 0. 1. DISPLAY_IDENTIFIER LV_END_DIAG_MAF_EGR_THR_OBD ECU_ADDRESS 0x7f9adc BYTE_ORDER MSB_LAST BIT_MASK 0x20 /end MEASUREMENT
/begin MEASUREMENT fmy_stat_maf_egr_thr_obd.err_info_stat.lv_cdn_diag "diagnosis condition of the diagnosis instance MAF_EGR_THR_OBD" UWORD _CNV_S_2_RANGE______383_CM 1 0. 0. 1. DISPLAY_IDENTIFIER LV_CDN_DIAG_MAF_EGR_THR_OBD ECU_ADDRESS 0x7f9adc BYTE_ORDER MSB_LAST BIT_MASK 0x10 /end MEASUREMENT
/begin MEASUREMENT fmy_stat_maf_egr_thr_obd.err_info_stat.err_sym "symptoms of the diagnosis instance MAF_EGR_THR_OBD" UWORD _CNV_S_6_CONV_ERRM__22_CM 1 0. 0. 15. DISPLAY_IDENTIFIER ERR_SYM_MAF_EGR_THR_OBD ECU_ADDRESS 0x7f9adc BYTE_ORDER MSB_LAST BIT_MASK 0xF /end MEASUREMENT
/begin MEASUREMENT lv_err_maf_dif_egr_thr_obd "Error flag of diagnosis instance MAF_DIF_EGR_THR_OBD" UBYTE _CNV_S_2_RANGE______23_CM 1 0. 0. 1. DISPLAY_IDENTIFIER LV_ERR_MAF_DIF_EGR_THR_OBD ECU_ADDRESS 0x7fb8e8 /end MEASUREMENT
/begin MEASUREMENT fmy_stat_maf_dif_egr_thr_obd.ctr_abc "anti bounce counter for diagnosis instance MAF_DIF_EGR_THR_OBD" UBYTE _CNV_A_R_LINEAR_____1_CM 1 0. 0. 255. DISPLAY_IDENTIFIER CTR_ABC_MAF_DIF_EGR_THR_OBD ECU_ADDRESS 0x7f9ae3 FORMAT "%3.0" /end MEASUREMENT
/begin MEASUREMENT fmy_stat_maf_dif_egr_thr_obd.ctr_end_diag "counter for end of diagnosis for diagnosis instance MAF_DIF_EGR_THR_OBD" UBYTE _CNV_A_R_LINEAR_____1_CM 1 0. 0. 255. DISPLAY_IDENTIFIER CTR_ABC_END_DIAG_MAF_DIF_EGR_THR_OBD ECU_ADDRESS 0x7f9ae2 FORMAT "%3.0" /end MEASUREMENT
/begin MEASUREMENT fmy_stat_maf_dif_egr_thr_obd.err_info_stat.reserved "" UWORD _CNV_A_R_LINEAR_____0_CM 1 0. 0. 65535. DISPLAY_IDENTIFIER FMY_STAT_MAF_DIF_EGR_THR_OBD_ERR_INFO_STAT_RESERVED ECU_ADDRESS 0x7f9ae0 BYTE_ORDER MSB_LAST BIT_MASK 0xF800 /end MEASUREMENT
/begin MEASUREMENT fmy_stat_maf_dif_egr_thr_obd.err_info_stat.lv_cdn_diag_stc "Statistical flag for condition of diagnosis of the diagnosis instance MAF_DIF_EGR_THR_OBD" UWORD _CNV_S_2_RANGE______383_CM 1 0. 0. 1. DISPLAY_IDENTIFIER LV_CDN_DIAG_STC_MAF_DIF_EGR_THR_OBD ECU_ADDRESS 0x7f9ae0 BYTE_ORDER MSB_LAST BIT_MASK 0x400 /end MEASUREMENT
/begin MEASUREMENT fmy_stat_maf_dif_egr_thr_obd.err_info_stat.lv_lock_diag "lock flag (CPU load optimisation) of the diagnosis instance MAF_DIF_EGR_THR_OBD" UWORD _CNV_S_2_RANGE______383_CM 1 0. 0. 1. DISPLAY_IDENTIFIER LV_LOCK_DIAG_MAF_DIF_EGR_THR_OBD ECU_ADDRESS 0x7f9ae0 BYTE_ORDER MSB_LAST BIT_MASK 0x200 /end MEASUREMENT
/begin MEASUREMENT fmy_stat_maf_dif_egr_thr_obd.err_info_stat.lv_err_mem "storage in dynamic failure memory of the diagnosis instance MAF_DIF_EGR_THR_OBD" UWORD _CNV_S_2_RANGE______383_CM 1 0. 0. 1. DISPLAY_IDENTIFIER LV_ERR_MEM_MAF_DIF_EGR_THR_OBD ECU_ADDRESS 0x7f9ae0 BYTE_ORDER MSB_LAST BIT_MASK 0x80 /end MEASUREMENT
/begin MEASUREMENT fmy_stat_maf_dif_egr_thr_obd.err_info_stat.lv_ready "readiness status of the diagnosis instance MAF_DIF_EGR_THR_OBD" UWORD _CNV_S_2_RANGE______383_CM 1 0. 0. 1. DISPLAY_IDENTIFIER LV_READY_MAF_DIF_EGR_THR_OBD ECU_ADDRESS 0x7f9ae0 BYTE_ORDER MSB_LAST BIT_MASK 0x40 /end MEASUREMENT
/begin MEASUREMENT fmy_stat_maf_dif_egr_thr_obd.err_info_stat.lv_end_diag "end of diagnosis of the diagnosis instance MAF_DIF_EGR_THR_OBD" UWORD _CNV_S_2_RANGE______383_CM 1 0. 0. 1. DISPLAY_IDENTIFIER LV_END_DIAG_MAF_DIF_EGR_THR_OBD ECU_ADDRESS 0x7f9ae0 BYTE_ORDER MSB_LAST BIT_MASK 0x20 /end MEASUREMENT
/begin MEASUREMENT fmy_stat_maf_dif_egr_thr_obd.err_info_stat.lv_cdn_diag "diagnosis condition of the diagnosis instance MAF_DIF_EGR_THR_OBD" UWORD _CNV_S_2_RANGE______383_CM 1 0. 0. 1. DISPLAY_IDENTIFIER LV_CDN_DIAG_MAF_DIF_EGR_THR_OBD ECU_ADDRESS 0x7f9ae0 BYTE_ORDER MSB_LAST BIT_MASK 0x10 /end MEASUREMENT
/begin MEASUREMENT fmy_stat_maf_dif_egr_thr_obd.err_info_stat.err_sym "symptoms of the diagnosis instance MAF_DIF_EGR_THR_OBD" UWORD _CNV_S_6_CONV_ERRM__22_CM 1 0. 0. 15. DISPLAY_IDENTIFIER ERR_SYM_MAF_DIF_EGR_THR_OBD ECU_ADDRESS 0x7f9ae0 BYTE_ORDER MSB_LAST BIT_MASK 0xF /end MEASUREMENT
/begin MEASUREMENT lv_err_map_dif_egr_thr_obd "Error flag of diagnosis instance MAP_DIF_EGR_THR_OBD" UBYTE _CNV_S_2_RANGE______23_CM 1 0. 0. 1. DISPLAY_IDENTIFIER LV_ERR_MAP_DIF_EGR_THR_OBD ECU_ADDRESS 0x7fb8e9 /end MEASUREMENT
/begin MEASUREMENT fmy_stat_map_dif_egr_thr_obd.ctr_abc "anti bounce counter for diagnosis instance MAP_DIF_EGR_THR_OBD" UBYTE _CNV_A_R_LINEAR_____1_CM 1 0. 0. 255. DISPLAY_IDENTIFIER CTR_ABC_MAP_DIF_EGR_THR_OBD ECU_ADDRESS 0x7f9ae7 FORMAT "%3.0" /end MEASUREMENT
/begin MEASUREMENT fmy_stat_map_dif_egr_thr_obd.ctr_end_diag "counter for end of diagnosis for diagnosis instance MAP_DIF_EGR_THR_OBD" UBYTE _CNV_A_R_LINEAR_____1_CM 1 0. 0. 255. DISPLAY_IDENTIFIER CTR_ABC_END_DIAG_MAP_DIF_EGR_THR_OBD ECU_ADDRESS 0x7f9ae6 FORMAT "%3.0" /end MEASUREMENT
/begin MEASUREMENT fmy_stat_map_dif_egr_thr_obd.err_info_stat.reserved "" UWORD _CNV_A_R_LINEAR_____0_CM 1 0. 0. 65535. DISPLAY_IDENTIFIER FMY_STAT_MAP_DIF_EGR_THR_OBD_ERR_INFO_STAT_RESERVED ECU_ADDRESS 0x7f9ae4 BYTE_ORDER MSB_LAST BIT_MASK 0xF800 /end MEASUREMENT
/begin MEASUREMENT fmy_stat_map_dif_egr_thr_obd.err_info_stat.lv_cdn_diag_stc "Statistical flag for condition of diagnosis of the diagnosis instance MAP_DIF_EGR_THR_OBD" UWORD _CNV_S_2_RANGE______383_CM 1 0. 0. 1. DISPLAY_IDENTIFIER LV_CDN_DIAG_STC_MAP_DIF_EGR_THR_OBD ECU_ADDRESS 0x7f9ae4 BYTE_ORDER MSB_LAST BIT_MASK 0x400 /end MEASUREMENT
/begin MEASUREMENT fmy_stat_map_dif_egr_thr_obd.err_info_stat.lv_lock_diag "lock flag (CPU load optimisation) of the diagnosis instance MAP_DIF_EGR_THR_OBD" UWORD _CNV_S_2_RANGE______383_CM 1 0. 0. 1. DISPLAY_IDENTIFIER LV_LOCK_DIAG_MAP_DIF_EGR_THR_OBD ECU_ADDRESS 0x7f9ae4 BYTE_ORDER MSB_LAST BIT_MASK 0x200 /end MEASUREMENT
/begin MEASUREMENT fmy_stat_map_dif_egr_thr_obd.err_info_stat.lv_err_mem "storage in dynamic failure memory of the diagnosis instance MAP_DIF_EGR_THR_OBD" UWORD _CNV_S_2_RANGE______383_CM 1 0. 0. 1. DISPLAY_IDENTIFIER LV_ERR_MEM_MAP_DIF_EGR_THR_OBD ECU_ADDRESS 0x7f9ae4 BYTE_ORDER MSB_LAST BIT_MASK 0x80 /end MEASUREMENT
/begin MEASUREMENT fmy_stat_map_dif_egr_thr_obd.err_info_stat.lv_ready "readiness status of the diagnosis instance MAP_DIF_EGR_THR_OBD" UWORD _CNV_S_2_RANGE______383_CM 1 0. 0. 1. DISPLAY_IDENTIFIER LV_READY_MAP_DIF_EGR_THR_OBD ECU_ADDRESS 0x7f9ae4 BYTE_ORDER MSB_LAST BIT_MASK 0x40 /end MEASUREMENT
/begin MEASUREMENT fmy_stat_map_dif_egr_thr_obd.err_info_stat.lv_end_diag "end of diagnosis of the diagnosis instance MAP_DIF_EGR_THR_OBD" UWORD _CNV_S_2_RANGE______383_CM 1 0. 0. 1. DISPLAY_IDENTIFIER LV_END_DIAG_MAP_DIF_EGR_THR_OBD ECU_ADDRESS 0x7f9ae4 BYTE_ORDER MSB_LAST BIT_MASK 0x20 /end MEASUREMENT
/begin MEASUREMENT fmy_stat_map_dif_egr_thr_obd.err_info_stat.lv_cdn_diag "diagnosis condition of the diagnosis instance MAP_DIF_EGR_THR_OBD" UWORD _CNV_S_2_RANGE______383_CM 1 0. 0. 1. DISPLAY_IDENTIFIER LV_CDN_DIAG_MAP_DIF_EGR_THR_OBD ECU_ADDRESS 0x7f9ae4 BYTE_ORDER MSB_LAST BIT_MASK 0x10 /end MEASUREMENT
/begin MEASUREMENT fmy_stat_map_dif_egr_thr_obd.err_info_stat.err_sym "symptoms of the diagnosis instance MAP_DIF_EGR_THR_OBD" UWORD _CNV_S_6_CONV_ERRM__22_CM 1 0. 0. 15. DISPLAY_IDENTIFIER ERR_SYM_MAP_DIF_EGR_THR_OBD ECU_ADDRESS 0x7f9ae4 BYTE_ORDER MSB_LAST BIT_MASK 0xF /end MEASUREMENT
/begin MEASUREMENT lv_err_vs "Error flag of diagnosis instance VS" UBYTE _CNV_S_2_RANGE______23_CM 1 0. 0. 1. DISPLAY_IDENTIFIER LV_ERR_VS ECU_ADDRESS 0x7fb8ea /end MEASUREMENT
/begin MEASUREMENT fmy_stat_vs.ctr_abc "anti bounce counter for diagnosis instance VS" UBYTE _CNV_A_R_LINEAR_____1_CM 1 0. 0. 255. DISPLAY_IDENTIFIER CTR_ABC_VS ECU_ADDRESS 0x7f9aeb FORMAT "%3.0" /end MEASUREMENT
/begin MEASUREMENT fmy_stat_vs.ctr_end_diag "counter for end of diagnosis for diagnosis instance VS" UBYTE _CNV_A_R_LINEAR_____1_CM 1 0. 0. 255. DISPLAY_IDENTIFIER CTR_ABC_END_DIAG_VS ECU_ADDRESS 0x7f9aea FORMAT "%3.0" /end MEASUREMENT
/begin MEASUREMENT fmy_stat_vs.err_info_stat.reserved "" UWORD _CNV_A_R_LINEAR_____0_CM 1 0. 0. 65535. DISPLAY_IDENTIFIER FMY_STAT_VS_ERR_INFO_STAT_RESERVED ECU_ADDRESS 0x7f9ae8 BYTE_ORDER MSB_LAST BIT_MASK 0xF800 /end MEASUREMENT
/begin MEASUREMENT fmy_stat_vs.err_info_stat.lv_cdn_diag_stc "Statistical flag for condition of diagnosis of the diagnosis instance VS" UWORD _CNV_S_2_RANGE______383_CM 1 0. 0. 1. DISPLAY_IDENTIFIER LV_CDN_DIAG_STC_VS ECU_ADDRESS 0x7f9ae8 BYTE_ORDER MSB_LAST BIT_MASK 0x400 /end MEASUREMENT
/begin MEASUREMENT fmy_stat_vs.err_info_stat.lv_lock_diag "lock flag (CPU load optimisation) of the diagnosis instance VS" UWORD _CNV_S_2_RANGE______383_CM 1 0. 0. 1. DISPLAY_IDENTIFIER LV_LOCK_DIAG_VS ECU_ADDRESS 0x7f9ae8 BYTE_ORDER MSB_LAST BIT_MASK 0x200 /end MEASUREMENT
/begin MEASUREMENT fmy_stat_vs.err_info_stat.lv_err_mem "storage in dynamic failure memory of the diagnosis instance VS" UWORD _CNV_S_2_RANGE______383_CM 1 0. 0. 1. DISPLAY_IDENTIFIER LV_ERR_MEM_VS ECU_ADDRESS 0x7f9ae8 BYTE_ORDER MSB_LAST BIT_MASK 0x80 /end MEASUREMENT
/begin MEASUREMENT fmy_stat_vs.err_info_stat.lv_ready "readiness status of the diagnosis instance VS" UWORD _CNV_S_2_RANGE______383_CM 1 0. 0. 1. DISPLAY_IDENTIFIER LV_READY_VS ECU_ADDRESS 0x7f9ae8 BYTE_ORDER MSB_LAST BIT_MASK 0x40 /end MEASUREMENT
/begin MEASUREMENT fmy_stat_vs.err_info_stat.lv_end_diag "end of diagnosis of the diagnosis instance VS" UWORD _CNV_S_2_RANGE______383_CM 1 0. 0. 1. DISPLAY_IDENTIFIER LV_END_DIAG_VS ECU_ADDRESS 0x7f9ae8 BYTE_ORDER MSB_LAST BIT_MASK 0x20 /end MEASUREMENT
/begin MEASUREMENT fmy_stat_vs.err_info_stat.lv_cdn_diag "diagnosis condition of the diagnosis instance VS" UWORD _CNV_S_2_RANGE______383_CM 1 0. 0. 1. DISPLAY_IDENTIFIER LV_CDN_DIAG_VS ECU_ADDRESS 0x7f9ae8 BYTE_ORDER MSB_LAST BIT_MASK 0x10 /end MEASUREMENT
/begin MEASUREMENT fmy_stat_vs.err_info_stat.err_sym "symptoms of the diagnosis instance VS" UWORD _CNV_S_6_CONV_ERRM__22_CM 1 0. 0. 15. DISPLAY_IDENTIFIER ERR_SYM_VS ECU_ADDRESS 0x7f9ae8 BYTE_ORDER MSB_LAST BIT_MASK 0xF /end MEASUREMENT
/begin MEASUREMENT lv_err_cs "Error flag of diagnosis instance CS" UBYTE _CNV_S_2_RANGE______23_CM 1 0. 0. 1. DISPLAY_IDENTIFIER LV_ERR_CS ECU_ADDRESS 0x7fb8eb /end MEASUREMENT
/begin MEASUREMENT fmy_stat_cs.ctr_abc "anti bounce counter for diagnosis instance CS" UBYTE _CNV_A_R_LINEAR_____1_CM 1 0. 0. 255. DISPLAY_IDENTIFIER CTR_ABC_CS ECU_ADDRESS 0x7f9aef FORMAT "%3.0" /end MEASUREMENT
/begin MEASUREMENT fmy_stat_cs.ctr_end_diag "counter for end of diagnosis for diagnosis instance CS" UBYTE _CNV_A_R_LINEAR_____1_CM 1 0. 0. 255. DISPLAY_IDENTIFIER CTR_ABC_END_DIAG_CS ECU_ADDRESS 0x7f9aee FORMAT "%3.0" /end MEASUREMENT
/begin MEASUREMENT fmy_stat_cs.err_info_stat.reserved "" UWORD _CNV_A_R_LINEAR_____0_CM 1 0. 0. 65535. DISPLAY_IDENTIFIER FMY_STAT_CS_ERR_INFO_STAT_RESERVED ECU_ADDRESS 0x7f9aec BYTE_ORDER MSB_LAST BIT_MASK 0xF800 /end MEASUREMENT
/begin MEASUREMENT fmy_stat_cs.err_info_stat.lv_cdn_diag_stc "Statistical flag for condition of diagnosis of the diagnosis instance CS" UWORD _CNV_S_2_RANGE______383_CM 1 0. 0. 1. DISPLAY_IDENTIFIER LV_CDN_DIAG_STC_CS ECU_ADDRESS 0x7f9aec BYTE_ORDER MSB_LAST BIT_MASK 0x400 /end MEASUREMENT
/begin MEASUREMENT fmy_stat_cs.err_info_stat.lv_lock_diag "lock flag (CPU load optimisation) of the diagnosis instance CS" UWORD _CNV_S_2_RANGE______383_CM 1 0. 0. 1. DISPLAY_IDENTIFIER LV_LOCK_DIAG_CS ECU_ADDRESS 0x7f9aec BYTE_ORDER MSB_LAST BIT_MASK 0x200 /end MEASUREMENT
/begin MEASUREMENT fmy_stat_cs.err_info_stat.lv_err_mem "storage in dynamic failure memory of the diagnosis instance CS" UWORD _CNV_S_2_RANGE______383_CM 1 0. 0. 1. DISPLAY_IDENTIFIER LV_ERR_MEM_CS ECU_ADDRESS 0x7f9aec BYTE_ORDER MSB_LAST BIT_MASK 0x80 /end MEASUREMENT
/begin MEASUREMENT fmy_stat_cs.err_info_stat.lv_ready "readiness status of the diagnosis instance CS" UWORD _CNV_S_2_RANGE______383_CM 1 0. 0. 1. DISPLAY_IDENTIFIER LV_READY_CS ECU_ADDRESS 0x7f9aec BYTE_ORDER MSB_LAST BIT_MASK 0x40 /end MEASUREMENT
/begin MEASUREMENT fmy_stat_cs.err_info_stat.lv_end_diag "end of diagnosis of the diagnosis instance CS" UWORD _CNV_S_2_RANGE______383_CM 1 0. 0. 1. DISPLAY_IDENTIFIER LV_END_DIAG_CS ECU_ADDRESS 0x7f9aec BYTE_ORDER MSB_LAST BIT_MASK 0x20 /end MEASUREMENT
/begin MEASUREMENT fmy_stat_cs.err_info_stat.lv_cdn_diag "diagnosis condition of the diagnosis instance CS" UWORD _CNV_S_2_RANGE______383_CM 1 0. 0. 1. DISPLAY_IDENTIFIER LV_CDN_DIAG_CS ECU_ADDRESS 0x7f9aec BYTE_ORDER MSB_LAST BIT_MASK 0x10 /end MEASUREMENT
/begin MEASUREMENT fmy_stat_cs.err_info_stat.err_sym "symptoms of the diagnosis instance CS" UWORD _CNV_S_6_CONV_ERRM__22_CM 1 0. 0. 15. DISPLAY_IDENTIFIER ERR_SYM_CS ECU_ADDRESS 0x7f9aec BYTE_ORDER MSB_LAST BIT_MASK 0xF /end MEASUREMENT
/begin MEASUREMENT lv_err_bls "Error flag of diagnosis instance BLS" UBYTE _CNV_S_2_RANGE______23_CM 1 0. 0. 1. DISPLAY_IDENTIFIER LV_ERR_BLS ECU_ADDRESS 0x7fb8ec /end MEASUREMENT
/begin MEASUREMENT fmy_stat_bls.ctr_abc "anti bounce counter for diagnosis instance BLS" UBYTE _CNV_A_R_LINEAR_____1_CM 1 0. 0. 255. DISPLAY_IDENTIFIER CTR_ABC_BLS ECU_ADDRESS 0x7f9af3 FORMAT "%3.0" /end MEASUREMENT
/begin MEASUREMENT fmy_stat_bls.ctr_end_diag "counter for end of diagnosis for diagnosis instance BLS" UBYTE _CNV_A_R_LINEAR_____1_CM 1 0. 0. 255. DISPLAY_IDENTIFIER CTR_ABC_END_DIAG_BLS ECU_ADDRESS 0x7f9af2 FORMAT "%3.0" /end MEASUREMENT
/begin MEASUREMENT fmy_stat_bls.err_info_stat.reserved "" UWORD _CNV_A_R_LINEAR_____0_CM 1 0. 0. 65535. DISPLAY_IDENTIFIER FMY_STAT_BLS_ERR_INFO_STAT_RESERVED ECU_ADDRESS 0x7f9af0 BYTE_ORDER MSB_LAST BIT_MASK 0xF800 /end MEASUREMENT
/begin MEASUREMENT fmy_stat_bls.err_info_stat.lv_cdn_diag_stc "Statistical flag for condition of diagnosis of the diagnosis instance BLS" UWORD _CNV_S_2_RANGE______383_CM 1 0. 0. 1. DISPLAY_IDENTIFIER LV_CDN_DIAG_STC_BLS ECU_ADDRESS 0x7f9af0 BYTE_ORDER MSB_LAST BIT_MASK 0x400 /end MEASUREMENT
/begin MEASUREMENT fmy_stat_bls.err_info_stat.lv_lock_diag "lock flag (CPU load optimisation) of the diagnosis instance BLS" UWORD _CNV_S_2_RANGE______383_CM 1 0. 0. 1. DISPLAY_IDENTIFIER LV_LOCK_DIAG_BLS ECU_ADDRESS 0x7f9af0 BYTE_ORDER MSB_LAST BIT_MASK 0x200 /end MEASUREMENT
/begin MEASUREMENT fmy_stat_bls.err_info_stat.lv_err_mem "storage in dynamic failure memory of the diagnosis instance BLS" UWORD _CNV_S_2_RANGE______383_CM 1 0. 0. 1. DISPLAY_IDENTIFIER LV_ERR_MEM_BLS ECU_ADDRESS 0x7f9af0 BYTE_ORDER MSB_LAST BIT_MASK 0x80 /end MEASUREMENT
/begin MEASUREMENT fmy_stat_bls.err_info_stat.lv_ready "readiness status of the diagnosis instance BLS" UWORD _CNV_S_2_RANGE______383_CM 1 0. 0. 1. DISPLAY_IDENTIFIER LV_READY_BLS ECU_ADDRESS 0x7f9af0 BYTE_ORDER MSB_LAST BIT_MASK 0x40 /end MEASUREMENT
/begin MEASUREMENT fmy_stat_bls.err_info_stat.lv_end_diag "end of diagnosis of the diagnosis instance BLS" UWORD _CNV_S_2_RANGE______383_CM 1 0. 0. 1. DISPLAY_IDENTIFIER LV_END_DIAG_BLS ECU_ADDRESS 0x7f9af0 BYTE_ORDER MSB_LAST BIT_MASK 0x20 /end MEASUREMENT
/begin MEASUREMENT fmy_stat_bls.err_info_stat.lv_cdn_diag "diagnosis condition of the diagnosis instance BLS" UWORD _CNV_S_2_RANGE______383_CM 1 0. 0. 1. DISPLAY_IDENTIFIER LV_CDN_DIAG_BLS ECU_ADDRESS 0x7f9af0 BYTE_ORDER MSB_LAST BIT_MASK 0x10 /end MEASUREMENT
/begin MEASUREMENT fmy_stat_bls.err_info_stat.err_sym "symptoms of the diagnosis instance BLS" UWORD _CNV_S_6_CONV_ERRM__22_CM 1 0. 0. 15. DISPLAY_IDENTIFIER ERR_SYM_BLS ECU_ADDRESS 0x7f9af0 BYTE_ORDER MSB_LAST BIT_MASK 0xF /end MEASUREMENT
/begin MEASUREMENT lv_err_bls_bts_dece "Error flag of diagnosis instance BLS_BTS_DECE" UBYTE _CNV_S_2_RANGE______23_CM 1 0. 0. 1. DISPLAY_IDENTIFIER LV_ERR_BLS_BTS_DECE ECU_ADDRESS 0x7fb8ed /end MEASUREMENT
/begin MEASUREMENT fmy_stat_bls_bts_dece.ctr_abc "anti bounce counter for diagnosis instance BLS_BTS_DECE" UBYTE _CNV_A_R_LINEAR_____1_CM 1 0. 0. 255. DISPLAY_IDENTIFIER CTR_ABC_BLS_BTS_DECE ECU_ADDRESS 0x7f9af7 FORMAT "%3.0" /end MEASUREMENT
/begin MEASUREMENT fmy_stat_bls_bts_dece.ctr_end_diag "counter for end of diagnosis for diagnosis instance BLS_BTS_DECE" UBYTE _CNV_A_R_LINEAR_____1_CM 1 0. 0. 255. DISPLAY_IDENTIFIER CTR_ABC_END_DIAG_BLS_BTS_DECE ECU_ADDRESS 0x7f9af6 FORMAT "%3.0" /end MEASUREMENT
/begin MEASUREMENT fmy_stat_bls_bts_dece.err_info_stat.reserved "" UWORD _CNV_A_R_LINEAR_____0_CM 1 0. 0. 65535. DISPLAY_IDENTIFIER FMY_STAT_BLS_BTS_DECE_ERR_INFO_STAT_RESERVED ECU_ADDRESS 0x7f9af4 BYTE_ORDER MSB_LAST BIT_MASK 0xF800 /end MEASUREMENT
/begin MEASUREMENT fmy_stat_bls_bts_dece.err_info_stat.lv_cdn_diag_stc "Statistical flag for condition of diagnosis of the diagnosis instance BLS_BTS_DECE" UWORD _CNV_S_2_RANGE______383_CM 1 0. 0. 1. DISPLAY_IDENTIFIER LV_CDN_DIAG_STC_BLS_BTS_DECE ECU_ADDRESS 0x7f9af4 BYTE_ORDER MSB_LAST BIT_MASK 0x400 /end MEASUREMENT
/begin MEASUREMENT fmy_stat_bls_bts_dece.err_info_stat.lv_lock_diag "lock flag (CPU load optimisation) of the diagnosis instance BLS_BTS_DECE" UWORD _CNV_S_2_RANGE______383_CM 1 0. 0. 1. DISPLAY_IDENTIFIER LV_LOCK_DIAG_BLS_BTS_DECE ECU_ADDRESS 0x7f9af4 BYTE_ORDER MSB_LAST BIT_MASK 0x200 /end MEASUREMENT
/begin MEASUREMENT fmy_stat_bls_bts_dece.err_info_stat.lv_err_mem "storage in dynamic failure memory of the diagnosis instance BLS_BTS_DECE" UWORD _CNV_S_2_RANGE______383_CM 1 0. 0. 1. DISPLAY_IDENTIFIER LV_ERR_MEM_BLS_BTS_DECE ECU_ADDRESS 0x7f9af4 BYTE_ORDER MSB_LAST BIT_MASK 0x80 /end MEASUREMENT
/begin MEASUREMENT fmy_stat_bls_bts_dece.err_info_stat.lv_ready "readiness status of the diagnosis instance BLS_BTS_DECE" UWORD _CNV_S_2_RANGE______383_CM 1 0. 0. 1. DISPLAY_IDENTIFIER LV_READY_BLS_BTS_DECE ECU_ADDRESS 0x7f9af4 BYTE_ORDER MSB_LAST BIT_MASK 0x40 /end MEASUREMENT
/begin MEASUREMENT fmy_stat_bls_bts_dece.err_info_stat.lv_end_diag "end of diagnosis of the diagnosis instance BLS_BTS_DECE" UWORD _CNV_S_2_RANGE______383_CM 1 0. 0. 1. DISPLAY_IDENTIFIER LV_END_DIAG_BLS_BTS_DECE ECU_ADDRESS 0x7f9af4 BYTE_ORDER MSB_LAST BIT_MASK 0x20 /end MEASUREMENT
/begin MEASUREMENT fmy_stat_bls_bts_dece.err_info_stat.lv_cdn_diag "diagnosis condition of the diagnosis instance BLS_BTS_DECE" UWORD _CNV_S_2_RANGE______383_CM 1 0. 0. 1. DISPLAY_IDENTIFIER LV_CDN_DIAG_BLS_BTS_DECE ECU_ADDRESS 0x7f9af4 BYTE_ORDER MSB_LAST BIT_MASK 0x10 /end MEASUREMENT
/begin MEASUREMENT fmy_stat_bls_bts_dece.err_info_stat.err_sym "symptoms of the diagnosis instance BLS_BTS_DECE" UWORD _CNV_S_6_CONV_ERRM__22_CM 1 0. 0. 15. DISPLAY_IDENTIFIER ERR_SYM_BLS_BTS_DECE ECU_ADDRESS 0x7f9af4 BYTE_ORDER MSB_LAST BIT_MASK 0xF /end MEASUREMENT
/begin MEASUREMENT lv_err_bls_bts_plaus "Error flag of diagnosis instance BLS_BTS_PLAUS" UBYTE _CNV_S_2_RANGE______23_CM 1 0. 0. 1. DISPLAY_IDENTIFIER LV_ERR_BLS_BTS_PLAUS ECU_ADDRESS 0x7fb8ee /end MEASUREMENT
/begin MEASUREMENT fmy_stat_bls_bts_plaus.ctr_abc "anti bounce counter for diagnosis instance BLS_BTS_PLAUS" UBYTE _CNV_A_R_LINEAR_____1_CM 1 0. 0. 255. DISPLAY_IDENTIFIER CTR_ABC_BLS_BTS_PLAUS ECU_ADDRESS 0x7f9afb FORMAT "%3.0" /end MEASUREMENT
/begin MEASUREMENT fmy_stat_bls_bts_plaus.ctr_end_diag "counter for end of diagnosis for diagnosis instance BLS_BTS_PLAUS" UBYTE _CNV_A_R_LINEAR_____1_CM 1 0. 0. 255. DISPLAY_IDENTIFIER CTR_ABC_END_DIAG_BLS_BTS_PLAUS ECU_ADDRESS 0x7f9afa FORMAT "%3.0" /end MEASUREMENT
/begin MEASUREMENT fmy_stat_bls_bts_plaus.err_info_stat.reserved "" UWORD _CNV_A_R_LINEAR_____0_CM 1 0. 0. 65535. DISPLAY_IDENTIFIER FMY_STAT_BLS_BTS_PLAUS_ERR_INFO_STAT_RESERVED ECU_ADDRESS 0x7f9af8 BYTE_ORDER MSB_LAST BIT_MASK 0xF800 /end MEASUREMENT
/begin MEASUREMENT fmy_stat_bls_bts_plaus.err_info_stat.lv_cdn_diag_stc "Statistical flag for condition of diagnosis of the diagnosis instance BLS_BTS_PLAUS" UWORD _CNV_S_2_RANGE______383_CM 1 0. 0. 1. DISPLAY_IDENTIFIER LV_CDN_DIAG_STC_BLS_BTS_PLAUS ECU_ADDRESS 0x7f9af8 BYTE_ORDER MSB_LAST BIT_MASK 0x400 /end MEASUREMENT
/begin MEASUREMENT fmy_stat_bls_bts_plaus.err_info_stat.lv_lock_diag "lock flag (CPU load optimisation) of the diagnosis instance BLS_BTS_PLAUS" UWORD _CNV_S_2_RANGE______383_CM 1 0. 0. 1. DISPLAY_IDENTIFIER LV_LOCK_DIAG_BLS_BTS_PLAUS ECU_ADDRESS 0x7f9af8 BYTE_ORDER MSB_LAST BIT_MASK 0x200 /end MEASUREMENT
/begin MEASUREMENT fmy_stat_bls_bts_plaus.err_info_stat.lv_err_mem "storage in dynamic failure memory of the diagnosis instance BLS_BTS_PLAUS" UWORD _CNV_S_2_RANGE______383_CM 1 0. 0. 1. DISPLAY_IDENTIFIER LV_ERR_MEM_BLS_BTS_PLAUS ECU_ADDRESS 0x7f9af8 BYTE_ORDER MSB_LAST BIT_MASK 0x80 /end MEASUREMENT
/begin MEASUREMENT fmy_stat_bls_bts_plaus.err_info_stat.lv_ready "readiness status of the diagnosis instance BLS_BTS_PLAUS" UWORD _CNV_S_2_RANGE______383_CM 1 0. 0. 1. DISPLAY_IDENTIFIER LV_READY_BLS_BTS_PLAUS ECU_ADDRESS 0x7f9af8 BYTE_ORDER MSB_LAST BIT_MASK 0x40 /end MEASUREMENT
/begin MEASUREMENT fmy_stat_bls_bts_plaus.err_info_stat.lv_end_diag "end of diagnosis of the diagnosis instance BLS_BTS_PLAUS" UWORD _CNV_S_2_RANGE______383_CM 1 0. 0. 1. DISPLAY_IDENTIFIER LV_END_DIAG_BLS_BTS_PLAUS ECU_ADDRESS 0x7f9af8 BYTE_ORDER MSB_LAST BIT_MASK 0x20 /end MEASUREMENT
/begin MEASUREMENT fmy_stat_bls_bts_plaus.err_info_stat.lv_cdn_diag "diagnosis condition of the diagnosis instance BLS_BTS_PLAUS" UWORD _CNV_S_2_RANGE______383_CM 1 0. 0. 1. DISPLAY_IDENTIFIER LV_CDN_DIAG_BLS_BTS_PLAUS ECU_ADDRESS 0x7f9af8 BYTE_ORDER MSB_LAST BIT_MASK 0x10 /end MEASUREMENT
/begin MEASUREMENT fmy_stat_bls_bts_plaus.err_info_stat.err_sym "symptoms of the diagnosis instance BLS_BTS_PLAUS" UWORD _CNV_S_6_CONV_ERRM__22_CM 1 0. 0. 15. DISPLAY_IDENTIFIER ERR_SYM_BLS_BTS_PLAUS ECU_ADDRESS 0x7f9af8 BYTE_ORDER MSB_LAST BIT_MASK 0xF /end MEASUREMENT
/begin MEASUREMENT fmy_stat_can_tcs.ctr_abc "anti bounce counter for diagnosis instance CAN_TCS" UBYTE _CNV_A_R_LINEAR_____1_CM 1 0. 0. 255. DISPLAY_IDENTIFIER CTR_ABC_CAN_TCS ECU_ADDRESS 0x7f9aff FORMAT "%3.0" /end MEASUREMENT
/begin MEASUREMENT fmy_stat_can_tcs.ctr_end_diag "counter for end of diagnosis for diagnosis instance CAN_TCS" UBYTE _CNV_A_R_LINEAR_____1_CM 1 0. 0. 255. DISPLAY_IDENTIFIER CTR_ABC_END_DIAG_CAN_TCS ECU_ADDRESS 0x7f9afe FORMAT "%3.0" /end MEASUREMENT
/begin MEASUREMENT fmy_stat_can_tcs.err_info_stat.reserved "" UWORD _CNV_A_R_LINEAR_____0_CM 1 0. 0. 65535. DISPLAY_IDENTIFIER FMY_STAT_CAN_TCS_ERR_INFO_STAT_RESERVED ECU_ADDRESS 0x7f9afc BYTE_ORDER MSB_LAST BIT_MASK 0xF800 /end MEASUREMENT
/begin MEASUREMENT fmy_stat_can_tcs.err_info_stat.lv_cdn_diag_stc "Statistical flag for condition of diagnosis of the diagnosis instance CAN_TCS" UWORD _CNV_S_2_RANGE______383_CM 1 0. 0. 1. DISPLAY_IDENTIFIER LV_CDN_DIAG_STC_CAN_TCS ECU_ADDRESS 0x7f9afc BYTE_ORDER MSB_LAST BIT_MASK 0x400 /end MEASUREMENT
/begin MEASUREMENT fmy_stat_can_tcs.err_info_stat.lv_lock_diag "lock flag (CPU load optimisation) of the diagnosis instance CAN_TCS" UWORD _CNV_S_2_RANGE______383_CM 1 0. 0. 1. DISPLAY_IDENTIFIER LV_LOCK_DIAG_CAN_TCS ECU_ADDRESS 0x7f9afc BYTE_ORDER MSB_LAST BIT_MASK 0x200 /end MEASUREMENT
/begin MEASUREMENT fmy_stat_can_tcs.err_info_stat.lv_err_mem "storage in dynamic failure memory of the diagnosis instance CAN_TCS" UWORD _CNV_S_2_RANGE______383_CM 1 0. 0. 1. DISPLAY_IDENTIFIER LV_ERR_MEM_CAN_TCS ECU_ADDRESS 0x7f9afc BYTE_ORDER MSB_LAST BIT_MASK 0x80 /end MEASUREMENT
/begin MEASUREMENT fmy_stat_can_tcs.err_info_stat.lv_ready "readiness status of the diagnosis instance CAN_TCS" UWORD _CNV_S_2_RANGE______383_CM 1 0. 0. 1. DISPLAY_IDENTIFIER LV_READY_CAN_TCS ECU_ADDRESS 0x7f9afc BYTE_ORDER MSB_LAST BIT_MASK 0x40 /end MEASUREMENT
/begin MEASUREMENT fmy_stat_can_tcs.err_info_stat.lv_end_diag "end of diagnosis of the diagnosis instance CAN_TCS" UWORD _CNV_S_2_RANGE______383_CM 1 0. 0. 1. DISPLAY_IDENTIFIER LV_END_DIAG_CAN_TCS ECU_ADDRESS 0x7f9afc BYTE_ORDER MSB_LAST BIT_MASK 0x20 /end MEASUREMENT
/begin MEASUREMENT fmy_stat_can_tcs.err_info_stat.lv_cdn_diag "diagnosis condition of the diagnosis instance CAN_TCS" UWORD _CNV_S_2_RANGE______383_CM 1 0. 0. 1. DISPLAY_IDENTIFIER LV_CDN_DIAG_CAN_TCS ECU_ADDRESS 0x7f9afc BYTE_ORDER MSB_LAST BIT_MASK 0x10 /end MEASUREMENT
/begin MEASUREMENT fmy_stat_can_tcs.err_info_stat.err_sym "symptoms of the diagnosis instance CAN_TCS" UWORD _CNV_S_6_CONV_ERRM__22_CM 1 0. 0. 15. DISPLAY_IDENTIFIER ERR_SYM_CAN_TCS ECU_ADDRESS 0x7f9afc BYTE_ORDER MSB_LAST BIT_MASK 0xF /end MEASUREMENT
/begin MEASUREMENT fmy_stat_can_tcu.ctr_abc "anti bounce counter for diagnosis instance CAN_TCU" UBYTE _CNV_A_R_LINEAR_____1_CM 1 0. 0. 255. DISPLAY_IDENTIFIER CTR_ABC_CAN_TCU ECU_ADDRESS 0x7f9b03 FORMAT "%3.0" /end MEASUREMENT
/begin MEASUREMENT fmy_stat_can_tcu.ctr_end_diag "counter for end of diagnosis for diagnosis instance CAN_TCU" UBYTE _CNV_A_R_LINEAR_____1_CM 1 0. 0. 255. DISPLAY_IDENTIFIER CTR_ABC_END_DIAG_CAN_TCU ECU_ADDRESS 0x7f9b02 FORMAT "%3.0" /end MEASUREMENT
/begin MEASUREMENT fmy_stat_can_tcu.err_info_stat.reserved "" UWORD _CNV_A_R_LINEAR_____0_CM 1 0. 0. 65535. DISPLAY_IDENTIFIER FMY_STAT_CAN_TCU_ERR_INFO_STAT_RESERVED ECU_ADDRESS 0x7f9b00 BYTE_ORDER MSB_LAST BIT_MASK 0xF800 /end MEASUREMENT
/begin MEASUREMENT fmy_stat_can_tcu.err_info_stat.lv_cdn_diag_stc "Statistical flag for condition of diagnosis of the diagnosis instance CAN_TCU" UWORD _CNV_S_2_RANGE______383_CM 1 0. 0. 1. DISPLAY_IDENTIFIER LV_CDN_DIAG_STC_CAN_TCU ECU_ADDRESS 0x7f9b00 BYTE_ORDER MSB_LAST BIT_MASK 0x400 /end MEASUREMENT
/begin MEASUREMENT fmy_stat_can_tcu.err_info_stat.lv_lock_diag "lock flag (CPU load optimisation) of the diagnosis instance CAN_TCU" UWORD _CNV_S_2_RANGE______383_CM 1 0. 0. 1. DISPLAY_IDENTIFIER LV_LOCK_DIAG_CAN_TCU ECU_ADDRESS 0x7f9b00 BYTE_ORDER MSB_LAST BIT_MASK 0x200 /end MEASUREMENT
/begin MEASUREMENT fmy_stat_can_tcu.err_info_stat.lv_err_mem "storage in dynamic failure memory of the diagnosis instance CAN_TCU" UWORD _CNV_S_2_RANGE______383_CM 1 0. 0. 1. DISPLAY_IDENTIFIER LV_ERR_MEM_CAN_TCU ECU_ADDRESS 0x7f9b00 BYTE_ORDER MSB_LAST BIT_MASK 0x80 /end MEASUREMENT
/begin MEASUREMENT fmy_stat_can_tcu.err_info_stat.lv_ready "readiness status of the diagnosis instance CAN_TCU" UWORD _CNV_S_2_RANGE______383_CM 1 0. 0. 1. DISPLAY_IDENTIFIER LV_READY_CAN_TCU ECU_ADDRESS 0x7f9b00 BYTE_ORDER MSB_LAST BIT_MASK 0x40 /end MEASUREMENT
/begin MEASUREMENT fmy_stat_can_tcu.err_info_stat.lv_end_diag "end of diagnosis of the diagnosis instance CAN_TCU" UWORD _CNV_S_2_RANGE______383_CM 1 0. 0. 1. DISPLAY_IDENTIFIER LV_END_DIAG_CAN_TCU ECU_ADDRESS 0x7f9b00 BYTE_ORDER MSB_LAST BIT_MASK 0x20 /end MEASUREMENT
/begin MEASUREMENT fmy_stat_can_tcu.err_info_stat.lv_cdn_diag "diagnosis condition of the diagnosis instance CAN_TCU" UWORD _CNV_S_2_RANGE______383_CM 1 0. 0. 1. DISPLAY_IDENTIFIER LV_CDN_DIAG_CAN_TCU ECU_ADDRESS 0x7f9b00 BYTE_ORDER MSB_LAST BIT_MASK 0x10 /end MEASUREMENT
/begin MEASUREMENT fmy_stat_can_tcu.err_info_stat.err_sym "symptoms of the diagnosis instance CAN_TCU" UWORD _CNV_S_6_CONV_ERRM__22_CM 1 0. 0. 15. DISPLAY_IDENTIFIER ERR_SYM_CAN_TCU ECU_ADDRESS 0x7f9b00 BYTE_ORDER MSB_LAST BIT_MASK 0xF /end MEASUREMENT
/begin MEASUREMENT fmy_stat_can_acu.ctr_abc "anti bounce counter for diagnosis instance CAN_ACU" UBYTE _CNV_A_R_LINEAR_____1_CM 1 0. 0. 255. DISPLAY_IDENTIFIER CTR_ABC_CAN_ACU ECU_ADDRESS 0x7f9b07 FORMAT "%3.0" /end MEASUREMENT
/begin MEASUREMENT fmy_stat_can_acu.ctr_end_diag "counter for end of diagnosis for diagnosis instance CAN_ACU" UBYTE _CNV_A_R_LINEAR_____1_CM 1 0. 0. 255. DISPLAY_IDENTIFIER CTR_ABC_END_DIAG_CAN_ACU ECU_ADDRESS 0x7f9b06 FORMAT "%3.0" /end MEASUREMENT
/begin MEASUREMENT fmy_stat_can_acu.err_info_stat.reserved "" UWORD _CNV_A_R_LINEAR_____0_CM 1 0. 0. 65535. DISPLAY_IDENTIFIER FMY_STAT_CAN_ACU_ERR_INFO_STAT_RESERVED ECU_ADDRESS 0x7f9b04 BYTE_ORDER MSB_LAST BIT_MASK 0xF800 /end MEASUREMENT
/begin MEASUREMENT fmy_stat_can_acu.err_info_stat.lv_cdn_diag_stc "Statistical flag for condition of diagnosis of the diagnosis instance CAN_ACU" UWORD _CNV_S_2_RANGE______383_CM 1 0. 0. 1. DISPLAY_IDENTIFIER LV_CDN_DIAG_STC_CAN_ACU ECU_ADDRESS 0x7f9b04 BYTE_ORDER MSB_LAST BIT_MASK 0x400 /end MEASUREMENT
/begin MEASUREMENT fmy_stat_can_acu.err_info_stat.lv_lock_diag "lock flag (CPU load optimisation) of the diagnosis instance CAN_ACU" UWORD _CNV_S_2_RANGE______383_CM 1 0. 0. 1. DISPLAY_IDENTIFIER LV_LOCK_DIAG_CAN_ACU ECU_ADDRESS 0x7f9b04 BYTE_ORDER MSB_LAST BIT_MASK 0x200 /end MEASUREMENT
/begin MEASUREMENT fmy_stat_can_acu.err_info_stat.lv_err_mem "storage in dynamic failure memory of the diagnosis instance CAN_ACU" UWORD _CNV_S_2_RANGE______383_CM 1 0. 0. 1. DISPLAY_IDENTIFIER LV_ERR_MEM_CAN_ACU ECU_ADDRESS 0x7f9b04 BYTE_ORDER MSB_LAST BIT_MASK 0x80 /end MEASUREMENT
/begin MEASUREMENT fmy_stat_can_acu.err_info_stat.lv_ready "readiness status of the diagnosis instance CAN_ACU" UWORD _CNV_S_2_RANGE______383_CM 1 0. 0. 1. DISPLAY_IDENTIFIER LV_READY_CAN_ACU ECU_ADDRESS 0x7f9b04 BYTE_ORDER MSB_LAST BIT_MASK 0x40 /end MEASUREMENT
/begin MEASUREMENT fmy_stat_can_acu.err_info_stat.lv_end_diag "end of diagnosis of the diagnosis instance CAN_ACU" UWORD _CNV_S_2_RANGE______383_CM 1 0. 0. 1. DISPLAY_IDENTIFIER LV_END_DIAG_CAN_ACU ECU_ADDRESS 0x7f9b04 BYTE_ORDER MSB_LAST BIT_MASK 0x20 /end MEASUREMENT
/begin MEASUREMENT fmy_stat_can_acu.err_info_stat.lv_cdn_diag "diagnosis condition of the diagnosis instance CAN_ACU" UWORD _CNV_S_2_RANGE______383_CM 1 0. 0. 1. DISPLAY_IDENTIFIER LV_CDN_DIAG_CAN_ACU ECU_ADDRESS 0x7f9b04 BYTE_ORDER MSB_LAST BIT_MASK 0x10 /end MEASUREMENT
/begin MEASUREMENT fmy_stat_can_acu.err_info_stat.err_sym "symptoms of the diagnosis instance CAN_ACU" UWORD _CNV_S_6_CONV_ERRM__22_CM 1 0. 0. 15. DISPLAY_IDENTIFIER ERR_SYM_CAN_ACU ECU_ADDRESS 0x7f9b04 BYTE_ORDER MSB_LAST BIT_MASK 0xF /end MEASUREMENT
/begin MEASUREMENT fmy_stat_can_ccu.ctr_abc "anti bounce counter for diagnosis instance CAN_CCU" UBYTE _CNV_A_R_LINEAR_____1_CM 1 0. 0. 255. DISPLAY_IDENTIFIER CTR_ABC_CAN_CCU ECU_ADDRESS 0x7f9b0b FORMAT "%3.0" /end MEASUREMENT
/begin MEASUREMENT fmy_stat_can_ccu.ctr_end_diag "counter for end of diagnosis for diagnosis instance CAN_CCU" UBYTE _CNV_A_R_LINEAR_____1_CM 1 0. 0. 255. DISPLAY_IDENTIFIER CTR_ABC_END_DIAG_CAN_CCU ECU_ADDRESS 0x7f9b0a FORMAT "%3.0" /end MEASUREMENT
/begin MEASUREMENT fmy_stat_can_ccu.err_info_stat.reserved "" UWORD _CNV_A_R_LINEAR_____0_CM 1 0. 0. 65535. DISPLAY_IDENTIFIER FMY_STAT_CAN_CCU_ERR_INFO_STAT_RESERVED ECU_ADDRESS 0x7f9b08 BYTE_ORDER MSB_LAST BIT_MASK 0xF800 /end MEASUREMENT
/begin MEASUREMENT fmy_stat_can_ccu.err_info_stat.lv_cdn_diag_stc "Statistical flag for condition of diagnosis of the diagnosis instance CAN_CCU" UWORD _CNV_S_2_RANGE______383_CM 1 0. 0. 1. DISPLAY_IDENTIFIER LV_CDN_DIAG_STC_CAN_CCU ECU_ADDRESS 0x7f9b08 BYTE_ORDER MSB_LAST BIT_MASK 0x400 /end MEASUREMENT
/begin MEASUREMENT fmy_stat_can_ccu.err_info_stat.lv_lock_diag "lock flag (CPU load optimisation) of the diagnosis instance CAN_CCU" UWORD _CNV_S_2_RANGE______383_CM 1 0. 0. 1. DISPLAY_IDENTIFIER LV_LOCK_DIAG_CAN_CCU ECU_ADDRESS 0x7f9b08 BYTE_ORDER MSB_LAST BIT_MASK 0x200 /end MEASUREMENT
/begin MEASUREMENT fmy_stat_can_ccu.err_info_stat.lv_err_mem "storage in dynamic failure memory of the diagnosis instance CAN_CCU" UWORD _CNV_S_2_RANGE______383_CM 1 0. 0. 1. DISPLAY_IDENTIFIER LV_ERR_MEM_CAN_CCU ECU_ADDRESS 0x7f9b08 BYTE_ORDER MSB_LAST BIT_MASK 0x80 /end MEASUREMENT
/begin MEASUREMENT fmy_stat_can_ccu.err_info_stat.lv_ready "readiness status of the diagnosis instance CAN_CCU" UWORD _CNV_S_2_RANGE______383_CM 1 0. 0. 1. DISPLAY_IDENTIFIER LV_READY_CAN_CCU ECU_ADDRESS 0x7f9b08 BYTE_ORDER MSB_LAST BIT_MASK 0x40 /end MEASUREMENT
/begin MEASUREMENT fmy_stat_can_ccu.err_info_stat.lv_end_diag "end of diagnosis of the diagnosis instance CAN_CCU" UWORD _CNV_S_2_RANGE______383_CM 1 0. 0. 1. DISPLAY_IDENTIFIER LV_END_DIAG_CAN_CCU ECU_ADDRESS 0x7f9b08 BYTE_ORDER MSB_LAST BIT_MASK 0x20 /end MEASUREMENT
/begin MEASUREMENT fmy_stat_can_ccu.err_info_stat.lv_cdn_diag "diagnosis condition of the diagnosis instance CAN_CCU" UWORD _CNV_S_2_RANGE______383_CM 1 0. 0. 1. DISPLAY_IDENTIFIER LV_CDN_DIAG_CAN_CCU ECU_ADDRESS 0x7f9b08 BYTE_ORDER MSB_LAST BIT_MASK 0x10 /end MEASUREMENT
/begin MEASUREMENT fmy_stat_can_ccu.err_info_stat.err_sym "symptoms of the diagnosis instance CAN_CCU" UWORD _CNV_S_6_CONV_ERRM__22_CM 1 0. 0. 15. DISPLAY_IDENTIFIER ERR_SYM_CAN_CCU ECU_ADDRESS 0x7f9b08 BYTE_ORDER MSB_LAST BIT_MASK 0xF /end MEASUREMENT
/begin MEASUREMENT fmy_stat_can_icl.ctr_abc "anti bounce counter for diagnosis instance CAN_ICL" UBYTE _CNV_A_R_LINEAR_____1_CM 1 0. 0. 255. DISPLAY_IDENTIFIER CTR_ABC_CAN_ICL ECU_ADDRESS 0x7f9b0f FORMAT "%3.0" /end MEASUREMENT
/begin MEASUREMENT fmy_stat_can_icl.ctr_end_diag "counter for end of diagnosis for diagnosis instance CAN_ICL" UBYTE _CNV_A_R_LINEAR_____1_CM 1 0. 0. 255. DISPLAY_IDENTIFIER CTR_ABC_END_DIAG_CAN_ICL ECU_ADDRESS 0x7f9b0e FORMAT "%3.0" /end MEASUREMENT
/begin MEASUREMENT fmy_stat_can_icl.err_info_stat.reserved "" UWORD _CNV_A_R_LINEAR_____0_CM 1 0. 0. 65535. DISPLAY_IDENTIFIER FMY_STAT_CAN_ICL_ERR_INFO_STAT_RESERVED ECU_ADDRESS 0x7f9b0c BYTE_ORDER MSB_LAST BIT_MASK 0xF800 /end MEASUREMENT
/begin MEASUREMENT fmy_stat_can_icl.err_info_stat.lv_cdn_diag_stc "Statistical flag for condition of diagnosis of the diagnosis instance CAN_ICL" UWORD _CNV_S_2_RANGE______383_CM 1 0. 0. 1. DISPLAY_IDENTIFIER LV_CDN_DIAG_STC_CAN_ICL ECU_ADDRESS 0x7f9b0c BYTE_ORDER MSB_LAST BIT_MASK 0x400 /end MEASUREMENT
/begin MEASUREMENT fmy_stat_can_icl.err_info_stat.lv_lock_diag "lock flag (CPU load optimisation) of the diagnosis instance CAN_ICL" UWORD _CNV_S_2_RANGE______383_CM 1 0. 0. 1. DISPLAY_IDENTIFIER LV_LOCK_DIAG_CAN_ICL ECU_ADDRESS 0x7f9b0c BYTE_ORDER MSB_LAST BIT_MASK 0x200 /end MEASUREMENT
/begin MEASUREMENT fmy_stat_can_icl.err_info_stat.lv_err_mem "storage in dynamic failure memory of the diagnosis instance CAN_ICL" UWORD _CNV_S_2_RANGE______383_CM 1 0. 0. 1. DISPLAY_IDENTIFIER LV_ERR_MEM_CAN_ICL ECU_ADDRESS 0x7f9b0c BYTE_ORDER MSB_LAST BIT_MASK 0x80 /end MEASUREMENT
/begin MEASUREMENT fmy_stat_can_icl.err_info_stat.lv_ready "readiness status of the diagnosis instance CAN_ICL" UWORD _CNV_S_2_RANGE______383_CM 1 0. 0. 1. DISPLAY_IDENTIFIER LV_READY_CAN_ICL ECU_ADDRESS 0x7f9b0c BYTE_ORDER MSB_LAST BIT_MASK 0x40 /end MEASUREMENT
/begin MEASUREMENT fmy_stat_can_icl.err_info_stat.lv_end_diag "end of diagnosis of the diagnosis instance CAN_ICL" UWORD _CNV_S_2_RANGE______383_CM 1 0. 0. 1. DISPLAY_IDENTIFIER LV_END_DIAG_CAN_ICL ECU_ADDRESS 0x7f9b0c BYTE_ORDER MSB_LAST BIT_MASK 0x20 /end MEASUREMENT
/begin MEASUREMENT fmy_stat_can_icl.err_info_stat.lv_cdn_diag "diagnosis condition of the diagnosis instance CAN_ICL" UWORD _CNV_S_2_RANGE______383_CM 1 0. 0. 1. DISPLAY_IDENTIFIER LV_CDN_DIAG_CAN_ICL ECU_ADDRESS 0x7f9b0c BYTE_ORDER MSB_LAST BIT_MASK 0x10 /end MEASUREMENT
/begin MEASUREMENT fmy_stat_can_icl.err_info_stat.err_sym "symptoms of the diagnosis instance CAN_ICL" UWORD _CNV_S_6_CONV_ERRM__22_CM 1 0. 0. 15. DISPLAY_IDENTIFIER ERR_SYM_CAN_ICL ECU_ADDRESS 0x7f9b0c BYTE_ORDER MSB_LAST BIT_MASK 0xF /end MEASUREMENT
/begin MEASUREMENT fmy_stat_can_vecu.ctr_abc "anti bounce counter for diagnosis instance CAN_VECU" UBYTE _CNV_A_R_LINEAR_____1_CM 1 0. 0. 255. DISPLAY_IDENTIFIER CTR_ABC_CAN_VECU ECU_ADDRESS 0x7f9b13 FORMAT "%3.0" /end MEASUREMENT
/begin MEASUREMENT fmy_stat_can_vecu.ctr_end_diag "counter for end of diagnosis for diagnosis instance CAN_VECU" UBYTE _CNV_A_R_LINEAR_____1_CM 1 0. 0. 255. DISPLAY_IDENTIFIER CTR_ABC_END_DIAG_CAN_VECU ECU_ADDRESS 0x7f9b12 FORMAT "%3.0" /end MEASUREMENT
/begin MEASUREMENT fmy_stat_can_vecu.err_info_stat.reserved "" UWORD _CNV_A_R_LINEAR_____0_CM 1 0. 0. 65535. DISPLAY_IDENTIFIER FMY_STAT_CAN_VECU_ERR_INFO_STAT_RESERVED ECU_ADDRESS 0x7f9b10 BYTE_ORDER MSB_LAST BIT_MASK 0xF800 /end MEASUREMENT
/begin MEASUREMENT fmy_stat_can_vecu.err_info_stat.lv_cdn_diag_stc "Statistical flag for condition of diagnosis of the diagnosis instance CAN_VECU" UWORD _CNV_S_2_RANGE______383_CM 1 0. 0. 1. DISPLAY_IDENTIFIER LV_CDN_DIAG_STC_CAN_VECU ECU_ADDRESS 0x7f9b10 BYTE_ORDER MSB_LAST BIT_MASK 0x400 /end MEASUREMENT
/begin MEASUREMENT fmy_stat_can_vecu.err_info_stat.lv_lock_diag "lock flag (CPU load optimisation) of the diagnosis instance CAN_VECU" UWORD _CNV_S_2_RANGE______383_CM 1 0. 0. 1. DISPLAY_IDENTIFIER LV_LOCK_DIAG_CAN_VECU ECU_ADDRESS 0x7f9b10 BYTE_ORDER MSB_LAST BIT_MASK 0x200 /end MEASUREMENT
/begin MEASUREMENT fmy_stat_can_vecu.err_info_stat.lv_err_mem "storage in dynamic failure memory of the diagnosis instance CAN_VECU" UWORD _CNV_S_2_RANGE______383_CM 1 0. 0. 1. DISPLAY_IDENTIFIER LV_ERR_MEM_CAN_VECU ECU_ADDRESS 0x7f9b10 BYTE_ORDER MSB_LAST BIT_MASK 0x80 /end MEASUREMENT
/begin MEASUREMENT fmy_stat_can_vecu.err_info_stat.lv_ready "readiness status of the diagnosis instance CAN_VECU" UWORD _CNV_S_2_RANGE______383_CM 1 0. 0. 1. DISPLAY_IDENTIFIER LV_READY_CAN_VECU ECU_ADDRESS 0x7f9b10 BYTE_ORDER MSB_LAST BIT_MASK 0x40 /end MEASUREMENT
/begin MEASUREMENT fmy_stat_can_vecu.err_info_stat.lv_end_diag "end of diagnosis of the diagnosis instance CAN_VECU" UWORD _CNV_S_2_RANGE______383_CM 1 0. 0. 1. DISPLAY_IDENTIFIER LV_END_DIAG_CAN_VECU ECU_ADDRESS 0x7f9b10 BYTE_ORDER MSB_LAST BIT_MASK 0x20 /end MEASUREMENT
/begin MEASUREMENT fmy_stat_can_vecu.err_info_stat.lv_cdn_diag "diagnosis condition of the diagnosis instance CAN_VECU" UWORD _CNV_S_2_RANGE______383_CM 1 0. 0. 1. DISPLAY_IDENTIFIER LV_CDN_DIAG_CAN_VECU ECU_ADDRESS 0x7f9b10 BYTE_ORDER MSB_LAST BIT_MASK 0x10 /end MEASUREMENT
/begin MEASUREMENT fmy_stat_can_vecu.err_info_stat.err_sym "symptoms of the diagnosis instance CAN_VECU" UWORD _CNV_S_6_CONV_ERRM__22_CM 1 0. 0. 15. DISPLAY_IDENTIFIER ERR_SYM_CAN_VECU ECU_ADDRESS 0x7f9b10 BYTE_ORDER MSB_LAST BIT_MASK 0xF /end MEASUREMENT
/begin MEASUREMENT fmy_stat_can_smls.ctr_abc "anti bounce counter for diagnosis instance CAN_SMLS" UBYTE _CNV_A_R_LINEAR_____1_CM 1 0. 0. 255. DISPLAY_IDENTIFIER CTR_ABC_CAN_SMLS ECU_ADDRESS 0x7f9b17 FORMAT "%3.0" /end MEASUREMENT
/begin MEASUREMENT fmy_stat_can_smls.ctr_end_diag "counter for end of diagnosis for diagnosis instance CAN_SMLS" UBYTE _CNV_A_R_LINEAR_____1_CM 1 0. 0. 255. DISPLAY_IDENTIFIER CTR_ABC_END_DIAG_CAN_SMLS ECU_ADDRESS 0x7f9b16 FORMAT "%3.0" /end MEASUREMENT
/begin MEASUREMENT fmy_stat_can_smls.err_info_stat.reserved "" UWORD _CNV_A_R_LINEAR_____0_CM 1 0. 0. 65535. DISPLAY_IDENTIFIER FMY_STAT_CAN_SMLS_ERR_INFO_STAT_RESERVED ECU_ADDRESS 0x7f9b14 BYTE_ORDER MSB_LAST BIT_MASK 0xF800 /end MEASUREMENT
/begin MEASUREMENT fmy_stat_can_smls.err_info_stat.lv_cdn_diag_stc "Statistical flag for condition of diagnosis of the diagnosis instance CAN_SMLS" UWORD _CNV_S_2_RANGE______383_CM 1 0. 0. 1. DISPLAY_IDENTIFIER LV_CDN_DIAG_STC_CAN_SMLS ECU_ADDRESS 0x7f9b14 BYTE_ORDER MSB_LAST BIT_MASK 0x400 /end MEASUREMENT
/begin MEASUREMENT fmy_stat_can_smls.err_info_stat.lv_lock_diag "lock flag (CPU load optimisation) of the diagnosis instance CAN_SMLS" UWORD _CNV_S_2_RANGE______383_CM 1 0. 0. 1. DISPLAY_IDENTIFIER LV_LOCK_DIAG_CAN_SMLS ECU_ADDRESS 0x7f9b14 BYTE_ORDER MSB_LAST BIT_MASK 0x200 /end MEASUREMENT
/begin MEASUREMENT fmy_stat_can_smls.err_info_stat.lv_err_mem "storage in dynamic failure memory of the diagnosis instance CAN_SMLS" UWORD _CNV_S_2_RANGE______383_CM 1 0. 0. 1. DISPLAY_IDENTIFIER LV_ERR_MEM_CAN_SMLS ECU_ADDRESS 0x7f9b14 BYTE_ORDER MSB_LAST BIT_MASK 0x80 /end MEASUREMENT
/begin MEASUREMENT fmy_stat_can_smls.err_info_stat.lv_ready "readiness status of the diagnosis instance CAN_SMLS" UWORD _CNV_S_2_RANGE______383_CM 1 0. 0. 1. DISPLAY_IDENTIFIER LV_READY_CAN_SMLS ECU_ADDRESS 0x7f9b14 BYTE_ORDER MSB_LAST BIT_MASK 0x40 /end MEASUREMENT
/begin MEASUREMENT fmy_stat_can_smls.err_info_stat.lv_end_diag "end of diagnosis of the diagnosis instance CAN_SMLS" UWORD _CNV_S_2_RANGE______383_CM 1 0. 0. 1. DISPLAY_IDENTIFIER LV_END_DIAG_CAN_SMLS ECU_ADDRESS 0x7f9b14 BYTE_ORDER MSB_LAST BIT_MASK 0x20 /end MEASUREMENT
/begin MEASUREMENT fmy_stat_can_smls.err_info_stat.lv_cdn_diag "diagnosis condition of the diagnosis instance CAN_SMLS" UWORD _CNV_S_2_RANGE______383_CM 1 0. 0. 1. DISPLAY_IDENTIFIER LV_CDN_DIAG_CAN_SMLS ECU_ADDRESS 0x7f9b14 BYTE_ORDER MSB_LAST BIT_MASK 0x10 /end MEASUREMENT
/begin MEASUREMENT fmy_stat_can_smls.err_info_stat.err_sym "symptoms of the diagnosis instance CAN_SMLS" UWORD _CNV_S_6_CONV_ERRM__22_CM 1 0. 0. 15. DISPLAY_IDENTIFIER ERR_SYM_CAN_SMLS ECU_ADDRESS 0x7f9b14 BYTE_ORDER MSB_LAST BIT_MASK 0xF /end MEASUREMENT
/begin MEASUREMENT fmy_stat_can_boff.ctr_abc "anti bounce counter for diagnosis instance CAN_BOFF" UBYTE _CNV_A_R_LINEAR_____1_CM 1 0. 0. 255. DISPLAY_IDENTIFIER CTR_ABC_CAN_BOFF ECU_ADDRESS 0x7f9b1b FORMAT "%3.0" /end MEASUREMENT
/begin MEASUREMENT fmy_stat_can_boff.ctr_end_diag "counter for end of diagnosis for diagnosis instance CAN_BOFF" UBYTE _CNV_A_R_LINEAR_____1_CM 1 0. 0. 255. DISPLAY_IDENTIFIER CTR_ABC_END_DIAG_CAN_BOFF ECU_ADDRESS 0x7f9b1a FORMAT "%3.0" /end MEASUREMENT
/begin MEASUREMENT fmy_stat_can_boff.err_info_stat.reserved "" UWORD _CNV_A_R_LINEAR_____0_CM 1 0. 0. 65535. DISPLAY_IDENTIFIER FMY_STAT_CAN_BOFF_ERR_INFO_STAT_RESERVED ECU_ADDRESS 0x7f9b18 BYTE_ORDER MSB_LAST BIT_MASK 0xF800 /end MEASUREMENT
/begin MEASUREMENT fmy_stat_can_boff.err_info_stat.lv_cdn_diag_stc "Statistical flag for condition of diagnosis of the diagnosis instance CAN_BOFF" UWORD _CNV_S_2_RANGE______383_CM 1 0. 0. 1. DISPLAY_IDENTIFIER LV_CDN_DIAG_STC_CAN_BOFF ECU_ADDRESS 0x7f9b18 BYTE_ORDER MSB_LAST BIT_MASK 0x400 /end MEASUREMENT
/begin MEASUREMENT fmy_stat_can_boff.err_info_stat.lv_lock_diag "lock flag (CPU load optimisation) of the diagnosis instance CAN_BOFF" UWORD _CNV_S_2_RANGE______383_CM 1 0. 0. 1. DISPLAY_IDENTIFIER LV_LOCK_DIAG_CAN_BOFF ECU_ADDRESS 0x7f9b18 BYTE_ORDER MSB_LAST BIT_MASK 0x200 /end MEASUREMENT
/begin MEASUREMENT fmy_stat_can_boff.err_info_stat.lv_err_mem "storage in dynamic failure memory of the diagnosis instance CAN_BOFF" UWORD _CNV_S_2_RANGE______383_CM 1 0. 0. 1. DISPLAY_IDENTIFIER LV_ERR_MEM_CAN_BOFF ECU_ADDRESS 0x7f9b18 BYTE_ORDER MSB_LAST BIT_MASK 0x80 /end MEASUREMENT
/begin MEASUREMENT fmy_stat_can_boff.err_info_stat.lv_ready "readiness status of the diagnosis instance CAN_BOFF" UWORD _CNV_S_2_RANGE______383_CM 1 0. 0. 1. DISPLAY_IDENTIFIER LV_READY_CAN_BOFF ECU_ADDRESS 0x7f9b18 BYTE_ORDER MSB_LAST BIT_MASK 0x40 /end MEASUREMENT
/begin MEASUREMENT fmy_stat_can_boff.err_info_stat.lv_end_diag "end of diagnosis of the diagnosis instance CAN_BOFF" UWORD _CNV_S_2_RANGE______383_CM 1 0. 0. 1. DISPLAY_IDENTIFIER LV_END_DIAG_CAN_BOFF ECU_ADDRESS 0x7f9b18 BYTE_ORDER MSB_LAST BIT_MASK 0x20 /end MEASUREMENT
/begin MEASUREMENT fmy_stat_can_boff.err_info_stat.lv_cdn_diag "diagnosis condition of the diagnosis instance CAN_BOFF" UWORD _CNV_S_2_RANGE______383_CM 1 0. 0. 1. DISPLAY_IDENTIFIER LV_CDN_DIAG_CAN_BOFF ECU_ADDRESS 0x7f9b18 BYTE_ORDER MSB_LAST BIT_MASK 0x10 /end MEASUREMENT
/begin MEASUREMENT fmy_stat_can_boff.err_info_stat.err_sym "symptoms of the diagnosis instance CAN_BOFF" UWORD _CNV_S_6_CONV_ERRM__22_CM 1 0. 0. 15. DISPLAY_IDENTIFIER ERR_SYM_CAN_BOFF ECU_ADDRESS 0x7f9b18 BYTE_ORDER MSB_LAST BIT_MASK 0xF /end MEASUREMENT
/begin MEASUREMENT fmy_stat_can_if_cft.ctr_abc "anti bounce counter for diagnosis instance CAN_IF_CFT" UBYTE _CNV_A_R_LINEAR_____1_CM 1 0. 0. 255. DISPLAY_IDENTIFIER CTR_ABC_CAN_IF_CFT ECU_ADDRESS 0x7f9b1f FORMAT "%3.0" /end MEASUREMENT
/begin MEASUREMENT fmy_stat_can_if_cft.ctr_end_diag "counter for end of diagnosis for diagnosis instance CAN_IF_CFT" UBYTE _CNV_A_R_LINEAR_____1_CM 1 0. 0. 255. DISPLAY_IDENTIFIER CTR_ABC_END_DIAG_CAN_IF_CFT ECU_ADDRESS 0x7f9b1e FORMAT "%3.0" /end MEASUREMENT
/begin MEASUREMENT fmy_stat_can_if_cft.err_info_stat.reserved "" UWORD _CNV_A_R_LINEAR_____0_CM 1 0. 0. 65535. DISPLAY_IDENTIFIER FMY_STAT_CAN_IF_CFT_ERR_INFO_STAT_RESERVED ECU_ADDRESS 0x7f9b1c BYTE_ORDER MSB_LAST BIT_MASK 0xF800 /end MEASUREMENT
/begin MEASUREMENT fmy_stat_can_if_cft.err_info_stat.lv_cdn_diag_stc "Statistical flag for condition of diagnosis of the diagnosis instance CAN_IF_CFT" UWORD _CNV_S_2_RANGE______383_CM 1 0. 0. 1. DISPLAY_IDENTIFIER LV_CDN_DIAG_STC_CAN_IF_CFT ECU_ADDRESS 0x7f9b1c BYTE_ORDER MSB_LAST BIT_MASK 0x400 /end MEASUREMENT
/begin MEASUREMENT fmy_stat_can_if_cft.err_info_stat.lv_lock_diag "lock flag (CPU load optimisation) of the diagnosis instance CAN_IF_CFT" UWORD _CNV_S_2_RANGE______383_CM 1 0. 0. 1. DISPLAY_IDENTIFIER LV_LOCK_DIAG_CAN_IF_CFT ECU_ADDRESS 0x7f9b1c BYTE_ORDER MSB_LAST BIT_MASK 0x200 /end MEASUREMENT
/begin MEASUREMENT fmy_stat_can_if_cft.err_info_stat.lv_err_mem "storage in dynamic failure memory of the diagnosis instance CAN_IF_CFT" UWORD _CNV_S_2_RANGE______383_CM 1 0. 0. 1. DISPLAY_IDENTIFIER LV_ERR_MEM_CAN_IF_CFT ECU_ADDRESS 0x7f9b1c BYTE_ORDER MSB_LAST BIT_MASK 0x80 /end MEASUREMENT
/begin MEASUREMENT fmy_stat_can_if_cft.err_info_stat.lv_ready "readiness status of the diagnosis instance CAN_IF_CFT" UWORD _CNV_S_2_RANGE______383_CM 1 0. 0. 1. DISPLAY_IDENTIFIER LV_READY_CAN_IF_CFT ECU_ADDRESS 0x7f9b1c BYTE_ORDER MSB_LAST BIT_MASK 0x40 /end MEASUREMENT
/begin MEASUREMENT fmy_stat_can_if_cft.err_info_stat.lv_end_diag "end of diagnosis of the diagnosis instance CAN_IF_CFT" UWORD _CNV_S_2_RANGE______383_CM 1 0. 0. 1. DISPLAY_IDENTIFIER LV_END_DIAG_CAN_IF_CFT ECU_ADDRESS 0x7f9b1c BYTE_ORDER MSB_LAST BIT_MASK 0x20 /end MEASUREMENT
/begin MEASUREMENT fmy_stat_can_if_cft.err_info_stat.lv_cdn_diag "diagnosis condition of the diagnosis instance CAN_IF_CFT" UWORD _CNV_S_2_RANGE______383_CM 1 0. 0. 1. DISPLAY_IDENTIFIER LV_CDN_DIAG_CAN_IF_CFT ECU_ADDRESS 0x7f9b1c BYTE_ORDER MSB_LAST BIT_MASK 0x10 /end MEASUREMENT
/begin MEASUREMENT fmy_stat_can_if_cft.err_info_stat.err_sym "symptoms of the diagnosis instance CAN_IF_CFT" UWORD _CNV_S_6_CONV_ERRM__22_CM 1 0. 0. 15. DISPLAY_IDENTIFIER ERR_SYM_CAN_IF_CFT ECU_ADDRESS 0x7f9b1c BYTE_ORDER MSB_LAST BIT_MASK 0xF /end MEASUREMENT
/begin MEASUREMENT fmy_stat_can_eilu.ctr_abc "anti bounce counter for diagnosis instance CAN_EILU" UBYTE _CNV_A_R_LINEAR_____1_CM 1 0. 0. 255. DISPLAY_IDENTIFIER CTR_ABC_CAN_EILU ECU_ADDRESS 0x7f9b23 FORMAT "%3.0" /end MEASUREMENT
/begin MEASUREMENT fmy_stat_can_eilu.ctr_end_diag "counter for end of diagnosis for diagnosis instance CAN_EILU" UBYTE _CNV_A_R_LINEAR_____1_CM 1 0. 0. 255. DISPLAY_IDENTIFIER CTR_ABC_END_DIAG_CAN_EILU ECU_ADDRESS 0x7f9b22 FORMAT "%3.0" /end MEASUREMENT
/begin MEASUREMENT fmy_stat_can_eilu.err_info_stat.reserved "" UWORD _CNV_A_R_LINEAR_____0_CM 1 0. 0. 65535. DISPLAY_IDENTIFIER FMY_STAT_CAN_EILU_ERR_INFO_STAT_RESERVED ECU_ADDRESS 0x7f9b20 BYTE_ORDER MSB_LAST BIT_MASK 0xF800 /end MEASUREMENT
/begin MEASUREMENT fmy_stat_can_eilu.err_info_stat.lv_cdn_diag_stc "Statistical flag for condition of diagnosis of the diagnosis instance CAN_EILU" UWORD _CNV_S_2_RANGE______383_CM 1 0. 0. 1. DISPLAY_IDENTIFIER LV_CDN_DIAG_STC_CAN_EILU ECU_ADDRESS 0x7f9b20 BYTE_ORDER MSB_LAST BIT_MASK 0x400 /end MEASUREMENT
/begin MEASUREMENT fmy_stat_can_eilu.err_info_stat.lv_lock_diag "lock flag (CPU load optimisation) of the diagnosis instance CAN_EILU" UWORD _CNV_S_2_RANGE______383_CM 1 0. 0. 1. DISPLAY_IDENTIFIER LV_LOCK_DIAG_CAN_EILU ECU_ADDRESS 0x7f9b20 BYTE_ORDER MSB_LAST BIT_MASK 0x200 /end MEASUREMENT
/begin MEASUREMENT fmy_stat_can_eilu.err_info_stat.lv_err_mem "storage in dynamic failure memory of the diagnosis instance CAN_EILU" UWORD _CNV_S_2_RANGE______383_CM 1 0. 0. 1. DISPLAY_IDENTIFIER LV_ERR_MEM_CAN_EILU ECU_ADDRESS 0x7f9b20 BYTE_ORDER MSB_LAST BIT_MASK 0x80 /end MEASUREMENT
/begin MEASUREMENT fmy_stat_can_eilu.err_info_stat.lv_ready "readiness status of the diagnosis instance CAN_EILU" UWORD _CNV_S_2_RANGE______383_CM 1 0. 0. 1. DISPLAY_IDENTIFIER LV_READY_CAN_EILU ECU_ADDRESS 0x7f9b20 BYTE_ORDER MSB_LAST BIT_MASK 0x40 /end MEASUREMENT
/begin MEASUREMENT fmy_stat_can_eilu.err_info_stat.lv_end_diag "end of diagnosis of the diagnosis instance CAN_EILU" UWORD _CNV_S_2_RANGE______383_CM 1 0. 0. 1. DISPLAY_IDENTIFIER LV_END_DIAG_CAN_EILU ECU_ADDRESS 0x7f9b20 BYTE_ORDER MSB_LAST BIT_MASK 0x20 /end MEASUREMENT
/begin MEASUREMENT fmy_stat_can_eilu.err_info_stat.lv_cdn_diag "diagnosis condition of the diagnosis instance CAN_EILU" UWORD _CNV_S_2_RANGE______383_CM 1 0. 0. 1. DISPLAY_IDENTIFIER LV_CDN_DIAG_CAN_EILU ECU_ADDRESS 0x7f9b20 BYTE_ORDER MSB_LAST BIT_MASK 0x10 /end MEASUREMENT
/begin MEASUREMENT fmy_stat_can_eilu.err_info_stat.err_sym "symptoms of the diagnosis instance CAN_EILU" UWORD _CNV_S_6_CONV_ERRM__22_CM 1 0. 0. 15. DISPLAY_IDENTIFIER ERR_SYM_CAN_EILU ECU_ADDRESS 0x7f9b20 BYTE_ORDER MSB_LAST BIT_MASK 0xF /end MEASUREMENT
/begin MEASUREMENT fmy_stat_can_dcc.ctr_abc "anti bounce counter for diagnosis instance CAN_DCC" UBYTE _CNV_A_R_LINEAR_____1_CM 1 0. 0. 255. DISPLAY_IDENTIFIER CTR_ABC_CAN_DCC ECU_ADDRESS 0x7f9b27 FORMAT "%3.0" /end MEASUREMENT
/begin MEASUREMENT fmy_stat_can_dcc.ctr_end_diag "counter for end of diagnosis for diagnosis instance CAN_DCC" UBYTE _CNV_A_R_LINEAR_____1_CM 1 0. 0. 255. DISPLAY_IDENTIFIER CTR_ABC_END_DIAG_CAN_DCC ECU_ADDRESS 0x7f9b26 FORMAT "%3.0" /end MEASUREMENT
/begin MEASUREMENT fmy_stat_can_dcc.err_info_stat.reserved "" UWORD _CNV_A_R_LINEAR_____0_CM 1 0. 0. 65535. DISPLAY_IDENTIFIER FMY_STAT_CAN_DCC_ERR_INFO_STAT_RESERVED ECU_ADDRESS 0x7f9b24 BYTE_ORDER MSB_LAST BIT_MASK 0xF800 /end MEASUREMENT
/begin MEASUREMENT fmy_stat_can_dcc.err_info_stat.lv_cdn_diag_stc "Statistical flag for condition of diagnosis of the diagnosis instance CAN_DCC" UWORD _CNV_S_2_RANGE______383_CM 1 0. 0. 1. DISPLAY_IDENTIFIER LV_CDN_DIAG_STC_CAN_DCC ECU_ADDRESS 0x7f9b24 BYTE_ORDER MSB_LAST BIT_MASK 0x400 /end MEASUREMENT
/begin MEASUREMENT fmy_stat_can_dcc.err_info_stat.lv_lock_diag "lock flag (CPU load optimisation) of the diagnosis instance CAN_DCC" UWORD _CNV_S_2_RANGE______383_CM 1 0. 0. 1. DISPLAY_IDENTIFIER LV_LOCK_DIAG_CAN_DCC ECU_ADDRESS 0x7f9b24 BYTE_ORDER MSB_LAST BIT_MASK 0x200 /end MEASUREMENT
/begin MEASUREMENT fmy_stat_can_dcc.err_info_stat.lv_err_mem "storage in dynamic failure memory of the diagnosis instance CAN_DCC" UWORD _CNV_S_2_RANGE______383_CM 1 0. 0. 1. DISPLAY_IDENTIFIER LV_ERR_MEM_CAN_DCC ECU_ADDRESS 0x7f9b24 BYTE_ORDER MSB_LAST BIT_MASK 0x80 /end MEASUREMENT
/begin MEASUREMENT fmy_stat_can_dcc.err_info_stat.lv_ready "readiness status of the diagnosis instance CAN_DCC" UWORD _CNV_S_2_RANGE______383_CM 1 0. 0. 1. DISPLAY_IDENTIFIER LV_READY_CAN_DCC ECU_ADDRESS 0x7f9b24 BYTE_ORDER MSB_LAST BIT_MASK 0x40 /end MEASUREMENT
/begin MEASUREMENT fmy_stat_can_dcc.err_info_stat.lv_end_diag "end of diagnosis of the diagnosis instance CAN_DCC" UWORD _CNV_S_2_RANGE______383_CM 1 0. 0. 1. DISPLAY_IDENTIFIER LV_END_DIAG_CAN_DCC ECU_ADDRESS 0x7f9b24 BYTE_ORDER MSB_LAST BIT_MASK 0x20 /end MEASUREMENT
/begin MEASUREMENT fmy_stat_can_dcc.err_info_stat.lv_cdn_diag "diagnosis condition of the diagnosis instance CAN_DCC" UWORD _CNV_S_2_RANGE______383_CM 1 0. 0. 1. DISPLAY_IDENTIFIER LV_CDN_DIAG_CAN_DCC ECU_ADDRESS 0x7f9b24 BYTE_ORDER MSB_LAST BIT_MASK 0x10 /end MEASUREMENT
/begin MEASUREMENT fmy_stat_can_dcc.err_info_stat.err_sym "symptoms of the diagnosis instance CAN_DCC" UWORD _CNV_S_6_CONV_ERRM__22_CM 1 0. 0. 15. DISPLAY_IDENTIFIER ERR_SYM_CAN_DCC ECU_ADDRESS 0x7f9b24 BYTE_ORDER MSB_LAST BIT_MASK 0xF /end MEASUREMENT
/begin MEASUREMENT fmy_stat_can_whl.ctr_abc "anti bounce counter for diagnosis instance CAN_WHL" UBYTE _CNV_A_R_LINEAR_____1_CM 1 0. 0. 255. DISPLAY_IDENTIFIER CTR_ABC_CAN_WHL ECU_ADDRESS 0x7f9b2b FORMAT "%3.0" /end MEASUREMENT
/begin MEASUREMENT fmy_stat_can_whl.ctr_end_diag "counter for end of diagnosis for diagnosis instance CAN_WHL" UBYTE _CNV_A_R_LINEAR_____1_CM 1 0. 0. 255. DISPLAY_IDENTIFIER CTR_ABC_END_DIAG_CAN_WHL ECU_ADDRESS 0x7f9b2a FORMAT "%3.0" /end MEASUREMENT
/begin MEASUREMENT fmy_stat_can_whl.err_info_stat.reserved "" UWORD _CNV_A_R_LINEAR_____0_CM 1 0. 0. 65535. DISPLAY_IDENTIFIER FMY_STAT_CAN_WHL_ERR_INFO_STAT_RESERVED ECU_ADDRESS 0x7f9b28 BYTE_ORDER MSB_LAST BIT_MASK 0xF800 /end MEASUREMENT
/begin MEASUREMENT fmy_stat_can_whl.err_info_stat.lv_cdn_diag_stc "Statistical flag for condition of diagnosis of the diagnosis instance CAN_WHL" UWORD _CNV_S_2_RANGE______383_CM 1 0. 0. 1. DISPLAY_IDENTIFIER LV_CDN_DIAG_STC_CAN_WHL ECU_ADDRESS 0x7f9b28 BYTE_ORDER MSB_LAST BIT_MASK 0x400 /end MEASUREMENT
/begin MEASUREMENT fmy_stat_can_whl.err_info_stat.lv_lock_diag "lock flag (CPU load optimisation) of the diagnosis instance CAN_WHL" UWORD _CNV_S_2_RANGE______383_CM 1 0. 0. 1. DISPLAY_IDENTIFIER LV_LOCK_DIAG_CAN_WHL ECU_ADDRESS 0x7f9b28 BYTE_ORDER MSB_LAST BIT_MASK 0x200 /end MEASUREMENT
/begin MEASUREMENT fmy_stat_can_whl.err_info_stat.lv_err_mem "storage in dynamic failure memory of the diagnosis instance CAN_WHL" UWORD _CNV_S_2_RANGE______383_CM 1 0. 0. 1. DISPLAY_IDENTIFIER LV_ERR_MEM_CAN_WHL ECU_ADDRESS 0x7f9b28 BYTE_ORDER MSB_LAST BIT_MASK 0x80 /end MEASUREMENT
/begin MEASUREMENT fmy_stat_can_whl.err_info_stat.lv_ready "readiness status of the diagnosis instance CAN_WHL" UWORD _CNV_S_2_RANGE______383_CM 1 0. 0. 1. DISPLAY_IDENTIFIER LV_READY_CAN_WHL ECU_ADDRESS 0x7f9b28 BYTE_ORDER MSB_LAST BIT_MASK 0x40 /end MEASUREMENT
/begin MEASUREMENT fmy_stat_can_whl.err_info_stat.lv_end_diag "end of diagnosis of the diagnosis instance CAN_WHL" UWORD _CNV_S_2_RANGE______383_CM 1 0. 0. 1. DISPLAY_IDENTIFIER LV_END_DIAG_CAN_WHL ECU_ADDRESS 0x7f9b28 BYTE_ORDER MSB_LAST BIT_MASK 0x20 /end MEASUREMENT
/begin MEASUREMENT fmy_stat_can_whl.err_info_stat.lv_cdn_diag "diagnosis condition of the diagnosis instance CAN_WHL" UWORD _CNV_S_2_RANGE______383_CM 1 0. 0. 1. DISPLAY_IDENTIFIER LV_CDN_DIAG_CAN_WHL ECU_ADDRESS 0x7f9b28 BYTE_ORDER MSB_LAST BIT_MASK 0x10 /end MEASUREMENT
/begin MEASUREMENT fmy_stat_can_whl.err_info_stat.err_sym "symptoms of the diagnosis instance CAN_WHL" UWORD _CNV_S_6_CONV_ERRM__22_CM 1 0. 0. 15. DISPLAY_IDENTIFIER ERR_SYM_CAN_WHL ECU_ADDRESS 0x7f9b28 BYTE_ORDER MSB_LAST BIT_MASK 0xF /end MEASUREMENT
/begin MEASUREMENT fmy_stat_can_sys_info.ctr_abc "anti bounce counter for diagnosis instance CAN_SYS_INFO" UBYTE _CNV_A_R_LINEAR_____1_CM 1 0. 0. 255. DISPLAY_IDENTIFIER CTR_ABC_CAN_SYS_INFO ECU_ADDRESS 0x7f9b2f FORMAT "%3.0" /end MEASUREMENT
/begin MEASUREMENT fmy_stat_can_sys_info.ctr_end_diag "counter for end of diagnosis for diagnosis instance CAN_SYS_INFO" UBYTE _CNV_A_R_LINEAR_____1_CM 1 0. 0. 255. DISPLAY_IDENTIFIER CTR_ABC_END_DIAG_CAN_SYS_INFO ECU_ADDRESS 0x7f9b2e FORMAT "%3.0" /end MEASUREMENT
/begin MEASUREMENT fmy_stat_can_sys_info.err_info_stat.reserved "" UWORD _CNV_A_R_LINEAR_____0_CM 1 0. 0. 65535. DISPLAY_IDENTIFIER FMY_STAT_CAN_SYS_INFO_ERR_INFO_STAT_RESERVED ECU_ADDRESS 0x7f9b2c BYTE_ORDER MSB_LAST BIT_MASK 0xF800 /end MEASUREMENT
/begin MEASUREMENT fmy_stat_can_sys_info.err_info_stat.lv_cdn_diag_stc "Statistical flag for condition of diagnosis of the diagnosis instance CAN_SYS_INFO" UWORD _CNV_S_2_RANGE______383_CM 1 0. 0. 1. DISPLAY_IDENTIFIER LV_CDN_DIAG_STC_CAN_SYS_INFO ECU_ADDRESS 0x7f9b2c BYTE_ORDER MSB_LAST BIT_MASK 0x400 /end MEASUREMENT
/begin MEASUREMENT fmy_stat_can_sys_info.err_info_stat.lv_lock_diag "lock flag (CPU load optimisation) of the diagnosis instance CAN_SYS_INFO" UWORD _CNV_S_2_RANGE______383_CM 1 0. 0. 1. DISPLAY_IDENTIFIER LV_LOCK_DIAG_CAN_SYS_INFO ECU_ADDRESS 0x7f9b2c BYTE_ORDER MSB_LAST BIT_MASK 0x200 /end MEASUREMENT
/begin MEASUREMENT fmy_stat_can_sys_info.err_info_stat.lv_err_mem "storage in dynamic failure memory of the diagnosis instance CAN_SYS_INFO" UWORD _CNV_S_2_RANGE______383_CM 1 0. 0. 1. DISPLAY_IDENTIFIER LV_ERR_MEM_CAN_SYS_INFO ECU_ADDRESS 0x7f9b2c BYTE_ORDER MSB_LAST BIT_MASK 0x80 /end MEASUREMENT
/begin MEASUREMENT fmy_stat_can_sys_info.err_info_stat.lv_ready "readiness status of the diagnosis instance CAN_SYS_INFO" UWORD _CNV_S_2_RANGE______383_CM 1 0. 0. 1. DISPLAY_IDENTIFIER LV_READY_CAN_SYS_INFO ECU_ADDRESS 0x7f9b2c BYTE_ORDER MSB_LAST BIT_MASK 0x40 /end MEASUREMENT
/begin MEASUREMENT fmy_stat_can_sys_info.err_info_stat.lv_end_diag "end of diagnosis of the diagnosis instance CAN_SYS_INFO" UWORD _CNV_S_2_RANGE______383_CM 1 0. 0. 1. DISPLAY_IDENTIFIER LV_END_DIAG_CAN_SYS_INFO ECU_ADDRESS 0x7f9b2c BYTE_ORDER MSB_LAST BIT_MASK 0x20 /end MEASUREMENT
/begin MEASUREMENT fmy_stat_can_sys_info.err_info_stat.lv_cdn_diag "diagnosis condition of the diagnosis instance CAN_SYS_INFO" UWORD _CNV_S_2_RANGE______383_CM 1 0. 0. 1. DISPLAY_IDENTIFIER LV_CDN_DIAG_CAN_SYS_INFO ECU_ADDRESS 0x7f9b2c BYTE_ORDER MSB_LAST BIT_MASK 0x10 /end MEASUREMENT
/begin MEASUREMENT fmy_stat_can_sys_info.err_info_stat.err_sym "symptoms of the diagnosis instance CAN_SYS_INFO" UWORD _CNV_S_6_CONV_ERRM__22_CM 1 0. 0. 15. DISPLAY_IDENTIFIER ERR_SYM_CAN_SYS_INFO ECU_ADDRESS 0x7f9b2c BYTE_ORDER MSB_LAST BIT_MASK 0xF /end MEASUREMENT
/begin MEASUREMENT fmy_stat_can_nom_sys.ctr_abc "anti bounce counter for diagnosis instance CAN_NOM_SYS" UBYTE _CNV_A_R_LINEAR_____1_CM 1 0. 0. 255. DISPLAY_IDENTIFIER CTR_ABC_CAN_NOM_SYS ECU_ADDRESS 0x7f9b33 FORMAT "%3.0" /end MEASUREMENT
/begin MEASUREMENT fmy_stat_can_nom_sys.ctr_end_diag "counter for end of diagnosis for diagnosis instance CAN_NOM_SYS" UBYTE _CNV_A_R_LINEAR_____1_CM 1 0. 0. 255. DISPLAY_IDENTIFIER CTR_ABC_END_DIAG_CAN_NOM_SYS ECU_ADDRESS 0x7f9b32 FORMAT "%3.0" /end MEASUREMENT
/begin MEASUREMENT fmy_stat_can_nom_sys.err_info_stat.reserved "" UWORD _CNV_A_R_LINEAR_____0_CM 1 0. 0. 65535. DISPLAY_IDENTIFIER FMY_STAT_CAN_NOM_SYS_ERR_INFO_STAT_RESERVED ECU_ADDRESS 0x7f9b30 BYTE_ORDER MSB_LAST BIT_MASK 0xF800 /end MEASUREMENT
/begin MEASUREMENT fmy_stat_can_nom_sys.err_info_stat.lv_cdn_diag_stc "Statistical flag for condition of diagnosis of the diagnosis instance CAN_NOM_SYS" UWORD _CNV_S_2_RANGE______383_CM 1 0. 0. 1. DISPLAY_IDENTIFIER LV_CDN_DIAG_STC_CAN_NOM_SYS ECU_ADDRESS 0x7f9b30 BYTE_ORDER MSB_LAST BIT_MASK 0x400 /end MEASUREMENT
/begin MEASUREMENT fmy_stat_can_nom_sys.err_info_stat.lv_lock_diag "lock flag (CPU load optimisation) of the diagnosis instance CAN_NOM_SYS" UWORD _CNV_S_2_RANGE______383_CM 1 0. 0. 1. DISPLAY_IDENTIFIER LV_LOCK_DIAG_CAN_NOM_SYS ECU_ADDRESS 0x7f9b30 BYTE_ORDER MSB_LAST BIT_MASK 0x200 /end MEASUREMENT
/begin MEASUREMENT fmy_stat_can_nom_sys.err_info_stat.lv_err_mem "storage in dynamic failure memory of the diagnosis instance CAN_NOM_SYS" UWORD _CNV_S_2_RANGE______383_CM 1 0. 0. 1. DISPLAY_IDENTIFIER LV_ERR_MEM_CAN_NOM_SYS ECU_ADDRESS 0x7f9b30 BYTE_ORDER MSB_LAST BIT_MASK 0x80 /end MEASUREMENT
/begin MEASUREMENT fmy_stat_can_nom_sys.err_info_stat.lv_ready "readiness status of the diagnosis instance CAN_NOM_SYS" UWORD _CNV_S_2_RANGE______383_CM 1 0. 0. 1. DISPLAY_IDENTIFIER LV_READY_CAN_NOM_SYS ECU_ADDRESS 0x7f9b30 BYTE_ORDER MSB_LAST BIT_MASK 0x40 /end MEASUREMENT
/begin MEASUREMENT fmy_stat_can_nom_sys.err_info_stat.lv_end_diag "end of diagnosis of the diagnosis instance CAN_NOM_SYS" UWORD _CNV_S_2_RANGE______383_CM 1 0. 0. 1. DISPLAY_IDENTIFIER LV_END_DIAG_CAN_NOM_SYS ECU_ADDRESS 0x7f9b30 BYTE_ORDER MSB_LAST BIT_MASK 0x20 /end MEASUREMENT
/begin MEASUREMENT fmy_stat_can_nom_sys.err_info_stat.lv_cdn_diag "diagnosis condition of the diagnosis instance CAN_NOM_SYS" UWORD _CNV_S_2_RANGE______383_CM 1 0. 0. 1. DISPLAY_IDENTIFIER LV_CDN_DIAG_CAN_NOM_SYS ECU_ADDRESS 0x7f9b30 BYTE_ORDER MSB_LAST BIT_MASK 0x10 /end MEASUREMENT
/begin MEASUREMENT fmy_stat_can_nom_sys.err_info_stat.err_sym "symptoms of the diagnosis instance CAN_NOM_SYS" UWORD _CNV_S_6_CONV_ERRM__22_CM 1 0. 0. 15. DISPLAY_IDENTIFIER ERR_SYM_CAN_NOM_SYS ECU_ADDRESS 0x7f9b30 BYTE_ORDER MSB_LAST BIT_MASK 0xF /end MEASUREMENT
/begin MEASUREMENT fmy_stat_can_tot.ctr_abc "anti bounce counter for diagnosis instance CAN_TOT" UBYTE _CNV_A_R_LINEAR_____1_CM 1 0. 0. 255. DISPLAY_IDENTIFIER CTR_ABC_CAN_TOT ECU_ADDRESS 0x7f9b37 FORMAT "%3.0" /end MEASUREMENT
/begin MEASUREMENT fmy_stat_can_tot.ctr_end_diag "counter for end of diagnosis for diagnosis instance CAN_TOT" UBYTE _CNV_A_R_LINEAR_____1_CM 1 0. 0. 255. DISPLAY_IDENTIFIER CTR_ABC_END_DIAG_CAN_TOT ECU_ADDRESS 0x7f9b36 FORMAT "%3.0" /end MEASUREMENT
/begin MEASUREMENT fmy_stat_can_tot.err_info_stat.reserved "" UWORD _CNV_A_R_LINEAR_____0_CM 1 0. 0. 65535. DISPLAY_IDENTIFIER FMY_STAT_CAN_TOT_ERR_INFO_STAT_RESERVED ECU_ADDRESS 0x7f9b34 BYTE_ORDER MSB_LAST BIT_MASK 0xF800 /end MEASUREMENT
/begin MEASUREMENT fmy_stat_can_tot.err_info_stat.lv_cdn_diag_stc "Statistical flag for condition of diagnosis of the diagnosis instance CAN_TOT" UWORD _CNV_S_2_RANGE______383_CM 1 0. 0. 1. DISPLAY_IDENTIFIER LV_CDN_DIAG_STC_CAN_TOT ECU_ADDRESS 0x7f9b34 BYTE_ORDER MSB_LAST BIT_MASK 0x400 /end MEASUREMENT
/begin MEASUREMENT fmy_stat_can_tot.err_info_stat.lv_lock_diag "lock flag (CPU load optimisation) of the diagnosis instance CAN_TOT" UWORD _CNV_S_2_RANGE______383_CM 1 0. 0. 1. DISPLAY_IDENTIFIER LV_LOCK_DIAG_CAN_TOT ECU_ADDRESS 0x7f9b34 BYTE_ORDER MSB_LAST BIT_MASK 0x200 /end MEASUREMENT
/begin MEASUREMENT fmy_stat_can_tot.err_info_stat.lv_err_mem "storage in dynamic failure memory of the diagnosis instance CAN_TOT" UWORD _CNV_S_2_RANGE______383_CM 1 0. 0. 1. DISPLAY_IDENTIFIER LV_ERR_MEM_CAN_TOT ECU_ADDRESS 0x7f9b34 BYTE_ORDER MSB_LAST BIT_MASK 0x80 /end MEASUREMENT
/begin MEASUREMENT fmy_stat_can_tot.err_info_stat.lv_ready "readiness status of the diagnosis instance CAN_TOT" UWORD _CNV_S_2_RANGE______383_CM 1 0. 0. 1. DISPLAY_IDENTIFIER LV_READY_CAN_TOT ECU_ADDRESS 0x7f9b34 BYTE_ORDER MSB_LAST BIT_MASK 0x40 /end MEASUREMENT
/begin MEASUREMENT fmy_stat_can_tot.err_info_stat.lv_end_diag "end of diagnosis of the diagnosis instance CAN_TOT" UWORD _CNV_S_2_RANGE______383_CM 1 0. 0. 1. DISPLAY_IDENTIFIER LV_END_DIAG_CAN_TOT ECU_ADDRESS 0x7f9b34 BYTE_ORDER MSB_LAST BIT_MASK 0x20 /end MEASUREMENT
/begin MEASUREMENT fmy_stat_can_tot.err_info_stat.lv_cdn_diag "diagnosis condition of the diagnosis instance CAN_TOT" UWORD _CNV_S_2_RANGE______383_CM 1 0. 0. 1. DISPLAY_IDENTIFIER LV_CDN_DIAG_CAN_TOT ECU_ADDRESS 0x7f9b34 BYTE_ORDER MSB_LAST BIT_MASK 0x10 /end MEASUREMENT
/begin MEASUREMENT fmy_stat_can_tot.err_info_stat.err_sym "symptoms of the diagnosis instance CAN_TOT" UWORD _CNV_S_6_CONV_ERRM__22_CM 1 0. 0. 15. DISPLAY_IDENTIFIER ERR_SYM_CAN_TOT ECU_ADDRESS 0x7f9b34 BYTE_ORDER MSB_LAST BIT_MASK 0xF /end MEASUREMENT
/begin MEASUREMENT fmy_stat_varcod.ctr_abc "anti bounce counter for diagnosis instance VARCOD" UBYTE _CNV_A_R_LINEAR_____1_CM 1 0. 0. 255. DISPLAY_IDENTIFIER CTR_ABC_VARCOD ECU_ADDRESS 0x7f9b3b FORMAT "%3.0" /end MEASUREMENT
/begin MEASUREMENT fmy_stat_varcod.ctr_end_diag "counter for end of diagnosis for diagnosis instance VARCOD" UBYTE _CNV_A_R_LINEAR_____1_CM 1 0. 0. 255. DISPLAY_IDENTIFIER CTR_ABC_END_DIAG_VARCOD ECU_ADDRESS 0x7f9b3a FORMAT "%3.0" /end MEASUREMENT
/begin MEASUREMENT fmy_stat_varcod.err_info_stat.reserved "" UWORD _CNV_A_R_LINEAR_____0_CM 1 0. 0. 65535. DISPLAY_IDENTIFIER FMY_STAT_VARCOD_ERR_INFO_STAT_RESERVED ECU_ADDRESS 0x7f9b38 BYTE_ORDER MSB_LAST BIT_MASK 0xF800 /end MEASUREMENT
/begin MEASUREMENT fmy_stat_varcod.err_info_stat.lv_cdn_diag_stc "Statistical flag for condition of diagnosis of the diagnosis instance VARCOD" UWORD _CNV_S_2_RANGE______383_CM 1 0. 0. 1. DISPLAY_IDENTIFIER LV_CDN_DIAG_STC_VARCOD ECU_ADDRESS 0x7f9b38 BYTE_ORDER MSB_LAST BIT_MASK 0x400 /end MEASUREMENT
/begin MEASUREMENT fmy_stat_varcod.err_info_stat.lv_lock_diag "lock flag (CPU load optimisation) of the diagnosis instance VARCOD" UWORD _CNV_S_2_RANGE______383_CM 1 0. 0. 1. DISPLAY_IDENTIFIER LV_LOCK_DIAG_VARCOD ECU_ADDRESS 0x7f9b38 BYTE_ORDER MSB_LAST BIT_MASK 0x200 /end MEASUREMENT
/begin MEASUREMENT fmy_stat_varcod.err_info_stat.lv_err_mem "storage in dynamic failure memory of the diagnosis instance VARCOD" UWORD _CNV_S_2_RANGE______383_CM 1 0. 0. 1. DISPLAY_IDENTIFIER LV_ERR_MEM_VARCOD ECU_ADDRESS 0x7f9b38 BYTE_ORDER MSB_LAST BIT_MASK 0x80 /end MEASUREMENT
/begin MEASUREMENT fmy_stat_varcod.err_info_stat.lv_ready "readiness status of the diagnosis instance VARCOD" UWORD _CNV_S_2_RANGE______383_CM 1 0. 0. 1. DISPLAY_IDENTIFIER LV_READY_VARCOD ECU_ADDRESS 0x7f9b38 BYTE_ORDER MSB_LAST BIT_MASK 0x40 /end MEASUREMENT
/begin MEASUREMENT fmy_stat_varcod.err_info_stat.lv_end_diag "end of diagnosis of the diagnosis instance VARCOD" UWORD _CNV_S_2_RANGE______383_CM 1 0. 0. 1. DISPLAY_IDENTIFIER LV_END_DIAG_VARCOD ECU_ADDRESS 0x7f9b38 BYTE_ORDER MSB_LAST BIT_MASK 0x20 /end MEASUREMENT
/begin MEASUREMENT fmy_stat_varcod.err_info_stat.lv_cdn_diag "diagnosis condition of the diagnosis instance VARCOD" UWORD _CNV_S_2_RANGE______383_CM 1 0. 0. 1. DISPLAY_IDENTIFIER LV_CDN_DIAG_VARCOD ECU_ADDRESS 0x7f9b38 BYTE_ORDER MSB_LAST BIT_MASK 0x10 /end MEASUREMENT
/begin MEASUREMENT fmy_stat_varcod.err_info_stat.err_sym "symptoms of the diagnosis instance VARCOD" UWORD _CNV_S_6_CONV_ERRM__22_CM 1 0. 0. 15. DISPLAY_IDENTIFIER ERR_SYM_VARCOD ECU_ADDRESS 0x7f9b38 BYTE_ORDER MSB_LAST BIT_MASK 0xF /end MEASUREMENT
/begin MEASUREMENT lv_err_egrv "Error flag of diagnosis instance EGRV" UBYTE _CNV_S_2_RANGE______23_CM 1 0. 0. 1. DISPLAY_IDENTIFIER LV_ERR_EGRV ECU_ADDRESS 0x7fb927 /end MEASUREMENT
/begin MEASUREMENT fmy_stat_egrv.ctr_abc "anti bounce counter for diagnosis instance EGRV" UBYTE _CNV_A_R_LINEAR_____1_CM 1 0. 0. 255. DISPLAY_IDENTIFIER CTR_ABC_EGRV ECU_ADDRESS 0x7f9bdf FORMAT "%3.0" /end MEASUREMENT
/begin MEASUREMENT fmy_stat_egrv.ctr_end_diag "counter for end of diagnosis for diagnosis instance EGRV" UBYTE _CNV_A_R_LINEAR_____1_CM 1 0. 0. 255. DISPLAY_IDENTIFIER CTR_ABC_END_DIAG_EGRV ECU_ADDRESS 0x7f9bde FORMAT "%3.0" /end MEASUREMENT
/begin MEASUREMENT fmy_stat_egrv.err_info_stat.reserved "" UWORD _CNV_A_R_LINEAR_____0_CM 1 0. 0. 65535. DISPLAY_IDENTIFIER FMY_STAT_EGRV_ERR_INFO_STAT_RESERVED ECU_ADDRESS 0x7f9bdc BYTE_ORDER MSB_LAST BIT_MASK 0xF800 /end MEASUREMENT
/begin MEASUREMENT fmy_stat_egrv.err_info_stat.lv_cdn_diag_stc "Statistical flag for condition of diagnosis of the diagnosis instance EGRV" UWORD _CNV_S_2_RANGE______383_CM 1 0. 0. 1. DISPLAY_IDENTIFIER LV_CDN_DIAG_STC_EGRV ECU_ADDRESS 0x7f9bdc BYTE_ORDER MSB_LAST BIT_MASK 0x400 /end MEASUREMENT
/begin MEASUREMENT fmy_stat_egrv.err_info_stat.lv_lock_diag "lock flag (CPU load optimisation) of the diagnosis instance EGRV" UWORD _CNV_S_2_RANGE______383_CM 1 0. 0. 1. DISPLAY_IDENTIFIER LV_LOCK_DIAG_EGRV ECU_ADDRESS 0x7f9bdc BYTE_ORDER MSB_LAST BIT_MASK 0x200 /end MEASUREMENT
/begin MEASUREMENT fmy_stat_egrv.err_info_stat.lv_err_mem "storage in dynamic failure memory of the diagnosis instance EGRV" UWORD _CNV_S_2_RANGE______383_CM 1 0. 0. 1. DISPLAY_IDENTIFIER LV_ERR_MEM_EGRV ECU_ADDRESS 0x7f9bdc BYTE_ORDER MSB_LAST BIT_MASK 0x80 /end MEASUREMENT
/begin MEASUREMENT fmy_stat_egrv.err_info_stat.lv_ready "readiness status of the diagnosis instance EGRV" UWORD _CNV_S_2_RANGE______383_CM 1 0. 0. 1. DISPLAY_IDENTIFIER LV_READY_EGRV ECU_ADDRESS 0x7f9bdc BYTE_ORDER MSB_LAST BIT_MASK 0x40 /end MEASUREMENT
/begin MEASUREMENT fmy_stat_egrv.err_info_stat.lv_end_diag "end of diagnosis of the diagnosis instance EGRV" UWORD _CNV_S_2_RANGE______383_CM 1 0. 0. 1. DISPLAY_IDENTIFIER LV_END_DIAG_EGRV ECU_ADDRESS 0x7f9bdc BYTE_ORDER MSB_LAST BIT_MASK 0x20 /end MEASUREMENT
/begin MEASUREMENT fmy_stat_egrv.err_info_stat.lv_cdn_diag "diagnosis condition of the diagnosis instance EGRV" UWORD _CNV_S_2_RANGE______383_CM 1 0. 0. 1. DISPLAY_IDENTIFIER LV_CDN_DIAG_EGRV ECU_ADDRESS 0x7f9bdc BYTE_ORDER MSB_LAST BIT_MASK 0x10 /end MEASUREMENT
/begin MEASUREMENT fmy_stat_egrv.err_info_stat.err_sym "symptoms of the diagnosis instance EGRV" UWORD _CNV_S_6_CONV_ERRM__22_CM 1 0. 0. 15. DISPLAY_IDENTIFIER ERR_SYM_EGRV ECU_ADDRESS 0x7f9bdc BYTE_ORDER MSB_LAST BIT_MASK 0xF /end MEASUREMENT
/begin MEASUREMENT lv_err_fsd_1 "Error flag of diagnosis instance FSD_1" UBYTE _CNV_S_2_RANGE______23_CM 1 0. 0. 1. DISPLAY_IDENTIFIER LV_ERR_FSD_1 ECU_ADDRESS 0x7fb928 /end MEASUREMENT
/begin MEASUREMENT fmy_stat_fsd_1.ctr_abc "anti bounce counter for diagnosis instance FSD_1" UBYTE _CNV_A_R_LINEAR_____1_CM 1 0. 0. 255. DISPLAY_IDENTIFIER CTR_ABC_FSD_1 ECU_ADDRESS 0x7f9be3 FORMAT "%3.0" /end MEASUREMENT
/begin MEASUREMENT fmy_stat_fsd_1.ctr_end_diag "counter for end of diagnosis for diagnosis instance FSD_1" UBYTE _CNV_A_R_LINEAR_____1_CM 1 0. 0. 255. DISPLAY_IDENTIFIER CTR_ABC_END_DIAG_FSD_1 ECU_ADDRESS 0x7f9be2 FORMAT "%3.0" /end MEASUREMENT
/begin MEASUREMENT fmy_stat_fsd_1.err_info_stat.reserved "" UWORD _CNV_A_R_LINEAR_____0_CM 1 0. 0. 65535. DISPLAY_IDENTIFIER FMY_STAT_FSD_1_ERR_INFO_STAT_RESERVED ECU_ADDRESS 0x7f9be0 BYTE_ORDER MSB_LAST BIT_MASK 0xF800 /end MEASUREMENT
/begin MEASUREMENT fmy_stat_fsd_1.err_info_stat.lv_cdn_diag_stc "Statistical flag for condition of diagnosis of the diagnosis instance FSD_1" UWORD _CNV_S_2_RANGE______383_CM 1 0. 0. 1. DISPLAY_IDENTIFIER LV_CDN_DIAG_STC_FSD_1 ECU_ADDRESS 0x7f9be0 BYTE_ORDER MSB_LAST BIT_MASK 0x400 /end MEASUREMENT
/begin MEASUREMENT fmy_stat_fsd_1.err_info_stat.lv_lock_diag "lock flag (CPU load optimisation) of the diagnosis instance FSD_1" UWORD _CNV_S_2_RANGE______383_CM 1 0. 0. 1. DISPLAY_IDENTIFIER LV_LOCK_DIAG_FSD_1 ECU_ADDRESS 0x7f9be0 BYTE_ORDER MSB_LAST BIT_MASK 0x200 /end MEASUREMENT
/begin MEASUREMENT fmy_stat_fsd_1.err_info_stat.lv_err_mem "storage in dynamic failure memory of the diagnosis instance FSD_1" UWORD _CNV_S_2_RANGE______383_CM 1 0. 0. 1. DISPLAY_IDENTIFIER LV_ERR_MEM_FSD_1 ECU_ADDRESS 0x7f9be0 BYTE_ORDER MSB_LAST BIT_MASK 0x80 /end MEASUREMENT
/begin MEASUREMENT fmy_stat_fsd_1.err_info_stat.lv_ready "readiness status of the diagnosis instance FSD_1" UWORD _CNV_S_2_RANGE______383_CM 1 0. 0. 1. DISPLAY_IDENTIFIER LV_READY_FSD_1 ECU_ADDRESS 0x7f9be0 BYTE_ORDER MSB_LAST BIT_MASK 0x40 /end MEASUREMENT
/begin MEASUREMENT fmy_stat_fsd_1.err_info_stat.lv_end_diag "end of diagnosis of the diagnosis instance FSD_1" UWORD _CNV_S_2_RANGE______383_CM 1 0. 0. 1. DISPLAY_IDENTIFIER LV_END_DIAG_FSD_1 ECU_ADDRESS 0x7f9be0 BYTE_ORDER MSB_LAST BIT_MASK 0x20 /end MEASUREMENT
/begin MEASUREMENT fmy_stat_fsd_1.err_info_stat.lv_cdn_diag "diagnosis condition of the diagnosis instance FSD_1" UWORD _CNV_S_2_RANGE______383_CM 1 0. 0. 1. DISPLAY_IDENTIFIER LV_CDN_DIAG_FSD_1 ECU_ADDRESS 0x7f9be0 BYTE_ORDER MSB_LAST BIT_MASK 0x10 /end MEASUREMENT
/begin MEASUREMENT fmy_stat_fsd_1.err_info_stat.err_sym "symptoms of the diagnosis instance FSD_1" UWORD _CNV_S_6_CONV_ERRM__22_CM 1 0. 0. 15. DISPLAY_IDENTIFIER ERR_SYM_FSD_1 ECU_ADDRESS 0x7f9be0 BYTE_ORDER MSB_LAST BIT_MASK 0xF /end MEASUREMENT
/begin MEASUREMENT lv_err_mis_a "Error flag of diagnosis instance MIS_A" UBYTE _CNV_S_2_RANGE______23_CM 1 0. 0. 1. DISPLAY_IDENTIFIER LV_ERR_MIS_A ECU_ADDRESS 0x7fb92a /end MEASUREMENT
/begin MEASUREMENT fmy_stat_mis_a.ctr_abc "anti bounce counter for diagnosis instance MIS_A" UBYTE _CNV_A_R_LINEAR_____1_CM 1 0. 0. 255. DISPLAY_IDENTIFIER CTR_ABC_MIS_A ECU_ADDRESS 0x7f9beb FORMAT "%3.0" /end MEASUREMENT
/begin MEASUREMENT fmy_stat_mis_a.ctr_end_diag "counter for end of diagnosis for diagnosis instance MIS_A" UBYTE _CNV_A_R_LINEAR_____1_CM 1 0. 0. 255. DISPLAY_IDENTIFIER CTR_ABC_END_DIAG_MIS_A ECU_ADDRESS 0x7f9bea FORMAT "%3.0" /end MEASUREMENT
/begin MEASUREMENT fmy_stat_mis_a.err_info_stat.reserved "" UWORD _CNV_A_R_LINEAR_____0_CM 1 0. 0. 65535. DISPLAY_IDENTIFIER FMY_STAT_MIS_A_ERR_INFO_STAT_RESERVED ECU_ADDRESS 0x7f9be8 BYTE_ORDER MSB_LAST BIT_MASK 0xF800 /end MEASUREMENT
/begin MEASUREMENT fmy_stat_mis_a.err_info_stat.lv_cdn_diag_stc "Statistical flag for condition of diagnosis of the diagnosis instance MIS_A" UWORD _CNV_S_2_RANGE______383_CM 1 0. 0. 1. DISPLAY_IDENTIFIER LV_CDN_DIAG_STC_MIS_A ECU_ADDRESS 0x7f9be8 BYTE_ORDER MSB_LAST BIT_MASK 0x400 /end MEASUREMENT
/begin MEASUREMENT fmy_stat_mis_a.err_info_stat.lv_lock_diag "lock flag (CPU load optimisation) of the diagnosis instance MIS_A" UWORD _CNV_S_2_RANGE______383_CM 1 0. 0. 1. DISPLAY_IDENTIFIER LV_LOCK_DIAG_MIS_A ECU_ADDRESS 0x7f9be8 BYTE_ORDER MSB_LAST BIT_MASK 0x200 /end MEASUREMENT
/begin MEASUREMENT fmy_stat_mis_a.err_info_stat.lv_err_mem "storage in dynamic failure memory of the diagnosis instance MIS_A" UWORD _CNV_S_2_RANGE______383_CM 1 0. 0. 1. DISPLAY_IDENTIFIER LV_ERR_MEM_MIS_A ECU_ADDRESS 0x7f9be8 BYTE_ORDER MSB_LAST BIT_MASK 0x80 /end MEASUREMENT
/begin MEASUREMENT fmy_stat_mis_a.err_info_stat.lv_ready "readiness status of the diagnosis instance MIS_A" UWORD _CNV_S_2_RANGE______383_CM 1 0. 0. 1. DISPLAY_IDENTIFIER LV_READY_MIS_A ECU_ADDRESS 0x7f9be8 BYTE_ORDER MSB_LAST BIT_MASK 0x40 /end MEASUREMENT
/begin MEASUREMENT fmy_stat_mis_a.err_info_stat.lv_end_diag "end of diagnosis of the diagnosis instance MIS_A" UWORD _CNV_S_2_RANGE______383_CM 1 0. 0. 1. DISPLAY_IDENTIFIER LV_END_DIAG_MIS_A ECU_ADDRESS 0x7f9be8 BYTE_ORDER MSB_LAST BIT_MASK 0x20 /end MEASUREMENT
/begin MEASUREMENT fmy_stat_mis_a.err_info_stat.lv_cdn_diag "diagnosis condition of the diagnosis instance MIS_A" UWORD _CNV_S_2_RANGE______383_CM 1 0. 0. 1. DISPLAY_IDENTIFIER LV_CDN_DIAG_MIS_A ECU_ADDRESS 0x7f9be8 BYTE_ORDER MSB_LAST BIT_MASK 0x10 /end MEASUREMENT
/begin MEASUREMENT fmy_stat_mis_a.err_info_stat.err_sym "symptoms of the diagnosis instance MIS_A" UWORD _CNV_S_6_CONV_ERRM__22_CM 1 0. 0. 15. DISPLAY_IDENTIFIER ERR_SYM_MIS_A ECU_ADDRESS 0x7f9be8 BYTE_ORDER MSB_LAST BIT_MASK 0xF /end MEASUREMENT
/begin MEASUREMENT lv_err_mis_b1 "Error flag of diagnosis instance MIS_B1" UBYTE _CNV_S_2_RANGE______23_CM 1 0. 0. 1. DISPLAY_IDENTIFIER LV_ERR_MIS_B1 ECU_ADDRESS 0x7fb92b /end MEASUREMENT
/begin MEASUREMENT fmy_stat_mis_b1.ctr_abc "anti bounce counter for diagnosis instance MIS_B1" UBYTE _CNV_A_R_LINEAR_____1_CM 1 0. 0. 255. DISPLAY_IDENTIFIER CTR_ABC_MIS_B1 ECU_ADDRESS 0x7f9bef FORMAT "%3.0" /end MEASUREMENT
/begin MEASUREMENT fmy_stat_mis_b1.ctr_end_diag "counter for end of diagnosis for diagnosis instance MIS_B1" UBYTE _CNV_A_R_LINEAR_____1_CM 1 0. 0. 255. DISPLAY_IDENTIFIER CTR_ABC_END_DIAG_MIS_B1 ECU_ADDRESS 0x7f9bee FORMAT "%3.0" /end MEASUREMENT
/begin MEASUREMENT fmy_stat_mis_b1.err_info_stat.reserved "" UWORD _CNV_A_R_LINEAR_____0_CM 1 0. 0. 65535. DISPLAY_IDENTIFIER FMY_STAT_MIS_B1_ERR_INFO_STAT_RESERVED ECU_ADDRESS 0x7f9bec BYTE_ORDER MSB_LAST BIT_MASK 0xF800 /end MEASUREMENT
/begin MEASUREMENT fmy_stat_mis_b1.err_info_stat.lv_cdn_diag_stc "Statistical flag for condition of diagnosis of the diagnosis instance MIS_B1" UWORD _CNV_S_2_RANGE______383_CM 1 0. 0. 1. DISPLAY_IDENTIFIER LV_CDN_DIAG_STC_MIS_B1 ECU_ADDRESS 0x7f9bec BYTE_ORDER MSB_LAST BIT_MASK 0x400 /end MEASUREMENT
/begin MEASUREMENT fmy_stat_mis_b1.err_info_stat.lv_lock_diag "lock flag (CPU load optimisation) of the diagnosis instance MIS_B1" UWORD _CNV_S_2_RANGE______383_CM 1 0. 0. 1. DISPLAY_IDENTIFIER LV_LOCK_DIAG_MIS_B1 ECU_ADDRESS 0x7f9bec BYTE_ORDER MSB_LAST BIT_MASK 0x200 /end MEASUREMENT
/begin MEASUREMENT fmy_stat_mis_b1.err_info_stat.lv_err_mem "storage in dynamic failure memory of the diagnosis instance MIS_B1" UWORD _CNV_S_2_RANGE______383_CM 1 0. 0. 1. DISPLAY_IDENTIFIER LV_ERR_MEM_MIS_B1 ECU_ADDRESS 0x7f9bec BYTE_ORDER MSB_LAST BIT_MASK 0x80 /end MEASUREMENT
/begin MEASUREMENT fmy_stat_mis_b1.err_info_stat.lv_ready "readiness status of the diagnosis instance MIS_B1" UWORD _CNV_S_2_RANGE______383_CM 1 0. 0. 1. DISPLAY_IDENTIFIER LV_READY_MIS_B1 ECU_ADDRESS 0x7f9bec BYTE_ORDER MSB_LAST BIT_MASK 0x40 /end MEASUREMENT
/begin MEASUREMENT fmy_stat_mis_b1.err_info_stat.lv_end_diag "end of diagnosis of the diagnosis instance MIS_B1" UWORD _CNV_S_2_RANGE______383_CM 1 0. 0. 1. DISPLAY_IDENTIFIER LV_END_DIAG_MIS_B1 ECU_ADDRESS 0x7f9bec BYTE_ORDER MSB_LAST BIT_MASK 0x20 /end MEASUREMENT
/begin MEASUREMENT fmy_stat_mis_b1.err_info_stat.lv_cdn_diag "diagnosis condition of the diagnosis instance MIS_B1" UWORD _CNV_S_2_RANGE______383_CM 1 0. 0. 1. DISPLAY_IDENTIFIER LV_CDN_DIAG_MIS_B1 ECU_ADDRESS 0x7f9bec BYTE_ORDER MSB_LAST BIT_MASK 0x10 /end MEASUREMENT
/begin MEASUREMENT fmy_stat_mis_b1.err_info_stat.err_sym "symptoms of the diagnosis instance MIS_B1" UWORD _CNV_S_6_CONV_ERRM__22_CM 1 0. 0. 15. DISPLAY_IDENTIFIER ERR_SYM_MIS_B1 ECU_ADDRESS 0x7f9bec BYTE_ORDER MSB_LAST BIT_MASK 0xF /end MEASUREMENT
/begin MEASUREMENT lv_err_mis_b4 "Error flag of diagnosis instance MIS_B4" UBYTE _CNV_S_2_RANGE______23_CM 1 0. 0. 1. DISPLAY_IDENTIFIER LV_ERR_MIS_B4 ECU_ADDRESS 0x7fb92c /end MEASUREMENT
/begin MEASUREMENT fmy_stat_mis_b4.ctr_abc "anti bounce counter for diagnosis instance MIS_B4" UBYTE _CNV_A_R_LINEAR_____1_CM 1 0. 0. 255. DISPLAY_IDENTIFIER CTR_ABC_MIS_B4 ECU_ADDRESS 0x7f9bf3 FORMAT "%3.0" /end MEASUREMENT
/begin MEASUREMENT fmy_stat_mis_b4.ctr_end_diag "counter for end of diagnosis for diagnosis instance MIS_B4" UBYTE _CNV_A_R_LINEAR_____1_CM 1 0. 0. 255. DISPLAY_IDENTIFIER CTR_ABC_END_DIAG_MIS_B4 ECU_ADDRESS 0x7f9bf2 FORMAT "%3.0" /end MEASUREMENT
/begin MEASUREMENT fmy_stat_mis_b4.err_info_stat.reserved "" UWORD _CNV_A_R_LINEAR_____0_CM 1 0. 0. 65535. DISPLAY_IDENTIFIER FMY_STAT_MIS_B4_ERR_INFO_STAT_RESERVED ECU_ADDRESS 0x7f9bf0 BYTE_ORDER MSB_LAST BIT_MASK 0xF800 /end MEASUREMENT
/begin MEASUREMENT fmy_stat_mis_b4.err_info_stat.lv_cdn_diag_stc "Statistical flag for condition of diagnosis of the diagnosis instance MIS_B4" UWORD _CNV_S_2_RANGE______383_CM 1 0. 0. 1. DISPLAY_IDENTIFIER LV_CDN_DIAG_STC_MIS_B4 ECU_ADDRESS 0x7f9bf0 BYTE_ORDER MSB_LAST BIT_MASK 0x400 /end MEASUREMENT
/begin MEASUREMENT fmy_stat_mis_b4.err_info_stat.lv_lock_diag "lock flag (CPU load optimisation) of the diagnosis instance MIS_B4" UWORD _CNV_S_2_RANGE______383_CM 1 0. 0. 1. DISPLAY_IDENTIFIER LV_LOCK_DIAG_MIS_B4 ECU_ADDRESS 0x7f9bf0 BYTE_ORDER MSB_LAST BIT_MASK 0x200 /end MEASUREMENT
/begin MEASUREMENT fmy_stat_mis_b4.err_info_stat.lv_err_mem "storage in dynamic failure memory of the diagnosis instance MIS_B4" UWORD _CNV_S_2_RANGE______383_CM 1 0. 0. 1. DISPLAY_IDENTIFIER LV_ERR_MEM_MIS_B4 ECU_ADDRESS 0x7f9bf0 BYTE_ORDER MSB_LAST BIT_MASK 0x80 /end MEASUREMENT
/begin MEASUREMENT fmy_stat_mis_b4.err_info_stat.lv_ready "readiness status of the diagnosis instance MIS_B4" UWORD _CNV_S_2_RANGE______383_CM 1 0. 0. 1. DISPLAY_IDENTIFIER LV_READY_MIS_B4 ECU_ADDRESS 0x7f9bf0 BYTE_ORDER MSB_LAST BIT_MASK 0x40 /end MEASUREMENT
/begin MEASUREMENT fmy_stat_mis_b4.err_info_stat.lv_end_diag "end of diagnosis of the diagnosis instance MIS_B4" UWORD _CNV_S_2_RANGE______383_CM 1 0. 0. 1. DISPLAY_IDENTIFIER LV_END_DIAG_MIS_B4 ECU_ADDRESS 0x7f9bf0 BYTE_ORDER MSB_LAST BIT_MASK 0x20 /end MEASUREMENT
/begin MEASUREMENT fmy_stat_mis_b4.err_info_stat.lv_cdn_diag "diagnosis condition of the diagnosis instance MIS_B4" UWORD _CNV_S_2_RANGE______383_CM 1 0. 0. 1. DISPLAY_IDENTIFIER LV_CDN_DIAG_MIS_B4 ECU_ADDRESS 0x7f9bf0 BYTE_ORDER MSB_LAST BIT_MASK 0x10 /end MEASUREMENT
/begin MEASUREMENT fmy_stat_mis_b4.err_info_stat.err_sym "symptoms of the diagnosis instance MIS_B4" UWORD _CNV_S_6_CONV_ERRM__22_CM 1 0. 0. 15. DISPLAY_IDENTIFIER ERR_SYM_MIS_B4 ECU_ADDRESS 0x7f9bf0 BYTE_ORDER MSB_LAST BIT_MASK 0xF /end MEASUREMENT
/begin MEASUREMENT lv_err_pcv_2 "Error flag of diagnosis instance PCV_2" UBYTE _CNV_S_2_RANGE______23_CM 1 0. 0. 1. DISPLAY_IDENTIFIER LV_ERR_PCV_2 ECU_ADDRESS 0x7fb92e /end MEASUREMENT
/begin MEASUREMENT fmy_stat_pcv_2.ctr_abc "anti bounce counter for diagnosis instance PCV_2" UBYTE _CNV_A_R_LINEAR_____1_CM 1 0. 0. 255. DISPLAY_IDENTIFIER CTR_ABC_PCV_2 ECU_ADDRESS 0x7f9bfb FORMAT "%3.0" /end MEASUREMENT
/begin MEASUREMENT fmy_stat_pcv_2.ctr_end_diag "counter for end of diagnosis for diagnosis instance PCV_2" UBYTE _CNV_A_R_LINEAR_____1_CM 1 0. 0. 255. DISPLAY_IDENTIFIER CTR_ABC_END_DIAG_PCV_2 ECU_ADDRESS 0x7f9bfa FORMAT "%3.0" /end MEASUREMENT
/begin MEASUREMENT fmy_stat_pcv_2.err_info_stat.reserved "" UWORD _CNV_A_R_LINEAR_____0_CM 1 0. 0. 65535. DISPLAY_IDENTIFIER FMY_STAT_PCV_2_ERR_INFO_STAT_RESERVED ECU_ADDRESS 0x7f9bf8 BYTE_ORDER MSB_LAST BIT_MASK 0xF800 /end MEASUREMENT
/begin MEASUREMENT fmy_stat_pcv_2.err_info_stat.lv_cdn_diag_stc "Statistical flag for condition of diagnosis of the diagnosis instance PCV_2" UWORD _CNV_S_2_RANGE______383_CM 1 0. 0. 1. DISPLAY_IDENTIFIER LV_CDN_DIAG_STC_PCV_2 ECU_ADDRESS 0x7f9bf8 BYTE_ORDER MSB_LAST BIT_MASK 0x400 /end MEASUREMENT
/begin MEASUREMENT fmy_stat_pcv_2.err_info_stat.lv_lock_diag "lock flag (CPU load optimisation) of the diagnosis instance PCV_2" UWORD _CNV_S_2_RANGE______383_CM 1 0. 0. 1. DISPLAY_IDENTIFIER LV_LOCK_DIAG_PCV_2 ECU_ADDRESS 0x7f9bf8 BYTE_ORDER MSB_LAST BIT_MASK 0x200 /end MEASUREMENT
/begin MEASUREMENT fmy_stat_pcv_2.err_info_stat.lv_err_mem "storage in dynamic failure memory of the diagnosis instance PCV_2" UWORD _CNV_S_2_RANGE______383_CM 1 0. 0. 1. DISPLAY_IDENTIFIER LV_ERR_MEM_PCV_2 ECU_ADDRESS 0x7f9bf8 BYTE_ORDER MSB_LAST BIT_MASK 0x80 /end MEASUREMENT
/begin MEASUREMENT fmy_stat_pcv_2.err_info_stat.lv_ready "readiness status of the diagnosis instance PCV_2" UWORD _CNV_S_2_RANGE______383_CM 1 0. 0. 1. DISPLAY_IDENTIFIER LV_READY_PCV_2 ECU_ADDRESS 0x7f9bf8 BYTE_ORDER MSB_LAST BIT_MASK 0x40 /end MEASUREMENT
/begin MEASUREMENT fmy_stat_pcv_2.err_info_stat.lv_end_diag "end of diagnosis of the diagnosis instance PCV_2" UWORD _CNV_S_2_RANGE______383_CM 1 0. 0. 1. DISPLAY_IDENTIFIER LV_END_DIAG_PCV_2 ECU_ADDRESS 0x7f9bf8 BYTE_ORDER MSB_LAST BIT_MASK 0x20 /end MEASUREMENT
/begin MEASUREMENT fmy_stat_pcv_2.err_info_stat.lv_cdn_diag "diagnosis condition of the diagnosis instance PCV_2" UWORD _CNV_S_2_RANGE______383_CM 1 0. 0. 1. DISPLAY_IDENTIFIER LV_CDN_DIAG_PCV_2 ECU_ADDRESS 0x7f9bf8 BYTE_ORDER MSB_LAST BIT_MASK 0x10 /end MEASUREMENT
/begin MEASUREMENT fmy_stat_pcv_2.err_info_stat.err_sym "symptoms of the diagnosis instance PCV_2" UWORD _CNV_S_6_CONV_ERRM__22_CM 1 0. 0. 15. DISPLAY_IDENTIFIER ERR_SYM_PCV_2 ECU_ADDRESS 0x7f9bf8 BYTE_ORDER MSB_LAST BIT_MASK 0xF /end MEASUREMENT
/begin MEASUREMENT lv_err_thr "Error flag of diagnosis instance THR" UBYTE _CNV_S_2_RANGE______23_CM 1 0. 0. 1. DISPLAY_IDENTIFIER LV_ERR_THR ECU_ADDRESS 0x7fb932 /end MEASUREMENT
/begin MEASUREMENT fmy_stat_thr.ctr_abc "anti bounce counter for diagnosis instance THR" UBYTE _CNV_A_R_LINEAR_____1_CM 1 0. 0. 255. DISPLAY_IDENTIFIER CTR_ABC_THR ECU_ADDRESS 0x7f9c0b FORMAT "%3.0" /end MEASUREMENT
/begin MEASUREMENT fmy_stat_thr.ctr_end_diag "counter for end of diagnosis for diagnosis instance THR" UBYTE _CNV_A_R_LINEAR_____1_CM 1 0. 0. 255. DISPLAY_IDENTIFIER CTR_ABC_END_DIAG_THR ECU_ADDRESS 0x7f9c0a FORMAT "%3.0" /end MEASUREMENT
/begin MEASUREMENT fmy_stat_thr.err_info_stat.reserved "" UWORD _CNV_A_R_LINEAR_____0_CM 1 0. 0. 65535. DISPLAY_IDENTIFIER FMY_STAT_THR_ERR_INFO_STAT_RESERVED ECU_ADDRESS 0x7f9c08 BYTE_ORDER MSB_LAST BIT_MASK 0xF800 /end MEASUREMENT
/begin MEASUREMENT fmy_stat_thr.err_info_stat.lv_cdn_diag_stc "Statistical flag for condition of diagnosis of the diagnosis instance THR" UWORD _CNV_S_2_RANGE______383_CM 1 0. 0. 1. DISPLAY_IDENTIFIER LV_CDN_DIAG_STC_THR ECU_ADDRESS 0x7f9c08 BYTE_ORDER MSB_LAST BIT_MASK 0x400 /end MEASUREMENT
/begin MEASUREMENT fmy_stat_thr.err_info_stat.lv_lock_diag "lock flag (CPU load optimisation) of the diagnosis instance THR" UWORD _CNV_S_2_RANGE______383_CM 1 0. 0. 1. DISPLAY_IDENTIFIER LV_LOCK_DIAG_THR ECU_ADDRESS 0x7f9c08 BYTE_ORDER MSB_LAST BIT_MASK 0x200 /end MEASUREMENT
/begin MEASUREMENT fmy_stat_thr.err_info_stat.lv_err_mem "storage in dynamic failure memory of the diagnosis instance THR" UWORD _CNV_S_2_RANGE______383_CM 1 0. 0. 1. DISPLAY_IDENTIFIER LV_ERR_MEM_THR ECU_ADDRESS 0x7f9c08 BYTE_ORDER MSB_LAST BIT_MASK 0x80 /end MEASUREMENT
/begin MEASUREMENT fmy_stat_thr.err_info_stat.lv_ready "readiness status of the diagnosis instance THR" UWORD _CNV_S_2_RANGE______383_CM 1 0. 0. 1. DISPLAY_IDENTIFIER LV_READY_THR ECU_ADDRESS 0x7f9c08 BYTE_ORDER MSB_LAST BIT_MASK 0x40 /end MEASUREMENT
/begin MEASUREMENT fmy_stat_thr.err_info_stat.lv_end_diag "end of diagnosis of the diagnosis instance THR" UWORD _CNV_S_2_RANGE______383_CM 1 0. 0. 1. DISPLAY_IDENTIFIER LV_END_DIAG_THR ECU_ADDRESS 0x7f9c08 BYTE_ORDER MSB_LAST BIT_MASK 0x20 /end MEASUREMENT
/begin MEASUREMENT fmy_stat_thr.err_info_stat.lv_cdn_diag "diagnosis condition of the diagnosis instance THR" UWORD _CNV_S_2_RANGE______383_CM 1 0. 0. 1. DISPLAY_IDENTIFIER LV_CDN_DIAG_THR ECU_ADDRESS 0x7f9c08 BYTE_ORDER MSB_LAST BIT_MASK 0x10 /end MEASUREMENT
/begin MEASUREMENT fmy_stat_thr.err_info_stat.err_sym "symptoms of the diagnosis instance THR" UWORD _CNV_S_6_CONV_ERRM__22_CM 1 0. 0. 15. DISPLAY_IDENTIFIER ERR_SYM_THR ECU_ADDRESS 0x7f9c08 BYTE_ORDER MSB_LAST BIT_MASK 0xF /end MEASUREMENT
/begin MEASUREMENT lv_err_var_cod "Error flag of diagnosis instance VAR_COD" UBYTE _CNV_S_2_RANGE______23_CM 1 0. 0. 1. DISPLAY_IDENTIFIER LV_ERR_VAR_COD ECU_ADDRESS 0x7fb933 /end MEASUREMENT
/begin MEASUREMENT fmy_stat_var_cod.ctr_abc "anti bounce counter for diagnosis instance VAR_COD" UBYTE _CNV_A_R_LINEAR_____1_CM 1 0. 0. 255. DISPLAY_IDENTIFIER CTR_ABC_VAR_COD ECU_ADDRESS 0x7f9c0f FORMAT "%3.0" /end MEASUREMENT
/begin MEASUREMENT fmy_stat_var_cod.ctr_end_diag "counter for end of diagnosis for diagnosis instance VAR_COD" UBYTE _CNV_A_R_LINEAR_____1_CM 1 0. 0. 255. DISPLAY_IDENTIFIER CTR_ABC_END_DIAG_VAR_COD ECU_ADDRESS 0x7f9c0e FORMAT "%3.0" /end MEASUREMENT
/begin MEASUREMENT fmy_stat_var_cod.err_info_stat.reserved "" UWORD _CNV_A_R_LINEAR_____0_CM 1 0. 0. 65535. DISPLAY_IDENTIFIER FMY_STAT_VAR_COD_ERR_INFO_STAT_RESERVED ECU_ADDRESS 0x7f9c0c BYTE_ORDER MSB_LAST BIT_MASK 0xF800 /end MEASUREMENT
/begin MEASUREMENT fmy_stat_var_cod.err_info_stat.lv_cdn_diag_stc "Statistical flag for condition of diagnosis of the diagnosis instance VAR_COD" UWORD _CNV_S_2_RANGE______383_CM 1 0. 0. 1. DISPLAY_IDENTIFIER LV_CDN_DIAG_STC_VAR_COD ECU_ADDRESS 0x7f9c0c BYTE_ORDER MSB_LAST BIT_MASK 0x400 /end MEASUREMENT
/begin MEASUREMENT fmy_stat_var_cod.err_info_stat.lv_lock_diag "lock flag (CPU load optimisation) of the diagnosis instance VAR_COD" UWORD _CNV_S_2_RANGE______383_CM 1 0. 0. 1. DISPLAY_IDENTIFIER LV_LOCK_DIAG_VAR_COD ECU_ADDRESS 0x7f9c0c BYTE_ORDER MSB_LAST BIT_MASK 0x200 /end MEASUREMENT
/begin MEASUREMENT fmy_stat_var_cod.err_info_stat.lv_err_mem "storage in dynamic failure memory of the diagnosis instance VAR_COD" UWORD _CNV_S_2_RANGE______383_CM 1 0. 0. 1. DISPLAY_IDENTIFIER LV_ERR_MEM_VAR_COD ECU_ADDRESS 0x7f9c0c BYTE_ORDER MSB_LAST BIT_MASK 0x80 /end MEASUREMENT
/begin MEASUREMENT fmy_stat_var_cod.err_info_stat.lv_ready "readiness status of the diagnosis instance VAR_COD" UWORD _CNV_S_2_RANGE______383_CM 1 0. 0. 1. DISPLAY_IDENTIFIER LV_READY_VAR_COD ECU_ADDRESS 0x7f9c0c BYTE_ORDER MSB_LAST BIT_MASK 0x40 /end MEASUREMENT
/begin MEASUREMENT fmy_stat_var_cod.err_info_stat.lv_end_diag "end of diagnosis of the diagnosis instance VAR_COD" UWORD _CNV_S_2_RANGE______383_CM 1 0. 0. 1. DISPLAY_IDENTIFIER LV_END_DIAG_VAR_COD ECU_ADDRESS 0x7f9c0c BYTE_ORDER MSB_LAST BIT_MASK 0x20 /end MEASUREMENT
/begin MEASUREMENT fmy_stat_var_cod.err_info_stat.lv_cdn_diag "diagnosis condition of the diagnosis instance VAR_COD" UWORD _CNV_S_2_RANGE______383_CM 1 0. 0. 1. DISPLAY_IDENTIFIER LV_CDN_DIAG_VAR_COD ECU_ADDRESS 0x7f9c0c BYTE_ORDER MSB_LAST BIT_MASK 0x10 /end MEASUREMENT
/begin MEASUREMENT fmy_stat_var_cod.err_info_stat.err_sym "symptoms of the diagnosis instance VAR_COD" UWORD _CNV_S_6_CONV_ERRM__22_CM 1 0. 0. 15. DISPLAY_IDENTIFIER ERR_SYM_VAR_COD ECU_ADDRESS 0x7f9c0c BYTE_ORDER MSB_LAST BIT_MASK 0xF /end MEASUREMENT
/begin MEASUREMENT lv_err_vcv_2 "Error flag of diagnosis instance VCV_2" UBYTE _CNV_S_2_RANGE______23_CM 1 0. 0. 1. DISPLAY_IDENTIFIER LV_ERR_VCV_2 ECU_ADDRESS 0x7fb936 /end MEASUREMENT
/begin MEASUREMENT fmy_stat_vcv_2.ctr_abc "anti bounce counter for diagnosis instance VCV_2" UBYTE _CNV_A_R_LINEAR_____1_CM 1 0. 0. 255. DISPLAY_IDENTIFIER CTR_ABC_VCV_2 ECU_ADDRESS 0x7f9c1b FORMAT "%3.0" /end MEASUREMENT
/begin MEASUREMENT fmy_stat_vcv_2.ctr_end_diag "counter for end of diagnosis for diagnosis instance VCV_2" UBYTE _CNV_A_R_LINEAR_____1_CM 1 0. 0. 255. DISPLAY_IDENTIFIER CTR_ABC_END_DIAG_VCV_2 ECU_ADDRESS 0x7f9c1a FORMAT "%3.0" /end MEASUREMENT
/begin MEASUREMENT fmy_stat_vcv_2.err_info_stat.reserved "" UWORD _CNV_A_R_LINEAR_____0_CM 1 0. 0. 65535. DISPLAY_IDENTIFIER FMY_STAT_VCV_2_ERR_INFO_STAT_RESERVED ECU_ADDRESS 0x7f9c18 BYTE_ORDER MSB_LAST BIT_MASK 0xF800 /end MEASUREMENT
/begin MEASUREMENT fmy_stat_vcv_2.err_info_stat.lv_cdn_diag_stc "Statistical flag for condition of diagnosis of the diagnosis instance VCV_2" UWORD _CNV_S_2_RANGE______383_CM 1 0. 0. 1. DISPLAY_IDENTIFIER LV_CDN_DIAG_STC_VCV_2 ECU_ADDRESS 0x7f9c18 BYTE_ORDER MSB_LAST BIT_MASK 0x400 /end MEASUREMENT
/begin MEASUREMENT fmy_stat_vcv_2.err_info_stat.lv_lock_diag "lock flag (CPU load optimisation) of the diagnosis instance VCV_2" UWORD _CNV_S_2_RANGE______383_CM 1 0. 0. 1. DISPLAY_IDENTIFIER LV_LOCK_DIAG_VCV_2 ECU_ADDRESS 0x7f9c18 BYTE_ORDER MSB_LAST BIT_MASK 0x200 /end MEASUREMENT
/begin MEASUREMENT fmy_stat_vcv_2.err_info_stat.lv_err_mem "storage in dynamic failure memory of the diagnosis instance VCV_2" UWORD _CNV_S_2_RANGE______383_CM 1 0. 0. 1. DISPLAY_IDENTIFIER LV_ERR_MEM_VCV_2 ECU_ADDRESS 0x7f9c18 BYTE_ORDER MSB_LAST BIT_MASK 0x80 /end MEASUREMENT
/begin MEASUREMENT fmy_stat_vcv_2.err_info_stat.lv_ready "readiness status of the diagnosis instance VCV_2" UWORD _CNV_S_2_RANGE______383_CM 1 0. 0. 1. DISPLAY_IDENTIFIER LV_READY_VCV_2 ECU_ADDRESS 0x7f9c18 BYTE_ORDER MSB_LAST BIT_MASK 0x40 /end MEASUREMENT
/begin MEASUREMENT fmy_stat_vcv_2.err_info_stat.lv_end_diag "end of diagnosis of the diagnosis instance VCV_2" UWORD _CNV_S_2_RANGE______383_CM 1 0. 0. 1. DISPLAY_IDENTIFIER LV_END_DIAG_VCV_2 ECU_ADDRESS 0x7f9c18 BYTE_ORDER MSB_LAST BIT_MASK 0x20 /end MEASUREMENT
/begin MEASUREMENT fmy_stat_vcv_2.err_info_stat.lv_cdn_diag "diagnosis condition of the diagnosis instance VCV_2" UWORD _CNV_S_2_RANGE______383_CM 1 0. 0. 1. DISPLAY_IDENTIFIER LV_CDN_DIAG_VCV_2 ECU_ADDRESS 0x7f9c18 BYTE_ORDER MSB_LAST BIT_MASK 0x10 /end MEASUREMENT
/begin MEASUREMENT fmy_stat_vcv_2.err_info_stat.err_sym "symptoms of the diagnosis instance VCV_2" UWORD _CNV_S_6_CONV_ERRM__22_CM 1 0. 0. 15. DISPLAY_IDENTIFIER ERR_SYM_VCV_2 ECU_ADDRESS 0x7f9c18 BYTE_ORDER MSB_LAST BIT_MASK 0xF /end MEASUREMENT
/begin COMPU_METHOD _CNV_A_R_LINEAR_____0_CM "" RAT_FUNC "%6.3" "[-]" COEFFS 0 1. 0. 0 0 1 /end COMPU_METHOD
/begin COMPU_METHOD _CNV_A_R_LINEAR_____1_CM "" RAT_FUNC "%6.3" "-" COEFFS 0 1. 0. 0 0 1 /end COMPU_METHOD
/begin COMPU_METHOD _CNV_S_6_CONV_ERRM__22_CM "" TAB_VERB "%6.3" "[-]" COMPU_TAB_REF _CNV_S_6_CONV_ERRM__22 /end COMPU_METHOD
/begin COMPU_VTAB _CNV_S_6_CONV_ERRM__22 "" TAB_VERB 6 0 "NO_SYM" 1 "SYM_0" 2 "SYM_1" 4 "SYM_2" 8 "SYM_3" 15 "BENCH_MODE" /end COMPU_VTAB
/begin COMPU_METHOD _CNV_S_2_RANGE______23_CM "" TAB_VERB "%6.3" "[-]" COMPU_TAB_REF _CNV_S_2_RANGE______23 /end COMPU_METHOD
/begin COMPU_VTAB _CNV_S_2_RANGE______23 "" TAB_VERB 2 0 "passive" 1 "active" /end COMPU_VTAB
/begin COMPU_METHOD _CNV_S_2_RANGE______383_CM "" TAB_VERB "%6.3" "-" COMPU_TAB_REF _CNV_S_2_RANGE______383 /end COMPU_METHOD
/begin COMPU_VTAB _CNV_S_2_RANGE______383 "" TAB_VERB 2 0 "passive" 1 "active" /end COMPU_VTAB
/begin FUNCTION ERRM_AMAFPLAD "Error Management data for diagnosis AMAFPLAD"
 /begin OUT_MEASUREMENT lv_err_maf_kgh_plaus fmy_stat_maf_kgh_plaus.ctr_abc fmy_stat_maf_kgh_plaus.ctr_end_diag fmy_stat_maf_kgh_plaus.err_info_stat.reserved fmy_stat_maf_kgh_plaus.err_info_stat.lv_cdn_diag_stc fmy_stat_maf_kgh_plaus.err_info_stat.lv_lock_diag fmy_stat_maf_kgh_plaus.err_info_stat.lv_err_mem fmy_stat_maf_kgh_plaus.err_info_stat.lv_ready fmy_stat_maf_kgh_plaus.err_info_stat.lv_end_diag fmy_stat_maf_kgh_plaus.err_info_stat.lv_cdn_diag fmy_stat_maf_kgh_plaus.err_info_stat.err_sym /end OUT_MEASUREMENT
/end FUNCTION
/begin FUNCTION ERRM_AMAFANAD "Error Management data for diagnosis AMAFANAD"
 /begin OUT_MEASUREMENT lv_err_maf_0_rng fmy_stat_maf_0_rng.ctr_abc fmy_stat_maf_0_rng.ctr_end_diag fmy_stat_maf_0_rng.err_info_stat.reserved fmy_stat_maf_0_rng.err_info_stat.lv_cdn_diag_stc fmy_stat_maf_0_rng.err_info_stat.lv_lock_diag fmy_stat_maf_0_rng.err_info_stat.lv_err_mem fmy_stat_maf_0_rng.err_info_stat.lv_ready fmy_stat_maf_0_rng.err_info_stat.lv_end_diag fmy_stat_maf_0_rng.err_info_stat.lv_cdn_diag fmy_stat_maf_0_rng.err_info_stat.err_sym /end OUT_MEASUREMENT
/end FUNCTION
/begin FUNCTION ERRM_ATPCDIAG "Error Management data for diagnosis ATPCDIAG"
 /begin OUT_MEASUREMENT lv_err_v_tpc_rng fmy_stat_v_tpc_rng.ctr_abc fmy_stat_v_tpc_rng.ctr_end_diag fmy_stat_v_tpc_rng.err_info_stat.reserved fmy_stat_v_tpc_rng.err_info_stat.lv_cdn_diag_stc fmy_stat_v_tpc_rng.err_info_stat.lv_lock_diag fmy_stat_v_tpc_rng.err_info_stat.lv_err_mem fmy_stat_v_tpc_rng.err_info_stat.lv_ready fmy_stat_v_tpc_rng.err_info_stat.lv_end_diag fmy_stat_v_tpc_rng.err_info_stat.lv_cdn_diag fmy_stat_v_tpc_rng.err_info_stat.err_sym lv_err_tpc_mes_plaus fmy_stat_tpc_mes_plaus.ctr_abc fmy_stat_tpc_mes_plaus.ctr_end_diag fmy_stat_tpc_mes_plaus.err_info_stat.reserved fmy_stat_tpc_mes_plaus.err_info_stat.lv_cdn_diag_stc fmy_stat_tpc_mes_plaus.err_info_stat.lv_lock_diag fmy_stat_tpc_mes_plaus.err_info_stat.lv_err_mem fmy_stat_tpc_mes_plaus.err_info_stat.lv_ready fmy_stat_tpc_mes_plaus.err_info_stat.lv_end_diag fmy_stat_tpc_mes_plaus.err_info_stat.lv_cdn_diag fmy_stat_tpc_mes_plaus.err_info_stat.err_sym /end OUT_MEASUREMENT
/end FUNCTION
/begin FUNCTION ERRM_ATACDIAG "Error Management data for diagnosis ATACDIAG"
 /begin OUT_MEASUREMENT lv_err_v_tac_rng fmy_stat_v_tac_rng.ctr_abc fmy_stat_v_tac_rng.ctr_end_diag fmy_stat_v_tac_rng.err_info_stat.reserved fmy_stat_v_tac_rng.err_info_stat.lv_cdn_diag_stc fmy_stat_v_tac_rng.err_info_stat.lv_lock_diag fmy_stat_v_tac_rng.err_info_stat.lv_err_mem fmy_stat_v_tac_rng.err_info_stat.lv_ready fmy_stat_v_tac_rng.err_info_stat.lv_end_diag fmy_stat_v_tac_rng.err_info_stat.lv_cdn_diag fmy_stat_v_tac_rng.err_info_stat.err_sym lv_err_tac_mes_grd fmy_stat_tac_mes_grd.ctr_abc fmy_stat_tac_mes_grd.ctr_end_diag fmy_stat_tac_mes_grd.err_info_stat.reserved fmy_stat_tac_mes_grd.err_info_stat.lv_cdn_diag_stc fmy_stat_tac_mes_grd.err_info_stat.lv_lock_diag fmy_stat_tac_mes_grd.err_info_stat.lv_err_mem fmy_stat_tac_mes_grd.err_info_stat.lv_ready fmy_stat_tac_mes_grd.err_info_stat.lv_end_diag fmy_stat_tac_mes_grd.err_info_stat.lv_cdn_diag fmy_stat_tac_mes_grd.err_info_stat.err_sym /end OUT_MEASUREMENT
/end FUNCTION
/begin FUNCTION ERRM_AOBDFSD "Error Management data for diagnosis AOBDFSD"
 /begin OUT_MEASUREMENT lv_err_mf_is_obd fmy_stat_mf_is_obd.ctr_abc fmy_stat_mf_is_obd.ctr_end_diag fmy_stat_mf_is_obd.err_info_stat.reserved fmy_stat_mf_is_obd.err_info_stat.lv_cdn_diag_stc fmy_stat_mf_is_obd.err_info_stat.lv_lock_diag fmy_stat_mf_is_obd.err_info_stat.lv_err_mem fmy_stat_mf_is_obd.err_info_stat.lv_ready fmy_stat_mf_is_obd.err_info_stat.lv_end_diag fmy_stat_mf_is_obd.err_info_stat.lv_cdn_diag fmy_stat_mf_is_obd.err_info_stat.err_sym /end OUT_MEASUREMENT
/end FUNCTION
/begin FUNCTION ERRM_ACYBDIAG "Error Management data for diagnosis ACYBDIAG"
 /begin OUT_MEASUREMENT lv_err_cyl_bal_0 fmy_stat_cyl_bal_0.ctr_abc fmy_stat_cyl_bal_0.ctr_end_diag fmy_stat_cyl_bal_0.err_info_stat.reserved fmy_stat_cyl_bal_0.err_info_stat.lv_cdn_diag_stc fmy_stat_cyl_bal_0.err_info_stat.lv_lock_diag fmy_stat_cyl_bal_0.err_info_stat.lv_err_mem fmy_stat_cyl_bal_0.err_info_stat.lv_ready fmy_stat_cyl_bal_0.err_info_stat.lv_end_diag fmy_stat_cyl_bal_0.err_info_stat.lv_cdn_diag fmy_stat_cyl_bal_0.err_info_stat.err_sym lv_err_cyl_bal_1 fmy_stat_cyl_bal_1.ctr_abc fmy_stat_cyl_bal_1.ctr_end_diag fmy_stat_cyl_bal_1.err_info_stat.reserved fmy_stat_cyl_bal_1.err_info_stat.lv_cdn_diag_stc fmy_stat_cyl_bal_1.err_info_stat.lv_lock_diag fmy_stat_cyl_bal_1.err_info_stat.lv_err_mem fmy_stat_cyl_bal_1.err_info_stat.lv_ready fmy_stat_cyl_bal_1.err_info_stat.lv_end_diag fmy_stat_cyl_bal_1.err_info_stat.lv_cdn_diag fmy_stat_cyl_bal_1.err_info_stat.err_sym lv_err_cyl_bal_2 fmy_stat_cyl_bal_2.ctr_abc fmy_stat_cyl_bal_2.ctr_end_diag fmy_stat_cyl_bal_2.err_info_stat.reserved fmy_stat_cyl_bal_2.err_info_stat.lv_cdn_diag_stc fmy_stat_cyl_bal_2.err_info_stat.lv_lock_diag fmy_stat_cyl_bal_2.err_info_stat.lv_err_mem fmy_stat_cyl_bal_2.err_info_stat.lv_ready fmy_stat_cyl_bal_2.err_info_stat.lv_end_diag fmy_stat_cyl_bal_2.err_info_stat.lv_cdn_diag fmy_stat_cyl_bal_2.err_info_stat.err_sym lv_err_cyl_bal_3 fmy_stat_cyl_bal_3.ctr_abc fmy_stat_cyl_bal_3.ctr_end_diag fmy_stat_cyl_bal_3.err_info_stat.reserved fmy_stat_cyl_bal_3.err_info_stat.lv_cdn_diag_stc fmy_stat_cyl_bal_3.err_info_stat.lv_lock_diag fmy_stat_cyl_bal_3.err_info_stat.lv_err_mem fmy_stat_cyl_bal_3.err_info_stat.lv_ready fmy_stat_cyl_bal_3.err_info_stat.lv_end_diag fmy_stat_cyl_bal_3.err_info_stat.lv_cdn_diag fmy_stat_cyl_bal_3.err_info_stat.err_sym /end OUT_MEASUREMENT
/end FUNCTION
/begin FUNCTION ERRM_AEGRVCAD "Error Management data for diagnosis AEGRVCAD"
 /begin OUT_MEASUREMENT lv_err_egrv_0_ctl fmy_stat_egrv_0_ctl.ctr_abc fmy_stat_egrv_0_ctl.ctr_end_diag fmy_stat_egrv_0_ctl.err_info_stat.reserved fmy_stat_egrv_0_ctl.err_info_stat.lv_cdn_diag_stc fmy_stat_egrv_0_ctl.err_info_stat.lv_lock_diag fmy_stat_egrv_0_ctl.err_info_stat.lv_err_mem fmy_stat_egrv_0_ctl.err_info_stat.lv_ready fmy_stat_egrv_0_ctl.err_info_stat.lv_end_diag fmy_stat_egrv_0_ctl.err_info_stat.lv_cdn_diag fmy_stat_egrv_0_ctl.err_info_stat.err_sym lv_err_v_egrv_0_bol_ad fmy_stat_v_egrv_0_bol_ad.ctr_abc fmy_stat_v_egrv_0_bol_ad.ctr_end_diag fmy_stat_v_egrv_0_bol_ad.err_info_stat.reserved fmy_stat_v_egrv_0_bol_ad.err_info_stat.lv_cdn_diag_stc fmy_stat_v_egrv_0_bol_ad.err_info_stat.lv_lock_diag fmy_stat_v_egrv_0_bol_ad.err_info_stat.lv_err_mem fmy_stat_v_egrv_0_bol_ad.err_info_stat.lv_ready fmy_stat_v_egrv_0_bol_ad.err_info_stat.lv_end_diag fmy_stat_v_egrv_0_bol_ad.err_info_stat.lv_cdn_diag fmy_stat_v_egrv_0_bol_ad.err_info_stat.err_sym /end OUT_MEASUREMENT
/end FUNCTION
/begin FUNCTION ERRM_ATHRCAD "Error Management data for diagnosis ATHRCAD"
 /begin OUT_MEASUREMENT lv_err_thr_0_ctl fmy_stat_thr_0_ctl.ctr_abc fmy_stat_thr_0_ctl.ctr_end_diag fmy_stat_thr_0_ctl.err_info_stat.reserved fmy_stat_thr_0_ctl.err_info_stat.lv_cdn_diag_stc fmy_stat_thr_0_ctl.err_info_stat.lv_lock_diag fmy_stat_thr_0_ctl.err_info_stat.lv_err_mem fmy_stat_thr_0_ctl.err_info_stat.lv_ready fmy_stat_thr_0_ctl.err_info_stat.lv_end_diag fmy_stat_thr_0_ctl.err_info_stat.lv_cdn_diag fmy_stat_thr_0_ctl.err_info_stat.err_sym lv_err_v_thr_0_bol_ad fmy_stat_v_thr_0_bol_ad.ctr_abc fmy_stat_v_thr_0_bol_ad.ctr_end_diag fmy_stat_v_thr_0_bol_ad.err_info_stat.reserved fmy_stat_v_thr_0_bol_ad.err_info_stat.lv_cdn_diag_stc fmy_stat_v_thr_0_bol_ad.err_info_stat.lv_lock_diag fmy_stat_v_thr_0_bol_ad.err_info_stat.lv_err_mem fmy_stat_v_thr_0_bol_ad.err_info_stat.lv_ready fmy_stat_v_thr_0_bol_ad.err_info_stat.lv_end_diag fmy_stat_v_thr_0_bol_ad.err_info_stat.lv_cdn_diag fmy_stat_v_thr_0_bol_ad.err_info_stat.err_sym /end OUT_MEASUREMENT
/end FUNCTION
/begin FUNCTION ERRM_ABPACAD "Error Management data for diagnosis ABPACAD"
 /begin OUT_MEASUREMENT lv_err_bpa_0_ctl fmy_stat_bpa_0_ctl.ctr_abc fmy_stat_bpa_0_ctl.ctr_end_diag fmy_stat_bpa_0_ctl.err_info_stat.reserved fmy_stat_bpa_0_ctl.err_info_stat.lv_cdn_diag_stc fmy_stat_bpa_0_ctl.err_info_stat.lv_lock_diag fmy_stat_bpa_0_ctl.err_info_stat.lv_err_mem fmy_stat_bpa_0_ctl.err_info_stat.lv_ready fmy_stat_bpa_0_ctl.err_info_stat.lv_end_diag fmy_stat_bpa_0_ctl.err_info_stat.lv_cdn_diag fmy_stat_bpa_0_ctl.err_info_stat.err_sym lv_err_v_bpa_0_bol_ad fmy_stat_v_bpa_0_bol_ad.ctr_abc fmy_stat_v_bpa_0_bol_ad.ctr_end_diag fmy_stat_v_bpa_0_bol_ad.err_info_stat.reserved fmy_stat_v_bpa_0_bol_ad.err_info_stat.lv_cdn_diag_stc fmy_stat_v_bpa_0_bol_ad.err_info_stat.lv_lock_diag fmy_stat_v_bpa_0_bol_ad.err_info_stat.lv_err_mem fmy_stat_v_bpa_0_bol_ad.err_info_stat.lv_ready fmy_stat_v_bpa_0_bol_ad.err_info_stat.lv_end_diag fmy_stat_v_bpa_0_bol_ad.err_info_stat.lv_cdn_diag fmy_stat_v_bpa_0_bol_ad.err_info_stat.err_sym /end OUT_MEASUREMENT
/end FUNCTION
/begin FUNCTION ERRM_ABYPCAD "Error Management data for diagnosis ABYPCAD"
 /begin OUT_MEASUREMENT lv_err_byp_0_ctl fmy_stat_byp_0_ctl.ctr_abc fmy_stat_byp_0_ctl.ctr_end_diag fmy_stat_byp_0_ctl.err_info_stat.reserved fmy_stat_byp_0_ctl.err_info_stat.lv_cdn_diag_stc fmy_stat_byp_0_ctl.err_info_stat.lv_lock_diag fmy_stat_byp_0_ctl.err_info_stat.lv_err_mem fmy_stat_byp_0_ctl.err_info_stat.lv_ready fmy_stat_byp_0_ctl.err_info_stat.lv_end_diag fmy_stat_byp_0_ctl.err_info_stat.lv_cdn_diag fmy_stat_byp_0_ctl.err_info_stat.err_sym lv_err_v_byp_0_bol_ad fmy_stat_v_byp_0_bol_ad.ctr_abc fmy_stat_v_byp_0_bol_ad.ctr_end_diag fmy_stat_v_byp_0_bol_ad.err_info_stat.reserved fmy_stat_v_byp_0_bol_ad.err_info_stat.lv_cdn_diag_stc fmy_stat_v_byp_0_bol_ad.err_info_stat.lv_lock_diag fmy_stat_v_byp_0_bol_ad.err_info_stat.lv_err_mem fmy_stat_v_byp_0_bol_ad.err_info_stat.lv_ready fmy_stat_v_byp_0_bol_ad.err_info_stat.lv_end_diag fmy_stat_v_byp_0_bol_ad.err_info_stat.lv_cdn_diag fmy_stat_v_byp_0_bol_ad.err_info_stat.err_sym /end OUT_MEASUREMENT
/end FUNCTION
/begin FUNCTION ERRM_AMAPCTLD "Error Management data for diagnosis AMAPCTLD"
 /begin OUT_MEASUREMENT lv_err_map_ctl_min fmy_stat_map_ctl_min.ctr_abc fmy_stat_map_ctl_min.ctr_end_diag fmy_stat_map_ctl_min.err_info_stat.reserved fmy_stat_map_ctl_min.err_info_stat.lv_cdn_diag_stc fmy_stat_map_ctl_min.err_info_stat.lv_lock_diag fmy_stat_map_ctl_min.err_info_stat.lv_err_mem fmy_stat_map_ctl_min.err_info_stat.lv_ready fmy_stat_map_ctl_min.err_info_stat.lv_end_diag fmy_stat_map_ctl_min.err_info_stat.lv_cdn_diag fmy_stat_map_ctl_min.err_info_stat.err_sym lv_err_map_ctl_max fmy_stat_map_ctl_max.ctr_abc fmy_stat_map_ctl_max.ctr_end_diag fmy_stat_map_ctl_max.err_info_stat.reserved fmy_stat_map_ctl_max.err_info_stat.lv_cdn_diag_stc fmy_stat_map_ctl_max.err_info_stat.lv_lock_diag fmy_stat_map_ctl_max.err_info_stat.lv_err_mem fmy_stat_map_ctl_max.err_info_stat.lv_ready fmy_stat_map_ctl_max.err_info_stat.lv_end_diag fmy_stat_map_ctl_max.err_info_stat.lv_cdn_diag fmy_stat_map_ctl_max.err_info_stat.err_sym /end OUT_MEASUREMENT
/end FUNCTION
/begin FUNCTION ERRM_ERRM_DIAG "Error Management data for diagnosis ERRM_DIAG"
 /begin OUT_MEASUREMENT lv_err_egr_is_slow_obd fmy_stat_egr_is_slow_obd.ctr_abc fmy_stat_egr_is_slow_obd.ctr_end_diag fmy_stat_egr_is_slow_obd.err_info_stat.reserved fmy_stat_egr_is_slow_obd.err_info_stat.lv_cdn_diag_stc fmy_stat_egr_is_slow_obd.err_info_stat.lv_lock_diag fmy_stat_egr_is_slow_obd.err_info_stat.lv_err_mem fmy_stat_egr_is_slow_obd.err_info_stat.lv_ready fmy_stat_egr_is_slow_obd.err_info_stat.lv_end_diag fmy_stat_egr_is_slow_obd.err_info_stat.lv_cdn_diag fmy_stat_egr_is_slow_obd.err_info_stat.err_sym lv_err_egrv fmy_stat_egrv.ctr_abc fmy_stat_egrv.ctr_end_diag fmy_stat_egrv.err_info_stat.reserved fmy_stat_egrv.err_info_stat.lv_cdn_diag_stc fmy_stat_egrv.err_info_stat.lv_lock_diag fmy_stat_egrv.err_info_stat.lv_err_mem fmy_stat_egrv.err_info_stat.lv_ready fmy_stat_egrv.err_info_stat.lv_end_diag fmy_stat_egrv.err_info_stat.lv_cdn_diag fmy_stat_egrv.err_info_stat.err_sym lv_err_fsd_1 fmy_stat_fsd_1.ctr_abc fmy_stat_fsd_1.ctr_end_diag fmy_stat_fsd_1.err_info_stat.reserved fmy_stat_fsd_1.err_info_stat.lv_cdn_diag_stc fmy_stat_fsd_1.err_info_stat.lv_lock_diag fmy_stat_fsd_1.err_info_stat.lv_err_mem fmy_stat_fsd_1.err_info_stat.lv_ready fmy_stat_fsd_1.err_info_stat.lv_end_diag fmy_stat_fsd_1.err_info_stat.lv_cdn_diag fmy_stat_fsd_1.err_info_stat.err_sym lv_err_mis_a fmy_stat_mis_a.ctr_abc fmy_stat_mis_a.ctr_end_diag fmy_stat_mis_a.err_info_stat.reserved fmy_stat_mis_a.err_info_stat.lv_cdn_diag_stc fmy_stat_mis_a.err_info_stat.lv_lock_diag fmy_stat_mis_a.err_info_stat.lv_err_mem fmy_stat_mis_a.err_info_stat.lv_ready fmy_stat_mis_a.err_info_stat.lv_end_diag fmy_stat_mis_a.err_info_stat.lv_cdn_diag fmy_stat_mis_a.err_info_stat.err_sym lv_err_mis_b1 fmy_stat_mis_b1.ctr_abc fmy_stat_mis_b1.ctr_end_diag fmy_stat_mis_b1.err_info_stat.reserved fmy_stat_mis_b1.err_info_stat.lv_cdn_diag_stc fmy_stat_mis_b1.err_info_stat.lv_lock_diag fmy_stat_mis_b1.err_info_stat.lv_err_mem fmy_stat_mis_b1.err_info_stat.lv_ready fmy_stat_mis_b1.err_info_stat.lv_end_diag fmy_stat_mis_b1.err_info_stat.lv_cdn_diag fmy_stat_mis_b1.err_info_stat.err_sym lv_err_mis_b4 fmy_stat_mis_b4.ctr_abc fmy_stat_mis_b4.ctr_end_diag fmy_stat_mis_b4.err_info_stat.reserved fmy_stat_mis_b4.err_info_stat.lv_cdn_diag_stc fmy_stat_mis_b4.err_info_stat.lv_lock_diag fmy_stat_mis_b4.err_info_stat.lv_err_mem fmy_stat_mis_b4.err_info_stat.lv_ready fmy_stat_mis_b4.err_info_stat.lv_end_diag fmy_stat_mis_b4.err_info_stat.lv_cdn_diag fmy_stat_mis_b4.err_info_stat.err_sym lv_err_pcv_2 fmy_stat_pcv_2.ctr_abc fmy_stat_pcv_2.ctr_end_diag fmy_stat_pcv_2.err_info_stat.reserved fmy_stat_pcv_2.err_info_stat.lv_cdn_diag_stc fmy_stat_pcv_2.err_info_stat.lv_lock_diag fmy_stat_pcv_2.err_info_stat.lv_err_mem fmy_stat_pcv_2.err_info_stat.lv_ready fmy_stat_pcv_2.err_info_stat.lv_end_diag fmy_stat_pcv_2.err_info_stat.lv_cdn_diag fmy_stat_pcv_2.err_info_stat.err_sym lv_err_thr fmy_stat_thr.ctr_abc fmy_stat_thr.ctr_end_diag fmy_stat_thr.err_info_stat.reserved fmy_stat_thr.err_info_stat.lv_cdn_diag_stc fmy_stat_thr.err_info_stat.lv_lock_diag fmy_stat_thr.err_info_stat.lv_err_mem fmy_stat_thr.err_info_stat.lv_ready fmy_stat_thr.err_info_stat.lv_end_diag fmy_stat_thr.err_info_stat.lv_cdn_diag fmy_stat_thr.err_info_stat.err_sym lv_err_var_cod fmy_stat_var_cod.ctr_abc fmy_stat_var_cod.ctr_end_diag fmy_stat_var_cod.err_info_stat.reserved fmy_stat_var_cod.err_info_stat.lv_cdn_diag_stc fmy_stat_var_cod.err_info_stat.lv_lock_diag fmy_stat_var_cod.err_info_stat.lv_err_mem fmy_stat_var_cod.err_info_stat.lv_ready fmy_stat_var_cod.err_info_stat.lv_end_diag fmy_stat_var_cod.err_info_stat.lv_cdn_diag fmy_stat_var_cod.err_info_stat.err_sym lv_err_vcv_2 fmy_stat_vcv_2.ctr_abc fmy_stat_vcv_2.ctr_end_diag fmy_stat_vcv_2.err_info_stat.reserved fmy_stat_vcv_2.err_info_stat.lv_cdn_diag_stc fmy_stat_vcv_2.err_info_stat.lv_lock_diag fmy_stat_vcv_2.err_info_stat.lv_err_mem fmy_stat_vcv_2.err_info_stat.lv_ready fmy_stat_vcv_2.err_info_stat.lv_end_diag fmy_stat_vcv_2.err_info_stat.lv_cdn_diag fmy_stat_vcv_2.err_info_stat.err_sym /end OUT_MEASUREMENT
/end FUNCTION
/begin FUNCTION ERRM_AOBDEGR "Error Management data for diagnosis AOBDEGR"
 /begin OUT_MEASUREMENT lv_err_maf_egr_thr_obd fmy_stat_maf_egr_thr_obd.ctr_abc fmy_stat_maf_egr_thr_obd.ctr_end_diag fmy_stat_maf_egr_thr_obd.err_info_stat.reserved fmy_stat_maf_egr_thr_obd.err_info_stat.lv_cdn_diag_stc fmy_stat_maf_egr_thr_obd.err_info_stat.lv_lock_diag fmy_stat_maf_egr_thr_obd.err_info_stat.lv_err_mem fmy_stat_maf_egr_thr_obd.err_info_stat.lv_ready fmy_stat_maf_egr_thr_obd.err_info_stat.lv_end_diag fmy_stat_maf_egr_thr_obd.err_info_stat.lv_cdn_diag fmy_stat_maf_egr_thr_obd.err_info_stat.err_sym lv_err_maf_dif_egr_thr_obd fmy_stat_maf_dif_egr_thr_obd.ctr_abc fmy_stat_maf_dif_egr_thr_obd.ctr_end_diag fmy_stat_maf_dif_egr_thr_obd.err_info_stat.reserved fmy_stat_maf_dif_egr_thr_obd.err_info_stat.lv_cdn_diag_stc fmy_stat_maf_dif_egr_thr_obd.err_info_stat.lv_lock_diag fmy_stat_maf_dif_egr_thr_obd.err_info_stat.lv_err_mem fmy_stat_maf_dif_egr_thr_obd.err_info_stat.lv_ready fmy_stat_maf_dif_egr_thr_obd.err_info_stat.lv_end_diag fmy_stat_maf_dif_egr_thr_obd.err_info_stat.lv_cdn_diag fmy_stat_maf_dif_egr_thr_obd.err_info_stat.err_sym lv_err_map_dif_egr_thr_obd fmy_stat_map_dif_egr_thr_obd.ctr_abc fmy_stat_map_dif_egr_thr_obd.ctr_end_diag fmy_stat_map_dif_egr_thr_obd.err_info_stat.reserved fmy_stat_map_dif_egr_thr_obd.err_info_stat.lv_cdn_diag_stc fmy_stat_map_dif_egr_thr_obd.err_info_stat.lv_lock_diag fmy_stat_map_dif_egr_thr_obd.err_info_stat.lv_err_mem fmy_stat_map_dif_egr_thr_obd.err_info_stat.lv_ready fmy_stat_map_dif_egr_thr_obd.err_info_stat.lv_end_diag fmy_stat_map_dif_egr_thr_obd.err_info_stat.lv_cdn_diag fmy_stat_map_dif_egr_thr_obd.err_info_stat.err_sym /end OUT_MEASUREMENT
/end FUNCTION
/begin FUNCTION ERRM_AVSDIAG "Error Management data for diagnosis AVSDIAG"
 /begin OUT_MEASUREMENT lv_err_vs fmy_stat_vs.ctr_abc fmy_stat_vs.ctr_end_diag fmy_stat_vs.err_info_stat.reserved fmy_stat_vs.err_info_stat.lv_cdn_diag_stc fmy_stat_vs.err_info_stat.lv_lock_diag fmy_stat_vs.err_info_stat.lv_err_mem fmy_stat_vs.err_info_stat.lv_ready fmy_stat_vs.err_info_stat.lv_end_diag fmy_stat_vs.err_info_stat.lv_cdn_diag fmy_stat_vs.err_info_stat.err_sym /end OUT_MEASUREMENT
/end FUNCTION
/begin FUNCTION ERRM_ACSDIAG "Error Management data for diagnosis ACSDIAG"
 /begin OUT_MEASUREMENT lv_err_cs fmy_stat_cs.ctr_abc fmy_stat_cs.ctr_end_diag fmy_stat_cs.err_info_stat.reserved fmy_stat_cs.err_info_stat.lv_cdn_diag_stc fmy_stat_cs.err_info_stat.lv_lock_diag fmy_stat_cs.err_info_stat.lv_err_mem fmy_stat_cs.err_info_stat.lv_ready fmy_stat_cs.err_info_stat.lv_end_diag fmy_stat_cs.err_info_stat.lv_cdn_diag fmy_stat_cs.err_info_stat.err_sym /end OUT_MEASUREMENT
/end FUNCTION
/begin FUNCTION ERRM_ABRAKE_D "Error Management data for diagnosis ABRAKE_D"
 /begin OUT_MEASUREMENT lv_err_bls fmy_stat_bls.ctr_abc fmy_stat_bls.ctr_end_diag fmy_stat_bls.err_info_stat.reserved fmy_stat_bls.err_info_stat.lv_cdn_diag_stc fmy_stat_bls.err_info_stat.lv_lock_diag fmy_stat_bls.err_info_stat.lv_err_mem fmy_stat_bls.err_info_stat.lv_ready fmy_stat_bls.err_info_stat.lv_end_diag fmy_stat_bls.err_info_stat.lv_cdn_diag fmy_stat_bls.err_info_stat.err_sym lv_err_bls_bts_dece fmy_stat_bls_bts_dece.ctr_abc fmy_stat_bls_bts_dece.ctr_end_diag fmy_stat_bls_bts_dece.err_info_stat.reserved fmy_stat_bls_bts_dece.err_info_stat.lv_cdn_diag_stc fmy_stat_bls_bts_dece.err_info_stat.lv_lock_diag fmy_stat_bls_bts_dece.err_info_stat.lv_err_mem fmy_stat_bls_bts_dece.err_info_stat.lv_ready fmy_stat_bls_bts_dece.err_info_stat.lv_end_diag fmy_stat_bls_bts_dece.err_info_stat.lv_cdn_diag fmy_stat_bls_bts_dece.err_info_stat.err_sym lv_err_bls_bts_plaus fmy_stat_bls_bts_plaus.ctr_abc fmy_stat_bls_bts_plaus.ctr_end_diag fmy_stat_bls_bts_plaus.err_info_stat.reserved fmy_stat_bls_bts_plaus.err_info_stat.lv_cdn_diag_stc fmy_stat_bls_bts_plaus.err_info_stat.lv_lock_diag fmy_stat_bls_bts_plaus.err_info_stat.lv_err_mem fmy_stat_bls_bts_plaus.err_info_stat.lv_ready fmy_stat_bls_bts_plaus.err_info_stat.lv_end_diag fmy_stat_bls_bts_plaus.err_info_stat.lv_cdn_diag fmy_stat_bls_bts_plaus.err_info_stat.err_sym /end OUT_MEASUREMENT
/end FUNCTION
/begin FUNCTION ERRM_ACANDGO "Error Management data for diagnosis ACANDGO"
 /begin OUT_MEASUREMENT fmy_stat_can_tcs.ctr_abc fmy_stat_can_tcs.ctr_end_diag fmy_stat_can_tcs.err_info_stat.reserved fmy_stat_can_tcs.err_info_stat.lv_cdn_diag_stc fmy_stat_can_tcs.err_info_stat.lv_lock_diag fmy_stat_can_tcs.err_info_stat.lv_err_mem fmy_stat_can_tcs.err_info_stat.lv_ready fmy_stat_can_tcs.err_info_stat.lv_end_diag fmy_stat_can_tcs.err_info_stat.lv_cdn_diag fmy_stat_can_tcs.err_info_stat.err_sym fmy_stat_can_tcu.ctr_abc fmy_stat_can_tcu.ctr_end_diag fmy_stat_can_tcu.err_info_stat.reserved fmy_stat_can_tcu.err_info_stat.lv_cdn_diag_stc fmy_stat_can_tcu.err_info_stat.lv_lock_diag fmy_stat_can_tcu.err_info_stat.lv_err_mem fmy_stat_can_tcu.err_info_stat.lv_ready fmy_stat_can_tcu.err_info_stat.lv_end_diag fmy_stat_can_tcu.err_info_stat.lv_cdn_diag fmy_stat_can_tcu.err_info_stat.err_sym fmy_stat_can_acu.ctr_abc fmy_stat_can_acu.ctr_end_diag fmy_stat_can_acu.err_info_stat.reserved fmy_stat_can_acu.err_info_stat.lv_cdn_diag_stc fmy_stat_can_acu.err_info_stat.lv_lock_diag fmy_stat_can_acu.err_info_stat.lv_err_mem fmy_stat_can_acu.err_info_stat.lv_ready fmy_stat_can_acu.err_info_stat.lv_end_diag fmy_stat_can_acu.err_info_stat.lv_cdn_diag fmy_stat_can_acu.err_info_stat.err_sym fmy_stat_can_ccu.ctr_abc fmy_stat_can_ccu.ctr_end_diag fmy_stat_can_ccu.err_info_stat.reserved fmy_stat_can_ccu.err_info_stat.lv_cdn_diag_stc fmy_stat_can_ccu.err_info_stat.lv_lock_diag fmy_stat_can_ccu.err_info_stat.lv_err_mem fmy_stat_can_ccu.err_info_stat.lv_ready fmy_stat_can_ccu.err_info_stat.lv_end_diag fmy_stat_can_ccu.err_info_stat.lv_cdn_diag fmy_stat_can_ccu.err_info_stat.err_sym fmy_stat_can_icl.ctr_abc fmy_stat_can_icl.ctr_end_diag fmy_stat_can_icl.err_info_stat.reserved fmy_stat_can_icl.err_info_stat.lv_cdn_diag_stc fmy_stat_can_icl.err_info_stat.lv_lock_diag fmy_stat_can_icl.err_info_stat.lv_err_mem fmy_stat_can_icl.err_info_stat.lv_ready fmy_stat_can_icl.err_info_stat.lv_end_diag fmy_stat_can_icl.err_info_stat.lv_cdn_diag fmy_stat_can_icl.err_info_stat.err_sym fmy_stat_can_vecu.ctr_abc fmy_stat_can_vecu.ctr_end_diag fmy_stat_can_vecu.err_info_stat.reserved fmy_stat_can_vecu.err_info_stat.lv_cdn_diag_stc fmy_stat_can_vecu.err_info_stat.lv_lock_diag fmy_stat_can_vecu.err_info_stat.lv_err_mem fmy_stat_can_vecu.err_info_stat.lv_ready fmy_stat_can_vecu.err_info_stat.lv_end_diag fmy_stat_can_vecu.err_info_stat.lv_cdn_diag fmy_stat_can_vecu.err_info_stat.err_sym fmy_stat_can_smls.ctr_abc fmy_stat_can_smls.ctr_end_diag fmy_stat_can_smls.err_info_stat.reserved fmy_stat_can_smls.err_info_stat.lv_cdn_diag_stc fmy_stat_can_smls.err_info_stat.lv_lock_diag fmy_stat_can_smls.err_info_stat.lv_err_mem fmy_stat_can_smls.err_info_stat.lv_ready fmy_stat_can_smls.err_info_stat.lv_end_diag fmy_stat_can_smls.err_info_stat.lv_cdn_diag fmy_stat_can_smls.err_info_stat.err_sym fmy_stat_can_boff.ctr_abc fmy_stat_can_boff.ctr_end_diag fmy_stat_can_boff.err_info_stat.reserved fmy_stat_can_boff.err_info_stat.lv_cdn_diag_stc fmy_stat_can_boff.err_info_stat.lv_lock_diag fmy_stat_can_boff.err_info_stat.lv_err_mem fmy_stat_can_boff.err_info_stat.lv_ready fmy_stat_can_boff.err_info_stat.lv_end_diag fmy_stat_can_boff.err_info_stat.lv_cdn_diag fmy_stat_can_boff.err_info_stat.err_sym fmy_stat_can_if_cft.ctr_abc fmy_stat_can_if_cft.ctr_end_diag fmy_stat_can_if_cft.err_info_stat.reserved fmy_stat_can_if_cft.err_info_stat.lv_cdn_diag_stc fmy_stat_can_if_cft.err_info_stat.lv_lock_diag fmy_stat_can_if_cft.err_info_stat.lv_err_mem fmy_stat_can_if_cft.err_info_stat.lv_ready fmy_stat_can_if_cft.err_info_stat.lv_end_diag fmy_stat_can_if_cft.err_info_stat.lv_cdn_diag fmy_stat_can_if_cft.err_info_stat.err_sym fmy_stat_can_eilu.ctr_abc fmy_stat_can_eilu.ctr_end_diag fmy_stat_can_eilu.err_info_stat.reserved fmy_stat_can_eilu.err_info_stat.lv_cdn_diag_stc fmy_stat_can_eilu.err_info_stat.lv_lock_diag fmy_stat_can_eilu.err_info_stat.lv_err_mem fmy_stat_can_eilu.err_info_stat.lv_ready fmy_stat_can_eilu.err_info_stat.lv_end_diag fmy_stat_can_eilu.err_info_stat.lv_cdn_diag fmy_stat_can_eilu.err_info_stat.err_sym fmy_stat_can_dcc.ctr_abc fmy_stat_can_dcc.ctr_end_diag fmy_stat_can_dcc.err_info_stat.reserved fmy_stat_can_dcc.err_info_stat.lv_cdn_diag_stc fmy_stat_can_dcc.err_info_stat.lv_lock_diag fmy_stat_can_dcc.err_info_stat.lv_err_mem fmy_stat_can_dcc.err_info_stat.lv_ready fmy_stat_can_dcc.err_info_stat.lv_end_diag fmy_stat_can_dcc.err_info_stat.lv_cdn_diag fmy_stat_can_dcc.err_info_stat.err_sym fmy_stat_can_whl.ctr_abc fmy_stat_can_whl.ctr_end_diag fmy_stat_can_whl.err_info_stat.reserved fmy_stat_can_whl.err_info_stat.lv_cdn_diag_stc fmy_stat_can_whl.err_info_stat.lv_lock_diag fmy_stat_can_whl.err_info_stat.lv_err_mem fmy_stat_can_whl.err_info_stat.lv_ready fmy_stat_can_whl.err_info_stat.lv_end_diag fmy_stat_can_whl.err_info_stat.lv_cdn_diag fmy_stat_can_whl.err_info_stat.err_sym fmy_stat_can_sys_info.ctr_abc fmy_stat_can_sys_info.ctr_end_diag fmy_stat_can_sys_info.err_info_stat.reserved fmy_stat_can_sys_info.err_info_stat.lv_cdn_diag_stc fmy_stat_can_sys_info.err_info_stat.lv_lock_diag fmy_stat_can_sys_info.err_info_stat.lv_err_mem fmy_stat_can_sys_info.err_info_stat.lv_ready fmy_stat_can_sys_info.err_info_stat.lv_end_diag fmy_stat_can_sys_info.err_info_stat.lv_cdn_diag fmy_stat_can_sys_info.err_info_stat.err_sym fmy_stat_can_nom_sys.ctr_abc fmy_stat_can_nom_sys.ctr_end_diag fmy_stat_can_nom_sys.err_info_stat.reserved fmy_stat_can_nom_sys.err_info_stat.lv_cdn_diag_stc fmy_stat_can_nom_sys.err_info_stat.lv_lock_diag fmy_stat_can_nom_sys.err_info_stat.lv_err_mem fmy_stat_can_nom_sys.err_info_stat.lv_ready fmy_stat_can_nom_sys.err_info_stat.lv_end_diag fmy_stat_can_nom_sys.err_info_stat.lv_cdn_diag fmy_stat_can_nom_sys.err_info_stat.err_sym fmy_stat_can_tot.ctr_abc fmy_stat_can_tot.ctr_end_diag fmy_stat_can_tot.err_info_stat.reserved fmy_stat_can_tot.err_info_stat.lv_cdn_diag_stc fmy_stat_can_tot.err_info_stat.lv_lock_diag fmy_stat_can_tot.err_info_stat.lv_err_mem fmy_stat_can_tot.err_info_stat.lv_ready fmy_stat_can_tot.err_info_stat.lv_end_diag fmy_stat_can_tot.err_info_stat.lv_cdn_diag fmy_stat_can_tot.err_info_stat.err_sym /end OUT_MEASUREMENT
/end FUNCTION
/begin FUNCTION ERRM_AVARDIAG "Error Management data for diagnosis AVARDIAG"
 /begin OUT_MEASUREMENT fmy_stat_varcod.ctr_abc fmy_stat_varcod.ctr_end_diag fmy_stat_varcod.err_info_stat.reserved fmy_stat_varcod.err_info_stat.lv_cdn_diag_stc fmy_stat_varcod.err_info_stat.lv_lock_diag fmy_stat_varcod.err_info_stat.lv_err_mem fmy_stat_varcod.err_info_stat.lv_ready fmy_stat_varcod.err_info_stat.lv_end_diag fmy_stat_varcod.err_info_stat.lv_cdn_diag fmy_stat_varcod.err_info_stat.err_sym /end OUT_MEASUREMENT
/end FUNCTION
/end MODULE
/end PROJECT
