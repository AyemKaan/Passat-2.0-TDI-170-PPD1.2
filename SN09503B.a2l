ASAP2_VERSION 1 41
/begin PROJECT SN0 "SIMOS PPD"
/begin HEADER "_default_HeaderComment" PROJECT_NO PRJ_NUM /end HEADER
/begin MODULE _default_ModuleName "_default_ModuleLongIdentifier"
/begin MOD_COMMON "_default_ModCommonComment" DEPOSIT ABSOLUTE BYTE_ORDER MSB_FIRST ALIGNMENT_BYTE 1 ALIGNMENT_WORD 2 ALIGNMENT_LONG 4 ALIGNMENT_FLOAT32_IEEE 4 ALIGNMENT_FLOAT64_IEEE 8 /end MOD_COMMON
/begin MEASUREMENT lv_err_acp_mes_rng "Error flag of diagnosis instance ACP_MES_RNG" UBYTE _CNV_S_2_RANGE______23_CM 1 0. 0. 1. DISPLAY_IDENTIFIER LV_ERR_ACP_MES_RNG ECU_ADDRESS 0x7fb8ff /end MEASUREMENT
/begin MEASUREMENT fmy_stat_acp_mes_rng.ctr_abc "anti bounce counter for diagnosis instance ACP_MES_RNG" UBYTE _CNV_A_R_LINEAR_____1_CM 1 0. 0. 255. DISPLAY_IDENTIFIER CTR_ABC_ACP_MES_RNG ECU_ADDRESS 0x7f9b3f FORMAT "%3.0" /end MEASUREMENT
/begin MEASUREMENT fmy_stat_acp_mes_rng.ctr_end_diag "counter for end of diagnosis for diagnosis instance ACP_MES_RNG" UBYTE _CNV_A_R_LINEAR_____1_CM 1 0. 0. 255. DISPLAY_IDENTIFIER CTR_ABC_END_DIAG_ACP_MES_RNG ECU_ADDRESS 0x7f9b3e FORMAT "%3.0" /end MEASUREMENT
/begin MEASUREMENT fmy_stat_acp_mes_rng.err_info_stat.reserved "" UWORD _CNV_A_R_LINEAR_____0_CM 1 0. 0. 65535. DISPLAY_IDENTIFIER FMY_STAT_ACP_MES_RNG_ERR_INFO_STAT_RESERVED ECU_ADDRESS 0x7f9b3c BYTE_ORDER MSB_LAST BIT_MASK 0xF800 /end MEASUREMENT
/begin MEASUREMENT fmy_stat_acp_mes_rng.err_info_stat.lv_cdn_diag_stc "Statistical flag for condition of diagnosis of the diagnosis instance ACP_MES_RNG" UWORD _CNV_S_2_RANGE______383_CM 1 0. 0. 1. DISPLAY_IDENTIFIER LV_CDN_DIAG_STC_ACP_MES_RNG ECU_ADDRESS 0x7f9b3c BYTE_ORDER MSB_LAST BIT_MASK 0x400 /end MEASUREMENT
/begin MEASUREMENT fmy_stat_acp_mes_rng.err_info_stat.lv_lock_diag "lock flag (CPU load optimisation) of the diagnosis instance ACP_MES_RNG" UWORD _CNV_S_2_RANGE______383_CM 1 0. 0. 1. DISPLAY_IDENTIFIER LV_LOCK_DIAG_ACP_MES_RNG ECU_ADDRESS 0x7f9b3c BYTE_ORDER MSB_LAST BIT_MASK 0x200 /end MEASUREMENT
/begin MEASUREMENT fmy_stat_acp_mes_rng.err_info_stat.lv_err_mem "storage in dynamic failure memory of the diagnosis instance ACP_MES_RNG" UWORD _CNV_S_2_RANGE______383_CM 1 0. 0. 1. DISPLAY_IDENTIFIER LV_ERR_MEM_ACP_MES_RNG ECU_ADDRESS 0x7f9b3c BYTE_ORDER MSB_LAST BIT_MASK 0x80 /end MEASUREMENT
/begin MEASUREMENT fmy_stat_acp_mes_rng.err_info_stat.lv_ready "readiness status of the diagnosis instance ACP_MES_RNG" UWORD _CNV_S_2_RANGE______383_CM 1 0. 0. 1. DISPLAY_IDENTIFIER LV_READY_ACP_MES_RNG ECU_ADDRESS 0x7f9b3c BYTE_ORDER MSB_LAST BIT_MASK 0x40 /end MEASUREMENT
/begin MEASUREMENT fmy_stat_acp_mes_rng.err_info_stat.lv_end_diag "end of diagnosis of the diagnosis instance ACP_MES_RNG" UWORD _CNV_S_2_RANGE______383_CM 1 0. 0. 1. DISPLAY_IDENTIFIER LV_END_DIAG_ACP_MES_RNG ECU_ADDRESS 0x7f9b3c BYTE_ORDER MSB_LAST BIT_MASK 0x20 /end MEASUREMENT
/begin MEASUREMENT fmy_stat_acp_mes_rng.err_info_stat.lv_cdn_diag "diagnosis condition of the diagnosis instance ACP_MES_RNG" UWORD _CNV_S_2_RANGE______383_CM 1 0. 0. 1. DISPLAY_IDENTIFIER LV_CDN_DIAG_ACP_MES_RNG ECU_ADDRESS 0x7f9b3c BYTE_ORDER MSB_LAST BIT_MASK 0x10 /end MEASUREMENT
/begin MEASUREMENT fmy_stat_acp_mes_rng.err_info_stat.err_sym "symptoms of the diagnosis instance ACP_MES_RNG" UWORD _CNV_S_6_CONV_ERRM__22_CM 1 0. 0. 15. DISPLAY_IDENTIFIER ERR_SYM_ACP_MES_RNG ECU_ADDRESS 0x7f9b3c BYTE_ORDER MSB_LAST BIT_MASK 0xF /end MEASUREMENT
/begin MEASUREMENT lv_err_acp_mes_grd "Error flag of diagnosis instance ACP_MES_GRD" UBYTE _CNV_S_2_RANGE______23_CM 1 0. 0. 1. DISPLAY_IDENTIFIER LV_ERR_ACP_MES_GRD ECU_ADDRESS 0x7fb900 /end MEASUREMENT
/begin MEASUREMENT fmy_stat_acp_mes_grd.ctr_abc "anti bounce counter for diagnosis instance ACP_MES_GRD" UBYTE _CNV_A_R_LINEAR_____1_CM 1 0. 0. 255. DISPLAY_IDENTIFIER CTR_ABC_ACP_MES_GRD ECU_ADDRESS 0x7f9b43 FORMAT "%3.0" /end MEASUREMENT
/begin MEASUREMENT fmy_stat_acp_mes_grd.ctr_end_diag "counter for end of diagnosis for diagnosis instance ACP_MES_GRD" UBYTE _CNV_A_R_LINEAR_____1_CM 1 0. 0. 255. DISPLAY_IDENTIFIER CTR_ABC_END_DIAG_ACP_MES_GRD ECU_ADDRESS 0x7f9b42 FORMAT "%3.0" /end MEASUREMENT
/begin MEASUREMENT fmy_stat_acp_mes_grd.err_info_stat.reserved "" UWORD _CNV_A_R_LINEAR_____0_CM 1 0. 0. 65535. DISPLAY_IDENTIFIER FMY_STAT_ACP_MES_GRD_ERR_INFO_STAT_RESERVED ECU_ADDRESS 0x7f9b40 BYTE_ORDER MSB_LAST BIT_MASK 0xF800 /end MEASUREMENT
/begin MEASUREMENT fmy_stat_acp_mes_grd.err_info_stat.lv_cdn_diag_stc "Statistical flag for condition of diagnosis of the diagnosis instance ACP_MES_GRD" UWORD _CNV_S_2_RANGE______383_CM 1 0. 0. 1. DISPLAY_IDENTIFIER LV_CDN_DIAG_STC_ACP_MES_GRD ECU_ADDRESS 0x7f9b40 BYTE_ORDER MSB_LAST BIT_MASK 0x400 /end MEASUREMENT
/begin MEASUREMENT fmy_stat_acp_mes_grd.err_info_stat.lv_lock_diag "lock flag (CPU load optimisation) of the diagnosis instance ACP_MES_GRD" UWORD _CNV_S_2_RANGE______383_CM 1 0. 0. 1. DISPLAY_IDENTIFIER LV_LOCK_DIAG_ACP_MES_GRD ECU_ADDRESS 0x7f9b40 BYTE_ORDER MSB_LAST BIT_MASK 0x200 /end MEASUREMENT
/begin MEASUREMENT fmy_stat_acp_mes_grd.err_info_stat.lv_err_mem "storage in dynamic failure memory of the diagnosis instance ACP_MES_GRD" UWORD _CNV_S_2_RANGE______383_CM 1 0. 0. 1. DISPLAY_IDENTIFIER LV_ERR_MEM_ACP_MES_GRD ECU_ADDRESS 0x7f9b40 BYTE_ORDER MSB_LAST BIT_MASK 0x80 /end MEASUREMENT
/begin MEASUREMENT fmy_stat_acp_mes_grd.err_info_stat.lv_ready "readiness status of the diagnosis instance ACP_MES_GRD" UWORD _CNV_S_2_RANGE______383_CM 1 0. 0. 1. DISPLAY_IDENTIFIER LV_READY_ACP_MES_GRD ECU_ADDRESS 0x7f9b40 BYTE_ORDER MSB_LAST BIT_MASK 0x40 /end MEASUREMENT
/begin MEASUREMENT fmy_stat_acp_mes_grd.err_info_stat.lv_end_diag "end of diagnosis of the diagnosis instance ACP_MES_GRD" UWORD _CNV_S_2_RANGE______383_CM 1 0. 0. 1. DISPLAY_IDENTIFIER LV_END_DIAG_ACP_MES_GRD ECU_ADDRESS 0x7f9b40 BYTE_ORDER MSB_LAST BIT_MASK 0x20 /end MEASUREMENT
/begin MEASUREMENT fmy_stat_acp_mes_grd.err_info_stat.lv_cdn_diag "diagnosis condition of the diagnosis instance ACP_MES_GRD" UWORD _CNV_S_2_RANGE______383_CM 1 0. 0. 1. DISPLAY_IDENTIFIER LV_CDN_DIAG_ACP_MES_GRD ECU_ADDRESS 0x7f9b40 BYTE_ORDER MSB_LAST BIT_MASK 0x10 /end MEASUREMENT
/begin MEASUREMENT fmy_stat_acp_mes_grd.err_info_stat.err_sym "symptoms of the diagnosis instance ACP_MES_GRD" UWORD _CNV_S_6_CONV_ERRM__22_CM 1 0. 0. 15. DISPLAY_IDENTIFIER ERR_SYM_ACP_MES_GRD ECU_ADDRESS 0x7f9b40 BYTE_ORDER MSB_LAST BIT_MASK 0xF /end MEASUREMENT
/begin MEASUREMENT lv_err_v_tba_rng "Error flag of diagnosis instance V_TBA_RNG" UBYTE _CNV_S_2_RANGE______23_CM 1 0. 0. 1. DISPLAY_IDENTIFIER LV_ERR_V_TBA_RNG ECU_ADDRESS 0x7fb901 /end MEASUREMENT
/begin MEASUREMENT fmy_stat_v_tba_rng.ctr_abc "anti bounce counter for diagnosis instance V_TBA_RNG" UBYTE _CNV_A_R_LINEAR_____1_CM 1 0. 0. 255. DISPLAY_IDENTIFIER CTR_ABC_V_TBA_RNG ECU_ADDRESS 0x7f9b47 FORMAT "%3.0" /end MEASUREMENT
/begin MEASUREMENT fmy_stat_v_tba_rng.ctr_end_diag "counter for end of diagnosis for diagnosis instance V_TBA_RNG" UBYTE _CNV_A_R_LINEAR_____1_CM 1 0. 0. 255. DISPLAY_IDENTIFIER CTR_ABC_END_DIAG_V_TBA_RNG ECU_ADDRESS 0x7f9b46 FORMAT "%3.0" /end MEASUREMENT
/begin MEASUREMENT fmy_stat_v_tba_rng.err_info_stat.reserved "" UWORD _CNV_A_R_LINEAR_____0_CM 1 0. 0. 65535. DISPLAY_IDENTIFIER FMY_STAT_V_TBA_RNG_ERR_INFO_STAT_RESERVED ECU_ADDRESS 0x7f9b44 BYTE_ORDER MSB_LAST BIT_MASK 0xF800 /end MEASUREMENT
/begin MEASUREMENT fmy_stat_v_tba_rng.err_info_stat.lv_cdn_diag_stc "Statistical flag for condition of diagnosis of the diagnosis instance V_TBA_RNG" UWORD _CNV_S_2_RANGE______383_CM 1 0. 0. 1. DISPLAY_IDENTIFIER LV_CDN_DIAG_STC_V_TBA_RNG ECU_ADDRESS 0x7f9b44 BYTE_ORDER MSB_LAST BIT_MASK 0x400 /end MEASUREMENT
/begin MEASUREMENT fmy_stat_v_tba_rng.err_info_stat.lv_lock_diag "lock flag (CPU load optimisation) of the diagnosis instance V_TBA_RNG" UWORD _CNV_S_2_RANGE______383_CM 1 0. 0. 1. DISPLAY_IDENTIFIER LV_LOCK_DIAG_V_TBA_RNG ECU_ADDRESS 0x7f9b44 BYTE_ORDER MSB_LAST BIT_MASK 0x200 /end MEASUREMENT
/begin MEASUREMENT fmy_stat_v_tba_rng.err_info_stat.lv_err_mem "storage in dynamic failure memory of the diagnosis instance V_TBA_RNG" UWORD _CNV_S_2_RANGE______383_CM 1 0. 0. 1. DISPLAY_IDENTIFIER LV_ERR_MEM_V_TBA_RNG ECU_ADDRESS 0x7f9b44 BYTE_ORDER MSB_LAST BIT_MASK 0x80 /end MEASUREMENT
/begin MEASUREMENT fmy_stat_v_tba_rng.err_info_stat.lv_ready "readiness status of the diagnosis instance V_TBA_RNG" UWORD _CNV_S_2_RANGE______383_CM 1 0. 0. 1. DISPLAY_IDENTIFIER LV_READY_V_TBA_RNG ECU_ADDRESS 0x7f9b44 BYTE_ORDER MSB_LAST BIT_MASK 0x40 /end MEASUREMENT
/begin MEASUREMENT fmy_stat_v_tba_rng.err_info_stat.lv_end_diag "end of diagnosis of the diagnosis instance V_TBA_RNG" UWORD _CNV_S_2_RANGE______383_CM 1 0. 0. 1. DISPLAY_IDENTIFIER LV_END_DIAG_V_TBA_RNG ECU_ADDRESS 0x7f9b44 BYTE_ORDER MSB_LAST BIT_MASK 0x20 /end MEASUREMENT
/begin MEASUREMENT fmy_stat_v_tba_rng.err_info_stat.lv_cdn_diag "diagnosis condition of the diagnosis instance V_TBA_RNG" UWORD _CNV_S_2_RANGE______383_CM 1 0. 0. 1. DISPLAY_IDENTIFIER LV_CDN_DIAG_V_TBA_RNG ECU_ADDRESS 0x7f9b44 BYTE_ORDER MSB_LAST BIT_MASK 0x10 /end MEASUREMENT
/begin MEASUREMENT fmy_stat_v_tba_rng.err_info_stat.err_sym "symptoms of the diagnosis instance V_TBA_RNG" UWORD _CNV_S_6_CONV_ERRM__22_CM 1 0. 0. 15. DISPLAY_IDENTIFIER ERR_SYM_V_TBA_RNG ECU_ADDRESS 0x7f9b44 BYTE_ORDER MSB_LAST BIT_MASK 0xF /end MEASUREMENT
/begin MEASUREMENT lv_err_tba_mes_grd "Error flag of diagnosis instance TBA_MES_GRD" UBYTE _CNV_S_2_RANGE______23_CM 1 0. 0. 1. DISPLAY_IDENTIFIER LV_ERR_TBA_MES_GRD ECU_ADDRESS 0x7fb902 /end MEASUREMENT
/begin MEASUREMENT fmy_stat_tba_mes_grd.ctr_abc "anti bounce counter for diagnosis instance TBA_MES_GRD" UBYTE _CNV_A_R_LINEAR_____1_CM 1 0. 0. 255. DISPLAY_IDENTIFIER CTR_ABC_TBA_MES_GRD ECU_ADDRESS 0x7f9b4b FORMAT "%3.0" /end MEASUREMENT
/begin MEASUREMENT fmy_stat_tba_mes_grd.ctr_end_diag "counter for end of diagnosis for diagnosis instance TBA_MES_GRD" UBYTE _CNV_A_R_LINEAR_____1_CM 1 0. 0. 255. DISPLAY_IDENTIFIER CTR_ABC_END_DIAG_TBA_MES_GRD ECU_ADDRESS 0x7f9b4a FORMAT "%3.0" /end MEASUREMENT
/begin MEASUREMENT fmy_stat_tba_mes_grd.err_info_stat.reserved "" UWORD _CNV_A_R_LINEAR_____0_CM 1 0. 0. 65535. DISPLAY_IDENTIFIER FMY_STAT_TBA_MES_GRD_ERR_INFO_STAT_RESERVED ECU_ADDRESS 0x7f9b48 BYTE_ORDER MSB_LAST BIT_MASK 0xF800 /end MEASUREMENT
/begin MEASUREMENT fmy_stat_tba_mes_grd.err_info_stat.lv_cdn_diag_stc "Statistical flag for condition of diagnosis of the diagnosis instance TBA_MES_GRD" UWORD _CNV_S_2_RANGE______383_CM 1 0. 0. 1. DISPLAY_IDENTIFIER LV_CDN_DIAG_STC_TBA_MES_GRD ECU_ADDRESS 0x7f9b48 BYTE_ORDER MSB_LAST BIT_MASK 0x400 /end MEASUREMENT
/begin MEASUREMENT fmy_stat_tba_mes_grd.err_info_stat.lv_lock_diag "lock flag (CPU load optimisation) of the diagnosis instance TBA_MES_GRD" UWORD _CNV_S_2_RANGE______383_CM 1 0. 0. 1. DISPLAY_IDENTIFIER LV_LOCK_DIAG_TBA_MES_GRD ECU_ADDRESS 0x7f9b48 BYTE_ORDER MSB_LAST BIT_MASK 0x200 /end MEASUREMENT
/begin MEASUREMENT fmy_stat_tba_mes_grd.err_info_stat.lv_err_mem "storage in dynamic failure memory of the diagnosis instance TBA_MES_GRD" UWORD _CNV_S_2_RANGE______383_CM 1 0. 0. 1. DISPLAY_IDENTIFIER LV_ERR_MEM_TBA_MES_GRD ECU_ADDRESS 0x7f9b48 BYTE_ORDER MSB_LAST BIT_MASK 0x80 /end MEASUREMENT
/begin MEASUREMENT fmy_stat_tba_mes_grd.err_info_stat.lv_ready "readiness status of the diagnosis instance TBA_MES_GRD" UWORD _CNV_S_2_RANGE______383_CM 1 0. 0. 1. DISPLAY_IDENTIFIER LV_READY_TBA_MES_GRD ECU_ADDRESS 0x7f9b48 BYTE_ORDER MSB_LAST BIT_MASK 0x40 /end MEASUREMENT
/begin MEASUREMENT fmy_stat_tba_mes_grd.err_info_stat.lv_end_diag "end of diagnosis of the diagnosis instance TBA_MES_GRD" UWORD _CNV_S_2_RANGE______383_CM 1 0. 0. 1. DISPLAY_IDENTIFIER LV_END_DIAG_TBA_MES_GRD ECU_ADDRESS 0x7f9b48 BYTE_ORDER MSB_LAST BIT_MASK 0x20 /end MEASUREMENT
/begin MEASUREMENT fmy_stat_tba_mes_grd.err_info_stat.lv_cdn_diag "diagnosis condition of the diagnosis instance TBA_MES_GRD" UWORD _CNV_S_2_RANGE______383_CM 1 0. 0. 1. DISPLAY_IDENTIFIER LV_CDN_DIAG_TBA_MES_GRD ECU_ADDRESS 0x7f9b48 BYTE_ORDER MSB_LAST BIT_MASK 0x10 /end MEASUREMENT
/begin MEASUREMENT fmy_stat_tba_mes_grd.err_info_stat.err_sym "symptoms of the diagnosis instance TBA_MES_GRD" UWORD _CNV_S_6_CONV_ERRM__22_CM 1 0. 0. 15. DISPLAY_IDENTIFIER ERR_SYM_TBA_MES_GRD ECU_ADDRESS 0x7f9b48 BYTE_ORDER MSB_LAST BIT_MASK 0xF /end MEASUREMENT
/begin MEASUREMENT lv_err_ducy_alter_pwm_rng "Error flag of diagnosis instance DUCY_ALTER_PWM_RNG" UBYTE _CNV_S_2_RANGE______23_CM 1 0. 0. 1. DISPLAY_IDENTIFIER LV_ERR_DUCY_ALTER_PWM_RNG ECU_ADDRESS 0x7fb903 /end MEASUREMENT
/begin MEASUREMENT fmy_stat_ducy_alter_pwm_rng.ctr_abc "anti bounce counter for diagnosis instance DUCY_ALTER_PWM_RNG" UBYTE _CNV_A_R_LINEAR_____1_CM 1 0. 0. 255. DISPLAY_IDENTIFIER CTR_ABC_DUCY_ALTER_PWM_RNG ECU_ADDRESS 0x7f9b4f FORMAT "%3.0" /end MEASUREMENT
/begin MEASUREMENT fmy_stat_ducy_alter_pwm_rng.ctr_end_diag "counter for end of diagnosis for diagnosis instance DUCY_ALTER_PWM_RNG" UBYTE _CNV_A_R_LINEAR_____1_CM 1 0. 0. 255. DISPLAY_IDENTIFIER CTR_ABC_END_DIAG_DUCY_ALTER_PWM_RNG ECU_ADDRESS 0x7f9b4e FORMAT "%3.0" /end MEASUREMENT
/begin MEASUREMENT fmy_stat_ducy_alter_pwm_rng.err_info_stat.reserved "" UWORD _CNV_A_R_LINEAR_____0_CM 1 0. 0. 65535. DISPLAY_IDENTIFIER FMY_STAT_DUCY_ALTER_PWM_RNG_ERR_INFO_STAT_RESERVED ECU_ADDRESS 0x7f9b4c BYTE_ORDER MSB_LAST BIT_MASK 0xF800 /end MEASUREMENT
/begin MEASUREMENT fmy_stat_ducy_alter_pwm_rng.err_info_stat.lv_cdn_diag_stc "Statistical flag for condition of diagnosis of the diagnosis instance DUCY_ALTER_PWM_RNG" UWORD _CNV_S_2_RANGE______383_CM 1 0. 0. 1. DISPLAY_IDENTIFIER LV_CDN_DIAG_STC_DUCY_ALTER_PWM_RNG ECU_ADDRESS 0x7f9b4c BYTE_ORDER MSB_LAST BIT_MASK 0x400 /end MEASUREMENT
/begin MEASUREMENT fmy_stat_ducy_alter_pwm_rng.err_info_stat.lv_lock_diag "lock flag (CPU load optimisation) of the diagnosis instance DUCY_ALTER_PWM_RNG" UWORD _CNV_S_2_RANGE______383_CM 1 0. 0. 1. DISPLAY_IDENTIFIER LV_LOCK_DIAG_DUCY_ALTER_PWM_RNG ECU_ADDRESS 0x7f9b4c BYTE_ORDER MSB_LAST BIT_MASK 0x200 /end MEASUREMENT
/begin MEASUREMENT fmy_stat_ducy_alter_pwm_rng.err_info_stat.lv_err_mem "storage in dynamic failure memory of the diagnosis instance DUCY_ALTER_PWM_RNG" UWORD _CNV_S_2_RANGE______383_CM 1 0. 0. 1. DISPLAY_IDENTIFIER LV_ERR_MEM_DUCY_ALTER_PWM_RNG ECU_ADDRESS 0x7f9b4c BYTE_ORDER MSB_LAST BIT_MASK 0x80 /end MEASUREMENT
/begin MEASUREMENT fmy_stat_ducy_alter_pwm_rng.err_info_stat.lv_ready "readiness status of the diagnosis instance DUCY_ALTER_PWM_RNG" UWORD _CNV_S_2_RANGE______383_CM 1 0. 0. 1. DISPLAY_IDENTIFIER LV_READY_DUCY_ALTER_PWM_RNG ECU_ADDRESS 0x7f9b4c BYTE_ORDER MSB_LAST BIT_MASK 0x40 /end MEASUREMENT
/begin MEASUREMENT fmy_stat_ducy_alter_pwm_rng.err_info_stat.lv_end_diag "end of diagnosis of the diagnosis instance DUCY_ALTER_PWM_RNG" UWORD _CNV_S_2_RANGE______383_CM 1 0. 0. 1. DISPLAY_IDENTIFIER LV_END_DIAG_DUCY_ALTER_PWM_RNG ECU_ADDRESS 0x7f9b4c BYTE_ORDER MSB_LAST BIT_MASK 0x20 /end MEASUREMENT
/begin MEASUREMENT fmy_stat_ducy_alter_pwm_rng.err_info_stat.lv_cdn_diag "diagnosis condition of the diagnosis instance DUCY_ALTER_PWM_RNG" UWORD _CNV_S_2_RANGE______383_CM 1 0. 0. 1. DISPLAY_IDENTIFIER LV_CDN_DIAG_DUCY_ALTER_PWM_RNG ECU_ADDRESS 0x7f9b4c BYTE_ORDER MSB_LAST BIT_MASK 0x10 /end MEASUREMENT
/begin MEASUREMENT fmy_stat_ducy_alter_pwm_rng.err_info_stat.err_sym "symptoms of the diagnosis instance DUCY_ALTER_PWM_RNG" UWORD _CNV_S_6_CONV_ERRM__22_CM 1 0. 0. 15. DISPLAY_IDENTIFIER ERR_SYM_DUCY_ALTER_PWM_RNG ECU_ADDRESS 0x7f9b4c BYTE_ORDER MSB_LAST BIT_MASK 0xF /end MEASUREMENT
/begin MEASUREMENT lv_err_ducy_alter_pwm_grd "Error flag of diagnosis instance DUCY_ALTER_PWM_GRD" UBYTE _CNV_S_2_RANGE______23_CM 1 0. 0. 1. DISPLAY_IDENTIFIER LV_ERR_DUCY_ALTER_PWM_GRD ECU_ADDRESS 0x7fb904 /end MEASUREMENT
/begin MEASUREMENT fmy_stat_ducy_alter_pwm_grd.ctr_abc "anti bounce counter for diagnosis instance DUCY_ALTER_PWM_GRD" UBYTE _CNV_A_R_LINEAR_____1_CM 1 0. 0. 255. DISPLAY_IDENTIFIER CTR_ABC_DUCY_ALTER_PWM_GRD ECU_ADDRESS 0x7f9b53 FORMAT "%3.0" /end MEASUREMENT
/begin MEASUREMENT fmy_stat_ducy_alter_pwm_grd.ctr_end_diag "counter for end of diagnosis for diagnosis instance DUCY_ALTER_PWM_GRD" UBYTE _CNV_A_R_LINEAR_____1_CM 1 0. 0. 255. DISPLAY_IDENTIFIER CTR_ABC_END_DIAG_DUCY_ALTER_PWM_GRD ECU_ADDRESS 0x7f9b52 FORMAT "%3.0" /end MEASUREMENT
/begin MEASUREMENT fmy_stat_ducy_alter_pwm_grd.err_info_stat.reserved "" UWORD _CNV_A_R_LINEAR_____0_CM 1 0. 0. 65535. DISPLAY_IDENTIFIER FMY_STAT_DUCY_ALTER_PWM_GRD_ERR_INFO_STAT_RESERVED ECU_ADDRESS 0x7f9b50 BYTE_ORDER MSB_LAST BIT_MASK 0xF800 /end MEASUREMENT
/begin MEASUREMENT fmy_stat_ducy_alter_pwm_grd.err_info_stat.lv_cdn_diag_stc "Statistical flag for condition of diagnosis of the diagnosis instance DUCY_ALTER_PWM_GRD" UWORD _CNV_S_2_RANGE______383_CM 1 0. 0. 1. DISPLAY_IDENTIFIER LV_CDN_DIAG_STC_DUCY_ALTER_PWM_GRD ECU_ADDRESS 0x7f9b50 BYTE_ORDER MSB_LAST BIT_MASK 0x400 /end MEASUREMENT
/begin MEASUREMENT fmy_stat_ducy_alter_pwm_grd.err_info_stat.lv_lock_diag "lock flag (CPU load optimisation) of the diagnosis instance DUCY_ALTER_PWM_GRD" UWORD _CNV_S_2_RANGE______383_CM 1 0. 0. 1. DISPLAY_IDENTIFIER LV_LOCK_DIAG_DUCY_ALTER_PWM_GRD ECU_ADDRESS 0x7f9b50 BYTE_ORDER MSB_LAST BIT_MASK 0x200 /end MEASUREMENT
/begin MEASUREMENT fmy_stat_ducy_alter_pwm_grd.err_info_stat.lv_err_mem "storage in dynamic failure memory of the diagnosis instance DUCY_ALTER_PWM_GRD" UWORD _CNV_S_2_RANGE______383_CM 1 0. 0. 1. DISPLAY_IDENTIFIER LV_ERR_MEM_DUCY_ALTER_PWM_GRD ECU_ADDRESS 0x7f9b50 BYTE_ORDER MSB_LAST BIT_MASK 0x80 /end MEASUREMENT
/begin MEASUREMENT fmy_stat_ducy_alter_pwm_grd.err_info_stat.lv_ready "readiness status of the diagnosis instance DUCY_ALTER_PWM_GRD" UWORD _CNV_S_2_RANGE______383_CM 1 0. 0. 1. DISPLAY_IDENTIFIER LV_READY_DUCY_ALTER_PWM_GRD ECU_ADDRESS 0x7f9b50 BYTE_ORDER MSB_LAST BIT_MASK 0x40 /end MEASUREMENT
/begin MEASUREMENT fmy_stat_ducy_alter_pwm_grd.err_info_stat.lv_end_diag "end of diagnosis of the diagnosis instance DUCY_ALTER_PWM_GRD" UWORD _CNV_S_2_RANGE______383_CM 1 0. 0. 1. DISPLAY_IDENTIFIER LV_END_DIAG_DUCY_ALTER_PWM_GRD ECU_ADDRESS 0x7f9b50 BYTE_ORDER MSB_LAST BIT_MASK 0x20 /end MEASUREMENT
/begin MEASUREMENT fmy_stat_ducy_alter_pwm_grd.err_info_stat.lv_cdn_diag "diagnosis condition of the diagnosis instance DUCY_ALTER_PWM_GRD" UWORD _CNV_S_2_RANGE______383_CM 1 0. 0. 1. DISPLAY_IDENTIFIER LV_CDN_DIAG_DUCY_ALTER_PWM_GRD ECU_ADDRESS 0x7f9b50 BYTE_ORDER MSB_LAST BIT_MASK 0x10 /end MEASUREMENT
/begin MEASUREMENT fmy_stat_ducy_alter_pwm_grd.err_info_stat.err_sym "symptoms of the diagnosis instance DUCY_ALTER_PWM_GRD" UWORD _CNV_S_6_CONV_ERRM__22_CM 1 0. 0. 15. DISPLAY_IDENTIFIER ERR_SYM_DUCY_ALTER_PWM_GRD ECU_ADDRESS 0x7f9b50 BYTE_ORDER MSB_LAST BIT_MASK 0xF /end MEASUREMENT
/begin MEASUREMENT lv_err_v_egrv_0_rng "Error flag of diagnosis instance V_EGRV_0_RNG" UBYTE _CNV_S_2_RANGE______23_CM 1 0. 0. 1. DISPLAY_IDENTIFIER LV_ERR_V_EGRV_0_RNG ECU_ADDRESS 0x7fb905 /end MEASUREMENT
/begin MEASUREMENT fmy_stat_v_egrv_0_rng.ctr_abc "anti bounce counter for diagnosis instance V_EGRV_0_RNG" UBYTE _CNV_A_R_LINEAR_____1_CM 1 0. 0. 255. DISPLAY_IDENTIFIER CTR_ABC_V_EGRV_0_RNG ECU_ADDRESS 0x7f9b57 FORMAT "%3.0" /end MEASUREMENT
/begin MEASUREMENT fmy_stat_v_egrv_0_rng.ctr_end_diag "counter for end of diagnosis for diagnosis instance V_EGRV_0_RNG" UBYTE _CNV_A_R_LINEAR_____1_CM 1 0. 0. 255. DISPLAY_IDENTIFIER CTR_ABC_END_DIAG_V_EGRV_0_RNG ECU_ADDRESS 0x7f9b56 FORMAT "%3.0" /end MEASUREMENT
/begin MEASUREMENT fmy_stat_v_egrv_0_rng.err_info_stat.reserved "" UWORD _CNV_A_R_LINEAR_____0_CM 1 0. 0. 65535. DISPLAY_IDENTIFIER FMY_STAT_V_EGRV_0_RNG_ERR_INFO_STAT_RESERVED ECU_ADDRESS 0x7f9b54 BYTE_ORDER MSB_LAST BIT_MASK 0xF800 /end MEASUREMENT
/begin MEASUREMENT fmy_stat_v_egrv_0_rng.err_info_stat.lv_cdn_diag_stc "Statistical flag for condition of diagnosis of the diagnosis instance V_EGRV_0_RNG" UWORD _CNV_S_2_RANGE______383_CM 1 0. 0. 1. DISPLAY_IDENTIFIER LV_CDN_DIAG_STC_V_EGRV_0_RNG ECU_ADDRESS 0x7f9b54 BYTE_ORDER MSB_LAST BIT_MASK 0x400 /end MEASUREMENT
/begin MEASUREMENT fmy_stat_v_egrv_0_rng.err_info_stat.lv_lock_diag "lock flag (CPU load optimisation) of the diagnosis instance V_EGRV_0_RNG" UWORD _CNV_S_2_RANGE______383_CM 1 0. 0. 1. DISPLAY_IDENTIFIER LV_LOCK_DIAG_V_EGRV_0_RNG ECU_ADDRESS 0x7f9b54 BYTE_ORDER MSB_LAST BIT_MASK 0x200 /end MEASUREMENT
/begin MEASUREMENT fmy_stat_v_egrv_0_rng.err_info_stat.lv_err_mem "storage in dynamic failure memory of the diagnosis instance V_EGRV_0_RNG" UWORD _CNV_S_2_RANGE______383_CM 1 0. 0. 1. DISPLAY_IDENTIFIER LV_ERR_MEM_V_EGRV_0_RNG ECU_ADDRESS 0x7f9b54 BYTE_ORDER MSB_LAST BIT_MASK 0x80 /end MEASUREMENT
/begin MEASUREMENT fmy_stat_v_egrv_0_rng.err_info_stat.lv_ready "readiness status of the diagnosis instance V_EGRV_0_RNG" UWORD _CNV_S_2_RANGE______383_CM 1 0. 0. 1. DISPLAY_IDENTIFIER LV_READY_V_EGRV_0_RNG ECU_ADDRESS 0x7f9b54 BYTE_ORDER MSB_LAST BIT_MASK 0x40 /end MEASUREMENT
/begin MEASUREMENT fmy_stat_v_egrv_0_rng.err_info_stat.lv_end_diag "end of diagnosis of the diagnosis instance V_EGRV_0_RNG" UWORD _CNV_S_2_RANGE______383_CM 1 0. 0. 1. DISPLAY_IDENTIFIER LV_END_DIAG_V_EGRV_0_RNG ECU_ADDRESS 0x7f9b54 BYTE_ORDER MSB_LAST BIT_MASK 0x20 /end MEASUREMENT
/begin MEASUREMENT fmy_stat_v_egrv_0_rng.err_info_stat.lv_cdn_diag "diagnosis condition of the diagnosis instance V_EGRV_0_RNG" UWORD _CNV_S_2_RANGE______383_CM 1 0. 0. 1. DISPLAY_IDENTIFIER LV_CDN_DIAG_V_EGRV_0_RNG ECU_ADDRESS 0x7f9b54 BYTE_ORDER MSB_LAST BIT_MASK 0x10 /end MEASUREMENT
/begin MEASUREMENT fmy_stat_v_egrv_0_rng.err_info_stat.err_sym "symptoms of the diagnosis instance V_EGRV_0_RNG" UWORD _CNV_S_6_CONV_ERRM__22_CM 1 0. 0. 15. DISPLAY_IDENTIFIER ERR_SYM_V_EGRV_0_RNG ECU_ADDRESS 0x7f9b54 BYTE_ORDER MSB_LAST BIT_MASK 0xF /end MEASUREMENT
/begin MEASUREMENT lv_err_v_egrv_1_rng "Error flag of diagnosis instance V_EGRV_1_RNG" UBYTE _CNV_S_2_RANGE______23_CM 1 0. 0. 1. DISPLAY_IDENTIFIER LV_ERR_V_EGRV_1_RNG ECU_ADDRESS 0x7fb906 /end MEASUREMENT
/begin MEASUREMENT fmy_stat_v_egrv_1_rng.ctr_abc "anti bounce counter for diagnosis instance V_EGRV_1_RNG" UBYTE _CNV_A_R_LINEAR_____1_CM 1 0. 0. 255. DISPLAY_IDENTIFIER CTR_ABC_V_EGRV_1_RNG ECU_ADDRESS 0x7f9b5b FORMAT "%3.0" /end MEASUREMENT
/begin MEASUREMENT fmy_stat_v_egrv_1_rng.ctr_end_diag "counter for end of diagnosis for diagnosis instance V_EGRV_1_RNG" UBYTE _CNV_A_R_LINEAR_____1_CM 1 0. 0. 255. DISPLAY_IDENTIFIER CTR_ABC_END_DIAG_V_EGRV_1_RNG ECU_ADDRESS 0x7f9b5a FORMAT "%3.0" /end MEASUREMENT
/begin MEASUREMENT fmy_stat_v_egrv_1_rng.err_info_stat.reserved "" UWORD _CNV_A_R_LINEAR_____0_CM 1 0. 0. 65535. DISPLAY_IDENTIFIER FMY_STAT_V_EGRV_1_RNG_ERR_INFO_STAT_RESERVED ECU_ADDRESS 0x7f9b58 BYTE_ORDER MSB_LAST BIT_MASK 0xF800 /end MEASUREMENT
/begin MEASUREMENT fmy_stat_v_egrv_1_rng.err_info_stat.lv_cdn_diag_stc "Statistical flag for condition of diagnosis of the diagnosis instance V_EGRV_1_RNG" UWORD _CNV_S_2_RANGE______383_CM 1 0. 0. 1. DISPLAY_IDENTIFIER LV_CDN_DIAG_STC_V_EGRV_1_RNG ECU_ADDRESS 0x7f9b58 BYTE_ORDER MSB_LAST BIT_MASK 0x400 /end MEASUREMENT
/begin MEASUREMENT fmy_stat_v_egrv_1_rng.err_info_stat.lv_lock_diag "lock flag (CPU load optimisation) of the diagnosis instance V_EGRV_1_RNG" UWORD _CNV_S_2_RANGE______383_CM 1 0. 0. 1. DISPLAY_IDENTIFIER LV_LOCK_DIAG_V_EGRV_1_RNG ECU_ADDRESS 0x7f9b58 BYTE_ORDER MSB_LAST BIT_MASK 0x200 /end MEASUREMENT
/begin MEASUREMENT fmy_stat_v_egrv_1_rng.err_info_stat.lv_err_mem "storage in dynamic failure memory of the diagnosis instance V_EGRV_1_RNG" UWORD _CNV_S_2_RANGE______383_CM 1 0. 0. 1. DISPLAY_IDENTIFIER LV_ERR_MEM_V_EGRV_1_RNG ECU_ADDRESS 0x7f9b58 BYTE_ORDER MSB_LAST BIT_MASK 0x80 /end MEASUREMENT
/begin MEASUREMENT fmy_stat_v_egrv_1_rng.err_info_stat.lv_ready "readiness status of the diagnosis instance V_EGRV_1_RNG" UWORD _CNV_S_2_RANGE______383_CM 1 0. 0. 1. DISPLAY_IDENTIFIER LV_READY_V_EGRV_1_RNG ECU_ADDRESS 0x7f9b58 BYTE_ORDER MSB_LAST BIT_MASK 0x40 /end MEASUREMENT
/begin MEASUREMENT fmy_stat_v_egrv_1_rng.err_info_stat.lv_end_diag "end of diagnosis of the diagnosis instance V_EGRV_1_RNG" UWORD _CNV_S_2_RANGE______383_CM 1 0. 0. 1. DISPLAY_IDENTIFIER LV_END_DIAG_V_EGRV_1_RNG ECU_ADDRESS 0x7f9b58 BYTE_ORDER MSB_LAST BIT_MASK 0x20 /end MEASUREMENT
/begin MEASUREMENT fmy_stat_v_egrv_1_rng.err_info_stat.lv_cdn_diag "diagnosis condition of the diagnosis instance V_EGRV_1_RNG" UWORD _CNV_S_2_RANGE______383_CM 1 0. 0. 1. DISPLAY_IDENTIFIER LV_CDN_DIAG_V_EGRV_1_RNG ECU_ADDRESS 0x7f9b58 BYTE_ORDER MSB_LAST BIT_MASK 0x10 /end MEASUREMENT
/begin MEASUREMENT fmy_stat_v_egrv_1_rng.err_info_stat.err_sym "symptoms of the diagnosis instance V_EGRV_1_RNG" UWORD _CNV_S_6_CONV_ERRM__22_CM 1 0. 0. 15. DISPLAY_IDENTIFIER ERR_SYM_V_EGRV_1_RNG ECU_ADDRESS 0x7f9b58 BYTE_ORDER MSB_LAST BIT_MASK 0xF /end MEASUREMENT
/begin MEASUREMENT lv_err_v_egrv_0_grd "Error flag of diagnosis instance V_EGRV_0_GRD" UBYTE _CNV_S_2_RANGE______23_CM 1 0. 0. 1. DISPLAY_IDENTIFIER LV_ERR_V_EGRV_0_GRD ECU_ADDRESS 0x7fb907 /end MEASUREMENT
/begin MEASUREMENT fmy_stat_v_egrv_0_grd.ctr_abc "anti bounce counter for diagnosis instance V_EGRV_0_GRD" UBYTE _CNV_A_R_LINEAR_____1_CM 1 0. 0. 255. DISPLAY_IDENTIFIER CTR_ABC_V_EGRV_0_GRD ECU_ADDRESS 0x7f9b5f FORMAT "%3.0" /end MEASUREMENT
/begin MEASUREMENT fmy_stat_v_egrv_0_grd.ctr_end_diag "counter for end of diagnosis for diagnosis instance V_EGRV_0_GRD" UBYTE _CNV_A_R_LINEAR_____1_CM 1 0. 0. 255. DISPLAY_IDENTIFIER CTR_ABC_END_DIAG_V_EGRV_0_GRD ECU_ADDRESS 0x7f9b5e FORMAT "%3.0" /end MEASUREMENT
/begin MEASUREMENT fmy_stat_v_egrv_0_grd.err_info_stat.reserved "" UWORD _CNV_A_R_LINEAR_____0_CM 1 0. 0. 65535. DISPLAY_IDENTIFIER FMY_STAT_V_EGRV_0_GRD_ERR_INFO_STAT_RESERVED ECU_ADDRESS 0x7f9b5c BYTE_ORDER MSB_LAST BIT_MASK 0xF800 /end MEASUREMENT
/begin MEASUREMENT fmy_stat_v_egrv_0_grd.err_info_stat.lv_cdn_diag_stc "Statistical flag for condition of diagnosis of the diagnosis instance V_EGRV_0_GRD" UWORD _CNV_S_2_RANGE______383_CM 1 0. 0. 1. DISPLAY_IDENTIFIER LV_CDN_DIAG_STC_V_EGRV_0_GRD ECU_ADDRESS 0x7f9b5c BYTE_ORDER MSB_LAST BIT_MASK 0x400 /end MEASUREMENT
/begin MEASUREMENT fmy_stat_v_egrv_0_grd.err_info_stat.lv_lock_diag "lock flag (CPU load optimisation) of the diagnosis instance V_EGRV_0_GRD" UWORD _CNV_S_2_RANGE______383_CM 1 0. 0. 1. DISPLAY_IDENTIFIER LV_LOCK_DIAG_V_EGRV_0_GRD ECU_ADDRESS 0x7f9b5c BYTE_ORDER MSB_LAST BIT_MASK 0x200 /end MEASUREMENT
/begin MEASUREMENT fmy_stat_v_egrv_0_grd.err_info_stat.lv_err_mem "storage in dynamic failure memory of the diagnosis instance V_EGRV_0_GRD" UWORD _CNV_S_2_RANGE______383_CM 1 0. 0. 1. DISPLAY_IDENTIFIER LV_ERR_MEM_V_EGRV_0_GRD ECU_ADDRESS 0x7f9b5c BYTE_ORDER MSB_LAST BIT_MASK 0x80 /end MEASUREMENT
/begin MEASUREMENT fmy_stat_v_egrv_0_grd.err_info_stat.lv_ready "readiness status of the diagnosis instance V_EGRV_0_GRD" UWORD _CNV_S_2_RANGE______383_CM 1 0. 0. 1. DISPLAY_IDENTIFIER LV_READY_V_EGRV_0_GRD ECU_ADDRESS 0x7f9b5c BYTE_ORDER MSB_LAST BIT_MASK 0x40 /end MEASUREMENT
/begin MEASUREMENT fmy_stat_v_egrv_0_grd.err_info_stat.lv_end_diag "end of diagnosis of the diagnosis instance V_EGRV_0_GRD" UWORD _CNV_S_2_RANGE______383_CM 1 0. 0. 1. DISPLAY_IDENTIFIER LV_END_DIAG_V_EGRV_0_GRD ECU_ADDRESS 0x7f9b5c BYTE_ORDER MSB_LAST BIT_MASK 0x20 /end MEASUREMENT
/begin MEASUREMENT fmy_stat_v_egrv_0_grd.err_info_stat.lv_cdn_diag "diagnosis condition of the diagnosis instance V_EGRV_0_GRD" UWORD _CNV_S_2_RANGE______383_CM 1 0. 0. 1. DISPLAY_IDENTIFIER LV_CDN_DIAG_V_EGRV_0_GRD ECU_ADDRESS 0x7f9b5c BYTE_ORDER MSB_LAST BIT_MASK 0x10 /end MEASUREMENT
/begin MEASUREMENT fmy_stat_v_egrv_0_grd.err_info_stat.err_sym "symptoms of the diagnosis instance V_EGRV_0_GRD" UWORD _CNV_S_6_CONV_ERRM__22_CM 1 0. 0. 15. DISPLAY_IDENTIFIER ERR_SYM_V_EGRV_0_GRD ECU_ADDRESS 0x7f9b5c BYTE_ORDER MSB_LAST BIT_MASK 0xF /end MEASUREMENT
/begin MEASUREMENT lv_err_v_egrv_1_grd "Error flag of diagnosis instance V_EGRV_1_GRD" UBYTE _CNV_S_2_RANGE______23_CM 1 0. 0. 1. DISPLAY_IDENTIFIER LV_ERR_V_EGRV_1_GRD ECU_ADDRESS 0x7fb908 /end MEASUREMENT
/begin MEASUREMENT fmy_stat_v_egrv_1_grd.ctr_abc "anti bounce counter for diagnosis instance V_EGRV_1_GRD" UBYTE _CNV_A_R_LINEAR_____1_CM 1 0. 0. 255. DISPLAY_IDENTIFIER CTR_ABC_V_EGRV_1_GRD ECU_ADDRESS 0x7f9b63 FORMAT "%3.0" /end MEASUREMENT
/begin MEASUREMENT fmy_stat_v_egrv_1_grd.ctr_end_diag "counter for end of diagnosis for diagnosis instance V_EGRV_1_GRD" UBYTE _CNV_A_R_LINEAR_____1_CM 1 0. 0. 255. DISPLAY_IDENTIFIER CTR_ABC_END_DIAG_V_EGRV_1_GRD ECU_ADDRESS 0x7f9b62 FORMAT "%3.0" /end MEASUREMENT
/begin MEASUREMENT fmy_stat_v_egrv_1_grd.err_info_stat.reserved "" UWORD _CNV_A_R_LINEAR_____0_CM 1 0. 0. 65535. DISPLAY_IDENTIFIER FMY_STAT_V_EGRV_1_GRD_ERR_INFO_STAT_RESERVED ECU_ADDRESS 0x7f9b60 BYTE_ORDER MSB_LAST BIT_MASK 0xF800 /end MEASUREMENT
/begin MEASUREMENT fmy_stat_v_egrv_1_grd.err_info_stat.lv_cdn_diag_stc "Statistical flag for condition of diagnosis of the diagnosis instance V_EGRV_1_GRD" UWORD _CNV_S_2_RANGE______383_CM 1 0. 0. 1. DISPLAY_IDENTIFIER LV_CDN_DIAG_STC_V_EGRV_1_GRD ECU_ADDRESS 0x7f9b60 BYTE_ORDER MSB_LAST BIT_MASK 0x400 /end MEASUREMENT
/begin MEASUREMENT fmy_stat_v_egrv_1_grd.err_info_stat.lv_lock_diag "lock flag (CPU load optimisation) of the diagnosis instance V_EGRV_1_GRD" UWORD _CNV_S_2_RANGE______383_CM 1 0. 0. 1. DISPLAY_IDENTIFIER LV_LOCK_DIAG_V_EGRV_1_GRD ECU_ADDRESS 0x7f9b60 BYTE_ORDER MSB_LAST BIT_MASK 0x200 /end MEASUREMENT
/begin MEASUREMENT fmy_stat_v_egrv_1_grd.err_info_stat.lv_err_mem "storage in dynamic failure memory of the diagnosis instance V_EGRV_1_GRD" UWORD _CNV_S_2_RANGE______383_CM 1 0. 0. 1. DISPLAY_IDENTIFIER LV_ERR_MEM_V_EGRV_1_GRD ECU_ADDRESS 0x7f9b60 BYTE_ORDER MSB_LAST BIT_MASK 0x80 /end MEASUREMENT
/begin MEASUREMENT fmy_stat_v_egrv_1_grd.err_info_stat.lv_ready "readiness status of the diagnosis instance V_EGRV_1_GRD" UWORD _CNV_S_2_RANGE______383_CM 1 0. 0. 1. DISPLAY_IDENTIFIER LV_READY_V_EGRV_1_GRD ECU_ADDRESS 0x7f9b60 BYTE_ORDER MSB_LAST BIT_MASK 0x40 /end MEASUREMENT
/begin MEASUREMENT fmy_stat_v_egrv_1_grd.err_info_stat.lv_end_diag "end of diagnosis of the diagnosis instance V_EGRV_1_GRD" UWORD _CNV_S_2_RANGE______383_CM 1 0. 0. 1. DISPLAY_IDENTIFIER LV_END_DIAG_V_EGRV_1_GRD ECU_ADDRESS 0x7f9b60 BYTE_ORDER MSB_LAST BIT_MASK 0x20 /end MEASUREMENT
/begin MEASUREMENT fmy_stat_v_egrv_1_grd.err_info_stat.lv_cdn_diag "diagnosis condition of the diagnosis instance V_EGRV_1_GRD" UWORD _CNV_S_2_RANGE______383_CM 1 0. 0. 1. DISPLAY_IDENTIFIER LV_CDN_DIAG_V_EGRV_1_GRD ECU_ADDRESS 0x7f9b60 BYTE_ORDER MSB_LAST BIT_MASK 0x10 /end MEASUREMENT
/begin MEASUREMENT fmy_stat_v_egrv_1_grd.err_info_stat.err_sym "symptoms of the diagnosis instance V_EGRV_1_GRD" UWORD _CNV_S_6_CONV_ERRM__22_CM 1 0. 0. 15. DISPLAY_IDENTIFIER ERR_SYM_V_EGRV_1_GRD ECU_ADDRESS 0x7f9b60 BYTE_ORDER MSB_LAST BIT_MASK 0xF /end MEASUREMENT
/begin MEASUREMENT lv_err_ges_maf_0_max "Error flag of diagnosis instance GES_MAF_0_MAX" UBYTE _CNV_S_2_RANGE______23_CM 1 0. 0. 1. DISPLAY_IDENTIFIER LV_ERR_GES_MAF_0_MAX ECU_ADDRESS 0x7fb909 /end MEASUREMENT
/begin MEASUREMENT fmy_stat_ges_maf_0_max.ctr_abc "anti bounce counter for diagnosis instance GES_MAF_0_MAX" UBYTE _CNV_A_R_LINEAR_____1_CM 1 0. 0. 255. DISPLAY_IDENTIFIER CTR_ABC_GES_MAF_0_MAX ECU_ADDRESS 0x7f9b67 FORMAT "%3.0" /end MEASUREMENT
/begin MEASUREMENT fmy_stat_ges_maf_0_max.ctr_end_diag "counter for end of diagnosis for diagnosis instance GES_MAF_0_MAX" UBYTE _CNV_A_R_LINEAR_____1_CM 1 0. 0. 255. DISPLAY_IDENTIFIER CTR_ABC_END_DIAG_GES_MAF_0_MAX ECU_ADDRESS 0x7f9b66 FORMAT "%3.0" /end MEASUREMENT
/begin MEASUREMENT fmy_stat_ges_maf_0_max.err_info_stat.reserved "" UWORD _CNV_A_R_LINEAR_____0_CM 1 0. 0. 65535. DISPLAY_IDENTIFIER FMY_STAT_GES_MAF_0_MAX_ERR_INFO_STAT_RESERVED ECU_ADDRESS 0x7f9b64 BYTE_ORDER MSB_LAST BIT_MASK 0xF800 /end MEASUREMENT
/begin MEASUREMENT fmy_stat_ges_maf_0_max.err_info_stat.lv_cdn_diag_stc "Statistical flag for condition of diagnosis of the diagnosis instance GES_MAF_0_MAX" UWORD _CNV_S_2_RANGE______383_CM 1 0. 0. 1. DISPLAY_IDENTIFIER LV_CDN_DIAG_STC_GES_MAF_0_MAX ECU_ADDRESS 0x7f9b64 BYTE_ORDER MSB_LAST BIT_MASK 0x400 /end MEASUREMENT
/begin MEASUREMENT fmy_stat_ges_maf_0_max.err_info_stat.lv_lock_diag "lock flag (CPU load optimisation) of the diagnosis instance GES_MAF_0_MAX" UWORD _CNV_S_2_RANGE______383_CM 1 0. 0. 1. DISPLAY_IDENTIFIER LV_LOCK_DIAG_GES_MAF_0_MAX ECU_ADDRESS 0x7f9b64 BYTE_ORDER MSB_LAST BIT_MASK 0x200 /end MEASUREMENT
/begin MEASUREMENT fmy_stat_ges_maf_0_max.err_info_stat.lv_err_mem "storage in dynamic failure memory of the diagnosis instance GES_MAF_0_MAX" UWORD _CNV_S_2_RANGE______383_CM 1 0. 0. 1. DISPLAY_IDENTIFIER LV_ERR_MEM_GES_MAF_0_MAX ECU_ADDRESS 0x7f9b64 BYTE_ORDER MSB_LAST BIT_MASK 0x80 /end MEASUREMENT
/begin MEASUREMENT fmy_stat_ges_maf_0_max.err_info_stat.lv_ready "readiness status of the diagnosis instance GES_MAF_0_MAX" UWORD _CNV_S_2_RANGE______383_CM 1 0. 0. 1. DISPLAY_IDENTIFIER LV_READY_GES_MAF_0_MAX ECU_ADDRESS 0x7f9b64 BYTE_ORDER MSB_LAST BIT_MASK 0x40 /end MEASUREMENT
/begin MEASUREMENT fmy_stat_ges_maf_0_max.err_info_stat.lv_end_diag "end of diagnosis of the diagnosis instance GES_MAF_0_MAX" UWORD _CNV_S_2_RANGE______383_CM 1 0. 0. 1. DISPLAY_IDENTIFIER LV_END_DIAG_GES_MAF_0_MAX ECU_ADDRESS 0x7f9b64 BYTE_ORDER MSB_LAST BIT_MASK 0x20 /end MEASUREMENT
/begin MEASUREMENT fmy_stat_ges_maf_0_max.err_info_stat.lv_cdn_diag "diagnosis condition of the diagnosis instance GES_MAF_0_MAX" UWORD _CNV_S_2_RANGE______383_CM 1 0. 0. 1. DISPLAY_IDENTIFIER LV_CDN_DIAG_GES_MAF_0_MAX ECU_ADDRESS 0x7f9b64 BYTE_ORDER MSB_LAST BIT_MASK 0x10 /end MEASUREMENT
/begin MEASUREMENT fmy_stat_ges_maf_0_max.err_info_stat.err_sym "symptoms of the diagnosis instance GES_MAF_0_MAX" UWORD _CNV_S_6_CONV_ERRM__22_CM 1 0. 0. 15. DISPLAY_IDENTIFIER ERR_SYM_GES_MAF_0_MAX ECU_ADDRESS 0x7f9b64 BYTE_ORDER MSB_LAST BIT_MASK 0xF /end MEASUREMENT
/begin MEASUREMENT lv_err_tco_1_2_plaus "Error flag of diagnosis instance TCO_1_2_PLAUS" UBYTE _CNV_S_2_RANGE______23_CM 1 0. 0. 1. DISPLAY_IDENTIFIER LV_ERR_TCO_1_2_PLAUS ECU_ADDRESS 0x7fb90a /end MEASUREMENT
/begin MEASUREMENT fmy_stat_tco_1_2_plaus.ctr_abc "anti bounce counter for diagnosis instance TCO_1_2_PLAUS" UBYTE _CNV_A_R_LINEAR_____1_CM 1 0. 0. 255. DISPLAY_IDENTIFIER CTR_ABC_TCO_1_2_PLAUS ECU_ADDRESS 0x7f9b6b FORMAT "%3.0" /end MEASUREMENT
/begin MEASUREMENT fmy_stat_tco_1_2_plaus.ctr_end_diag "counter for end of diagnosis for diagnosis instance TCO_1_2_PLAUS" UBYTE _CNV_A_R_LINEAR_____1_CM 1 0. 0. 255. DISPLAY_IDENTIFIER CTR_ABC_END_DIAG_TCO_1_2_PLAUS ECU_ADDRESS 0x7f9b6a FORMAT "%3.0" /end MEASUREMENT
/begin MEASUREMENT fmy_stat_tco_1_2_plaus.err_info_stat.reserved "" UWORD _CNV_A_R_LINEAR_____0_CM 1 0. 0. 65535. DISPLAY_IDENTIFIER FMY_STAT_TCO_1_2_PLAUS_ERR_INFO_STAT_RESERVED ECU_ADDRESS 0x7f9b68 BYTE_ORDER MSB_LAST BIT_MASK 0xF800 /end MEASUREMENT
/begin MEASUREMENT fmy_stat_tco_1_2_plaus.err_info_stat.lv_cdn_diag_stc "Statistical flag for condition of diagnosis of the diagnosis instance TCO_1_2_PLAUS" UWORD _CNV_S_2_RANGE______383_CM 1 0. 0. 1. DISPLAY_IDENTIFIER LV_CDN_DIAG_STC_TCO_1_2_PLAUS ECU_ADDRESS 0x7f9b68 BYTE_ORDER MSB_LAST BIT_MASK 0x400 /end MEASUREMENT
/begin MEASUREMENT fmy_stat_tco_1_2_plaus.err_info_stat.lv_lock_diag "lock flag (CPU load optimisation) of the diagnosis instance TCO_1_2_PLAUS" UWORD _CNV_S_2_RANGE______383_CM 1 0. 0. 1. DISPLAY_IDENTIFIER LV_LOCK_DIAG_TCO_1_2_PLAUS ECU_ADDRESS 0x7f9b68 BYTE_ORDER MSB_LAST BIT_MASK 0x200 /end MEASUREMENT
/begin MEASUREMENT fmy_stat_tco_1_2_plaus.err_info_stat.lv_err_mem "storage in dynamic failure memory of the diagnosis instance TCO_1_2_PLAUS" UWORD _CNV_S_2_RANGE______383_CM 1 0. 0. 1. DISPLAY_IDENTIFIER LV_ERR_MEM_TCO_1_2_PLAUS ECU_ADDRESS 0x7f9b68 BYTE_ORDER MSB_LAST BIT_MASK 0x80 /end MEASUREMENT
/begin MEASUREMENT fmy_stat_tco_1_2_plaus.err_info_stat.lv_ready "readiness status of the diagnosis instance TCO_1_2_PLAUS" UWORD _CNV_S_2_RANGE______383_CM 1 0. 0. 1. DISPLAY_IDENTIFIER LV_READY_TCO_1_2_PLAUS ECU_ADDRESS 0x7f9b68 BYTE_ORDER MSB_LAST BIT_MASK 0x40 /end MEASUREMENT
/begin MEASUREMENT fmy_stat_tco_1_2_plaus.err_info_stat.lv_end_diag "end of diagnosis of the diagnosis instance TCO_1_2_PLAUS" UWORD _CNV_S_2_RANGE______383_CM 1 0. 0. 1. DISPLAY_IDENTIFIER LV_END_DIAG_TCO_1_2_PLAUS ECU_ADDRESS 0x7f9b68 BYTE_ORDER MSB_LAST BIT_MASK 0x20 /end MEASUREMENT
/begin MEASUREMENT fmy_stat_tco_1_2_plaus.err_info_stat.lv_cdn_diag "diagnosis condition of the diagnosis instance TCO_1_2_PLAUS" UWORD _CNV_S_2_RANGE______383_CM 1 0. 0. 1. DISPLAY_IDENTIFIER LV_CDN_DIAG_TCO_1_2_PLAUS ECU_ADDRESS 0x7f9b68 BYTE_ORDER MSB_LAST BIT_MASK 0x10 /end MEASUREMENT
/begin MEASUREMENT fmy_stat_tco_1_2_plaus.err_info_stat.err_sym "symptoms of the diagnosis instance TCO_1_2_PLAUS" UWORD _CNV_S_6_CONV_ERRM__22_CM 1 0. 0. 15. DISPLAY_IDENTIFIER ERR_SYM_TCO_1_2_PLAUS ECU_ADDRESS 0x7f9b68 BYTE_ORDER MSB_LAST BIT_MASK 0xF /end MEASUREMENT
/begin MEASUREMENT lv_err_efp_rly_dps "Error flag of diagnosis instance EFP_RLY_DPS" UBYTE _CNV_S_2_RANGE______23_CM 1 0. 0. 1. DISPLAY_IDENTIFIER LV_ERR_EFP_RLY_DPS ECU_ADDRESS 0x7fb90b /end MEASUREMENT
/begin MEASUREMENT fmy_stat_efp_rly_dps.ctr_abc "anti bounce counter for diagnosis instance EFP_RLY_DPS" UBYTE _CNV_A_R_LINEAR_____1_CM 1 0. 0. 255. DISPLAY_IDENTIFIER CTR_ABC_EFP_RLY_DPS ECU_ADDRESS 0x7f9b6f FORMAT "%3.0" /end MEASUREMENT
/begin MEASUREMENT fmy_stat_efp_rly_dps.ctr_end_diag "counter for end of diagnosis for diagnosis instance EFP_RLY_DPS" UBYTE _CNV_A_R_LINEAR_____1_CM 1 0. 0. 255. DISPLAY_IDENTIFIER CTR_ABC_END_DIAG_EFP_RLY_DPS ECU_ADDRESS 0x7f9b6e FORMAT "%3.0" /end MEASUREMENT
/begin MEASUREMENT fmy_stat_efp_rly_dps.err_info_stat.reserved "" UWORD _CNV_A_R_LINEAR_____0_CM 1 0. 0. 65535. DISPLAY_IDENTIFIER FMY_STAT_EFP_RLY_DPS_ERR_INFO_STAT_RESERVED ECU_ADDRESS 0x7f9b6c BYTE_ORDER MSB_LAST BIT_MASK 0xF800 /end MEASUREMENT
/begin MEASUREMENT fmy_stat_efp_rly_dps.err_info_stat.lv_cdn_diag_stc "Statistical flag for condition of diagnosis of the diagnosis instance EFP_RLY_DPS" UWORD _CNV_S_2_RANGE______383_CM 1 0. 0. 1. DISPLAY_IDENTIFIER LV_CDN_DIAG_STC_EFP_RLY_DPS ECU_ADDRESS 0x7f9b6c BYTE_ORDER MSB_LAST BIT_MASK 0x400 /end MEASUREMENT
/begin MEASUREMENT fmy_stat_efp_rly_dps.err_info_stat.lv_lock_diag "lock flag (CPU load optimisation) of the diagnosis instance EFP_RLY_DPS" UWORD _CNV_S_2_RANGE______383_CM 1 0. 0. 1. DISPLAY_IDENTIFIER LV_LOCK_DIAG_EFP_RLY_DPS ECU_ADDRESS 0x7f9b6c BYTE_ORDER MSB_LAST BIT_MASK 0x200 /end MEASUREMENT
/begin MEASUREMENT fmy_stat_efp_rly_dps.err_info_stat.lv_err_mem "storage in dynamic failure memory of the diagnosis instance EFP_RLY_DPS" UWORD _CNV_S_2_RANGE______383_CM 1 0. 0. 1. DISPLAY_IDENTIFIER LV_ERR_MEM_EFP_RLY_DPS ECU_ADDRESS 0x7f9b6c BYTE_ORDER MSB_LAST BIT_MASK 0x80 /end MEASUREMENT
/begin MEASUREMENT fmy_stat_efp_rly_dps.err_info_stat.lv_ready "readiness status of the diagnosis instance EFP_RLY_DPS" UWORD _CNV_S_2_RANGE______383_CM 1 0. 0. 1. DISPLAY_IDENTIFIER LV_READY_EFP_RLY_DPS ECU_ADDRESS 0x7f9b6c BYTE_ORDER MSB_LAST BIT_MASK 0x40 /end MEASUREMENT
/begin MEASUREMENT fmy_stat_efp_rly_dps.err_info_stat.lv_end_diag "end of diagnosis of the diagnosis instance EFP_RLY_DPS" UWORD _CNV_S_2_RANGE______383_CM 1 0. 0. 1. DISPLAY_IDENTIFIER LV_END_DIAG_EFP_RLY_DPS ECU_ADDRESS 0x7f9b6c BYTE_ORDER MSB_LAST BIT_MASK 0x20 /end MEASUREMENT
/begin MEASUREMENT fmy_stat_efp_rly_dps.err_info_stat.lv_cdn_diag "diagnosis condition of the diagnosis instance EFP_RLY_DPS" UWORD _CNV_S_2_RANGE______383_CM 1 0. 0. 1. DISPLAY_IDENTIFIER LV_CDN_DIAG_EFP_RLY_DPS ECU_ADDRESS 0x7f9b6c BYTE_ORDER MSB_LAST BIT_MASK 0x10 /end MEASUREMENT
/begin MEASUREMENT fmy_stat_efp_rly_dps.err_info_stat.err_sym "symptoms of the diagnosis instance EFP_RLY_DPS" UWORD _CNV_S_6_CONV_ERRM__22_CM 1 0. 0. 15. DISPLAY_IDENTIFIER ERR_SYM_EFP_RLY_DPS ECU_ADDRESS 0x7f9b6c BYTE_ORDER MSB_LAST BIT_MASK 0xF /end MEASUREMENT
/begin MEASUREMENT lv_err_efp_rly_plaus_1 "Error flag of diagnosis instance EFP_RLY_PLAUS_1" UBYTE _CNV_S_2_RANGE______23_CM 1 0. 0. 1. DISPLAY_IDENTIFIER LV_ERR_EFP_RLY_PLAUS_1 ECU_ADDRESS 0x7fb90c /end MEASUREMENT
/begin MEASUREMENT fmy_stat_efp_rly_plaus_1.ctr_abc "anti bounce counter for diagnosis instance EFP_RLY_PLAUS_1" UBYTE _CNV_A_R_LINEAR_____1_CM 1 0. 0. 255. DISPLAY_IDENTIFIER CTR_ABC_EFP_RLY_PLAUS_1 ECU_ADDRESS 0x7f9b73 FORMAT "%3.0" /end MEASUREMENT
/begin MEASUREMENT fmy_stat_efp_rly_plaus_1.ctr_end_diag "counter for end of diagnosis for diagnosis instance EFP_RLY_PLAUS_1" UBYTE _CNV_A_R_LINEAR_____1_CM 1 0. 0. 255. DISPLAY_IDENTIFIER CTR_ABC_END_DIAG_EFP_RLY_PLAUS_1 ECU_ADDRESS 0x7f9b72 FORMAT "%3.0" /end MEASUREMENT
/begin MEASUREMENT fmy_stat_efp_rly_plaus_1.err_info_stat.reserved "" UWORD _CNV_A_R_LINEAR_____0_CM 1 0. 0. 65535. DISPLAY_IDENTIFIER FMY_STAT_EFP_RLY_PLAUS_1_ERR_INFO_STAT_RESERVED ECU_ADDRESS 0x7f9b70 BYTE_ORDER MSB_LAST BIT_MASK 0xF800 /end MEASUREMENT
/begin MEASUREMENT fmy_stat_efp_rly_plaus_1.err_info_stat.lv_cdn_diag_stc "Statistical flag for condition of diagnosis of the diagnosis instance EFP_RLY_PLAUS_1" UWORD _CNV_S_2_RANGE______383_CM 1 0. 0. 1. DISPLAY_IDENTIFIER LV_CDN_DIAG_STC_EFP_RLY_PLAUS_1 ECU_ADDRESS 0x7f9b70 BYTE_ORDER MSB_LAST BIT_MASK 0x400 /end MEASUREMENT
/begin MEASUREMENT fmy_stat_efp_rly_plaus_1.err_info_stat.lv_lock_diag "lock flag (CPU load optimisation) of the diagnosis instance EFP_RLY_PLAUS_1" UWORD _CNV_S_2_RANGE______383_CM 1 0. 0. 1. DISPLAY_IDENTIFIER LV_LOCK_DIAG_EFP_RLY_PLAUS_1 ECU_ADDRESS 0x7f9b70 BYTE_ORDER MSB_LAST BIT_MASK 0x200 /end MEASUREMENT
/begin MEASUREMENT fmy_stat_efp_rly_plaus_1.err_info_stat.lv_err_mem "storage in dynamic failure memory of the diagnosis instance EFP_RLY_PLAUS_1" UWORD _CNV_S_2_RANGE______383_CM 1 0. 0. 1. DISPLAY_IDENTIFIER LV_ERR_MEM_EFP_RLY_PLAUS_1 ECU_ADDRESS 0x7f9b70 BYTE_ORDER MSB_LAST BIT_MASK 0x80 /end MEASUREMENT
/begin MEASUREMENT fmy_stat_efp_rly_plaus_1.err_info_stat.lv_ready "readiness status of the diagnosis instance EFP_RLY_PLAUS_1" UWORD _CNV_S_2_RANGE______383_CM 1 0. 0. 1. DISPLAY_IDENTIFIER LV_READY_EFP_RLY_PLAUS_1 ECU_ADDRESS 0x7f9b70 BYTE_ORDER MSB_LAST BIT_MASK 0x40 /end MEASUREMENT
/begin MEASUREMENT fmy_stat_efp_rly_plaus_1.err_info_stat.lv_end_diag "end of diagnosis of the diagnosis instance EFP_RLY_PLAUS_1" UWORD _CNV_S_2_RANGE______383_CM 1 0. 0. 1. DISPLAY_IDENTIFIER LV_END_DIAG_EFP_RLY_PLAUS_1 ECU_ADDRESS 0x7f9b70 BYTE_ORDER MSB_LAST BIT_MASK 0x20 /end MEASUREMENT
/begin MEASUREMENT fmy_stat_efp_rly_plaus_1.err_info_stat.lv_cdn_diag "diagnosis condition of the diagnosis instance EFP_RLY_PLAUS_1" UWORD _CNV_S_2_RANGE______383_CM 1 0. 0. 1. DISPLAY_IDENTIFIER LV_CDN_DIAG_EFP_RLY_PLAUS_1 ECU_ADDRESS 0x7f9b70 BYTE_ORDER MSB_LAST BIT_MASK 0x10 /end MEASUREMENT
/begin MEASUREMENT fmy_stat_efp_rly_plaus_1.err_info_stat.err_sym "symptoms of the diagnosis instance EFP_RLY_PLAUS_1" UWORD _CNV_S_6_CONV_ERRM__22_CM 1 0. 0. 15. DISPLAY_IDENTIFIER ERR_SYM_EFP_RLY_PLAUS_1 ECU_ADDRESS 0x7f9b70 BYTE_ORDER MSB_LAST BIT_MASK 0xF /end MEASUREMENT
/begin MEASUREMENT lv_err_efp_rly_plaus_2 "Error flag of diagnosis instance EFP_RLY_PLAUS_2" UBYTE _CNV_S_2_RANGE______23_CM 1 0. 0. 1. DISPLAY_IDENTIFIER LV_ERR_EFP_RLY_PLAUS_2 ECU_ADDRESS 0x7fb90d /end MEASUREMENT
/begin MEASUREMENT fmy_stat_efp_rly_plaus_2.ctr_abc "anti bounce counter for diagnosis instance EFP_RLY_PLAUS_2" UBYTE _CNV_A_R_LINEAR_____1_CM 1 0. 0. 255. DISPLAY_IDENTIFIER CTR_ABC_EFP_RLY_PLAUS_2 ECU_ADDRESS 0x7f9b77 FORMAT "%3.0" /end MEASUREMENT
/begin MEASUREMENT fmy_stat_efp_rly_plaus_2.ctr_end_diag "counter for end of diagnosis for diagnosis instance EFP_RLY_PLAUS_2" UBYTE _CNV_A_R_LINEAR_____1_CM 1 0. 0. 255. DISPLAY_IDENTIFIER CTR_ABC_END_DIAG_EFP_RLY_PLAUS_2 ECU_ADDRESS 0x7f9b76 FORMAT "%3.0" /end MEASUREMENT
/begin MEASUREMENT fmy_stat_efp_rly_plaus_2.err_info_stat.reserved "" UWORD _CNV_A_R_LINEAR_____0_CM 1 0. 0. 65535. DISPLAY_IDENTIFIER FMY_STAT_EFP_RLY_PLAUS_2_ERR_INFO_STAT_RESERVED ECU_ADDRESS 0x7f9b74 BYTE_ORDER MSB_LAST BIT_MASK 0xF800 /end MEASUREMENT
/begin MEASUREMENT fmy_stat_efp_rly_plaus_2.err_info_stat.lv_cdn_diag_stc "Statistical flag for condition of diagnosis of the diagnosis instance EFP_RLY_PLAUS_2" UWORD _CNV_S_2_RANGE______383_CM 1 0. 0. 1. DISPLAY_IDENTIFIER LV_CDN_DIAG_STC_EFP_RLY_PLAUS_2 ECU_ADDRESS 0x7f9b74 BYTE_ORDER MSB_LAST BIT_MASK 0x400 /end MEASUREMENT
/begin MEASUREMENT fmy_stat_efp_rly_plaus_2.err_info_stat.lv_lock_diag "lock flag (CPU load optimisation) of the diagnosis instance EFP_RLY_PLAUS_2" UWORD _CNV_S_2_RANGE______383_CM 1 0. 0. 1. DISPLAY_IDENTIFIER LV_LOCK_DIAG_EFP_RLY_PLAUS_2 ECU_ADDRESS 0x7f9b74 BYTE_ORDER MSB_LAST BIT_MASK 0x200 /end MEASUREMENT
/begin MEASUREMENT fmy_stat_efp_rly_plaus_2.err_info_stat.lv_err_mem "storage in dynamic failure memory of the diagnosis instance EFP_RLY_PLAUS_2" UWORD _CNV_S_2_RANGE______383_CM 1 0. 0. 1. DISPLAY_IDENTIFIER LV_ERR_MEM_EFP_RLY_PLAUS_2 ECU_ADDRESS 0x7f9b74 BYTE_ORDER MSB_LAST BIT_MASK 0x80 /end MEASUREMENT
/begin MEASUREMENT fmy_stat_efp_rly_plaus_2.err_info_stat.lv_ready "readiness status of the diagnosis instance EFP_RLY_PLAUS_2" UWORD _CNV_S_2_RANGE______383_CM 1 0. 0. 1. DISPLAY_IDENTIFIER LV_READY_EFP_RLY_PLAUS_2 ECU_ADDRESS 0x7f9b74 BYTE_ORDER MSB_LAST BIT_MASK 0x40 /end MEASUREMENT
/begin MEASUREMENT fmy_stat_efp_rly_plaus_2.err_info_stat.lv_end_diag "end of diagnosis of the diagnosis instance EFP_RLY_PLAUS_2" UWORD _CNV_S_2_RANGE______383_CM 1 0. 0. 1. DISPLAY_IDENTIFIER LV_END_DIAG_EFP_RLY_PLAUS_2 ECU_ADDRESS 0x7f9b74 BYTE_ORDER MSB_LAST BIT_MASK 0x20 /end MEASUREMENT
/begin MEASUREMENT fmy_stat_efp_rly_plaus_2.err_info_stat.lv_cdn_diag "diagnosis condition of the diagnosis instance EFP_RLY_PLAUS_2" UWORD _CNV_S_2_RANGE______383_CM 1 0. 0. 1. DISPLAY_IDENTIFIER LV_CDN_DIAG_EFP_RLY_PLAUS_2 ECU_ADDRESS 0x7f9b74 BYTE_ORDER MSB_LAST BIT_MASK 0x10 /end MEASUREMENT
/begin MEASUREMENT fmy_stat_efp_rly_plaus_2.err_info_stat.err_sym "symptoms of the diagnosis instance EFP_RLY_PLAUS_2" UWORD _CNV_S_6_CONV_ERRM__22_CM 1 0. 0. 15. DISPLAY_IDENTIFIER ERR_SYM_EFP_RLY_PLAUS_2 ECU_ADDRESS 0x7f9b74 BYTE_ORDER MSB_LAST BIT_MASK 0xF /end MEASUREMENT
/begin MEASUREMENT lv_err_spi_mps "Error flag of diagnosis instance SPI_MPS" UBYTE _CNV_S_2_RANGE______23_CM 1 0. 0. 1. DISPLAY_IDENTIFIER LV_ERR_SPI_MPS ECU_ADDRESS 0x7fb90e /end MEASUREMENT
/begin MEASUREMENT fmy_stat_spi_mps.ctr_abc "anti bounce counter for diagnosis instance SPI_MPS" UBYTE _CNV_A_R_LINEAR_____1_CM 1 0. 0. 255. DISPLAY_IDENTIFIER CTR_ABC_SPI_MPS ECU_ADDRESS 0x7f9b7b FORMAT "%3.0" /end MEASUREMENT
/begin MEASUREMENT fmy_stat_spi_mps.ctr_end_diag "counter for end of diagnosis for diagnosis instance SPI_MPS" UBYTE _CNV_A_R_LINEAR_____1_CM 1 0. 0. 255. DISPLAY_IDENTIFIER CTR_ABC_END_DIAG_SPI_MPS ECU_ADDRESS 0x7f9b7a FORMAT "%3.0" /end MEASUREMENT
/begin MEASUREMENT fmy_stat_spi_mps.err_info_stat.reserved "" UWORD _CNV_A_R_LINEAR_____0_CM 1 0. 0. 65535. DISPLAY_IDENTIFIER FMY_STAT_SPI_MPS_ERR_INFO_STAT_RESERVED ECU_ADDRESS 0x7f9b78 BYTE_ORDER MSB_LAST BIT_MASK 0xF800 /end MEASUREMENT
/begin MEASUREMENT fmy_stat_spi_mps.err_info_stat.lv_cdn_diag_stc "Statistical flag for condition of diagnosis of the diagnosis instance SPI_MPS" UWORD _CNV_S_2_RANGE______383_CM 1 0. 0. 1. DISPLAY_IDENTIFIER LV_CDN_DIAG_STC_SPI_MPS ECU_ADDRESS 0x7f9b78 BYTE_ORDER MSB_LAST BIT_MASK 0x400 /end MEASUREMENT
/begin MEASUREMENT fmy_stat_spi_mps.err_info_stat.lv_lock_diag "lock flag (CPU load optimisation) of the diagnosis instance SPI_MPS" UWORD _CNV_S_2_RANGE______383_CM 1 0. 0. 1. DISPLAY_IDENTIFIER LV_LOCK_DIAG_SPI_MPS ECU_ADDRESS 0x7f9b78 BYTE_ORDER MSB_LAST BIT_MASK 0x200 /end MEASUREMENT
/begin MEASUREMENT fmy_stat_spi_mps.err_info_stat.lv_err_mem "storage in dynamic failure memory of the diagnosis instance SPI_MPS" UWORD _CNV_S_2_RANGE______383_CM 1 0. 0. 1. DISPLAY_IDENTIFIER LV_ERR_MEM_SPI_MPS ECU_ADDRESS 0x7f9b78 BYTE_ORDER MSB_LAST BIT_MASK 0x80 /end MEASUREMENT
/begin MEASUREMENT fmy_stat_spi_mps.err_info_stat.lv_ready "readiness status of the diagnosis instance SPI_MPS" UWORD _CNV_S_2_RANGE______383_CM 1 0. 0. 1. DISPLAY_IDENTIFIER LV_READY_SPI_MPS ECU_ADDRESS 0x7f9b78 BYTE_ORDER MSB_LAST BIT_MASK 0x40 /end MEASUREMENT
/begin MEASUREMENT fmy_stat_spi_mps.err_info_stat.lv_end_diag "end of diagnosis of the diagnosis instance SPI_MPS" UWORD _CNV_S_2_RANGE______383_CM 1 0. 0. 1. DISPLAY_IDENTIFIER LV_END_DIAG_SPI_MPS ECU_ADDRESS 0x7f9b78 BYTE_ORDER MSB_LAST BIT_MASK 0x20 /end MEASUREMENT
/begin MEASUREMENT fmy_stat_spi_mps.err_info_stat.lv_cdn_diag "diagnosis condition of the diagnosis instance SPI_MPS" UWORD _CNV_S_2_RANGE______383_CM 1 0. 0. 1. DISPLAY_IDENTIFIER LV_CDN_DIAG_SPI_MPS ECU_ADDRESS 0x7f9b78 BYTE_ORDER MSB_LAST BIT_MASK 0x10 /end MEASUREMENT
/begin MEASUREMENT fmy_stat_spi_mps.err_info_stat.err_sym "symptoms of the diagnosis instance SPI_MPS" UWORD _CNV_S_6_CONV_ERRM__22_CM 1 0. 0. 15. DISPLAY_IDENTIFIER ERR_SYM_SPI_MPS ECU_ADDRESS 0x7f9b78 BYTE_ORDER MSB_LAST BIT_MASK 0xF /end MEASUREMENT
/begin MEASUREMENT lv_err_spi_oct "Error flag of diagnosis instance SPI_OCT" UBYTE _CNV_S_2_RANGE______23_CM 1 0. 0. 1. DISPLAY_IDENTIFIER LV_ERR_SPI_OCT ECU_ADDRESS 0x7fb90f /end MEASUREMENT
/begin MEASUREMENT fmy_stat_spi_oct.ctr_abc "anti bounce counter for diagnosis instance SPI_OCT" UBYTE _CNV_A_R_LINEAR_____1_CM 1 0. 0. 255. DISPLAY_IDENTIFIER CTR_ABC_SPI_OCT ECU_ADDRESS 0x7f9b7f FORMAT "%3.0" /end MEASUREMENT
/begin MEASUREMENT fmy_stat_spi_oct.ctr_end_diag "counter for end of diagnosis for diagnosis instance SPI_OCT" UBYTE _CNV_A_R_LINEAR_____1_CM 1 0. 0. 255. DISPLAY_IDENTIFIER CTR_ABC_END_DIAG_SPI_OCT ECU_ADDRESS 0x7f9b7e FORMAT "%3.0" /end MEASUREMENT
/begin MEASUREMENT fmy_stat_spi_oct.err_info_stat.reserved "" UWORD _CNV_A_R_LINEAR_____0_CM 1 0. 0. 65535. DISPLAY_IDENTIFIER FMY_STAT_SPI_OCT_ERR_INFO_STAT_RESERVED ECU_ADDRESS 0x7f9b7c BYTE_ORDER MSB_LAST BIT_MASK 0xF800 /end MEASUREMENT
/begin MEASUREMENT fmy_stat_spi_oct.err_info_stat.lv_cdn_diag_stc "Statistical flag for condition of diagnosis of the diagnosis instance SPI_OCT" UWORD _CNV_S_2_RANGE______383_CM 1 0. 0. 1. DISPLAY_IDENTIFIER LV_CDN_DIAG_STC_SPI_OCT ECU_ADDRESS 0x7f9b7c BYTE_ORDER MSB_LAST BIT_MASK 0x400 /end MEASUREMENT
/begin MEASUREMENT fmy_stat_spi_oct.err_info_stat.lv_lock_diag "lock flag (CPU load optimisation) of the diagnosis instance SPI_OCT" UWORD _CNV_S_2_RANGE______383_CM 1 0. 0. 1. DISPLAY_IDENTIFIER LV_LOCK_DIAG_SPI_OCT ECU_ADDRESS 0x7f9b7c BYTE_ORDER MSB_LAST BIT_MASK 0x200 /end MEASUREMENT
/begin MEASUREMENT fmy_stat_spi_oct.err_info_stat.lv_err_mem "storage in dynamic failure memory of the diagnosis instance SPI_OCT" UWORD _CNV_S_2_RANGE______383_CM 1 0. 0. 1. DISPLAY_IDENTIFIER LV_ERR_MEM_SPI_OCT ECU_ADDRESS 0x7f9b7c BYTE_ORDER MSB_LAST BIT_MASK 0x80 /end MEASUREMENT
/begin MEASUREMENT fmy_stat_spi_oct.err_info_stat.lv_ready "readiness status of the diagnosis instance SPI_OCT" UWORD _CNV_S_2_RANGE______383_CM 1 0. 0. 1. DISPLAY_IDENTIFIER LV_READY_SPI_OCT ECU_ADDRESS 0x7f9b7c BYTE_ORDER MSB_LAST BIT_MASK 0x40 /end MEASUREMENT
/begin MEASUREMENT fmy_stat_spi_oct.err_info_stat.lv_end_diag "end of diagnosis of the diagnosis instance SPI_OCT" UWORD _CNV_S_2_RANGE______383_CM 1 0. 0. 1. DISPLAY_IDENTIFIER LV_END_DIAG_SPI_OCT ECU_ADDRESS 0x7f9b7c BYTE_ORDER MSB_LAST BIT_MASK 0x20 /end MEASUREMENT
/begin MEASUREMENT fmy_stat_spi_oct.err_info_stat.lv_cdn_diag "diagnosis condition of the diagnosis instance SPI_OCT" UWORD _CNV_S_2_RANGE______383_CM 1 0. 0. 1. DISPLAY_IDENTIFIER LV_CDN_DIAG_SPI_OCT ECU_ADDRESS 0x7f9b7c BYTE_ORDER MSB_LAST BIT_MASK 0x10 /end MEASUREMENT
/begin MEASUREMENT fmy_stat_spi_oct.err_info_stat.err_sym "symptoms of the diagnosis instance SPI_OCT" UWORD _CNV_S_6_CONV_ERRM__22_CM 1 0. 0. 15. DISPLAY_IDENTIFIER ERR_SYM_SPI_OCT ECU_ADDRESS 0x7f9b7c BYTE_ORDER MSB_LAST BIT_MASK 0xF /end MEASUREMENT
/begin MEASUREMENT lv_err_spi_qps "Error flag of diagnosis instance SPI_QPS" UBYTE _CNV_S_2_RANGE______23_CM 1 0. 0. 1. DISPLAY_IDENTIFIER LV_ERR_SPI_QPS ECU_ADDRESS 0x7fb910 /end MEASUREMENT
/begin MEASUREMENT fmy_stat_spi_qps.ctr_abc "anti bounce counter for diagnosis instance SPI_QPS" UBYTE _CNV_A_R_LINEAR_____1_CM 1 0. 0. 255. DISPLAY_IDENTIFIER CTR_ABC_SPI_QPS ECU_ADDRESS 0x7f9b83 FORMAT "%3.0" /end MEASUREMENT
/begin MEASUREMENT fmy_stat_spi_qps.ctr_end_diag "counter for end of diagnosis for diagnosis instance SPI_QPS" UBYTE _CNV_A_R_LINEAR_____1_CM 1 0. 0. 255. DISPLAY_IDENTIFIER CTR_ABC_END_DIAG_SPI_QPS ECU_ADDRESS 0x7f9b82 FORMAT "%3.0" /end MEASUREMENT
/begin MEASUREMENT fmy_stat_spi_qps.err_info_stat.reserved "" UWORD _CNV_A_R_LINEAR_____0_CM 1 0. 0. 65535. DISPLAY_IDENTIFIER FMY_STAT_SPI_QPS_ERR_INFO_STAT_RESERVED ECU_ADDRESS 0x7f9b80 BYTE_ORDER MSB_LAST BIT_MASK 0xF800 /end MEASUREMENT
/begin MEASUREMENT fmy_stat_spi_qps.err_info_stat.lv_cdn_diag_stc "Statistical flag for condition of diagnosis of the diagnosis instance SPI_QPS" UWORD _CNV_S_2_RANGE______383_CM 1 0. 0. 1. DISPLAY_IDENTIFIER LV_CDN_DIAG_STC_SPI_QPS ECU_ADDRESS 0x7f9b80 BYTE_ORDER MSB_LAST BIT_MASK 0x400 /end MEASUREMENT
/begin MEASUREMENT fmy_stat_spi_qps.err_info_stat.lv_lock_diag "lock flag (CPU load optimisation) of the diagnosis instance SPI_QPS" UWORD _CNV_S_2_RANGE______383_CM 1 0. 0. 1. DISPLAY_IDENTIFIER LV_LOCK_DIAG_SPI_QPS ECU_ADDRESS 0x7f9b80 BYTE_ORDER MSB_LAST BIT_MASK 0x200 /end MEASUREMENT
/begin MEASUREMENT fmy_stat_spi_qps.err_info_stat.lv_err_mem "storage in dynamic failure memory of the diagnosis instance SPI_QPS" UWORD _CNV_S_2_RANGE______383_CM 1 0. 0. 1. DISPLAY_IDENTIFIER LV_ERR_MEM_SPI_QPS ECU_ADDRESS 0x7f9b80 BYTE_ORDER MSB_LAST BIT_MASK 0x80 /end MEASUREMENT
/begin MEASUREMENT fmy_stat_spi_qps.err_info_stat.lv_ready "readiness status of the diagnosis instance SPI_QPS" UWORD _CNV_S_2_RANGE______383_CM 1 0. 0. 1. DISPLAY_IDENTIFIER LV_READY_SPI_QPS ECU_ADDRESS 0x7f9b80 BYTE_ORDER MSB_LAST BIT_MASK 0x40 /end MEASUREMENT
/begin MEASUREMENT fmy_stat_spi_qps.err_info_stat.lv_end_diag "end of diagnosis of the diagnosis instance SPI_QPS" UWORD _CNV_S_2_RANGE______383_CM 1 0. 0. 1. DISPLAY_IDENTIFIER LV_END_DIAG_SPI_QPS ECU_ADDRESS 0x7f9b80 BYTE_ORDER MSB_LAST BIT_MASK 0x20 /end MEASUREMENT
/begin MEASUREMENT fmy_stat_spi_qps.err_info_stat.lv_cdn_diag "diagnosis condition of the diagnosis instance SPI_QPS" UWORD _CNV_S_2_RANGE______383_CM 1 0. 0. 1. DISPLAY_IDENTIFIER LV_CDN_DIAG_SPI_QPS ECU_ADDRESS 0x7f9b80 BYTE_ORDER MSB_LAST BIT_MASK 0x10 /end MEASUREMENT
/begin MEASUREMENT fmy_stat_spi_qps.err_info_stat.err_sym "symptoms of the diagnosis instance SPI_QPS" UWORD _CNV_S_6_CONV_ERRM__22_CM 1 0. 0. 15. DISPLAY_IDENTIFIER ERR_SYM_SPI_QPS ECU_ADDRESS 0x7f9b80 BYTE_ORDER MSB_LAST BIT_MASK 0xF /end MEASUREMENT
/begin MEASUREMENT lv_err_egr_byp_dps "Error flag of diagnosis instance EGR_BYP_DPS" UBYTE _CNV_S_2_RANGE______23_CM 1 0. 0. 1. DISPLAY_IDENTIFIER LV_ERR_EGR_BYP_DPS ECU_ADDRESS 0x7fb911 /end MEASUREMENT
/begin MEASUREMENT fmy_stat_egr_byp_dps.ctr_abc "anti bounce counter for diagnosis instance EGR_BYP_DPS" UBYTE _CNV_A_R_LINEAR_____1_CM 1 0. 0. 255. DISPLAY_IDENTIFIER CTR_ABC_EGR_BYP_DPS ECU_ADDRESS 0x7f9b87 FORMAT "%3.0" /end MEASUREMENT
/begin MEASUREMENT fmy_stat_egr_byp_dps.ctr_end_diag "counter for end of diagnosis for diagnosis instance EGR_BYP_DPS" UBYTE _CNV_A_R_LINEAR_____1_CM 1 0. 0. 255. DISPLAY_IDENTIFIER CTR_ABC_END_DIAG_EGR_BYP_DPS ECU_ADDRESS 0x7f9b86 FORMAT "%3.0" /end MEASUREMENT
/begin MEASUREMENT fmy_stat_egr_byp_dps.err_info_stat.reserved "" UWORD _CNV_A_R_LINEAR_____0_CM 1 0. 0. 65535. DISPLAY_IDENTIFIER FMY_STAT_EGR_BYP_DPS_ERR_INFO_STAT_RESERVED ECU_ADDRESS 0x7f9b84 BYTE_ORDER MSB_LAST BIT_MASK 0xF800 /end MEASUREMENT
/begin MEASUREMENT fmy_stat_egr_byp_dps.err_info_stat.lv_cdn_diag_stc "Statistical flag for condition of diagnosis of the diagnosis instance EGR_BYP_DPS" UWORD _CNV_S_2_RANGE______383_CM 1 0. 0. 1. DISPLAY_IDENTIFIER LV_CDN_DIAG_STC_EGR_BYP_DPS ECU_ADDRESS 0x7f9b84 BYTE_ORDER MSB_LAST BIT_MASK 0x400 /end MEASUREMENT
/begin MEASUREMENT fmy_stat_egr_byp_dps.err_info_stat.lv_lock_diag "lock flag (CPU load optimisation) of the diagnosis instance EGR_BYP_DPS" UWORD _CNV_S_2_RANGE______383_CM 1 0. 0. 1. DISPLAY_IDENTIFIER LV_LOCK_DIAG_EGR_BYP_DPS ECU_ADDRESS 0x7f9b84 BYTE_ORDER MSB_LAST BIT_MASK 0x200 /end MEASUREMENT
/begin MEASUREMENT fmy_stat_egr_byp_dps.err_info_stat.lv_err_mem "storage in dynamic failure memory of the diagnosis instance EGR_BYP_DPS" UWORD _CNV_S_2_RANGE______383_CM 1 0. 0. 1. DISPLAY_IDENTIFIER LV_ERR_MEM_EGR_BYP_DPS ECU_ADDRESS 0x7f9b84 BYTE_ORDER MSB_LAST BIT_MASK 0x80 /end MEASUREMENT
/begin MEASUREMENT fmy_stat_egr_byp_dps.err_info_stat.lv_ready "readiness status of the diagnosis instance EGR_BYP_DPS" UWORD _CNV_S_2_RANGE______383_CM 1 0. 0. 1. DISPLAY_IDENTIFIER LV_READY_EGR_BYP_DPS ECU_ADDRESS 0x7f9b84 BYTE_ORDER MSB_LAST BIT_MASK 0x40 /end MEASUREMENT
/begin MEASUREMENT fmy_stat_egr_byp_dps.err_info_stat.lv_end_diag "end of diagnosis of the diagnosis instance EGR_BYP_DPS" UWORD _CNV_S_2_RANGE______383_CM 1 0. 0. 1. DISPLAY_IDENTIFIER LV_END_DIAG_EGR_BYP_DPS ECU_ADDRESS 0x7f9b84 BYTE_ORDER MSB_LAST BIT_MASK 0x20 /end MEASUREMENT
/begin MEASUREMENT fmy_stat_egr_byp_dps.err_info_stat.lv_cdn_diag "diagnosis condition of the diagnosis instance EGR_BYP_DPS" UWORD _CNV_S_2_RANGE______383_CM 1 0. 0. 1. DISPLAY_IDENTIFIER LV_CDN_DIAG_EGR_BYP_DPS ECU_ADDRESS 0x7f9b84 BYTE_ORDER MSB_LAST BIT_MASK 0x10 /end MEASUREMENT
/begin MEASUREMENT fmy_stat_egr_byp_dps.err_info_stat.err_sym "symptoms of the diagnosis instance EGR_BYP_DPS" UWORD _CNV_S_6_CONV_ERRM__22_CM 1 0. 0. 15. DISPLAY_IDENTIFIER ERR_SYM_EGR_BYP_DPS ECU_ADDRESS 0x7f9b84 BYTE_ORDER MSB_LAST BIT_MASK 0xF /end MEASUREMENT
/begin MEASUREMENT lv_err_egrv_0 "Error flag of diagnosis instance EGRV_0" UBYTE _CNV_S_2_RANGE______23_CM 1 0. 0. 1. DISPLAY_IDENTIFIER LV_ERR_EGRV_0 ECU_ADDRESS 0x7fb912 /end MEASUREMENT
/begin MEASUREMENT fmy_stat_egrv_0.ctr_abc "anti bounce counter for diagnosis instance EGRV_0" UBYTE _CNV_A_R_LINEAR_____1_CM 1 0. 0. 255. DISPLAY_IDENTIFIER CTR_ABC_EGRV_0 ECU_ADDRESS 0x7f9b8b FORMAT "%3.0" /end MEASUREMENT
/begin MEASUREMENT fmy_stat_egrv_0.ctr_end_diag "counter for end of diagnosis for diagnosis instance EGRV_0" UBYTE _CNV_A_R_LINEAR_____1_CM 1 0. 0. 255. DISPLAY_IDENTIFIER CTR_ABC_END_DIAG_EGRV_0 ECU_ADDRESS 0x7f9b8a FORMAT "%3.0" /end MEASUREMENT
/begin MEASUREMENT fmy_stat_egrv_0.err_info_stat.reserved "" UWORD _CNV_A_R_LINEAR_____0_CM 1 0. 0. 65535. DISPLAY_IDENTIFIER FMY_STAT_EGRV_0_ERR_INFO_STAT_RESERVED ECU_ADDRESS 0x7f9b88 BYTE_ORDER MSB_LAST BIT_MASK 0xF800 /end MEASUREMENT
/begin MEASUREMENT fmy_stat_egrv_0.err_info_stat.lv_cdn_diag_stc "Statistical flag for condition of diagnosis of the diagnosis instance EGRV_0" UWORD _CNV_S_2_RANGE______383_CM 1 0. 0. 1. DISPLAY_IDENTIFIER LV_CDN_DIAG_STC_EGRV_0 ECU_ADDRESS 0x7f9b88 BYTE_ORDER MSB_LAST BIT_MASK 0x400 /end MEASUREMENT
/begin MEASUREMENT fmy_stat_egrv_0.err_info_stat.lv_lock_diag "lock flag (CPU load optimisation) of the diagnosis instance EGRV_0" UWORD _CNV_S_2_RANGE______383_CM 1 0. 0. 1. DISPLAY_IDENTIFIER LV_LOCK_DIAG_EGRV_0 ECU_ADDRESS 0x7f9b88 BYTE_ORDER MSB_LAST BIT_MASK 0x200 /end MEASUREMENT
/begin MEASUREMENT fmy_stat_egrv_0.err_info_stat.lv_err_mem "storage in dynamic failure memory of the diagnosis instance EGRV_0" UWORD _CNV_S_2_RANGE______383_CM 1 0. 0. 1. DISPLAY_IDENTIFIER LV_ERR_MEM_EGRV_0 ECU_ADDRESS 0x7f9b88 BYTE_ORDER MSB_LAST BIT_MASK 0x80 /end MEASUREMENT
/begin MEASUREMENT fmy_stat_egrv_0.err_info_stat.lv_ready "readiness status of the diagnosis instance EGRV_0" UWORD _CNV_S_2_RANGE______383_CM 1 0. 0. 1. DISPLAY_IDENTIFIER LV_READY_EGRV_0 ECU_ADDRESS 0x7f9b88 BYTE_ORDER MSB_LAST BIT_MASK 0x40 /end MEASUREMENT
/begin MEASUREMENT fmy_stat_egrv_0.err_info_stat.lv_end_diag "end of diagnosis of the diagnosis instance EGRV_0" UWORD _CNV_S_2_RANGE______383_CM 1 0. 0. 1. DISPLAY_IDENTIFIER LV_END_DIAG_EGRV_0 ECU_ADDRESS 0x7f9b88 BYTE_ORDER MSB_LAST BIT_MASK 0x20 /end MEASUREMENT
/begin MEASUREMENT fmy_stat_egrv_0.err_info_stat.lv_cdn_diag "diagnosis condition of the diagnosis instance EGRV_0" UWORD _CNV_S_2_RANGE______383_CM 1 0. 0. 1. DISPLAY_IDENTIFIER LV_CDN_DIAG_EGRV_0 ECU_ADDRESS 0x7f9b88 BYTE_ORDER MSB_LAST BIT_MASK 0x10 /end MEASUREMENT
/begin MEASUREMENT fmy_stat_egrv_0.err_info_stat.err_sym "symptoms of the diagnosis instance EGRV_0" UWORD _CNV_S_6_CONV_ERRM__22_CM 1 0. 0. 15. DISPLAY_IDENTIFIER ERR_SYM_EGRV_0 ECU_ADDRESS 0x7f9b88 BYTE_ORDER MSB_LAST BIT_MASK 0xF /end MEASUREMENT
/begin MEASUREMENT lv_err_pps_ini_0 "Error flag of diagnosis instance PPS_INI_0" UBYTE _CNV_S_2_RANGE______23_CM 1 0. 0. 1. DISPLAY_IDENTIFIER LV_ERR_PPS_INI_0 ECU_ADDRESS 0x7fb913 /end MEASUREMENT
/begin MEASUREMENT fmy_stat_pps_ini_0.ctr_abc "anti bounce counter for diagnosis instance PPS_INI_0" UBYTE _CNV_A_R_LINEAR_____1_CM 1 0. 0. 255. DISPLAY_IDENTIFIER CTR_ABC_PPS_INI_0 ECU_ADDRESS 0x7f9b8f FORMAT "%3.0" /end MEASUREMENT
/begin MEASUREMENT fmy_stat_pps_ini_0.ctr_end_diag "counter for end of diagnosis for diagnosis instance PPS_INI_0" UBYTE _CNV_A_R_LINEAR_____1_CM 1 0. 0. 255. DISPLAY_IDENTIFIER CTR_ABC_END_DIAG_PPS_INI_0 ECU_ADDRESS 0x7f9b8e FORMAT "%3.0" /end MEASUREMENT
/begin MEASUREMENT fmy_stat_pps_ini_0.err_info_stat.reserved "" UWORD _CNV_A_R_LINEAR_____0_CM 1 0. 0. 65535. DISPLAY_IDENTIFIER FMY_STAT_PPS_INI_0_ERR_INFO_STAT_RESERVED ECU_ADDRESS 0x7f9b8c BYTE_ORDER MSB_LAST BIT_MASK 0xF800 /end MEASUREMENT
/begin MEASUREMENT fmy_stat_pps_ini_0.err_info_stat.lv_cdn_diag_stc "Statistical flag for condition of diagnosis of the diagnosis instance PPS_INI_0" UWORD _CNV_S_2_RANGE______383_CM 1 0. 0. 1. DISPLAY_IDENTIFIER LV_CDN_DIAG_STC_PPS_INI_0 ECU_ADDRESS 0x7f9b8c BYTE_ORDER MSB_LAST BIT_MASK 0x400 /end MEASUREMENT
/begin MEASUREMENT fmy_stat_pps_ini_0.err_info_stat.lv_lock_diag "lock flag (CPU load optimisation) of the diagnosis instance PPS_INI_0" UWORD _CNV_S_2_RANGE______383_CM 1 0. 0. 1. DISPLAY_IDENTIFIER LV_LOCK_DIAG_PPS_INI_0 ECU_ADDRESS 0x7f9b8c BYTE_ORDER MSB_LAST BIT_MASK 0x200 /end MEASUREMENT
/begin MEASUREMENT fmy_stat_pps_ini_0.err_info_stat.lv_err_mem "storage in dynamic failure memory of the diagnosis instance PPS_INI_0" UWORD _CNV_S_2_RANGE______383_CM 1 0. 0. 1. DISPLAY_IDENTIFIER LV_ERR_MEM_PPS_INI_0 ECU_ADDRESS 0x7f9b8c BYTE_ORDER MSB_LAST BIT_MASK 0x80 /end MEASUREMENT
/begin MEASUREMENT fmy_stat_pps_ini_0.err_info_stat.lv_ready "readiness status of the diagnosis instance PPS_INI_0" UWORD _CNV_S_2_RANGE______383_CM 1 0. 0. 1. DISPLAY_IDENTIFIER LV_READY_PPS_INI_0 ECU_ADDRESS 0x7f9b8c BYTE_ORDER MSB_LAST BIT_MASK 0x40 /end MEASUREMENT
/begin MEASUREMENT fmy_stat_pps_ini_0.err_info_stat.lv_end_diag "end of diagnosis of the diagnosis instance PPS_INI_0" UWORD _CNV_S_2_RANGE______383_CM 1 0. 0. 1. DISPLAY_IDENTIFIER LV_END_DIAG_PPS_INI_0 ECU_ADDRESS 0x7f9b8c BYTE_ORDER MSB_LAST BIT_MASK 0x20 /end MEASUREMENT
/begin MEASUREMENT fmy_stat_pps_ini_0.err_info_stat.lv_cdn_diag "diagnosis condition of the diagnosis instance PPS_INI_0" UWORD _CNV_S_2_RANGE______383_CM 1 0. 0. 1. DISPLAY_IDENTIFIER LV_CDN_DIAG_PPS_INI_0 ECU_ADDRESS 0x7f9b8c BYTE_ORDER MSB_LAST BIT_MASK 0x10 /end MEASUREMENT
/begin MEASUREMENT fmy_stat_pps_ini_0.err_info_stat.err_sym "symptoms of the diagnosis instance PPS_INI_0" UWORD _CNV_S_6_CONV_ERRM__22_CM 1 0. 0. 15. DISPLAY_IDENTIFIER ERR_SYM_PPS_INI_0 ECU_ADDRESS 0x7f9b8c BYTE_ORDER MSB_LAST BIT_MASK 0xF /end MEASUREMENT
/begin MEASUREMENT lv_err_pps_ini_tout_0 "Error flag of diagnosis instance PPS_INI_TOUT_0" UBYTE _CNV_S_2_RANGE______23_CM 1 0. 0. 1. DISPLAY_IDENTIFIER LV_ERR_PPS_INI_TOUT_0 ECU_ADDRESS 0x7fb914 /end MEASUREMENT
/begin MEASUREMENT fmy_stat_pps_ini_tout_0.ctr_abc "anti bounce counter for diagnosis instance PPS_INI_TOUT_0" UBYTE _CNV_A_R_LINEAR_____1_CM 1 0. 0. 255. DISPLAY_IDENTIFIER CTR_ABC_PPS_INI_TOUT_0 ECU_ADDRESS 0x7f9b93 FORMAT "%3.0" /end MEASUREMENT
/begin MEASUREMENT fmy_stat_pps_ini_tout_0.ctr_end_diag "counter for end of diagnosis for diagnosis instance PPS_INI_TOUT_0" UBYTE _CNV_A_R_LINEAR_____1_CM 1 0. 0. 255. DISPLAY_IDENTIFIER CTR_ABC_END_DIAG_PPS_INI_TOUT_0 ECU_ADDRESS 0x7f9b92 FORMAT "%3.0" /end MEASUREMENT
/begin MEASUREMENT fmy_stat_pps_ini_tout_0.err_info_stat.reserved "" UWORD _CNV_A_R_LINEAR_____0_CM 1 0. 0. 65535. DISPLAY_IDENTIFIER FMY_STAT_PPS_INI_TOUT_0_ERR_INFO_STAT_RESERVED ECU_ADDRESS 0x7f9b90 BYTE_ORDER MSB_LAST BIT_MASK 0xF800 /end MEASUREMENT
/begin MEASUREMENT fmy_stat_pps_ini_tout_0.err_info_stat.lv_cdn_diag_stc "Statistical flag for condition of diagnosis of the diagnosis instance PPS_INI_TOUT_0" UWORD _CNV_S_2_RANGE______383_CM 1 0. 0. 1. DISPLAY_IDENTIFIER LV_CDN_DIAG_STC_PPS_INI_TOUT_0 ECU_ADDRESS 0x7f9b90 BYTE_ORDER MSB_LAST BIT_MASK 0x400 /end MEASUREMENT
/begin MEASUREMENT fmy_stat_pps_ini_tout_0.err_info_stat.lv_lock_diag "lock flag (CPU load optimisation) of the diagnosis instance PPS_INI_TOUT_0" UWORD _CNV_S_2_RANGE______383_CM 1 0. 0. 1. DISPLAY_IDENTIFIER LV_LOCK_DIAG_PPS_INI_TOUT_0 ECU_ADDRESS 0x7f9b90 BYTE_ORDER MSB_LAST BIT_MASK 0x200 /end MEASUREMENT
/begin MEASUREMENT fmy_stat_pps_ini_tout_0.err_info_stat.lv_err_mem "storage in dynamic failure memory of the diagnosis instance PPS_INI_TOUT_0" UWORD _CNV_S_2_RANGE______383_CM 1 0. 0. 1. DISPLAY_IDENTIFIER LV_ERR_MEM_PPS_INI_TOUT_0 ECU_ADDRESS 0x7f9b90 BYTE_ORDER MSB_LAST BIT_MASK 0x80 /end MEASUREMENT
/begin MEASUREMENT fmy_stat_pps_ini_tout_0.err_info_stat.lv_ready "readiness status of the diagnosis instance PPS_INI_TOUT_0" UWORD _CNV_S_2_RANGE______383_CM 1 0. 0. 1. DISPLAY_IDENTIFIER LV_READY_PPS_INI_TOUT_0 ECU_ADDRESS 0x7f9b90 BYTE_ORDER MSB_LAST BIT_MASK 0x40 /end MEASUREMENT
/begin MEASUREMENT fmy_stat_pps_ini_tout_0.err_info_stat.lv_end_diag "end of diagnosis of the diagnosis instance PPS_INI_TOUT_0" UWORD _CNV_S_2_RANGE______383_CM 1 0. 0. 1. DISPLAY_IDENTIFIER LV_END_DIAG_PPS_INI_TOUT_0 ECU_ADDRESS 0x7f9b90 BYTE_ORDER MSB_LAST BIT_MASK 0x20 /end MEASUREMENT
/begin MEASUREMENT fmy_stat_pps_ini_tout_0.err_info_stat.lv_cdn_diag "diagnosis condition of the diagnosis instance PPS_INI_TOUT_0" UWORD _CNV_S_2_RANGE______383_CM 1 0. 0. 1. DISPLAY_IDENTIFIER LV_CDN_DIAG_PPS_INI_TOUT_0 ECU_ADDRESS 0x7f9b90 BYTE_ORDER MSB_LAST BIT_MASK 0x10 /end MEASUREMENT
/begin MEASUREMENT fmy_stat_pps_ini_tout_0.err_info_stat.err_sym "symptoms of the diagnosis instance PPS_INI_TOUT_0" UWORD _CNV_S_6_CONV_ERRM__22_CM 1 0. 0. 15. DISPLAY_IDENTIFIER ERR_SYM_PPS_INI_TOUT_0 ECU_ADDRESS 0x7f9b90 BYTE_ORDER MSB_LAST BIT_MASK 0xF /end MEASUREMENT
/begin MEASUREMENT lv_err_pps_plaus_0 "Error flag of diagnosis instance PPS_PLAUS_0" UBYTE _CNV_S_2_RANGE______23_CM 1 0. 0. 1. DISPLAY_IDENTIFIER LV_ERR_PPS_PLAUS_0 ECU_ADDRESS 0x7fb915 /end MEASUREMENT
/begin MEASUREMENT fmy_stat_pps_plaus_0.ctr_abc "anti bounce counter for diagnosis instance PPS_PLAUS_0" UBYTE _CNV_A_R_LINEAR_____1_CM 1 0. 0. 255. DISPLAY_IDENTIFIER CTR_ABC_PPS_PLAUS_0 ECU_ADDRESS 0x7f9b97 FORMAT "%3.0" /end MEASUREMENT
/begin MEASUREMENT fmy_stat_pps_plaus_0.ctr_end_diag "counter for end of diagnosis for diagnosis instance PPS_PLAUS_0" UBYTE _CNV_A_R_LINEAR_____1_CM 1 0. 0. 255. DISPLAY_IDENTIFIER CTR_ABC_END_DIAG_PPS_PLAUS_0 ECU_ADDRESS 0x7f9b96 FORMAT "%3.0" /end MEASUREMENT
/begin MEASUREMENT fmy_stat_pps_plaus_0.err_info_stat.reserved "" UWORD _CNV_A_R_LINEAR_____0_CM 1 0. 0. 65535. DISPLAY_IDENTIFIER FMY_STAT_PPS_PLAUS_0_ERR_INFO_STAT_RESERVED ECU_ADDRESS 0x7f9b94 BYTE_ORDER MSB_LAST BIT_MASK 0xF800 /end MEASUREMENT
/begin MEASUREMENT fmy_stat_pps_plaus_0.err_info_stat.lv_cdn_diag_stc "Statistical flag for condition of diagnosis of the diagnosis instance PPS_PLAUS_0" UWORD _CNV_S_2_RANGE______383_CM 1 0. 0. 1. DISPLAY_IDENTIFIER LV_CDN_DIAG_STC_PPS_PLAUS_0 ECU_ADDRESS 0x7f9b94 BYTE_ORDER MSB_LAST BIT_MASK 0x400 /end MEASUREMENT
/begin MEASUREMENT fmy_stat_pps_plaus_0.err_info_stat.lv_lock_diag "lock flag (CPU load optimisation) of the diagnosis instance PPS_PLAUS_0" UWORD _CNV_S_2_RANGE______383_CM 1 0. 0. 1. DISPLAY_IDENTIFIER LV_LOCK_DIAG_PPS_PLAUS_0 ECU_ADDRESS 0x7f9b94 BYTE_ORDER MSB_LAST BIT_MASK 0x200 /end MEASUREMENT
/begin MEASUREMENT fmy_stat_pps_plaus_0.err_info_stat.lv_err_mem "storage in dynamic failure memory of the diagnosis instance PPS_PLAUS_0" UWORD _CNV_S_2_RANGE______383_CM 1 0. 0. 1. DISPLAY_IDENTIFIER LV_ERR_MEM_PPS_PLAUS_0 ECU_ADDRESS 0x7f9b94 BYTE_ORDER MSB_LAST BIT_MASK 0x80 /end MEASUREMENT
/begin MEASUREMENT fmy_stat_pps_plaus_0.err_info_stat.lv_ready "readiness status of the diagnosis instance PPS_PLAUS_0" UWORD _CNV_S_2_RANGE______383_CM 1 0. 0. 1. DISPLAY_IDENTIFIER LV_READY_PPS_PLAUS_0 ECU_ADDRESS 0x7f9b94 BYTE_ORDER MSB_LAST BIT_MASK 0x40 /end MEASUREMENT
/begin MEASUREMENT fmy_stat_pps_plaus_0.err_info_stat.lv_end_diag "end of diagnosis of the diagnosis instance PPS_PLAUS_0" UWORD _CNV_S_2_RANGE______383_CM 1 0. 0. 1. DISPLAY_IDENTIFIER LV_END_DIAG_PPS_PLAUS_0 ECU_ADDRESS 0x7f9b94 BYTE_ORDER MSB_LAST BIT_MASK 0x20 /end MEASUREMENT
/begin MEASUREMENT fmy_stat_pps_plaus_0.err_info_stat.lv_cdn_diag "diagnosis condition of the diagnosis instance PPS_PLAUS_0" UWORD _CNV_S_2_RANGE______383_CM 1 0. 0. 1. DISPLAY_IDENTIFIER LV_CDN_DIAG_PPS_PLAUS_0 ECU_ADDRESS 0x7f9b94 BYTE_ORDER MSB_LAST BIT_MASK 0x10 /end MEASUREMENT
/begin MEASUREMENT fmy_stat_pps_plaus_0.err_info_stat.err_sym "symptoms of the diagnosis instance PPS_PLAUS_0" UWORD _CNV_S_6_CONV_ERRM__22_CM 1 0. 0. 15. DISPLAY_IDENTIFIER ERR_SYM_PPS_PLAUS_0 ECU_ADDRESS 0x7f9b94 BYTE_ORDER MSB_LAST BIT_MASK 0xF /end MEASUREMENT
/begin MEASUREMENT lv_err_pps_cal_0 "Error flag of diagnosis instance PPS_CAL_0" UBYTE _CNV_S_2_RANGE______23_CM 1 0. 0. 1. DISPLAY_IDENTIFIER LV_ERR_PPS_CAL_0 ECU_ADDRESS 0x7fb916 /end MEASUREMENT
/begin MEASUREMENT fmy_stat_pps_cal_0.ctr_abc "anti bounce counter for diagnosis instance PPS_CAL_0" UBYTE _CNV_A_R_LINEAR_____1_CM 1 0. 0. 255. DISPLAY_IDENTIFIER CTR_ABC_PPS_CAL_0 ECU_ADDRESS 0x7f9b9b FORMAT "%3.0" /end MEASUREMENT
/begin MEASUREMENT fmy_stat_pps_cal_0.ctr_end_diag "counter for end of diagnosis for diagnosis instance PPS_CAL_0" UBYTE _CNV_A_R_LINEAR_____1_CM 1 0. 0. 255. DISPLAY_IDENTIFIER CTR_ABC_END_DIAG_PPS_CAL_0 ECU_ADDRESS 0x7f9b9a FORMAT "%3.0" /end MEASUREMENT
/begin MEASUREMENT fmy_stat_pps_cal_0.err_info_stat.reserved "" UWORD _CNV_A_R_LINEAR_____0_CM 1 0. 0. 65535. DISPLAY_IDENTIFIER FMY_STAT_PPS_CAL_0_ERR_INFO_STAT_RESERVED ECU_ADDRESS 0x7f9b98 BYTE_ORDER MSB_LAST BIT_MASK 0xF800 /end MEASUREMENT
/begin MEASUREMENT fmy_stat_pps_cal_0.err_info_stat.lv_cdn_diag_stc "Statistical flag for condition of diagnosis of the diagnosis instance PPS_CAL_0" UWORD _CNV_S_2_RANGE______383_CM 1 0. 0. 1. DISPLAY_IDENTIFIER LV_CDN_DIAG_STC_PPS_CAL_0 ECU_ADDRESS 0x7f9b98 BYTE_ORDER MSB_LAST BIT_MASK 0x400 /end MEASUREMENT
/begin MEASUREMENT fmy_stat_pps_cal_0.err_info_stat.lv_lock_diag "lock flag (CPU load optimisation) of the diagnosis instance PPS_CAL_0" UWORD _CNV_S_2_RANGE______383_CM 1 0. 0. 1. DISPLAY_IDENTIFIER LV_LOCK_DIAG_PPS_CAL_0 ECU_ADDRESS 0x7f9b98 BYTE_ORDER MSB_LAST BIT_MASK 0x200 /end MEASUREMENT
/begin MEASUREMENT fmy_stat_pps_cal_0.err_info_stat.lv_err_mem "storage in dynamic failure memory of the diagnosis instance PPS_CAL_0" UWORD _CNV_S_2_RANGE______383_CM 1 0. 0. 1. DISPLAY_IDENTIFIER LV_ERR_MEM_PPS_CAL_0 ECU_ADDRESS 0x7f9b98 BYTE_ORDER MSB_LAST BIT_MASK 0x80 /end MEASUREMENT
/begin MEASUREMENT fmy_stat_pps_cal_0.err_info_stat.lv_ready "readiness status of the diagnosis instance PPS_CAL_0" UWORD _CNV_S_2_RANGE______383_CM 1 0. 0. 1. DISPLAY_IDENTIFIER LV_READY_PPS_CAL_0 ECU_ADDRESS 0x7f9b98 BYTE_ORDER MSB_LAST BIT_MASK 0x40 /end MEASUREMENT
/begin MEASUREMENT fmy_stat_pps_cal_0.err_info_stat.lv_end_diag "end of diagnosis of the diagnosis instance PPS_CAL_0" UWORD _CNV_S_2_RANGE______383_CM 1 0. 0. 1. DISPLAY_IDENTIFIER LV_END_DIAG_PPS_CAL_0 ECU_ADDRESS 0x7f9b98 BYTE_ORDER MSB_LAST BIT_MASK 0x20 /end MEASUREMENT
/begin MEASUREMENT fmy_stat_pps_cal_0.err_info_stat.lv_cdn_diag "diagnosis condition of the diagnosis instance PPS_CAL_0" UWORD _CNV_S_2_RANGE______383_CM 1 0. 0. 1. DISPLAY_IDENTIFIER LV_CDN_DIAG_PPS_CAL_0 ECU_ADDRESS 0x7f9b98 BYTE_ORDER MSB_LAST BIT_MASK 0x10 /end MEASUREMENT
/begin MEASUREMENT fmy_stat_pps_cal_0.err_info_stat.err_sym "symptoms of the diagnosis instance PPS_CAL_0" UWORD _CNV_S_6_CONV_ERRM__22_CM 1 0. 0. 15. DISPLAY_IDENTIFIER ERR_SYM_PPS_CAL_0 ECU_ADDRESS 0x7f9b98 BYTE_ORDER MSB_LAST BIT_MASK 0xF /end MEASUREMENT
/begin MEASUREMENT lv_err_pps_v_inj_0 "Error flag of diagnosis instance PPS_V_INJ_0" UBYTE _CNV_S_2_RANGE______23_CM 1 0. 0. 1. DISPLAY_IDENTIFIER LV_ERR_PPS_V_INJ_0 ECU_ADDRESS 0x7fb917 /end MEASUREMENT
/begin MEASUREMENT fmy_stat_pps_v_inj_0.ctr_abc "anti bounce counter for diagnosis instance PPS_V_INJ_0" UBYTE _CNV_A_R_LINEAR_____1_CM 1 0. 0. 255. DISPLAY_IDENTIFIER CTR_ABC_PPS_V_INJ_0 ECU_ADDRESS 0x7f9b9f FORMAT "%3.0" /end MEASUREMENT
/begin MEASUREMENT fmy_stat_pps_v_inj_0.ctr_end_diag "counter for end of diagnosis for diagnosis instance PPS_V_INJ_0" UBYTE _CNV_A_R_LINEAR_____1_CM 1 0. 0. 255. DISPLAY_IDENTIFIER CTR_ABC_END_DIAG_PPS_V_INJ_0 ECU_ADDRESS 0x7f9b9e FORMAT "%3.0" /end MEASUREMENT
/begin MEASUREMENT fmy_stat_pps_v_inj_0.err_info_stat.reserved "" UWORD _CNV_A_R_LINEAR_____0_CM 1 0. 0. 65535. DISPLAY_IDENTIFIER FMY_STAT_PPS_V_INJ_0_ERR_INFO_STAT_RESERVED ECU_ADDRESS 0x7f9b9c BYTE_ORDER MSB_LAST BIT_MASK 0xF800 /end MEASUREMENT
/begin MEASUREMENT fmy_stat_pps_v_inj_0.err_info_stat.lv_cdn_diag_stc "Statistical flag for condition of diagnosis of the diagnosis instance PPS_V_INJ_0" UWORD _CNV_S_2_RANGE______383_CM 1 0. 0. 1. DISPLAY_IDENTIFIER LV_CDN_DIAG_STC_PPS_V_INJ_0 ECU_ADDRESS 0x7f9b9c BYTE_ORDER MSB_LAST BIT_MASK 0x400 /end MEASUREMENT
/begin MEASUREMENT fmy_stat_pps_v_inj_0.err_info_stat.lv_lock_diag "lock flag (CPU load optimisation) of the diagnosis instance PPS_V_INJ_0" UWORD _CNV_S_2_RANGE______383_CM 1 0. 0. 1. DISPLAY_IDENTIFIER LV_LOCK_DIAG_PPS_V_INJ_0 ECU_ADDRESS 0x7f9b9c BYTE_ORDER MSB_LAST BIT_MASK 0x200 /end MEASUREMENT
/begin MEASUREMENT fmy_stat_pps_v_inj_0.err_info_stat.lv_err_mem "storage in dynamic failure memory of the diagnosis instance PPS_V_INJ_0" UWORD _CNV_S_2_RANGE______383_CM 1 0. 0. 1. DISPLAY_IDENTIFIER LV_ERR_MEM_PPS_V_INJ_0 ECU_ADDRESS 0x7f9b9c BYTE_ORDER MSB_LAST BIT_MASK 0x80 /end MEASUREMENT
/begin MEASUREMENT fmy_stat_pps_v_inj_0.err_info_stat.lv_ready "readiness status of the diagnosis instance PPS_V_INJ_0" UWORD _CNV_S_2_RANGE______383_CM 1 0. 0. 1. DISPLAY_IDENTIFIER LV_READY_PPS_V_INJ_0 ECU_ADDRESS 0x7f9b9c BYTE_ORDER MSB_LAST BIT_MASK 0x40 /end MEASUREMENT
/begin MEASUREMENT fmy_stat_pps_v_inj_0.err_info_stat.lv_end_diag "end of diagnosis of the diagnosis instance PPS_V_INJ_0" UWORD _CNV_S_2_RANGE______383_CM 1 0. 0. 1. DISPLAY_IDENTIFIER LV_END_DIAG_PPS_V_INJ_0 ECU_ADDRESS 0x7f9b9c BYTE_ORDER MSB_LAST BIT_MASK 0x20 /end MEASUREMENT
/begin MEASUREMENT fmy_stat_pps_v_inj_0.err_info_stat.lv_cdn_diag "diagnosis condition of the diagnosis instance PPS_V_INJ_0" UWORD _CNV_S_2_RANGE______383_CM 1 0. 0. 1. DISPLAY_IDENTIFIER LV_CDN_DIAG_PPS_V_INJ_0 ECU_ADDRESS 0x7f9b9c BYTE_ORDER MSB_LAST BIT_MASK 0x10 /end MEASUREMENT
/begin MEASUREMENT fmy_stat_pps_v_inj_0.err_info_stat.err_sym "symptoms of the diagnosis instance PPS_V_INJ_0" UWORD _CNV_S_6_CONV_ERRM__22_CM 1 0. 0. 15. DISPLAY_IDENTIFIER ERR_SYM_PPS_V_INJ_0 ECU_ADDRESS 0x7f9b9c BYTE_ORDER MSB_LAST BIT_MASK 0xF /end MEASUREMENT
/begin MEASUREMENT lv_err_pps_wdt_0 "Error flag of diagnosis instance PPS_WDT_0" UBYTE _CNV_S_2_RANGE______23_CM 1 0. 0. 1. DISPLAY_IDENTIFIER LV_ERR_PPS_WDT_0 ECU_ADDRESS 0x7fb918 /end MEASUREMENT
/begin MEASUREMENT fmy_stat_pps_wdt_0.ctr_abc "anti bounce counter for diagnosis instance PPS_WDT_0" UBYTE _CNV_A_R_LINEAR_____1_CM 1 0. 0. 255. DISPLAY_IDENTIFIER CTR_ABC_PPS_WDT_0 ECU_ADDRESS 0x7f9ba3 FORMAT "%3.0" /end MEASUREMENT
/begin MEASUREMENT fmy_stat_pps_wdt_0.ctr_end_diag "counter for end of diagnosis for diagnosis instance PPS_WDT_0" UBYTE _CNV_A_R_LINEAR_____1_CM 1 0. 0. 255. DISPLAY_IDENTIFIER CTR_ABC_END_DIAG_PPS_WDT_0 ECU_ADDRESS 0x7f9ba2 FORMAT "%3.0" /end MEASUREMENT
/begin MEASUREMENT fmy_stat_pps_wdt_0.err_info_stat.reserved "" UWORD _CNV_A_R_LINEAR_____0_CM 1 0. 0. 65535. DISPLAY_IDENTIFIER FMY_STAT_PPS_WDT_0_ERR_INFO_STAT_RESERVED ECU_ADDRESS 0x7f9ba0 BYTE_ORDER MSB_LAST BIT_MASK 0xF800 /end MEASUREMENT
/begin MEASUREMENT fmy_stat_pps_wdt_0.err_info_stat.lv_cdn_diag_stc "Statistical flag for condition of diagnosis of the diagnosis instance PPS_WDT_0" UWORD _CNV_S_2_RANGE______383_CM 1 0. 0. 1. DISPLAY_IDENTIFIER LV_CDN_DIAG_STC_PPS_WDT_0 ECU_ADDRESS 0x7f9ba0 BYTE_ORDER MSB_LAST BIT_MASK 0x400 /end MEASUREMENT
/begin MEASUREMENT fmy_stat_pps_wdt_0.err_info_stat.lv_lock_diag "lock flag (CPU load optimisation) of the diagnosis instance PPS_WDT_0" UWORD _CNV_S_2_RANGE______383_CM 1 0. 0. 1. DISPLAY_IDENTIFIER LV_LOCK_DIAG_PPS_WDT_0 ECU_ADDRESS 0x7f9ba0 BYTE_ORDER MSB_LAST BIT_MASK 0x200 /end MEASUREMENT
/begin MEASUREMENT fmy_stat_pps_wdt_0.err_info_stat.lv_err_mem "storage in dynamic failure memory of the diagnosis instance PPS_WDT_0" UWORD _CNV_S_2_RANGE______383_CM 1 0. 0. 1. DISPLAY_IDENTIFIER LV_ERR_MEM_PPS_WDT_0 ECU_ADDRESS 0x7f9ba0 BYTE_ORDER MSB_LAST BIT_MASK 0x80 /end MEASUREMENT
/begin MEASUREMENT fmy_stat_pps_wdt_0.err_info_stat.lv_ready "readiness status of the diagnosis instance PPS_WDT_0" UWORD _CNV_S_2_RANGE______383_CM 1 0. 0. 1. DISPLAY_IDENTIFIER LV_READY_PPS_WDT_0 ECU_ADDRESS 0x7f9ba0 BYTE_ORDER MSB_LAST BIT_MASK 0x40 /end MEASUREMENT
/begin MEASUREMENT fmy_stat_pps_wdt_0.err_info_stat.lv_end_diag "end of diagnosis of the diagnosis instance PPS_WDT_0" UWORD _CNV_S_2_RANGE______383_CM 1 0. 0. 1. DISPLAY_IDENTIFIER LV_END_DIAG_PPS_WDT_0 ECU_ADDRESS 0x7f9ba0 BYTE_ORDER MSB_LAST BIT_MASK 0x20 /end MEASUREMENT
/begin MEASUREMENT fmy_stat_pps_wdt_0.err_info_stat.lv_cdn_diag "diagnosis condition of the diagnosis instance PPS_WDT_0" UWORD _CNV_S_2_RANGE______383_CM 1 0. 0. 1. DISPLAY_IDENTIFIER LV_CDN_DIAG_PPS_WDT_0 ECU_ADDRESS 0x7f9ba0 BYTE_ORDER MSB_LAST BIT_MASK 0x10 /end MEASUREMENT
/begin MEASUREMENT fmy_stat_pps_wdt_0.err_info_stat.err_sym "symptoms of the diagnosis instance PPS_WDT_0" UWORD _CNV_S_6_CONV_ERRM__22_CM 1 0. 0. 15. DISPLAY_IDENTIFIER ERR_SYM_PPS_WDT_0 ECU_ADDRESS 0x7f9ba0 BYTE_ORDER MSB_LAST BIT_MASK 0xF /end MEASUREMENT
/begin MEASUREMENT lv_err_pps_fsm_0 "Error flag of diagnosis instance PPS_FSM_0" UBYTE _CNV_S_2_RANGE______23_CM 1 0. 0. 1. DISPLAY_IDENTIFIER LV_ERR_PPS_FSM_0 ECU_ADDRESS 0x7fb919 /end MEASUREMENT
/begin MEASUREMENT fmy_stat_pps_fsm_0.ctr_abc "anti bounce counter for diagnosis instance PPS_FSM_0" UBYTE _CNV_A_R_LINEAR_____1_CM 1 0. 0. 255. DISPLAY_IDENTIFIER CTR_ABC_PPS_FSM_0 ECU_ADDRESS 0x7f9ba7 FORMAT "%3.0" /end MEASUREMENT
/begin MEASUREMENT fmy_stat_pps_fsm_0.ctr_end_diag "counter for end of diagnosis for diagnosis instance PPS_FSM_0" UBYTE _CNV_A_R_LINEAR_____1_CM 1 0. 0. 255. DISPLAY_IDENTIFIER CTR_ABC_END_DIAG_PPS_FSM_0 ECU_ADDRESS 0x7f9ba6 FORMAT "%3.0" /end MEASUREMENT
/begin MEASUREMENT fmy_stat_pps_fsm_0.err_info_stat.reserved "" UWORD _CNV_A_R_LINEAR_____0_CM 1 0. 0. 65535. DISPLAY_IDENTIFIER FMY_STAT_PPS_FSM_0_ERR_INFO_STAT_RESERVED ECU_ADDRESS 0x7f9ba4 BYTE_ORDER MSB_LAST BIT_MASK 0xF800 /end MEASUREMENT
/begin MEASUREMENT fmy_stat_pps_fsm_0.err_info_stat.lv_cdn_diag_stc "Statistical flag for condition of diagnosis of the diagnosis instance PPS_FSM_0" UWORD _CNV_S_2_RANGE______383_CM 1 0. 0. 1. DISPLAY_IDENTIFIER LV_CDN_DIAG_STC_PPS_FSM_0 ECU_ADDRESS 0x7f9ba4 BYTE_ORDER MSB_LAST BIT_MASK 0x400 /end MEASUREMENT
/begin MEASUREMENT fmy_stat_pps_fsm_0.err_info_stat.lv_lock_diag "lock flag (CPU load optimisation) of the diagnosis instance PPS_FSM_0" UWORD _CNV_S_2_RANGE______383_CM 1 0. 0. 1. DISPLAY_IDENTIFIER LV_LOCK_DIAG_PPS_FSM_0 ECU_ADDRESS 0x7f9ba4 BYTE_ORDER MSB_LAST BIT_MASK 0x200 /end MEASUREMENT
/begin MEASUREMENT fmy_stat_pps_fsm_0.err_info_stat.lv_err_mem "storage in dynamic failure memory of the diagnosis instance PPS_FSM_0" UWORD _CNV_S_2_RANGE______383_CM 1 0. 0. 1. DISPLAY_IDENTIFIER LV_ERR_MEM_PPS_FSM_0 ECU_ADDRESS 0x7f9ba4 BYTE_ORDER MSB_LAST BIT_MASK 0x80 /end MEASUREMENT
/begin MEASUREMENT fmy_stat_pps_fsm_0.err_info_stat.lv_ready "readiness status of the diagnosis instance PPS_FSM_0" UWORD _CNV_S_2_RANGE______383_CM 1 0. 0. 1. DISPLAY_IDENTIFIER LV_READY_PPS_FSM_0 ECU_ADDRESS 0x7f9ba4 BYTE_ORDER MSB_LAST BIT_MASK 0x40 /end MEASUREMENT
/begin MEASUREMENT fmy_stat_pps_fsm_0.err_info_stat.lv_end_diag "end of diagnosis of the diagnosis instance PPS_FSM_0" UWORD _CNV_S_2_RANGE______383_CM 1 0. 0. 1. DISPLAY_IDENTIFIER LV_END_DIAG_PPS_FSM_0 ECU_ADDRESS 0x7f9ba4 BYTE_ORDER MSB_LAST BIT_MASK 0x20 /end MEASUREMENT
/begin MEASUREMENT fmy_stat_pps_fsm_0.err_info_stat.lv_cdn_diag "diagnosis condition of the diagnosis instance PPS_FSM_0" UWORD _CNV_S_2_RANGE______383_CM 1 0. 0. 1. DISPLAY_IDENTIFIER LV_CDN_DIAG_PPS_FSM_0 ECU_ADDRESS 0x7f9ba4 BYTE_ORDER MSB_LAST BIT_MASK 0x10 /end MEASUREMENT
/begin MEASUREMENT fmy_stat_pps_fsm_0.err_info_stat.err_sym "symptoms of the diagnosis instance PPS_FSM_0" UWORD _CNV_S_6_CONV_ERRM__22_CM 1 0. 0. 15. DISPLAY_IDENTIFIER ERR_SYM_PPS_FSM_0 ECU_ADDRESS 0x7f9ba4 BYTE_ORDER MSB_LAST BIT_MASK 0xF /end MEASUREMENT
/begin MEASUREMENT lv_err_pps_oc_0 "Error flag of diagnosis instance PPS_OC_0" UBYTE _CNV_S_2_RANGE______23_CM 1 0. 0. 1. DISPLAY_IDENTIFIER LV_ERR_PPS_OC_0 ECU_ADDRESS 0x7fb91a /end MEASUREMENT
/begin MEASUREMENT fmy_stat_pps_oc_0.ctr_abc "anti bounce counter for diagnosis instance PPS_OC_0" UBYTE _CNV_A_R_LINEAR_____1_CM 1 0. 0. 255. DISPLAY_IDENTIFIER CTR_ABC_PPS_OC_0 ECU_ADDRESS 0x7f9bab FORMAT "%3.0" /end MEASUREMENT
/begin MEASUREMENT fmy_stat_pps_oc_0.ctr_end_diag "counter for end of diagnosis for diagnosis instance PPS_OC_0" UBYTE _CNV_A_R_LINEAR_____1_CM 1 0. 0. 255. DISPLAY_IDENTIFIER CTR_ABC_END_DIAG_PPS_OC_0 ECU_ADDRESS 0x7f9baa FORMAT "%3.0" /end MEASUREMENT
/begin MEASUREMENT fmy_stat_pps_oc_0.err_info_stat.reserved "" UWORD _CNV_A_R_LINEAR_____0_CM 1 0. 0. 65535. DISPLAY_IDENTIFIER FMY_STAT_PPS_OC_0_ERR_INFO_STAT_RESERVED ECU_ADDRESS 0x7f9ba8 BYTE_ORDER MSB_LAST BIT_MASK 0xF800 /end MEASUREMENT
/begin MEASUREMENT fmy_stat_pps_oc_0.err_info_stat.lv_cdn_diag_stc "Statistical flag for condition of diagnosis of the diagnosis instance PPS_OC_0" UWORD _CNV_S_2_RANGE______383_CM 1 0. 0. 1. DISPLAY_IDENTIFIER LV_CDN_DIAG_STC_PPS_OC_0 ECU_ADDRESS 0x7f9ba8 BYTE_ORDER MSB_LAST BIT_MASK 0x400 /end MEASUREMENT
/begin MEASUREMENT fmy_stat_pps_oc_0.err_info_stat.lv_lock_diag "lock flag (CPU load optimisation) of the diagnosis instance PPS_OC_0" UWORD _CNV_S_2_RANGE______383_CM 1 0. 0. 1. DISPLAY_IDENTIFIER LV_LOCK_DIAG_PPS_OC_0 ECU_ADDRESS 0x7f9ba8 BYTE_ORDER MSB_LAST BIT_MASK 0x200 /end MEASUREMENT
/begin MEASUREMENT fmy_stat_pps_oc_0.err_info_stat.lv_err_mem "storage in dynamic failure memory of the diagnosis instance PPS_OC_0" UWORD _CNV_S_2_RANGE______383_CM 1 0. 0. 1. DISPLAY_IDENTIFIER LV_ERR_MEM_PPS_OC_0 ECU_ADDRESS 0x7f9ba8 BYTE_ORDER MSB_LAST BIT_MASK 0x80 /end MEASUREMENT
/begin MEASUREMENT fmy_stat_pps_oc_0.err_info_stat.lv_ready "readiness status of the diagnosis instance PPS_OC_0" UWORD _CNV_S_2_RANGE______383_CM 1 0. 0. 1. DISPLAY_IDENTIFIER LV_READY_PPS_OC_0 ECU_ADDRESS 0x7f9ba8 BYTE_ORDER MSB_LAST BIT_MASK 0x40 /end MEASUREMENT
/begin MEASUREMENT fmy_stat_pps_oc_0.err_info_stat.lv_end_diag "end of diagnosis of the diagnosis instance PPS_OC_0" UWORD _CNV_S_2_RANGE______383_CM 1 0. 0. 1. DISPLAY_IDENTIFIER LV_END_DIAG_PPS_OC_0 ECU_ADDRESS 0x7f9ba8 BYTE_ORDER MSB_LAST BIT_MASK 0x20 /end MEASUREMENT
/begin MEASUREMENT fmy_stat_pps_oc_0.err_info_stat.lv_cdn_diag "diagnosis condition of the diagnosis instance PPS_OC_0" UWORD _CNV_S_2_RANGE______383_CM 1 0. 0. 1. DISPLAY_IDENTIFIER LV_CDN_DIAG_PPS_OC_0 ECU_ADDRESS 0x7f9ba8 BYTE_ORDER MSB_LAST BIT_MASK 0x10 /end MEASUREMENT
/begin MEASUREMENT fmy_stat_pps_oc_0.err_info_stat.err_sym "symptoms of the diagnosis instance PPS_OC_0" UWORD _CNV_S_6_CONV_ERRM__22_CM 1 0. 0. 15. DISPLAY_IDENTIFIER ERR_SYM_PPS_OC_0 ECU_ADDRESS 0x7f9ba8 BYTE_ORDER MSB_LAST BIT_MASK 0xF /end MEASUREMENT
/begin MEASUREMENT lv_err_pps_oc_1 "Error flag of diagnosis instance PPS_OC_1" UBYTE _CNV_S_2_RANGE______23_CM 1 0. 0. 1. DISPLAY_IDENTIFIER LV_ERR_PPS_OC_1 ECU_ADDRESS 0x7fb91b /end MEASUREMENT
/begin MEASUREMENT fmy_stat_pps_oc_1.ctr_abc "anti bounce counter for diagnosis instance PPS_OC_1" UBYTE _CNV_A_R_LINEAR_____1_CM 1 0. 0. 255. DISPLAY_IDENTIFIER CTR_ABC_PPS_OC_1 ECU_ADDRESS 0x7f9baf FORMAT "%3.0" /end MEASUREMENT
/begin MEASUREMENT fmy_stat_pps_oc_1.ctr_end_diag "counter for end of diagnosis for diagnosis instance PPS_OC_1" UBYTE _CNV_A_R_LINEAR_____1_CM 1 0. 0. 255. DISPLAY_IDENTIFIER CTR_ABC_END_DIAG_PPS_OC_1 ECU_ADDRESS 0x7f9bae FORMAT "%3.0" /end MEASUREMENT
/begin MEASUREMENT fmy_stat_pps_oc_1.err_info_stat.reserved "" UWORD _CNV_A_R_LINEAR_____0_CM 1 0. 0. 65535. DISPLAY_IDENTIFIER FMY_STAT_PPS_OC_1_ERR_INFO_STAT_RESERVED ECU_ADDRESS 0x7f9bac BYTE_ORDER MSB_LAST BIT_MASK 0xF800 /end MEASUREMENT
/begin MEASUREMENT fmy_stat_pps_oc_1.err_info_stat.lv_cdn_diag_stc "Statistical flag for condition of diagnosis of the diagnosis instance PPS_OC_1" UWORD _CNV_S_2_RANGE______383_CM 1 0. 0. 1. DISPLAY_IDENTIFIER LV_CDN_DIAG_STC_PPS_OC_1 ECU_ADDRESS 0x7f9bac BYTE_ORDER MSB_LAST BIT_MASK 0x400 /end MEASUREMENT
/begin MEASUREMENT fmy_stat_pps_oc_1.err_info_stat.lv_lock_diag "lock flag (CPU load optimisation) of the diagnosis instance PPS_OC_1" UWORD _CNV_S_2_RANGE______383_CM 1 0. 0. 1. DISPLAY_IDENTIFIER LV_LOCK_DIAG_PPS_OC_1 ECU_ADDRESS 0x7f9bac BYTE_ORDER MSB_LAST BIT_MASK 0x200 /end MEASUREMENT
/begin MEASUREMENT fmy_stat_pps_oc_1.err_info_stat.lv_err_mem "storage in dynamic failure memory of the diagnosis instance PPS_OC_1" UWORD _CNV_S_2_RANGE______383_CM 1 0. 0. 1. DISPLAY_IDENTIFIER LV_ERR_MEM_PPS_OC_1 ECU_ADDRESS 0x7f9bac BYTE_ORDER MSB_LAST BIT_MASK 0x80 /end MEASUREMENT
/begin MEASUREMENT fmy_stat_pps_oc_1.err_info_stat.lv_ready "readiness status of the diagnosis instance PPS_OC_1" UWORD _CNV_S_2_RANGE______383_CM 1 0. 0. 1. DISPLAY_IDENTIFIER LV_READY_PPS_OC_1 ECU_ADDRESS 0x7f9bac BYTE_ORDER MSB_LAST BIT_MASK 0x40 /end MEASUREMENT
/begin MEASUREMENT fmy_stat_pps_oc_1.err_info_stat.lv_end_diag "end of diagnosis of the diagnosis instance PPS_OC_1" UWORD _CNV_S_2_RANGE______383_CM 1 0. 0. 1. DISPLAY_IDENTIFIER LV_END_DIAG_PPS_OC_1 ECU_ADDRESS 0x7f9bac BYTE_ORDER MSB_LAST BIT_MASK 0x20 /end MEASUREMENT
/begin MEASUREMENT fmy_stat_pps_oc_1.err_info_stat.lv_cdn_diag "diagnosis condition of the diagnosis instance PPS_OC_1" UWORD _CNV_S_2_RANGE______383_CM 1 0. 0. 1. DISPLAY_IDENTIFIER LV_CDN_DIAG_PPS_OC_1 ECU_ADDRESS 0x7f9bac BYTE_ORDER MSB_LAST BIT_MASK 0x10 /end MEASUREMENT
/begin MEASUREMENT fmy_stat_pps_oc_1.err_info_stat.err_sym "symptoms of the diagnosis instance PPS_OC_1" UWORD _CNV_S_6_CONV_ERRM__22_CM 1 0. 0. 15. DISPLAY_IDENTIFIER ERR_SYM_PPS_OC_1 ECU_ADDRESS 0x7f9bac BYTE_ORDER MSB_LAST BIT_MASK 0xF /end MEASUREMENT
/begin MEASUREMENT lv_err_pps_oc_2 "Error flag of diagnosis instance PPS_OC_2" UBYTE _CNV_S_2_RANGE______23_CM 1 0. 0. 1. DISPLAY_IDENTIFIER LV_ERR_PPS_OC_2 ECU_ADDRESS 0x7fb91c /end MEASUREMENT
/begin MEASUREMENT fmy_stat_pps_oc_2.ctr_abc "anti bounce counter for diagnosis instance PPS_OC_2" UBYTE _CNV_A_R_LINEAR_____1_CM 1 0. 0. 255. DISPLAY_IDENTIFIER CTR_ABC_PPS_OC_2 ECU_ADDRESS 0x7f9bb3 FORMAT "%3.0" /end MEASUREMENT
/begin MEASUREMENT fmy_stat_pps_oc_2.ctr_end_diag "counter for end of diagnosis for diagnosis instance PPS_OC_2" UBYTE _CNV_A_R_LINEAR_____1_CM 1 0. 0. 255. DISPLAY_IDENTIFIER CTR_ABC_END_DIAG_PPS_OC_2 ECU_ADDRESS 0x7f9bb2 FORMAT "%3.0" /end MEASUREMENT
/begin MEASUREMENT fmy_stat_pps_oc_2.err_info_stat.reserved "" UWORD _CNV_A_R_LINEAR_____0_CM 1 0. 0. 65535. DISPLAY_IDENTIFIER FMY_STAT_PPS_OC_2_ERR_INFO_STAT_RESERVED ECU_ADDRESS 0x7f9bb0 BYTE_ORDER MSB_LAST BIT_MASK 0xF800 /end MEASUREMENT
/begin MEASUREMENT fmy_stat_pps_oc_2.err_info_stat.lv_cdn_diag_stc "Statistical flag for condition of diagnosis of the diagnosis instance PPS_OC_2" UWORD _CNV_S_2_RANGE______383_CM 1 0. 0. 1. DISPLAY_IDENTIFIER LV_CDN_DIAG_STC_PPS_OC_2 ECU_ADDRESS 0x7f9bb0 BYTE_ORDER MSB_LAST BIT_MASK 0x400 /end MEASUREMENT
/begin MEASUREMENT fmy_stat_pps_oc_2.err_info_stat.lv_lock_diag "lock flag (CPU load optimisation) of the diagnosis instance PPS_OC_2" UWORD _CNV_S_2_RANGE______383_CM 1 0. 0. 1. DISPLAY_IDENTIFIER LV_LOCK_DIAG_PPS_OC_2 ECU_ADDRESS 0x7f9bb0 BYTE_ORDER MSB_LAST BIT_MASK 0x200 /end MEASUREMENT
/begin MEASUREMENT fmy_stat_pps_oc_2.err_info_stat.lv_err_mem "storage in dynamic failure memory of the diagnosis instance PPS_OC_2" UWORD _CNV_S_2_RANGE______383_CM 1 0. 0. 1. DISPLAY_IDENTIFIER LV_ERR_MEM_PPS_OC_2 ECU_ADDRESS 0x7f9bb0 BYTE_ORDER MSB_LAST BIT_MASK 0x80 /end MEASUREMENT
/begin MEASUREMENT fmy_stat_pps_oc_2.err_info_stat.lv_ready "readiness status of the diagnosis instance PPS_OC_2" UWORD _CNV_S_2_RANGE______383_CM 1 0. 0. 1. DISPLAY_IDENTIFIER LV_READY_PPS_OC_2 ECU_ADDRESS 0x7f9bb0 BYTE_ORDER MSB_LAST BIT_MASK 0x40 /end MEASUREMENT
/begin MEASUREMENT fmy_stat_pps_oc_2.err_info_stat.lv_end_diag "end of diagnosis of the diagnosis instance PPS_OC_2" UWORD _CNV_S_2_RANGE______383_CM 1 0. 0. 1. DISPLAY_IDENTIFIER LV_END_DIAG_PPS_OC_2 ECU_ADDRESS 0x7f9bb0 BYTE_ORDER MSB_LAST BIT_MASK 0x20 /end MEASUREMENT
/begin MEASUREMENT fmy_stat_pps_oc_2.err_info_stat.lv_cdn_diag "diagnosis condition of the diagnosis instance PPS_OC_2" UWORD _CNV_S_2_RANGE______383_CM 1 0. 0. 1. DISPLAY_IDENTIFIER LV_CDN_DIAG_PPS_OC_2 ECU_ADDRESS 0x7f9bb0 BYTE_ORDER MSB_LAST BIT_MASK 0x10 /end MEASUREMENT
/begin MEASUREMENT fmy_stat_pps_oc_2.err_info_stat.err_sym "symptoms of the diagnosis instance PPS_OC_2" UWORD _CNV_S_6_CONV_ERRM__22_CM 1 0. 0. 15. DISPLAY_IDENTIFIER ERR_SYM_PPS_OC_2 ECU_ADDRESS 0x7f9bb0 BYTE_ORDER MSB_LAST BIT_MASK 0xF /end MEASUREMENT
/begin MEASUREMENT lv_err_pps_oc_3 "Error flag of diagnosis instance PPS_OC_3" UBYTE _CNV_S_2_RANGE______23_CM 1 0. 0. 1. DISPLAY_IDENTIFIER LV_ERR_PPS_OC_3 ECU_ADDRESS 0x7fb91d /end MEASUREMENT
/begin MEASUREMENT fmy_stat_pps_oc_3.ctr_abc "anti bounce counter for diagnosis instance PPS_OC_3" UBYTE _CNV_A_R_LINEAR_____1_CM 1 0. 0. 255. DISPLAY_IDENTIFIER CTR_ABC_PPS_OC_3 ECU_ADDRESS 0x7f9bb7 FORMAT "%3.0" /end MEASUREMENT
/begin MEASUREMENT fmy_stat_pps_oc_3.ctr_end_diag "counter for end of diagnosis for diagnosis instance PPS_OC_3" UBYTE _CNV_A_R_LINEAR_____1_CM 1 0. 0. 255. DISPLAY_IDENTIFIER CTR_ABC_END_DIAG_PPS_OC_3 ECU_ADDRESS 0x7f9bb6 FORMAT "%3.0" /end MEASUREMENT
/begin MEASUREMENT fmy_stat_pps_oc_3.err_info_stat.reserved "" UWORD _CNV_A_R_LINEAR_____0_CM 1 0. 0. 65535. DISPLAY_IDENTIFIER FMY_STAT_PPS_OC_3_ERR_INFO_STAT_RESERVED ECU_ADDRESS 0x7f9bb4 BYTE_ORDER MSB_LAST BIT_MASK 0xF800 /end MEASUREMENT
/begin MEASUREMENT fmy_stat_pps_oc_3.err_info_stat.lv_cdn_diag_stc "Statistical flag for condition of diagnosis of the diagnosis instance PPS_OC_3" UWORD _CNV_S_2_RANGE______383_CM 1 0. 0. 1. DISPLAY_IDENTIFIER LV_CDN_DIAG_STC_PPS_OC_3 ECU_ADDRESS 0x7f9bb4 BYTE_ORDER MSB_LAST BIT_MASK 0x400 /end MEASUREMENT
/begin MEASUREMENT fmy_stat_pps_oc_3.err_info_stat.lv_lock_diag "lock flag (CPU load optimisation) of the diagnosis instance PPS_OC_3" UWORD _CNV_S_2_RANGE______383_CM 1 0. 0. 1. DISPLAY_IDENTIFIER LV_LOCK_DIAG_PPS_OC_3 ECU_ADDRESS 0x7f9bb4 BYTE_ORDER MSB_LAST BIT_MASK 0x200 /end MEASUREMENT
/begin MEASUREMENT fmy_stat_pps_oc_3.err_info_stat.lv_err_mem "storage in dynamic failure memory of the diagnosis instance PPS_OC_3" UWORD _CNV_S_2_RANGE______383_CM 1 0. 0. 1. DISPLAY_IDENTIFIER LV_ERR_MEM_PPS_OC_3 ECU_ADDRESS 0x7f9bb4 BYTE_ORDER MSB_LAST BIT_MASK 0x80 /end MEASUREMENT
/begin MEASUREMENT fmy_stat_pps_oc_3.err_info_stat.lv_ready "readiness status of the diagnosis instance PPS_OC_3" UWORD _CNV_S_2_RANGE______383_CM 1 0. 0. 1. DISPLAY_IDENTIFIER LV_READY_PPS_OC_3 ECU_ADDRESS 0x7f9bb4 BYTE_ORDER MSB_LAST BIT_MASK 0x40 /end MEASUREMENT
/begin MEASUREMENT fmy_stat_pps_oc_3.err_info_stat.lv_end_diag "end of diagnosis of the diagnosis instance PPS_OC_3" UWORD _CNV_S_2_RANGE______383_CM 1 0. 0. 1. DISPLAY_IDENTIFIER LV_END_DIAG_PPS_OC_3 ECU_ADDRESS 0x7f9bb4 BYTE_ORDER MSB_LAST BIT_MASK 0x20 /end MEASUREMENT
/begin MEASUREMENT fmy_stat_pps_oc_3.err_info_stat.lv_cdn_diag "diagnosis condition of the diagnosis instance PPS_OC_3" UWORD _CNV_S_2_RANGE______383_CM 1 0. 0. 1. DISPLAY_IDENTIFIER LV_CDN_DIAG_PPS_OC_3 ECU_ADDRESS 0x7f9bb4 BYTE_ORDER MSB_LAST BIT_MASK 0x10 /end MEASUREMENT
/begin MEASUREMENT fmy_stat_pps_oc_3.err_info_stat.err_sym "symptoms of the diagnosis instance PPS_OC_3" UWORD _CNV_S_6_CONV_ERRM__22_CM 1 0. 0. 15. DISPLAY_IDENTIFIER ERR_SYM_PPS_OC_3 ECU_ADDRESS 0x7f9bb4 BYTE_ORDER MSB_LAST BIT_MASK 0xF /end MEASUREMENT
/begin MEASUREMENT lv_err_pps_sc_h_l_0 "Error flag of diagnosis instance PPS_SC_H_L_0" UBYTE _CNV_S_2_RANGE______23_CM 1 0. 0. 1. DISPLAY_IDENTIFIER LV_ERR_PPS_SC_H_L_0 ECU_ADDRESS 0x7fb91e /end MEASUREMENT
/begin MEASUREMENT fmy_stat_pps_sc_h_l_0.ctr_abc "anti bounce counter for diagnosis instance PPS_SC_H_L_0" UBYTE _CNV_A_R_LINEAR_____1_CM 1 0. 0. 255. DISPLAY_IDENTIFIER CTR_ABC_PPS_SC_H_L_0 ECU_ADDRESS 0x7f9bbb FORMAT "%3.0" /end MEASUREMENT
/begin MEASUREMENT fmy_stat_pps_sc_h_l_0.ctr_end_diag "counter for end of diagnosis for diagnosis instance PPS_SC_H_L_0" UBYTE _CNV_A_R_LINEAR_____1_CM 1 0. 0. 255. DISPLAY_IDENTIFIER CTR_ABC_END_DIAG_PPS_SC_H_L_0 ECU_ADDRESS 0x7f9bba FORMAT "%3.0" /end MEASUREMENT
/begin MEASUREMENT fmy_stat_pps_sc_h_l_0.err_info_stat.reserved "" UWORD _CNV_A_R_LINEAR_____0_CM 1 0. 0. 65535. DISPLAY_IDENTIFIER FMY_STAT_PPS_SC_H_L_0_ERR_INFO_STAT_RESERVED ECU_ADDRESS 0x7f9bb8 BYTE_ORDER MSB_LAST BIT_MASK 0xF800 /end MEASUREMENT
/begin MEASUREMENT fmy_stat_pps_sc_h_l_0.err_info_stat.lv_cdn_diag_stc "Statistical flag for condition of diagnosis of the diagnosis instance PPS_SC_H_L_0" UWORD _CNV_S_2_RANGE______383_CM 1 0. 0. 1. DISPLAY_IDENTIFIER LV_CDN_DIAG_STC_PPS_SC_H_L_0 ECU_ADDRESS 0x7f9bb8 BYTE_ORDER MSB_LAST BIT_MASK 0x400 /end MEASUREMENT
/begin MEASUREMENT fmy_stat_pps_sc_h_l_0.err_info_stat.lv_lock_diag "lock flag (CPU load optimisation) of the diagnosis instance PPS_SC_H_L_0" UWORD _CNV_S_2_RANGE______383_CM 1 0. 0. 1. DISPLAY_IDENTIFIER LV_LOCK_DIAG_PPS_SC_H_L_0 ECU_ADDRESS 0x7f9bb8 BYTE_ORDER MSB_LAST BIT_MASK 0x200 /end MEASUREMENT
/begin MEASUREMENT fmy_stat_pps_sc_h_l_0.err_info_stat.lv_err_mem "storage in dynamic failure memory of the diagnosis instance PPS_SC_H_L_0" UWORD _CNV_S_2_RANGE______383_CM 1 0. 0. 1. DISPLAY_IDENTIFIER LV_ERR_MEM_PPS_SC_H_L_0 ECU_ADDRESS 0x7f9bb8 BYTE_ORDER MSB_LAST BIT_MASK 0x80 /end MEASUREMENT
/begin MEASUREMENT fmy_stat_pps_sc_h_l_0.err_info_stat.lv_ready "readiness status of the diagnosis instance PPS_SC_H_L_0" UWORD _CNV_S_2_RANGE______383_CM 1 0. 0. 1. DISPLAY_IDENTIFIER LV_READY_PPS_SC_H_L_0 ECU_ADDRESS 0x7f9bb8 BYTE_ORDER MSB_LAST BIT_MASK 0x40 /end MEASUREMENT
/begin MEASUREMENT fmy_stat_pps_sc_h_l_0.err_info_stat.lv_end_diag "end of diagnosis of the diagnosis instance PPS_SC_H_L_0" UWORD _CNV_S_2_RANGE______383_CM 1 0. 0. 1. DISPLAY_IDENTIFIER LV_END_DIAG_PPS_SC_H_L_0 ECU_ADDRESS 0x7f9bb8 BYTE_ORDER MSB_LAST BIT_MASK 0x20 /end MEASUREMENT
/begin MEASUREMENT fmy_stat_pps_sc_h_l_0.err_info_stat.lv_cdn_diag "diagnosis condition of the diagnosis instance PPS_SC_H_L_0" UWORD _CNV_S_2_RANGE______383_CM 1 0. 0. 1. DISPLAY_IDENTIFIER LV_CDN_DIAG_PPS_SC_H_L_0 ECU_ADDRESS 0x7f9bb8 BYTE_ORDER MSB_LAST BIT_MASK 0x10 /end MEASUREMENT
/begin MEASUREMENT fmy_stat_pps_sc_h_l_0.err_info_stat.err_sym "symptoms of the diagnosis instance PPS_SC_H_L_0" UWORD _CNV_S_6_CONV_ERRM__22_CM 1 0. 0. 15. DISPLAY_IDENTIFIER ERR_SYM_PPS_SC_H_L_0 ECU_ADDRESS 0x7f9bb8 BYTE_ORDER MSB_LAST BIT_MASK 0xF /end MEASUREMENT
/begin MEASUREMENT lv_err_pps_sc_h_l_1 "Error flag of diagnosis instance PPS_SC_H_L_1" UBYTE _CNV_S_2_RANGE______23_CM 1 0. 0. 1. DISPLAY_IDENTIFIER LV_ERR_PPS_SC_H_L_1 ECU_ADDRESS 0x7fb91f /end MEASUREMENT
/begin MEASUREMENT fmy_stat_pps_sc_h_l_1.ctr_abc "anti bounce counter for diagnosis instance PPS_SC_H_L_1" UBYTE _CNV_A_R_LINEAR_____1_CM 1 0. 0. 255. DISPLAY_IDENTIFIER CTR_ABC_PPS_SC_H_L_1 ECU_ADDRESS 0x7f9bbf FORMAT "%3.0" /end MEASUREMENT
/begin MEASUREMENT fmy_stat_pps_sc_h_l_1.ctr_end_diag "counter for end of diagnosis for diagnosis instance PPS_SC_H_L_1" UBYTE _CNV_A_R_LINEAR_____1_CM 1 0. 0. 255. DISPLAY_IDENTIFIER CTR_ABC_END_DIAG_PPS_SC_H_L_1 ECU_ADDRESS 0x7f9bbe FORMAT "%3.0" /end MEASUREMENT
/begin MEASUREMENT fmy_stat_pps_sc_h_l_1.err_info_stat.reserved "" UWORD _CNV_A_R_LINEAR_____0_CM 1 0. 0. 65535. DISPLAY_IDENTIFIER FMY_STAT_PPS_SC_H_L_1_ERR_INFO_STAT_RESERVED ECU_ADDRESS 0x7f9bbc BYTE_ORDER MSB_LAST BIT_MASK 0xF800 /end MEASUREMENT
/begin MEASUREMENT fmy_stat_pps_sc_h_l_1.err_info_stat.lv_cdn_diag_stc "Statistical flag for condition of diagnosis of the diagnosis instance PPS_SC_H_L_1" UWORD _CNV_S_2_RANGE______383_CM 1 0. 0. 1. DISPLAY_IDENTIFIER LV_CDN_DIAG_STC_PPS_SC_H_L_1 ECU_ADDRESS 0x7f9bbc BYTE_ORDER MSB_LAST BIT_MASK 0x400 /end MEASUREMENT
/begin MEASUREMENT fmy_stat_pps_sc_h_l_1.err_info_stat.lv_lock_diag "lock flag (CPU load optimisation) of the diagnosis instance PPS_SC_H_L_1" UWORD _CNV_S_2_RANGE______383_CM 1 0. 0. 1. DISPLAY_IDENTIFIER LV_LOCK_DIAG_PPS_SC_H_L_1 ECU_ADDRESS 0x7f9bbc BYTE_ORDER MSB_LAST BIT_MASK 0x200 /end MEASUREMENT
/begin MEASUREMENT fmy_stat_pps_sc_h_l_1.err_info_stat.lv_err_mem "storage in dynamic failure memory of the diagnosis instance PPS_SC_H_L_1" UWORD _CNV_S_2_RANGE______383_CM 1 0. 0. 1. DISPLAY_IDENTIFIER LV_ERR_MEM_PPS_SC_H_L_1 ECU_ADDRESS 0x7f9bbc BYTE_ORDER MSB_LAST BIT_MASK 0x80 /end MEASUREMENT
/begin MEASUREMENT fmy_stat_pps_sc_h_l_1.err_info_stat.lv_ready "readiness status of the diagnosis instance PPS_SC_H_L_1" UWORD _CNV_S_2_RANGE______383_CM 1 0. 0. 1. DISPLAY_IDENTIFIER LV_READY_PPS_SC_H_L_1 ECU_ADDRESS 0x7f9bbc BYTE_ORDER MSB_LAST BIT_MASK 0x40 /end MEASUREMENT
/begin MEASUREMENT fmy_stat_pps_sc_h_l_1.err_info_stat.lv_end_diag "end of diagnosis of the diagnosis instance PPS_SC_H_L_1" UWORD _CNV_S_2_RANGE______383_CM 1 0. 0. 1. DISPLAY_IDENTIFIER LV_END_DIAG_PPS_SC_H_L_1 ECU_ADDRESS 0x7f9bbc BYTE_ORDER MSB_LAST BIT_MASK 0x20 /end MEASUREMENT
/begin MEASUREMENT fmy_stat_pps_sc_h_l_1.err_info_stat.lv_cdn_diag "diagnosis condition of the diagnosis instance PPS_SC_H_L_1" UWORD _CNV_S_2_RANGE______383_CM 1 0. 0. 1. DISPLAY_IDENTIFIER LV_CDN_DIAG_PPS_SC_H_L_1 ECU_ADDRESS 0x7f9bbc BYTE_ORDER MSB_LAST BIT_MASK 0x10 /end MEASUREMENT
/begin MEASUREMENT fmy_stat_pps_sc_h_l_1.err_info_stat.err_sym "symptoms of the diagnosis instance PPS_SC_H_L_1" UWORD _CNV_S_6_CONV_ERRM__22_CM 1 0. 0. 15. DISPLAY_IDENTIFIER ERR_SYM_PPS_SC_H_L_1 ECU_ADDRESS 0x7f9bbc BYTE_ORDER MSB_LAST BIT_MASK 0xF /end MEASUREMENT
/begin MEASUREMENT lv_err_pps_sc_h_l_2 "Error flag of diagnosis instance PPS_SC_H_L_2" UBYTE _CNV_S_2_RANGE______23_CM 1 0. 0. 1. DISPLAY_IDENTIFIER LV_ERR_PPS_SC_H_L_2 ECU_ADDRESS 0x7fb920 /end MEASUREMENT
/begin MEASUREMENT fmy_stat_pps_sc_h_l_2.ctr_abc "anti bounce counter for diagnosis instance PPS_SC_H_L_2" UBYTE _CNV_A_R_LINEAR_____1_CM 1 0. 0. 255. DISPLAY_IDENTIFIER CTR_ABC_PPS_SC_H_L_2 ECU_ADDRESS 0x7f9bc3 FORMAT "%3.0" /end MEASUREMENT
/begin MEASUREMENT fmy_stat_pps_sc_h_l_2.ctr_end_diag "counter for end of diagnosis for diagnosis instance PPS_SC_H_L_2" UBYTE _CNV_A_R_LINEAR_____1_CM 1 0. 0. 255. DISPLAY_IDENTIFIER CTR_ABC_END_DIAG_PPS_SC_H_L_2 ECU_ADDRESS 0x7f9bc2 FORMAT "%3.0" /end MEASUREMENT
/begin MEASUREMENT fmy_stat_pps_sc_h_l_2.err_info_stat.reserved "" UWORD _CNV_A_R_LINEAR_____0_CM 1 0. 0. 65535. DISPLAY_IDENTIFIER FMY_STAT_PPS_SC_H_L_2_ERR_INFO_STAT_RESERVED ECU_ADDRESS 0x7f9bc0 BYTE_ORDER MSB_LAST BIT_MASK 0xF800 /end MEASUREMENT
/begin MEASUREMENT fmy_stat_pps_sc_h_l_2.err_info_stat.lv_cdn_diag_stc "Statistical flag for condition of diagnosis of the diagnosis instance PPS_SC_H_L_2" UWORD _CNV_S_2_RANGE______383_CM 1 0. 0. 1. DISPLAY_IDENTIFIER LV_CDN_DIAG_STC_PPS_SC_H_L_2 ECU_ADDRESS 0x7f9bc0 BYTE_ORDER MSB_LAST BIT_MASK 0x400 /end MEASUREMENT
/begin MEASUREMENT fmy_stat_pps_sc_h_l_2.err_info_stat.lv_lock_diag "lock flag (CPU load optimisation) of the diagnosis instance PPS_SC_H_L_2" UWORD _CNV_S_2_RANGE______383_CM 1 0. 0. 1. DISPLAY_IDENTIFIER LV_LOCK_DIAG_PPS_SC_H_L_2 ECU_ADDRESS 0x7f9bc0 BYTE_ORDER MSB_LAST BIT_MASK 0x200 /end MEASUREMENT
/begin MEASUREMENT fmy_stat_pps_sc_h_l_2.err_info_stat.lv_err_mem "storage in dynamic failure memory of the diagnosis instance PPS_SC_H_L_2" UWORD _CNV_S_2_RANGE______383_CM 1 0. 0. 1. DISPLAY_IDENTIFIER LV_ERR_MEM_PPS_SC_H_L_2 ECU_ADDRESS 0x7f9bc0 BYTE_ORDER MSB_LAST BIT_MASK 0x80 /end MEASUREMENT
/begin MEASUREMENT fmy_stat_pps_sc_h_l_2.err_info_stat.lv_ready "readiness status of the diagnosis instance PPS_SC_H_L_2" UWORD _CNV_S_2_RANGE______383_CM 1 0. 0. 1. DISPLAY_IDENTIFIER LV_READY_PPS_SC_H_L_2 ECU_ADDRESS 0x7f9bc0 BYTE_ORDER MSB_LAST BIT_MASK 0x40 /end MEASUREMENT
/begin MEASUREMENT fmy_stat_pps_sc_h_l_2.err_info_stat.lv_end_diag "end of diagnosis of the diagnosis instance PPS_SC_H_L_2" UWORD _CNV_S_2_RANGE______383_CM 1 0. 0. 1. DISPLAY_IDENTIFIER LV_END_DIAG_PPS_SC_H_L_2 ECU_ADDRESS 0x7f9bc0 BYTE_ORDER MSB_LAST BIT_MASK 0x20 /end MEASUREMENT
/begin MEASUREMENT fmy_stat_pps_sc_h_l_2.err_info_stat.lv_cdn_diag "diagnosis condition of the diagnosis instance PPS_SC_H_L_2" UWORD _CNV_S_2_RANGE______383_CM 1 0. 0. 1. DISPLAY_IDENTIFIER LV_CDN_DIAG_PPS_SC_H_L_2 ECU_ADDRESS 0x7f9bc0 BYTE_ORDER MSB_LAST BIT_MASK 0x10 /end MEASUREMENT
/begin MEASUREMENT fmy_stat_pps_sc_h_l_2.err_info_stat.err_sym "symptoms of the diagnosis instance PPS_SC_H_L_2" UWORD _CNV_S_6_CONV_ERRM__22_CM 1 0. 0. 15. DISPLAY_IDENTIFIER ERR_SYM_PPS_SC_H_L_2 ECU_ADDRESS 0x7f9bc0 BYTE_ORDER MSB_LAST BIT_MASK 0xF /end MEASUREMENT
/begin MEASUREMENT lv_err_pps_sc_h_l_3 "Error flag of diagnosis instance PPS_SC_H_L_3" UBYTE _CNV_S_2_RANGE______23_CM 1 0. 0. 1. DISPLAY_IDENTIFIER LV_ERR_PPS_SC_H_L_3 ECU_ADDRESS 0x7fb921 /end MEASUREMENT
/begin MEASUREMENT fmy_stat_pps_sc_h_l_3.ctr_abc "anti bounce counter for diagnosis instance PPS_SC_H_L_3" UBYTE _CNV_A_R_LINEAR_____1_CM 1 0. 0. 255. DISPLAY_IDENTIFIER CTR_ABC_PPS_SC_H_L_3 ECU_ADDRESS 0x7f9bc7 FORMAT "%3.0" /end MEASUREMENT
/begin MEASUREMENT fmy_stat_pps_sc_h_l_3.ctr_end_diag "counter for end of diagnosis for diagnosis instance PPS_SC_H_L_3" UBYTE _CNV_A_R_LINEAR_____1_CM 1 0. 0. 255. DISPLAY_IDENTIFIER CTR_ABC_END_DIAG_PPS_SC_H_L_3 ECU_ADDRESS 0x7f9bc6 FORMAT "%3.0" /end MEASUREMENT
/begin MEASUREMENT fmy_stat_pps_sc_h_l_3.err_info_stat.reserved "" UWORD _CNV_A_R_LINEAR_____0_CM 1 0. 0. 65535. DISPLAY_IDENTIFIER FMY_STAT_PPS_SC_H_L_3_ERR_INFO_STAT_RESERVED ECU_ADDRESS 0x7f9bc4 BYTE_ORDER MSB_LAST BIT_MASK 0xF800 /end MEASUREMENT
/begin MEASUREMENT fmy_stat_pps_sc_h_l_3.err_info_stat.lv_cdn_diag_stc "Statistical flag for condition of diagnosis of the diagnosis instance PPS_SC_H_L_3" UWORD _CNV_S_2_RANGE______383_CM 1 0. 0. 1. DISPLAY_IDENTIFIER LV_CDN_DIAG_STC_PPS_SC_H_L_3 ECU_ADDRESS 0x7f9bc4 BYTE_ORDER MSB_LAST BIT_MASK 0x400 /end MEASUREMENT
/begin MEASUREMENT fmy_stat_pps_sc_h_l_3.err_info_stat.lv_lock_diag "lock flag (CPU load optimisation) of the diagnosis instance PPS_SC_H_L_3" UWORD _CNV_S_2_RANGE______383_CM 1 0. 0. 1. DISPLAY_IDENTIFIER LV_LOCK_DIAG_PPS_SC_H_L_3 ECU_ADDRESS 0x7f9bc4 BYTE_ORDER MSB_LAST BIT_MASK 0x200 /end MEASUREMENT
/begin MEASUREMENT fmy_stat_pps_sc_h_l_3.err_info_stat.lv_err_mem "storage in dynamic failure memory of the diagnosis instance PPS_SC_H_L_3" UWORD _CNV_S_2_RANGE______383_CM 1 0. 0. 1. DISPLAY_IDENTIFIER LV_ERR_MEM_PPS_SC_H_L_3 ECU_ADDRESS 0x7f9bc4 BYTE_ORDER MSB_LAST BIT_MASK 0x80 /end MEASUREMENT
/begin MEASUREMENT fmy_stat_pps_sc_h_l_3.err_info_stat.lv_ready "readiness status of the diagnosis instance PPS_SC_H_L_3" UWORD _CNV_S_2_RANGE______383_CM 1 0. 0. 1. DISPLAY_IDENTIFIER LV_READY_PPS_SC_H_L_3 ECU_ADDRESS 0x7f9bc4 BYTE_ORDER MSB_LAST BIT_MASK 0x40 /end MEASUREMENT
/begin MEASUREMENT fmy_stat_pps_sc_h_l_3.err_info_stat.lv_end_diag "end of diagnosis of the diagnosis instance PPS_SC_H_L_3" UWORD _CNV_S_2_RANGE______383_CM 1 0. 0. 1. DISPLAY_IDENTIFIER LV_END_DIAG_PPS_SC_H_L_3 ECU_ADDRESS 0x7f9bc4 BYTE_ORDER MSB_LAST BIT_MASK 0x20 /end MEASUREMENT
/begin MEASUREMENT fmy_stat_pps_sc_h_l_3.err_info_stat.lv_cdn_diag "diagnosis condition of the diagnosis instance PPS_SC_H_L_3" UWORD _CNV_S_2_RANGE______383_CM 1 0. 0. 1. DISPLAY_IDENTIFIER LV_CDN_DIAG_PPS_SC_H_L_3 ECU_ADDRESS 0x7f9bc4 BYTE_ORDER MSB_LAST BIT_MASK 0x10 /end MEASUREMENT
/begin MEASUREMENT fmy_stat_pps_sc_h_l_3.err_info_stat.err_sym "symptoms of the diagnosis instance PPS_SC_H_L_3" UWORD _CNV_S_6_CONV_ERRM__22_CM 1 0. 0. 15. DISPLAY_IDENTIFIER ERR_SYM_PPS_SC_H_L_3 ECU_ADDRESS 0x7f9bc4 BYTE_ORDER MSB_LAST BIT_MASK 0xF /end MEASUREMENT
/begin MEASUREMENT lv_err_pps_sc_h_0 "Error flag of diagnosis instance PPS_SC_H_0" UBYTE _CNV_S_2_RANGE______23_CM 1 0. 0. 1. DISPLAY_IDENTIFIER LV_ERR_PPS_SC_H_0 ECU_ADDRESS 0x7fb922 /end MEASUREMENT
/begin MEASUREMENT fmy_stat_pps_sc_h_0.ctr_abc "anti bounce counter for diagnosis instance PPS_SC_H_0" UBYTE _CNV_A_R_LINEAR_____1_CM 1 0. 0. 255. DISPLAY_IDENTIFIER CTR_ABC_PPS_SC_H_0 ECU_ADDRESS 0x7f9bcb FORMAT "%3.0" /end MEASUREMENT
/begin MEASUREMENT fmy_stat_pps_sc_h_0.ctr_end_diag "counter for end of diagnosis for diagnosis instance PPS_SC_H_0" UBYTE _CNV_A_R_LINEAR_____1_CM 1 0. 0. 255. DISPLAY_IDENTIFIER CTR_ABC_END_DIAG_PPS_SC_H_0 ECU_ADDRESS 0x7f9bca FORMAT "%3.0" /end MEASUREMENT
/begin MEASUREMENT fmy_stat_pps_sc_h_0.err_info_stat.reserved "" UWORD _CNV_A_R_LINEAR_____0_CM 1 0. 0. 65535. DISPLAY_IDENTIFIER FMY_STAT_PPS_SC_H_0_ERR_INFO_STAT_RESERVED ECU_ADDRESS 0x7f9bc8 BYTE_ORDER MSB_LAST BIT_MASK 0xF800 /end MEASUREMENT
/begin MEASUREMENT fmy_stat_pps_sc_h_0.err_info_stat.lv_cdn_diag_stc "Statistical flag for condition of diagnosis of the diagnosis instance PPS_SC_H_0" UWORD _CNV_S_2_RANGE______383_CM 1 0. 0. 1. DISPLAY_IDENTIFIER LV_CDN_DIAG_STC_PPS_SC_H_0 ECU_ADDRESS 0x7f9bc8 BYTE_ORDER MSB_LAST BIT_MASK 0x400 /end MEASUREMENT
/begin MEASUREMENT fmy_stat_pps_sc_h_0.err_info_stat.lv_lock_diag "lock flag (CPU load optimisation) of the diagnosis instance PPS_SC_H_0" UWORD _CNV_S_2_RANGE______383_CM 1 0. 0. 1. DISPLAY_IDENTIFIER LV_LOCK_DIAG_PPS_SC_H_0 ECU_ADDRESS 0x7f9bc8 BYTE_ORDER MSB_LAST BIT_MASK 0x200 /end MEASUREMENT
/begin MEASUREMENT fmy_stat_pps_sc_h_0.err_info_stat.lv_err_mem "storage in dynamic failure memory of the diagnosis instance PPS_SC_H_0" UWORD _CNV_S_2_RANGE______383_CM 1 0. 0. 1. DISPLAY_IDENTIFIER LV_ERR_MEM_PPS_SC_H_0 ECU_ADDRESS 0x7f9bc8 BYTE_ORDER MSB_LAST BIT_MASK 0x80 /end MEASUREMENT
/begin MEASUREMENT fmy_stat_pps_sc_h_0.err_info_stat.lv_ready "readiness status of the diagnosis instance PPS_SC_H_0" UWORD _CNV_S_2_RANGE______383_CM 1 0. 0. 1. DISPLAY_IDENTIFIER LV_READY_PPS_SC_H_0 ECU_ADDRESS 0x7f9bc8 BYTE_ORDER MSB_LAST BIT_MASK 0x40 /end MEASUREMENT
/begin MEASUREMENT fmy_stat_pps_sc_h_0.err_info_stat.lv_end_diag "end of diagnosis of the diagnosis instance PPS_SC_H_0" UWORD _CNV_S_2_RANGE______383_CM 1 0. 0. 1. DISPLAY_IDENTIFIER LV_END_DIAG_PPS_SC_H_0 ECU_ADDRESS 0x7f9bc8 BYTE_ORDER MSB_LAST BIT_MASK 0x20 /end MEASUREMENT
/begin MEASUREMENT fmy_stat_pps_sc_h_0.err_info_stat.lv_cdn_diag "diagnosis condition of the diagnosis instance PPS_SC_H_0" UWORD _CNV_S_2_RANGE______383_CM 1 0. 0. 1. DISPLAY_IDENTIFIER LV_CDN_DIAG_PPS_SC_H_0 ECU_ADDRESS 0x7f9bc8 BYTE_ORDER MSB_LAST BIT_MASK 0x10 /end MEASUREMENT
/begin MEASUREMENT fmy_stat_pps_sc_h_0.err_info_stat.err_sym "symptoms of the diagnosis instance PPS_SC_H_0" UWORD _CNV_S_6_CONV_ERRM__22_CM 1 0. 0. 15. DISPLAY_IDENTIFIER ERR_SYM_PPS_SC_H_0 ECU_ADDRESS 0x7f9bc8 BYTE_ORDER MSB_LAST BIT_MASK 0xF /end MEASUREMENT
/begin MEASUREMENT lv_err_pps_sc_l_0 "Error flag of diagnosis instance PPS_SC_L_0" UBYTE _CNV_S_2_RANGE______23_CM 1 0. 0. 1. DISPLAY_IDENTIFIER LV_ERR_PPS_SC_L_0 ECU_ADDRESS 0x7fb923 /end MEASUREMENT
/begin MEASUREMENT fmy_stat_pps_sc_l_0.ctr_abc "anti bounce counter for diagnosis instance PPS_SC_L_0" UBYTE _CNV_A_R_LINEAR_____1_CM 1 0. 0. 255. DISPLAY_IDENTIFIER CTR_ABC_PPS_SC_L_0 ECU_ADDRESS 0x7f9bcf FORMAT "%3.0" /end MEASUREMENT
/begin MEASUREMENT fmy_stat_pps_sc_l_0.ctr_end_diag "counter for end of diagnosis for diagnosis instance PPS_SC_L_0" UBYTE _CNV_A_R_LINEAR_____1_CM 1 0. 0. 255. DISPLAY_IDENTIFIER CTR_ABC_END_DIAG_PPS_SC_L_0 ECU_ADDRESS 0x7f9bce FORMAT "%3.0" /end MEASUREMENT
/begin MEASUREMENT fmy_stat_pps_sc_l_0.err_info_stat.reserved "" UWORD _CNV_A_R_LINEAR_____0_CM 1 0. 0. 65535. DISPLAY_IDENTIFIER FMY_STAT_PPS_SC_L_0_ERR_INFO_STAT_RESERVED ECU_ADDRESS 0x7f9bcc BYTE_ORDER MSB_LAST BIT_MASK 0xF800 /end MEASUREMENT
/begin MEASUREMENT fmy_stat_pps_sc_l_0.err_info_stat.lv_cdn_diag_stc "Statistical flag for condition of diagnosis of the diagnosis instance PPS_SC_L_0" UWORD _CNV_S_2_RANGE______383_CM 1 0. 0. 1. DISPLAY_IDENTIFIER LV_CDN_DIAG_STC_PPS_SC_L_0 ECU_ADDRESS 0x7f9bcc BYTE_ORDER MSB_LAST BIT_MASK 0x400 /end MEASUREMENT
/begin MEASUREMENT fmy_stat_pps_sc_l_0.err_info_stat.lv_lock_diag "lock flag (CPU load optimisation) of the diagnosis instance PPS_SC_L_0" UWORD _CNV_S_2_RANGE______383_CM 1 0. 0. 1. DISPLAY_IDENTIFIER LV_LOCK_DIAG_PPS_SC_L_0 ECU_ADDRESS 0x7f9bcc BYTE_ORDER MSB_LAST BIT_MASK 0x200 /end MEASUREMENT
/begin MEASUREMENT fmy_stat_pps_sc_l_0.err_info_stat.lv_err_mem "storage in dynamic failure memory of the diagnosis instance PPS_SC_L_0" UWORD _CNV_S_2_RANGE______383_CM 1 0. 0. 1. DISPLAY_IDENTIFIER LV_ERR_MEM_PPS_SC_L_0 ECU_ADDRESS 0x7f9bcc BYTE_ORDER MSB_LAST BIT_MASK 0x80 /end MEASUREMENT
/begin MEASUREMENT fmy_stat_pps_sc_l_0.err_info_stat.lv_ready "readiness status of the diagnosis instance PPS_SC_L_0" UWORD _CNV_S_2_RANGE______383_CM 1 0. 0. 1. DISPLAY_IDENTIFIER LV_READY_PPS_SC_L_0 ECU_ADDRESS 0x7f9bcc BYTE_ORDER MSB_LAST BIT_MASK 0x40 /end MEASUREMENT
/begin MEASUREMENT fmy_stat_pps_sc_l_0.err_info_stat.lv_end_diag "end of diagnosis of the diagnosis instance PPS_SC_L_0" UWORD _CNV_S_2_RANGE______383_CM 1 0. 0. 1. DISPLAY_IDENTIFIER LV_END_DIAG_PPS_SC_L_0 ECU_ADDRESS 0x7f9bcc BYTE_ORDER MSB_LAST BIT_MASK 0x20 /end MEASUREMENT
/begin MEASUREMENT fmy_stat_pps_sc_l_0.err_info_stat.lv_cdn_diag "diagnosis condition of the diagnosis instance PPS_SC_L_0" UWORD _CNV_S_2_RANGE______383_CM 1 0. 0. 1. DISPLAY_IDENTIFIER LV_CDN_DIAG_PPS_SC_L_0 ECU_ADDRESS 0x7f9bcc BYTE_ORDER MSB_LAST BIT_MASK 0x10 /end MEASUREMENT
/begin MEASUREMENT fmy_stat_pps_sc_l_0.err_info_stat.err_sym "symptoms of the diagnosis instance PPS_SC_L_0" UWORD _CNV_S_6_CONV_ERRM__22_CM 1 0. 0. 15. DISPLAY_IDENTIFIER ERR_SYM_PPS_SC_L_0 ECU_ADDRESS 0x7f9bcc BYTE_ORDER MSB_LAST BIT_MASK 0xF /end MEASUREMENT
/begin MEASUREMENT lv_err_v_teg_tur_up_rng "Error flag of diagnosis instance V_TEG_TUR_UP_RNG" UBYTE _CNV_S_2_RANGE______23_CM 1 0. 0. 1. DISPLAY_IDENTIFIER LV_ERR_V_TEG_TUR_UP_RNG ECU_ADDRESS 0x7fb924 /end MEASUREMENT
/begin MEASUREMENT fmy_stat_v_teg_tur_up_rng.ctr_abc "anti bounce counter for diagnosis instance V_TEG_TUR_UP_RNG" UBYTE _CNV_A_R_LINEAR_____1_CM 1 0. 0. 255. DISPLAY_IDENTIFIER CTR_ABC_V_TEG_TUR_UP_RNG ECU_ADDRESS 0x7f9bd3 FORMAT "%3.0" /end MEASUREMENT
/begin MEASUREMENT fmy_stat_v_teg_tur_up_rng.ctr_end_diag "counter for end of diagnosis for diagnosis instance V_TEG_TUR_UP_RNG" UBYTE _CNV_A_R_LINEAR_____1_CM 1 0. 0. 255. DISPLAY_IDENTIFIER CTR_ABC_END_DIAG_V_TEG_TUR_UP_RNG ECU_ADDRESS 0x7f9bd2 FORMAT "%3.0" /end MEASUREMENT
/begin MEASUREMENT fmy_stat_v_teg_tur_up_rng.err_info_stat.reserved "" UWORD _CNV_A_R_LINEAR_____0_CM 1 0. 0. 65535. DISPLAY_IDENTIFIER FMY_STAT_V_TEG_TUR_UP_RNG_ERR_INFO_STAT_RESERVED ECU_ADDRESS 0x7f9bd0 BYTE_ORDER MSB_LAST BIT_MASK 0xF800 /end MEASUREMENT
/begin MEASUREMENT fmy_stat_v_teg_tur_up_rng.err_info_stat.lv_cdn_diag_stc "Statistical flag for condition of diagnosis of the diagnosis instance V_TEG_TUR_UP_RNG" UWORD _CNV_S_2_RANGE______383_CM 1 0. 0. 1. DISPLAY_IDENTIFIER LV_CDN_DIAG_STC_V_TEG_TUR_UP_RNG ECU_ADDRESS 0x7f9bd0 BYTE_ORDER MSB_LAST BIT_MASK 0x400 /end MEASUREMENT
/begin MEASUREMENT fmy_stat_v_teg_tur_up_rng.err_info_stat.lv_lock_diag "lock flag (CPU load optimisation) of the diagnosis instance V_TEG_TUR_UP_RNG" UWORD _CNV_S_2_RANGE______383_CM 1 0. 0. 1. DISPLAY_IDENTIFIER LV_LOCK_DIAG_V_TEG_TUR_UP_RNG ECU_ADDRESS 0x7f9bd0 BYTE_ORDER MSB_LAST BIT_MASK 0x200 /end MEASUREMENT
/begin MEASUREMENT fmy_stat_v_teg_tur_up_rng.err_info_stat.lv_err_mem "storage in dynamic failure memory of the diagnosis instance V_TEG_TUR_UP_RNG" UWORD _CNV_S_2_RANGE______383_CM 1 0. 0. 1. DISPLAY_IDENTIFIER LV_ERR_MEM_V_TEG_TUR_UP_RNG ECU_ADDRESS 0x7f9bd0 BYTE_ORDER MSB_LAST BIT_MASK 0x80 /end MEASUREMENT
/begin MEASUREMENT fmy_stat_v_teg_tur_up_rng.err_info_stat.lv_ready "readiness status of the diagnosis instance V_TEG_TUR_UP_RNG" UWORD _CNV_S_2_RANGE______383_CM 1 0. 0. 1. DISPLAY_IDENTIFIER LV_READY_V_TEG_TUR_UP_RNG ECU_ADDRESS 0x7f9bd0 BYTE_ORDER MSB_LAST BIT_MASK 0x40 /end MEASUREMENT
/begin MEASUREMENT fmy_stat_v_teg_tur_up_rng.err_info_stat.lv_end_diag "end of diagnosis of the diagnosis instance V_TEG_TUR_UP_RNG" UWORD _CNV_S_2_RANGE______383_CM 1 0. 0. 1. DISPLAY_IDENTIFIER LV_END_DIAG_V_TEG_TUR_UP_RNG ECU_ADDRESS 0x7f9bd0 BYTE_ORDER MSB_LAST BIT_MASK 0x20 /end MEASUREMENT
/begin MEASUREMENT fmy_stat_v_teg_tur_up_rng.err_info_stat.lv_cdn_diag "diagnosis condition of the diagnosis instance V_TEG_TUR_UP_RNG" UWORD _CNV_S_2_RANGE______383_CM 1 0. 0. 1. DISPLAY_IDENTIFIER LV_CDN_DIAG_V_TEG_TUR_UP_RNG ECU_ADDRESS 0x7f9bd0 BYTE_ORDER MSB_LAST BIT_MASK 0x10 /end MEASUREMENT
/begin MEASUREMENT fmy_stat_v_teg_tur_up_rng.err_info_stat.err_sym "symptoms of the diagnosis instance V_TEG_TUR_UP_RNG" UWORD _CNV_S_6_CONV_ERRM__22_CM 1 0. 0. 15. DISPLAY_IDENTIFIER ERR_SYM_V_TEG_TUR_UP_RNG ECU_ADDRESS 0x7f9bd0 BYTE_ORDER MSB_LAST BIT_MASK 0xF /end MEASUREMENT
/begin MEASUREMENT lv_err_teg_tur_up_mes_grd "Error flag of diagnosis instance TEG_TUR_UP_MES_GRD" UBYTE _CNV_S_2_RANGE______23_CM 1 0. 0. 1. DISPLAY_IDENTIFIER LV_ERR_TEG_TUR_UP_MES_GRD ECU_ADDRESS 0x7fb925 /end MEASUREMENT
/begin MEASUREMENT fmy_stat_teg_tur_up_mes_grd.ctr_abc "anti bounce counter for diagnosis instance TEG_TUR_UP_MES_GRD" UBYTE _CNV_A_R_LINEAR_____1_CM 1 0. 0. 255. DISPLAY_IDENTIFIER CTR_ABC_TEG_TUR_UP_MES_GRD ECU_ADDRESS 0x7f9bd7 FORMAT "%3.0" /end MEASUREMENT
/begin MEASUREMENT fmy_stat_teg_tur_up_mes_grd.ctr_end_diag "counter for end of diagnosis for diagnosis instance TEG_TUR_UP_MES_GRD" UBYTE _CNV_A_R_LINEAR_____1_CM 1 0. 0. 255. DISPLAY_IDENTIFIER CTR_ABC_END_DIAG_TEG_TUR_UP_MES_GRD ECU_ADDRESS 0x7f9bd6 FORMAT "%3.0" /end MEASUREMENT
/begin MEASUREMENT fmy_stat_teg_tur_up_mes_grd.err_info_stat.reserved "" UWORD _CNV_A_R_LINEAR_____0_CM 1 0. 0. 65535. DISPLAY_IDENTIFIER FMY_STAT_TEG_TUR_UP_MES_GRD_ERR_INFO_STAT_RESERVED ECU_ADDRESS 0x7f9bd4 BYTE_ORDER MSB_LAST BIT_MASK 0xF800 /end MEASUREMENT
/begin MEASUREMENT fmy_stat_teg_tur_up_mes_grd.err_info_stat.lv_cdn_diag_stc "Statistical flag for condition of diagnosis of the diagnosis instance TEG_TUR_UP_MES_GRD" UWORD _CNV_S_2_RANGE______383_CM 1 0. 0. 1. DISPLAY_IDENTIFIER LV_CDN_DIAG_STC_TEG_TUR_UP_MES_GRD ECU_ADDRESS 0x7f9bd4 BYTE_ORDER MSB_LAST BIT_MASK 0x400 /end MEASUREMENT
/begin MEASUREMENT fmy_stat_teg_tur_up_mes_grd.err_info_stat.lv_lock_diag "lock flag (CPU load optimisation) of the diagnosis instance TEG_TUR_UP_MES_GRD" UWORD _CNV_S_2_RANGE______383_CM 1 0. 0. 1. DISPLAY_IDENTIFIER LV_LOCK_DIAG_TEG_TUR_UP_MES_GRD ECU_ADDRESS 0x7f9bd4 BYTE_ORDER MSB_LAST BIT_MASK 0x200 /end MEASUREMENT
/begin MEASUREMENT fmy_stat_teg_tur_up_mes_grd.err_info_stat.lv_err_mem "storage in dynamic failure memory of the diagnosis instance TEG_TUR_UP_MES_GRD" UWORD _CNV_S_2_RANGE______383_CM 1 0. 0. 1. DISPLAY_IDENTIFIER LV_ERR_MEM_TEG_TUR_UP_MES_GRD ECU_ADDRESS 0x7f9bd4 BYTE_ORDER MSB_LAST BIT_MASK 0x80 /end MEASUREMENT
/begin MEASUREMENT fmy_stat_teg_tur_up_mes_grd.err_info_stat.lv_ready "readiness status of the diagnosis instance TEG_TUR_UP_MES_GRD" UWORD _CNV_S_2_RANGE______383_CM 1 0. 0. 1. DISPLAY_IDENTIFIER LV_READY_TEG_TUR_UP_MES_GRD ECU_ADDRESS 0x7f9bd4 BYTE_ORDER MSB_LAST BIT_MASK 0x40 /end MEASUREMENT
/begin MEASUREMENT fmy_stat_teg_tur_up_mes_grd.err_info_stat.lv_end_diag "end of diagnosis of the diagnosis instance TEG_TUR_UP_MES_GRD" UWORD _CNV_S_2_RANGE______383_CM 1 0. 0. 1. DISPLAY_IDENTIFIER LV_END_DIAG_TEG_TUR_UP_MES_GRD ECU_ADDRESS 0x7f9bd4 BYTE_ORDER MSB_LAST BIT_MASK 0x20 /end MEASUREMENT
/begin MEASUREMENT fmy_stat_teg_tur_up_mes_grd.err_info_stat.lv_cdn_diag "diagnosis condition of the diagnosis instance TEG_TUR_UP_MES_GRD" UWORD _CNV_S_2_RANGE______383_CM 1 0. 0. 1. DISPLAY_IDENTIFIER LV_CDN_DIAG_TEG_TUR_UP_MES_GRD ECU_ADDRESS 0x7f9bd4 BYTE_ORDER MSB_LAST BIT_MASK 0x10 /end MEASUREMENT
/begin MEASUREMENT fmy_stat_teg_tur_up_mes_grd.err_info_stat.err_sym "symptoms of the diagnosis instance TEG_TUR_UP_MES_GRD" UWORD _CNV_S_6_CONV_ERRM__22_CM 1 0. 0. 15. DISPLAY_IDENTIFIER ERR_SYM_TEG_TUR_UP_MES_GRD ECU_ADDRESS 0x7f9bd4 BYTE_ORDER MSB_LAST BIT_MASK 0xF /end MEASUREMENT
/begin MEASUREMENT lv_err_bpa "Error flag of diagnosis instance BPA" UBYTE _CNV_S_2_RANGE______23_CM 1 0. 0. 1. DISPLAY_IDENTIFIER LV_ERR_BPA ECU_ADDRESS 0x7fb926 /end MEASUREMENT
/begin MEASUREMENT fmy_stat_bpa.ctr_abc "anti bounce counter for diagnosis instance BPA" UBYTE _CNV_A_R_LINEAR_____1_CM 1 0. 0. 255. DISPLAY_IDENTIFIER CTR_ABC_BPA ECU_ADDRESS 0x7f9bdb FORMAT "%3.0" /end MEASUREMENT
/begin MEASUREMENT fmy_stat_bpa.ctr_end_diag "counter for end of diagnosis for diagnosis instance BPA" UBYTE _CNV_A_R_LINEAR_____1_CM 1 0. 0. 255. DISPLAY_IDENTIFIER CTR_ABC_END_DIAG_BPA ECU_ADDRESS 0x7f9bda FORMAT "%3.0" /end MEASUREMENT
/begin MEASUREMENT fmy_stat_bpa.err_info_stat.reserved "" UWORD _CNV_A_R_LINEAR_____0_CM 1 0. 0. 65535. DISPLAY_IDENTIFIER FMY_STAT_BPA_ERR_INFO_STAT_RESERVED ECU_ADDRESS 0x7f9bd8 BYTE_ORDER MSB_LAST BIT_MASK 0xF800 /end MEASUREMENT
/begin MEASUREMENT fmy_stat_bpa.err_info_stat.lv_cdn_diag_stc "Statistical flag for condition of diagnosis of the diagnosis instance BPA" UWORD _CNV_S_2_RANGE______383_CM 1 0. 0. 1. DISPLAY_IDENTIFIER LV_CDN_DIAG_STC_BPA ECU_ADDRESS 0x7f9bd8 BYTE_ORDER MSB_LAST BIT_MASK 0x400 /end MEASUREMENT
/begin MEASUREMENT fmy_stat_bpa.err_info_stat.lv_lock_diag "lock flag (CPU load optimisation) of the diagnosis instance BPA" UWORD _CNV_S_2_RANGE______383_CM 1 0. 0. 1. DISPLAY_IDENTIFIER LV_LOCK_DIAG_BPA ECU_ADDRESS 0x7f9bd8 BYTE_ORDER MSB_LAST BIT_MASK 0x200 /end MEASUREMENT
/begin MEASUREMENT fmy_stat_bpa.err_info_stat.lv_err_mem "storage in dynamic failure memory of the diagnosis instance BPA" UWORD _CNV_S_2_RANGE______383_CM 1 0. 0. 1. DISPLAY_IDENTIFIER LV_ERR_MEM_BPA ECU_ADDRESS 0x7f9bd8 BYTE_ORDER MSB_LAST BIT_MASK 0x80 /end MEASUREMENT
/begin MEASUREMENT fmy_stat_bpa.err_info_stat.lv_ready "readiness status of the diagnosis instance BPA" UWORD _CNV_S_2_RANGE______383_CM 1 0. 0. 1. DISPLAY_IDENTIFIER LV_READY_BPA ECU_ADDRESS 0x7f9bd8 BYTE_ORDER MSB_LAST BIT_MASK 0x40 /end MEASUREMENT
/begin MEASUREMENT fmy_stat_bpa.err_info_stat.lv_end_diag "end of diagnosis of the diagnosis instance BPA" UWORD _CNV_S_2_RANGE______383_CM 1 0. 0. 1. DISPLAY_IDENTIFIER LV_END_DIAG_BPA ECU_ADDRESS 0x7f9bd8 BYTE_ORDER MSB_LAST BIT_MASK 0x20 /end MEASUREMENT
/begin MEASUREMENT fmy_stat_bpa.err_info_stat.lv_cdn_diag "diagnosis condition of the diagnosis instance BPA" UWORD _CNV_S_2_RANGE______383_CM 1 0. 0. 1. DISPLAY_IDENTIFIER LV_CDN_DIAG_BPA ECU_ADDRESS 0x7f9bd8 BYTE_ORDER MSB_LAST BIT_MASK 0x10 /end MEASUREMENT
/begin MEASUREMENT fmy_stat_bpa.err_info_stat.err_sym "symptoms of the diagnosis instance BPA" UWORD _CNV_S_6_CONV_ERRM__22_CM 1 0. 0. 15. DISPLAY_IDENTIFIER ERR_SYM_BPA ECU_ADDRESS 0x7f9bd8 BYTE_ORDER MSB_LAST BIT_MASK 0xF /end MEASUREMENT
/begin MEASUREMENT lv_err_gl_rly_dps "Error flag of diagnosis instance GL_RLY_DPS" UBYTE _CNV_S_2_RANGE______23_CM 1 0. 0. 1. DISPLAY_IDENTIFIER LV_ERR_GL_RLY_DPS ECU_ADDRESS 0x7fb929 /end MEASUREMENT
/begin MEASUREMENT fmy_stat_gl_rly_dps.ctr_abc "anti bounce counter for diagnosis instance GL_RLY_DPS" UBYTE _CNV_A_R_LINEAR_____1_CM 1 0. 0. 255. DISPLAY_IDENTIFIER CTR_ABC_GL_RLY_DPS ECU_ADDRESS 0x7f9be7 FORMAT "%3.0" /end MEASUREMENT
/begin MEASUREMENT fmy_stat_gl_rly_dps.ctr_end_diag "counter for end of diagnosis for diagnosis instance GL_RLY_DPS" UBYTE _CNV_A_R_LINEAR_____1_CM 1 0. 0. 255. DISPLAY_IDENTIFIER CTR_ABC_END_DIAG_GL_RLY_DPS ECU_ADDRESS 0x7f9be6 FORMAT "%3.0" /end MEASUREMENT
/begin MEASUREMENT fmy_stat_gl_rly_dps.err_info_stat.reserved "" UWORD _CNV_A_R_LINEAR_____0_CM 1 0. 0. 65535. DISPLAY_IDENTIFIER FMY_STAT_GL_RLY_DPS_ERR_INFO_STAT_RESERVED ECU_ADDRESS 0x7f9be4 BYTE_ORDER MSB_LAST BIT_MASK 0xF800 /end MEASUREMENT
/begin MEASUREMENT fmy_stat_gl_rly_dps.err_info_stat.lv_cdn_diag_stc "Statistical flag for condition of diagnosis of the diagnosis instance GL_RLY_DPS" UWORD _CNV_S_2_RANGE______383_CM 1 0. 0. 1. DISPLAY_IDENTIFIER LV_CDN_DIAG_STC_GL_RLY_DPS ECU_ADDRESS 0x7f9be4 BYTE_ORDER MSB_LAST BIT_MASK 0x400 /end MEASUREMENT
/begin MEASUREMENT fmy_stat_gl_rly_dps.err_info_stat.lv_lock_diag "lock flag (CPU load optimisation) of the diagnosis instance GL_RLY_DPS" UWORD _CNV_S_2_RANGE______383_CM 1 0. 0. 1. DISPLAY_IDENTIFIER LV_LOCK_DIAG_GL_RLY_DPS ECU_ADDRESS 0x7f9be4 BYTE_ORDER MSB_LAST BIT_MASK 0x200 /end MEASUREMENT
/begin MEASUREMENT fmy_stat_gl_rly_dps.err_info_stat.lv_err_mem "storage in dynamic failure memory of the diagnosis instance GL_RLY_DPS" UWORD _CNV_S_2_RANGE______383_CM 1 0. 0. 1. DISPLAY_IDENTIFIER LV_ERR_MEM_GL_RLY_DPS ECU_ADDRESS 0x7f9be4 BYTE_ORDER MSB_LAST BIT_MASK 0x80 /end MEASUREMENT
/begin MEASUREMENT fmy_stat_gl_rly_dps.err_info_stat.lv_ready "readiness status of the diagnosis instance GL_RLY_DPS" UWORD _CNV_S_2_RANGE______383_CM 1 0. 0. 1. DISPLAY_IDENTIFIER LV_READY_GL_RLY_DPS ECU_ADDRESS 0x7f9be4 BYTE_ORDER MSB_LAST BIT_MASK 0x40 /end MEASUREMENT
/begin MEASUREMENT fmy_stat_gl_rly_dps.err_info_stat.lv_end_diag "end of diagnosis of the diagnosis instance GL_RLY_DPS" UWORD _CNV_S_2_RANGE______383_CM 1 0. 0. 1. DISPLAY_IDENTIFIER LV_END_DIAG_GL_RLY_DPS ECU_ADDRESS 0x7f9be4 BYTE_ORDER MSB_LAST BIT_MASK 0x20 /end MEASUREMENT
/begin MEASUREMENT fmy_stat_gl_rly_dps.err_info_stat.lv_cdn_diag "diagnosis condition of the diagnosis instance GL_RLY_DPS" UWORD _CNV_S_2_RANGE______383_CM 1 0. 0. 1. DISPLAY_IDENTIFIER LV_CDN_DIAG_GL_RLY_DPS ECU_ADDRESS 0x7f9be4 BYTE_ORDER MSB_LAST BIT_MASK 0x10 /end MEASUREMENT
/begin MEASUREMENT fmy_stat_gl_rly_dps.err_info_stat.err_sym "symptoms of the diagnosis instance GL_RLY_DPS" UWORD _CNV_S_6_CONV_ERRM__22_CM 1 0. 0. 15. DISPLAY_IDENTIFIER ERR_SYM_GL_RLY_DPS ECU_ADDRESS 0x7f9be4 BYTE_ORDER MSB_LAST BIT_MASK 0xF /end MEASUREMENT
/begin MEASUREMENT lv_err_pcv_1 "Error flag of diagnosis instance PCV_1" UBYTE _CNV_S_2_RANGE______23_CM 1 0. 0. 1. DISPLAY_IDENTIFIER LV_ERR_PCV_1 ECU_ADDRESS 0x7fb92d /end MEASUREMENT
/begin MEASUREMENT fmy_stat_pcv_1.ctr_abc "anti bounce counter for diagnosis instance PCV_1" UBYTE _CNV_A_R_LINEAR_____1_CM 1 0. 0. 255. DISPLAY_IDENTIFIER CTR_ABC_PCV_1 ECU_ADDRESS 0x7f9bf7 FORMAT "%3.0" /end MEASUREMENT
/begin MEASUREMENT fmy_stat_pcv_1.ctr_end_diag "counter for end of diagnosis for diagnosis instance PCV_1" UBYTE _CNV_A_R_LINEAR_____1_CM 1 0. 0. 255. DISPLAY_IDENTIFIER CTR_ABC_END_DIAG_PCV_1 ECU_ADDRESS 0x7f9bf6 FORMAT "%3.0" /end MEASUREMENT
/begin MEASUREMENT fmy_stat_pcv_1.err_info_stat.reserved "" UWORD _CNV_A_R_LINEAR_____0_CM 1 0. 0. 65535. DISPLAY_IDENTIFIER FMY_STAT_PCV_1_ERR_INFO_STAT_RESERVED ECU_ADDRESS 0x7f9bf4 BYTE_ORDER MSB_LAST BIT_MASK 0xF800 /end MEASUREMENT
/begin MEASUREMENT fmy_stat_pcv_1.err_info_stat.lv_cdn_diag_stc "Statistical flag for condition of diagnosis of the diagnosis instance PCV_1" UWORD _CNV_S_2_RANGE______383_CM 1 0. 0. 1. DISPLAY_IDENTIFIER LV_CDN_DIAG_STC_PCV_1 ECU_ADDRESS 0x7f9bf4 BYTE_ORDER MSB_LAST BIT_MASK 0x400 /end MEASUREMENT
/begin MEASUREMENT fmy_stat_pcv_1.err_info_stat.lv_lock_diag "lock flag (CPU load optimisation) of the diagnosis instance PCV_1" UWORD _CNV_S_2_RANGE______383_CM 1 0. 0. 1. DISPLAY_IDENTIFIER LV_LOCK_DIAG_PCV_1 ECU_ADDRESS 0x7f9bf4 BYTE_ORDER MSB_LAST BIT_MASK 0x200 /end MEASUREMENT
/begin MEASUREMENT fmy_stat_pcv_1.err_info_stat.lv_err_mem "storage in dynamic failure memory of the diagnosis instance PCV_1" UWORD _CNV_S_2_RANGE______383_CM 1 0. 0. 1. DISPLAY_IDENTIFIER LV_ERR_MEM_PCV_1 ECU_ADDRESS 0x7f9bf4 BYTE_ORDER MSB_LAST BIT_MASK 0x80 /end MEASUREMENT
/begin MEASUREMENT fmy_stat_pcv_1.err_info_stat.lv_ready "readiness status of the diagnosis instance PCV_1" UWORD _CNV_S_2_RANGE______383_CM 1 0. 0. 1. DISPLAY_IDENTIFIER LV_READY_PCV_1 ECU_ADDRESS 0x7f9bf4 BYTE_ORDER MSB_LAST BIT_MASK 0x40 /end MEASUREMENT
/begin MEASUREMENT fmy_stat_pcv_1.err_info_stat.lv_end_diag "end of diagnosis of the diagnosis instance PCV_1" UWORD _CNV_S_2_RANGE______383_CM 1 0. 0. 1. DISPLAY_IDENTIFIER LV_END_DIAG_PCV_1 ECU_ADDRESS 0x7f9bf4 BYTE_ORDER MSB_LAST BIT_MASK 0x20 /end MEASUREMENT
/begin MEASUREMENT fmy_stat_pcv_1.err_info_stat.lv_cdn_diag "diagnosis condition of the diagnosis instance PCV_1" UWORD _CNV_S_2_RANGE______383_CM 1 0. 0. 1. DISPLAY_IDENTIFIER LV_CDN_DIAG_PCV_1 ECU_ADDRESS 0x7f9bf4 BYTE_ORDER MSB_LAST BIT_MASK 0x10 /end MEASUREMENT
/begin MEASUREMENT fmy_stat_pcv_1.err_info_stat.err_sym "symptoms of the diagnosis instance PCV_1" UWORD _CNV_S_6_CONV_ERRM__22_CM 1 0. 0. 15. DISPLAY_IDENTIFIER ERR_SYM_PCV_1 ECU_ADDRESS 0x7f9bf4 BYTE_ORDER MSB_LAST BIT_MASK 0xF /end MEASUREMENT
/begin MEASUREMENT lv_err_pcv_3 "Error flag of diagnosis instance PCV_3" UBYTE _CNV_S_2_RANGE______23_CM 1 0. 0. 1. DISPLAY_IDENTIFIER LV_ERR_PCV_3 ECU_ADDRESS 0x7fb92f /end MEASUREMENT
/begin MEASUREMENT fmy_stat_pcv_3.ctr_abc "anti bounce counter for diagnosis instance PCV_3" UBYTE _CNV_A_R_LINEAR_____1_CM 1 0. 0. 255. DISPLAY_IDENTIFIER CTR_ABC_PCV_3 ECU_ADDRESS 0x7f9bff FORMAT "%3.0" /end MEASUREMENT
/begin MEASUREMENT fmy_stat_pcv_3.ctr_end_diag "counter for end of diagnosis for diagnosis instance PCV_3" UBYTE _CNV_A_R_LINEAR_____1_CM 1 0. 0. 255. DISPLAY_IDENTIFIER CTR_ABC_END_DIAG_PCV_3 ECU_ADDRESS 0x7f9bfe FORMAT "%3.0" /end MEASUREMENT
/begin MEASUREMENT fmy_stat_pcv_3.err_info_stat.reserved "" UWORD _CNV_A_R_LINEAR_____0_CM 1 0. 0. 65535. DISPLAY_IDENTIFIER FMY_STAT_PCV_3_ERR_INFO_STAT_RESERVED ECU_ADDRESS 0x7f9bfc BYTE_ORDER MSB_LAST BIT_MASK 0xF800 /end MEASUREMENT
/begin MEASUREMENT fmy_stat_pcv_3.err_info_stat.lv_cdn_diag_stc "Statistical flag for condition of diagnosis of the diagnosis instance PCV_3" UWORD _CNV_S_2_RANGE______383_CM 1 0. 0. 1. DISPLAY_IDENTIFIER LV_CDN_DIAG_STC_PCV_3 ECU_ADDRESS 0x7f9bfc BYTE_ORDER MSB_LAST BIT_MASK 0x400 /end MEASUREMENT
/begin MEASUREMENT fmy_stat_pcv_3.err_info_stat.lv_lock_diag "lock flag (CPU load optimisation) of the diagnosis instance PCV_3" UWORD _CNV_S_2_RANGE______383_CM 1 0. 0. 1. DISPLAY_IDENTIFIER LV_LOCK_DIAG_PCV_3 ECU_ADDRESS 0x7f9bfc BYTE_ORDER MSB_LAST BIT_MASK 0x200 /end MEASUREMENT
/begin MEASUREMENT fmy_stat_pcv_3.err_info_stat.lv_err_mem "storage in dynamic failure memory of the diagnosis instance PCV_3" UWORD _CNV_S_2_RANGE______383_CM 1 0. 0. 1. DISPLAY_IDENTIFIER LV_ERR_MEM_PCV_3 ECU_ADDRESS 0x7f9bfc BYTE_ORDER MSB_LAST BIT_MASK 0x80 /end MEASUREMENT
/begin MEASUREMENT fmy_stat_pcv_3.err_info_stat.lv_ready "readiness status of the diagnosis instance PCV_3" UWORD _CNV_S_2_RANGE______383_CM 1 0. 0. 1. DISPLAY_IDENTIFIER LV_READY_PCV_3 ECU_ADDRESS 0x7f9bfc BYTE_ORDER MSB_LAST BIT_MASK 0x40 /end MEASUREMENT
/begin MEASUREMENT fmy_stat_pcv_3.err_info_stat.lv_end_diag "end of diagnosis of the diagnosis instance PCV_3" UWORD _CNV_S_2_RANGE______383_CM 1 0. 0. 1. DISPLAY_IDENTIFIER LV_END_DIAG_PCV_3 ECU_ADDRESS 0x7f9bfc BYTE_ORDER MSB_LAST BIT_MASK 0x20 /end MEASUREMENT
/begin MEASUREMENT fmy_stat_pcv_3.err_info_stat.lv_cdn_diag "diagnosis condition of the diagnosis instance PCV_3" UWORD _CNV_S_2_RANGE______383_CM 1 0. 0. 1. DISPLAY_IDENTIFIER LV_CDN_DIAG_PCV_3 ECU_ADDRESS 0x7f9bfc BYTE_ORDER MSB_LAST BIT_MASK 0x10 /end MEASUREMENT
/begin MEASUREMENT fmy_stat_pcv_3.err_info_stat.err_sym "symptoms of the diagnosis instance PCV_3" UWORD _CNV_S_6_CONV_ERRM__22_CM 1 0. 0. 15. DISPLAY_IDENTIFIER ERR_SYM_PCV_3 ECU_ADDRESS 0x7f9bfc BYTE_ORDER MSB_LAST BIT_MASK 0xF /end MEASUREMENT
/begin MEASUREMENT lv_err_rly_main "Error flag of diagnosis instance RLY_MAIN" UBYTE _CNV_S_2_RANGE______23_CM 1 0. 0. 1. DISPLAY_IDENTIFIER LV_ERR_RLY_MAIN ECU_ADDRESS 0x7fb930 /end MEASUREMENT
/begin MEASUREMENT fmy_stat_rly_main.ctr_abc "anti bounce counter for diagnosis instance RLY_MAIN" UBYTE _CNV_A_R_LINEAR_____1_CM 1 0. 0. 255. DISPLAY_IDENTIFIER CTR_ABC_RLY_MAIN ECU_ADDRESS 0x7f9c03 FORMAT "%3.0" /end MEASUREMENT
/begin MEASUREMENT fmy_stat_rly_main.ctr_end_diag "counter for end of diagnosis for diagnosis instance RLY_MAIN" UBYTE _CNV_A_R_LINEAR_____1_CM 1 0. 0. 255. DISPLAY_IDENTIFIER CTR_ABC_END_DIAG_RLY_MAIN ECU_ADDRESS 0x7f9c02 FORMAT "%3.0" /end MEASUREMENT
/begin MEASUREMENT fmy_stat_rly_main.err_info_stat.reserved "" UWORD _CNV_A_R_LINEAR_____0_CM 1 0. 0. 65535. DISPLAY_IDENTIFIER FMY_STAT_RLY_MAIN_ERR_INFO_STAT_RESERVED ECU_ADDRESS 0x7f9c00 BYTE_ORDER MSB_LAST BIT_MASK 0xF800 /end MEASUREMENT
/begin MEASUREMENT fmy_stat_rly_main.err_info_stat.lv_cdn_diag_stc "Statistical flag for condition of diagnosis of the diagnosis instance RLY_MAIN" UWORD _CNV_S_2_RANGE______383_CM 1 0. 0. 1. DISPLAY_IDENTIFIER LV_CDN_DIAG_STC_RLY_MAIN ECU_ADDRESS 0x7f9c00 BYTE_ORDER MSB_LAST BIT_MASK 0x400 /end MEASUREMENT
/begin MEASUREMENT fmy_stat_rly_main.err_info_stat.lv_lock_diag "lock flag (CPU load optimisation) of the diagnosis instance RLY_MAIN" UWORD _CNV_S_2_RANGE______383_CM 1 0. 0. 1. DISPLAY_IDENTIFIER LV_LOCK_DIAG_RLY_MAIN ECU_ADDRESS 0x7f9c00 BYTE_ORDER MSB_LAST BIT_MASK 0x200 /end MEASUREMENT
/begin MEASUREMENT fmy_stat_rly_main.err_info_stat.lv_err_mem "storage in dynamic failure memory of the diagnosis instance RLY_MAIN" UWORD _CNV_S_2_RANGE______383_CM 1 0. 0. 1. DISPLAY_IDENTIFIER LV_ERR_MEM_RLY_MAIN ECU_ADDRESS 0x7f9c00 BYTE_ORDER MSB_LAST BIT_MASK 0x80 /end MEASUREMENT
/begin MEASUREMENT fmy_stat_rly_main.err_info_stat.lv_ready "readiness status of the diagnosis instance RLY_MAIN" UWORD _CNV_S_2_RANGE______383_CM 1 0. 0. 1. DISPLAY_IDENTIFIER LV_READY_RLY_MAIN ECU_ADDRESS 0x7f9c00 BYTE_ORDER MSB_LAST BIT_MASK 0x40 /end MEASUREMENT
/begin MEASUREMENT fmy_stat_rly_main.err_info_stat.lv_end_diag "end of diagnosis of the diagnosis instance RLY_MAIN" UWORD _CNV_S_2_RANGE______383_CM 1 0. 0. 1. DISPLAY_IDENTIFIER LV_END_DIAG_RLY_MAIN ECU_ADDRESS 0x7f9c00 BYTE_ORDER MSB_LAST BIT_MASK 0x20 /end MEASUREMENT
/begin MEASUREMENT fmy_stat_rly_main.err_info_stat.lv_cdn_diag "diagnosis condition of the diagnosis instance RLY_MAIN" UWORD _CNV_S_2_RANGE______383_CM 1 0. 0. 1. DISPLAY_IDENTIFIER LV_CDN_DIAG_RLY_MAIN ECU_ADDRESS 0x7f9c00 BYTE_ORDER MSB_LAST BIT_MASK 0x10 /end MEASUREMENT
/begin MEASUREMENT fmy_stat_rly_main.err_info_stat.err_sym "symptoms of the diagnosis instance RLY_MAIN" UWORD _CNV_S_6_CONV_ERRM__22_CM 1 0. 0. 15. DISPLAY_IDENTIFIER ERR_SYM_RLY_MAIN ECU_ADDRESS 0x7f9c00 BYTE_ORDER MSB_LAST BIT_MASK 0xF /end MEASUREMENT
/begin MEASUREMENT lv_err_rly_power "Error flag of diagnosis instance RLY_POWER" UBYTE _CNV_S_2_RANGE______23_CM 1 0. 0. 1. DISPLAY_IDENTIFIER LV_ERR_RLY_POWER ECU_ADDRESS 0x7fb931 /end MEASUREMENT
/begin MEASUREMENT fmy_stat_rly_power.ctr_abc "anti bounce counter for diagnosis instance RLY_POWER" UBYTE _CNV_A_R_LINEAR_____1_CM 1 0. 0. 255. DISPLAY_IDENTIFIER CTR_ABC_RLY_POWER ECU_ADDRESS 0x7f9c07 FORMAT "%3.0" /end MEASUREMENT
/begin MEASUREMENT fmy_stat_rly_power.ctr_end_diag "counter for end of diagnosis for diagnosis instance RLY_POWER" UBYTE _CNV_A_R_LINEAR_____1_CM 1 0. 0. 255. DISPLAY_IDENTIFIER CTR_ABC_END_DIAG_RLY_POWER ECU_ADDRESS 0x7f9c06 FORMAT "%3.0" /end MEASUREMENT
/begin MEASUREMENT fmy_stat_rly_power.err_info_stat.reserved "" UWORD _CNV_A_R_LINEAR_____0_CM 1 0. 0. 65535. DISPLAY_IDENTIFIER FMY_STAT_RLY_POWER_ERR_INFO_STAT_RESERVED ECU_ADDRESS 0x7f9c04 BYTE_ORDER MSB_LAST BIT_MASK 0xF800 /end MEASUREMENT
/begin MEASUREMENT fmy_stat_rly_power.err_info_stat.lv_cdn_diag_stc "Statistical flag for condition of diagnosis of the diagnosis instance RLY_POWER" UWORD _CNV_S_2_RANGE______383_CM 1 0. 0. 1. DISPLAY_IDENTIFIER LV_CDN_DIAG_STC_RLY_POWER ECU_ADDRESS 0x7f9c04 BYTE_ORDER MSB_LAST BIT_MASK 0x400 /end MEASUREMENT
/begin MEASUREMENT fmy_stat_rly_power.err_info_stat.lv_lock_diag "lock flag (CPU load optimisation) of the diagnosis instance RLY_POWER" UWORD _CNV_S_2_RANGE______383_CM 1 0. 0. 1. DISPLAY_IDENTIFIER LV_LOCK_DIAG_RLY_POWER ECU_ADDRESS 0x7f9c04 BYTE_ORDER MSB_LAST BIT_MASK 0x200 /end MEASUREMENT
/begin MEASUREMENT fmy_stat_rly_power.err_info_stat.lv_err_mem "storage in dynamic failure memory of the diagnosis instance RLY_POWER" UWORD _CNV_S_2_RANGE______383_CM 1 0. 0. 1. DISPLAY_IDENTIFIER LV_ERR_MEM_RLY_POWER ECU_ADDRESS 0x7f9c04 BYTE_ORDER MSB_LAST BIT_MASK 0x80 /end MEASUREMENT
/begin MEASUREMENT fmy_stat_rly_power.err_info_stat.lv_ready "readiness status of the diagnosis instance RLY_POWER" UWORD _CNV_S_2_RANGE______383_CM 1 0. 0. 1. DISPLAY_IDENTIFIER LV_READY_RLY_POWER ECU_ADDRESS 0x7f9c04 BYTE_ORDER MSB_LAST BIT_MASK 0x40 /end MEASUREMENT
/begin MEASUREMENT fmy_stat_rly_power.err_info_stat.lv_end_diag "end of diagnosis of the diagnosis instance RLY_POWER" UWORD _CNV_S_2_RANGE______383_CM 1 0. 0. 1. DISPLAY_IDENTIFIER LV_END_DIAG_RLY_POWER ECU_ADDRESS 0x7f9c04 BYTE_ORDER MSB_LAST BIT_MASK 0x20 /end MEASUREMENT
/begin MEASUREMENT fmy_stat_rly_power.err_info_stat.lv_cdn_diag "diagnosis condition of the diagnosis instance RLY_POWER" UWORD _CNV_S_2_RANGE______383_CM 1 0. 0. 1. DISPLAY_IDENTIFIER LV_CDN_DIAG_RLY_POWER ECU_ADDRESS 0x7f9c04 BYTE_ORDER MSB_LAST BIT_MASK 0x10 /end MEASUREMENT
/begin MEASUREMENT fmy_stat_rly_power.err_info_stat.err_sym "symptoms of the diagnosis instance RLY_POWER" UWORD _CNV_S_6_CONV_ERRM__22_CM 1 0. 0. 15. DISPLAY_IDENTIFIER ERR_SYM_RLY_POWER ECU_ADDRESS 0x7f9c04 BYTE_ORDER MSB_LAST BIT_MASK 0xF /end MEASUREMENT
/begin MEASUREMENT fmy_stat_vb.ctr_abc "anti bounce counter for diagnosis instance VB" UBYTE _CNV_A_R_LINEAR_____1_CM 1 0. 0. 255. DISPLAY_IDENTIFIER CTR_ABC_VB ECU_ADDRESS 0x7f9c13 FORMAT "%3.0" /end MEASUREMENT
/begin MEASUREMENT fmy_stat_vb.ctr_end_diag "counter for end of diagnosis for diagnosis instance VB" UBYTE _CNV_A_R_LINEAR_____1_CM 1 0. 0. 255. DISPLAY_IDENTIFIER CTR_ABC_END_DIAG_VB ECU_ADDRESS 0x7f9c12 FORMAT "%3.0" /end MEASUREMENT
/begin MEASUREMENT fmy_stat_vb.err_info_stat.reserved "" UWORD _CNV_A_R_LINEAR_____0_CM 1 0. 0. 65535. DISPLAY_IDENTIFIER FMY_STAT_VB_ERR_INFO_STAT_RESERVED ECU_ADDRESS 0x7f9c10 BYTE_ORDER MSB_LAST BIT_MASK 0xF800 /end MEASUREMENT
/begin MEASUREMENT fmy_stat_vb.err_info_stat.lv_cdn_diag_stc "Statistical flag for condition of diagnosis of the diagnosis instance VB" UWORD _CNV_S_2_RANGE______383_CM 1 0. 0. 1. DISPLAY_IDENTIFIER LV_CDN_DIAG_STC_VB ECU_ADDRESS 0x7f9c10 BYTE_ORDER MSB_LAST BIT_MASK 0x400 /end MEASUREMENT
/begin MEASUREMENT fmy_stat_vb.err_info_stat.lv_lock_diag "lock flag (CPU load optimisation) of the diagnosis instance VB" UWORD _CNV_S_2_RANGE______383_CM 1 0. 0. 1. DISPLAY_IDENTIFIER LV_LOCK_DIAG_VB ECU_ADDRESS 0x7f9c10 BYTE_ORDER MSB_LAST BIT_MASK 0x200 /end MEASUREMENT
/begin MEASUREMENT fmy_stat_vb.err_info_stat.lv_err_mem "storage in dynamic failure memory of the diagnosis instance VB" UWORD _CNV_S_2_RANGE______383_CM 1 0. 0. 1. DISPLAY_IDENTIFIER LV_ERR_MEM_VB ECU_ADDRESS 0x7f9c10 BYTE_ORDER MSB_LAST BIT_MASK 0x80 /end MEASUREMENT
/begin MEASUREMENT fmy_stat_vb.err_info_stat.lv_ready "readiness status of the diagnosis instance VB" UWORD _CNV_S_2_RANGE______383_CM 1 0. 0. 1. DISPLAY_IDENTIFIER LV_READY_VB ECU_ADDRESS 0x7f9c10 BYTE_ORDER MSB_LAST BIT_MASK 0x40 /end MEASUREMENT
/begin MEASUREMENT fmy_stat_vb.err_info_stat.lv_end_diag "end of diagnosis of the diagnosis instance VB" UWORD _CNV_S_2_RANGE______383_CM 1 0. 0. 1. DISPLAY_IDENTIFIER LV_END_DIAG_VB ECU_ADDRESS 0x7f9c10 BYTE_ORDER MSB_LAST BIT_MASK 0x20 /end MEASUREMENT
/begin MEASUREMENT fmy_stat_vb.err_info_stat.lv_cdn_diag "diagnosis condition of the diagnosis instance VB" UWORD _CNV_S_2_RANGE______383_CM 1 0. 0. 1. DISPLAY_IDENTIFIER LV_CDN_DIAG_VB ECU_ADDRESS 0x7f9c10 BYTE_ORDER MSB_LAST BIT_MASK 0x10 /end MEASUREMENT
/begin MEASUREMENT fmy_stat_vb.err_info_stat.err_sym "symptoms of the diagnosis instance VB" UWORD _CNV_S_6_CONV_ERRM__22_CM 1 0. 0. 15. DISPLAY_IDENTIFIER ERR_SYM_VB ECU_ADDRESS 0x7f9c10 BYTE_ORDER MSB_LAST BIT_MASK 0xF /end MEASUREMENT
/begin MEASUREMENT lv_err_vcv_1 "Error flag of diagnosis instance VCV_1" UBYTE _CNV_S_2_RANGE______23_CM 1 0. 0. 1. DISPLAY_IDENTIFIER LV_ERR_VCV_1 ECU_ADDRESS 0x7fb935 /end MEASUREMENT
/begin MEASUREMENT fmy_stat_vcv_1.ctr_abc "anti bounce counter for diagnosis instance VCV_1" UBYTE _CNV_A_R_LINEAR_____1_CM 1 0. 0. 255. DISPLAY_IDENTIFIER CTR_ABC_VCV_1 ECU_ADDRESS 0x7f9c17 FORMAT "%3.0" /end MEASUREMENT
/begin MEASUREMENT fmy_stat_vcv_1.ctr_end_diag "counter for end of diagnosis for diagnosis instance VCV_1" UBYTE _CNV_A_R_LINEAR_____1_CM 1 0. 0. 255. DISPLAY_IDENTIFIER CTR_ABC_END_DIAG_VCV_1 ECU_ADDRESS 0x7f9c16 FORMAT "%3.0" /end MEASUREMENT
/begin MEASUREMENT fmy_stat_vcv_1.err_info_stat.reserved "" UWORD _CNV_A_R_LINEAR_____0_CM 1 0. 0. 65535. DISPLAY_IDENTIFIER FMY_STAT_VCV_1_ERR_INFO_STAT_RESERVED ECU_ADDRESS 0x7f9c14 BYTE_ORDER MSB_LAST BIT_MASK 0xF800 /end MEASUREMENT
/begin MEASUREMENT fmy_stat_vcv_1.err_info_stat.lv_cdn_diag_stc "Statistical flag for condition of diagnosis of the diagnosis instance VCV_1" UWORD _CNV_S_2_RANGE______383_CM 1 0. 0. 1. DISPLAY_IDENTIFIER LV_CDN_DIAG_STC_VCV_1 ECU_ADDRESS 0x7f9c14 BYTE_ORDER MSB_LAST BIT_MASK 0x400 /end MEASUREMENT
/begin MEASUREMENT fmy_stat_vcv_1.err_info_stat.lv_lock_diag "lock flag (CPU load optimisation) of the diagnosis instance VCV_1" UWORD _CNV_S_2_RANGE______383_CM 1 0. 0. 1. DISPLAY_IDENTIFIER LV_LOCK_DIAG_VCV_1 ECU_ADDRESS 0x7f9c14 BYTE_ORDER MSB_LAST BIT_MASK 0x200 /end MEASUREMENT
/begin MEASUREMENT fmy_stat_vcv_1.err_info_stat.lv_err_mem "storage in dynamic failure memory of the diagnosis instance VCV_1" UWORD _CNV_S_2_RANGE______383_CM 1 0. 0. 1. DISPLAY_IDENTIFIER LV_ERR_MEM_VCV_1 ECU_ADDRESS 0x7f9c14 BYTE_ORDER MSB_LAST BIT_MASK 0x80 /end MEASUREMENT
/begin MEASUREMENT fmy_stat_vcv_1.err_info_stat.lv_ready "readiness status of the diagnosis instance VCV_1" UWORD _CNV_S_2_RANGE______383_CM 1 0. 0. 1. DISPLAY_IDENTIFIER LV_READY_VCV_1 ECU_ADDRESS 0x7f9c14 BYTE_ORDER MSB_LAST BIT_MASK 0x40 /end MEASUREMENT
/begin MEASUREMENT fmy_stat_vcv_1.err_info_stat.lv_end_diag "end of diagnosis of the diagnosis instance VCV_1" UWORD _CNV_S_2_RANGE______383_CM 1 0. 0. 1. DISPLAY_IDENTIFIER LV_END_DIAG_VCV_1 ECU_ADDRESS 0x7f9c14 BYTE_ORDER MSB_LAST BIT_MASK 0x20 /end MEASUREMENT
/begin MEASUREMENT fmy_stat_vcv_1.err_info_stat.lv_cdn_diag "diagnosis condition of the diagnosis instance VCV_1" UWORD _CNV_S_2_RANGE______383_CM 1 0. 0. 1. DISPLAY_IDENTIFIER LV_CDN_DIAG_VCV_1 ECU_ADDRESS 0x7f9c14 BYTE_ORDER MSB_LAST BIT_MASK 0x10 /end MEASUREMENT
/begin MEASUREMENT fmy_stat_vcv_1.err_info_stat.err_sym "symptoms of the diagnosis instance VCV_1" UWORD _CNV_S_6_CONV_ERRM__22_CM 1 0. 0. 15. DISPLAY_IDENTIFIER ERR_SYM_VCV_1 ECU_ADDRESS 0x7f9c14 BYTE_ORDER MSB_LAST BIT_MASK 0xF /end MEASUREMENT
/begin MEASUREMENT lv_err_vcv_3 "Error flag of diagnosis instance VCV_3" UBYTE _CNV_S_2_RANGE______23_CM 1 0. 0. 1. DISPLAY_IDENTIFIER LV_ERR_VCV_3 ECU_ADDRESS 0x7fb937 /end MEASUREMENT
/begin MEASUREMENT fmy_stat_vcv_3.ctr_abc "anti bounce counter for diagnosis instance VCV_3" UBYTE _CNV_A_R_LINEAR_____1_CM 1 0. 0. 255. DISPLAY_IDENTIFIER CTR_ABC_VCV_3 ECU_ADDRESS 0x7f9c1f FORMAT "%3.0" /end MEASUREMENT
/begin MEASUREMENT fmy_stat_vcv_3.ctr_end_diag "counter for end of diagnosis for diagnosis instance VCV_3" UBYTE _CNV_A_R_LINEAR_____1_CM 1 0. 0. 255. DISPLAY_IDENTIFIER CTR_ABC_END_DIAG_VCV_3 ECU_ADDRESS 0x7f9c1e FORMAT "%3.0" /end MEASUREMENT
/begin MEASUREMENT fmy_stat_vcv_3.err_info_stat.reserved "" UWORD _CNV_A_R_LINEAR_____0_CM 1 0. 0. 65535. DISPLAY_IDENTIFIER FMY_STAT_VCV_3_ERR_INFO_STAT_RESERVED ECU_ADDRESS 0x7f9c1c BYTE_ORDER MSB_LAST BIT_MASK 0xF800 /end MEASUREMENT
/begin MEASUREMENT fmy_stat_vcv_3.err_info_stat.lv_cdn_diag_stc "Statistical flag for condition of diagnosis of the diagnosis instance VCV_3" UWORD _CNV_S_2_RANGE______383_CM 1 0. 0. 1. DISPLAY_IDENTIFIER LV_CDN_DIAG_STC_VCV_3 ECU_ADDRESS 0x7f9c1c BYTE_ORDER MSB_LAST BIT_MASK 0x400 /end MEASUREMENT
/begin MEASUREMENT fmy_stat_vcv_3.err_info_stat.lv_lock_diag "lock flag (CPU load optimisation) of the diagnosis instance VCV_3" UWORD _CNV_S_2_RANGE______383_CM 1 0. 0. 1. DISPLAY_IDENTIFIER LV_LOCK_DIAG_VCV_3 ECU_ADDRESS 0x7f9c1c BYTE_ORDER MSB_LAST BIT_MASK 0x200 /end MEASUREMENT
/begin MEASUREMENT fmy_stat_vcv_3.err_info_stat.lv_err_mem "storage in dynamic failure memory of the diagnosis instance VCV_3" UWORD _CNV_S_2_RANGE______383_CM 1 0. 0. 1. DISPLAY_IDENTIFIER LV_ERR_MEM_VCV_3 ECU_ADDRESS 0x7f9c1c BYTE_ORDER MSB_LAST BIT_MASK 0x80 /end MEASUREMENT
/begin MEASUREMENT fmy_stat_vcv_3.err_info_stat.lv_ready "readiness status of the diagnosis instance VCV_3" UWORD _CNV_S_2_RANGE______383_CM 1 0. 0. 1. DISPLAY_IDENTIFIER LV_READY_VCV_3 ECU_ADDRESS 0x7f9c1c BYTE_ORDER MSB_LAST BIT_MASK 0x40 /end MEASUREMENT
/begin MEASUREMENT fmy_stat_vcv_3.err_info_stat.lv_end_diag "end of diagnosis of the diagnosis instance VCV_3" UWORD _CNV_S_2_RANGE______383_CM 1 0. 0. 1. DISPLAY_IDENTIFIER LV_END_DIAG_VCV_3 ECU_ADDRESS 0x7f9c1c BYTE_ORDER MSB_LAST BIT_MASK 0x20 /end MEASUREMENT
/begin MEASUREMENT fmy_stat_vcv_3.err_info_stat.lv_cdn_diag "diagnosis condition of the diagnosis instance VCV_3" UWORD _CNV_S_2_RANGE______383_CM 1 0. 0. 1. DISPLAY_IDENTIFIER LV_CDN_DIAG_VCV_3 ECU_ADDRESS 0x7f9c1c BYTE_ORDER MSB_LAST BIT_MASK 0x10 /end MEASUREMENT
/begin MEASUREMENT fmy_stat_vcv_3.err_info_stat.err_sym "symptoms of the diagnosis instance VCV_3" UWORD _CNV_S_6_CONV_ERRM__22_CM 1 0. 0. 15. DISPLAY_IDENTIFIER ERR_SYM_VCV_3 ECU_ADDRESS 0x7f9c1c BYTE_ORDER MSB_LAST BIT_MASK 0xF /end MEASUREMENT
/begin COMPU_METHOD _CNV_A_R_LINEAR_____0_CM "" RAT_FUNC "%6.3" "[-]" COEFFS 0 1. 0. 0 0 1 /end COMPU_METHOD
/begin COMPU_METHOD _CNV_A_R_LINEAR_____1_CM "" RAT_FUNC "%6.3" "-" COEFFS 0 1. 0. 0 0 1 /end COMPU_METHOD
/begin COMPU_METHOD _CNV_S_6_CONV_ERRM__22_CM "" TAB_VERB "%6.3" "[-]" COMPU_TAB_REF _CNV_S_6_CONV_ERRM__22 /end COMPU_METHOD
/begin COMPU_VTAB _CNV_S_6_CONV_ERRM__22 "" TAB_VERB 6 0 "NO_SYM" 1 "SYM_0" 2 "SYM_1" 4 "SYM_2" 8 "SYM_3" 15 "BENCH_MODE" /end COMPU_VTAB
/begin COMPU_METHOD _CNV_S_2_RANGE______23_CM "" TAB_VERB "%6.3" "[-]" COMPU_TAB_REF _CNV_S_2_RANGE______23 /end COMPU_METHOD
/begin COMPU_VTAB _CNV_S_2_RANGE______23 "" TAB_VERB 2 0 "passive" 1 "active" /end COMPU_VTAB
/begin COMPU_METHOD _CNV_S_2_RANGE______383_CM "" TAB_VERB "%6.3" "-" COMPU_TAB_REF _CNV_S_2_RANGE______383 /end COMPU_METHOD
/begin COMPU_VTAB _CNV_S_2_RANGE______383 "" TAB_VERB 2 0 "passive" 1 "active" /end COMPU_VTAB
/begin FUNCTION ERRM_AAC_DIAG "Error Management data for diagnosis AAC_DIAG"
 /begin OUT_MEASUREMENT lv_err_acp_mes_rng fmy_stat_acp_mes_rng.ctr_abc fmy_stat_acp_mes_rng.ctr_end_diag fmy_stat_acp_mes_rng.err_info_stat.reserved fmy_stat_acp_mes_rng.err_info_stat.lv_cdn_diag_stc fmy_stat_acp_mes_rng.err_info_stat.lv_lock_diag fmy_stat_acp_mes_rng.err_info_stat.lv_err_mem fmy_stat_acp_mes_rng.err_info_stat.lv_ready fmy_stat_acp_mes_rng.err_info_stat.lv_end_diag fmy_stat_acp_mes_rng.err_info_stat.lv_cdn_diag fmy_stat_acp_mes_rng.err_info_stat.err_sym lv_err_acp_mes_grd fmy_stat_acp_mes_grd.ctr_abc fmy_stat_acp_mes_grd.ctr_end_diag fmy_stat_acp_mes_grd.err_info_stat.reserved fmy_stat_acp_mes_grd.err_info_stat.lv_cdn_diag_stc fmy_stat_acp_mes_grd.err_info_stat.lv_lock_diag fmy_stat_acp_mes_grd.err_info_stat.lv_err_mem fmy_stat_acp_mes_grd.err_info_stat.lv_ready fmy_stat_acp_mes_grd.err_info_stat.lv_end_diag fmy_stat_acp_mes_grd.err_info_stat.lv_cdn_diag fmy_stat_acp_mes_grd.err_info_stat.err_sym /end OUT_MEASUREMENT
/end FUNCTION
/begin FUNCTION ERRM_ATBADIAG "Error Management data for diagnosis ATBADIAG"
 /begin OUT_MEASUREMENT lv_err_v_tba_rng fmy_stat_v_tba_rng.ctr_abc fmy_stat_v_tba_rng.ctr_end_diag fmy_stat_v_tba_rng.err_info_stat.reserved fmy_stat_v_tba_rng.err_info_stat.lv_cdn_diag_stc fmy_stat_v_tba_rng.err_info_stat.lv_lock_diag fmy_stat_v_tba_rng.err_info_stat.lv_err_mem fmy_stat_v_tba_rng.err_info_stat.lv_ready fmy_stat_v_tba_rng.err_info_stat.lv_end_diag fmy_stat_v_tba_rng.err_info_stat.lv_cdn_diag fmy_stat_v_tba_rng.err_info_stat.err_sym lv_err_tba_mes_grd fmy_stat_tba_mes_grd.ctr_abc fmy_stat_tba_mes_grd.ctr_end_diag fmy_stat_tba_mes_grd.err_info_stat.reserved fmy_stat_tba_mes_grd.err_info_stat.lv_cdn_diag_stc fmy_stat_tba_mes_grd.err_info_stat.lv_lock_diag fmy_stat_tba_mes_grd.err_info_stat.lv_err_mem fmy_stat_tba_mes_grd.err_info_stat.lv_ready fmy_stat_tba_mes_grd.err_info_stat.lv_end_diag fmy_stat_tba_mes_grd.err_info_stat.lv_cdn_diag fmy_stat_tba_mes_grd.err_info_stat.err_sym /end OUT_MEASUREMENT
/end FUNCTION
/begin FUNCTION ERRM_AALTDIAG "Error Management data for diagnosis AALTDIAG"
 /begin OUT_MEASUREMENT lv_err_ducy_alter_pwm_rng fmy_stat_ducy_alter_pwm_rng.ctr_abc fmy_stat_ducy_alter_pwm_rng.ctr_end_diag fmy_stat_ducy_alter_pwm_rng.err_info_stat.reserved fmy_stat_ducy_alter_pwm_rng.err_info_stat.lv_cdn_diag_stc fmy_stat_ducy_alter_pwm_rng.err_info_stat.lv_lock_diag fmy_stat_ducy_alter_pwm_rng.err_info_stat.lv_err_mem fmy_stat_ducy_alter_pwm_rng.err_info_stat.lv_ready fmy_stat_ducy_alter_pwm_rng.err_info_stat.lv_end_diag fmy_stat_ducy_alter_pwm_rng.err_info_stat.lv_cdn_diag fmy_stat_ducy_alter_pwm_rng.err_info_stat.err_sym lv_err_ducy_alter_pwm_grd fmy_stat_ducy_alter_pwm_grd.ctr_abc fmy_stat_ducy_alter_pwm_grd.ctr_end_diag fmy_stat_ducy_alter_pwm_grd.err_info_stat.reserved fmy_stat_ducy_alter_pwm_grd.err_info_stat.lv_cdn_diag_stc fmy_stat_ducy_alter_pwm_grd.err_info_stat.lv_lock_diag fmy_stat_ducy_alter_pwm_grd.err_info_stat.lv_err_mem fmy_stat_ducy_alter_pwm_grd.err_info_stat.lv_ready fmy_stat_ducy_alter_pwm_grd.err_info_stat.lv_end_diag fmy_stat_ducy_alter_pwm_grd.err_info_stat.lv_cdn_diag fmy_stat_ducy_alter_pwm_grd.err_info_stat.err_sym /end OUT_MEASUREMENT
/end FUNCTION
/begin FUNCTION ERRM_AVEGRVDG "Error Management data for diagnosis AVEGRVDG"
 /begin OUT_MEASUREMENT lv_err_v_egrv_0_rng fmy_stat_v_egrv_0_rng.ctr_abc fmy_stat_v_egrv_0_rng.ctr_end_diag fmy_stat_v_egrv_0_rng.err_info_stat.reserved fmy_stat_v_egrv_0_rng.err_info_stat.lv_cdn_diag_stc fmy_stat_v_egrv_0_rng.err_info_stat.lv_lock_diag fmy_stat_v_egrv_0_rng.err_info_stat.lv_err_mem fmy_stat_v_egrv_0_rng.err_info_stat.lv_ready fmy_stat_v_egrv_0_rng.err_info_stat.lv_end_diag fmy_stat_v_egrv_0_rng.err_info_stat.lv_cdn_diag fmy_stat_v_egrv_0_rng.err_info_stat.err_sym lv_err_v_egrv_1_rng fmy_stat_v_egrv_1_rng.ctr_abc fmy_stat_v_egrv_1_rng.ctr_end_diag fmy_stat_v_egrv_1_rng.err_info_stat.reserved fmy_stat_v_egrv_1_rng.err_info_stat.lv_cdn_diag_stc fmy_stat_v_egrv_1_rng.err_info_stat.lv_lock_diag fmy_stat_v_egrv_1_rng.err_info_stat.lv_err_mem fmy_stat_v_egrv_1_rng.err_info_stat.lv_ready fmy_stat_v_egrv_1_rng.err_info_stat.lv_end_diag fmy_stat_v_egrv_1_rng.err_info_stat.lv_cdn_diag fmy_stat_v_egrv_1_rng.err_info_stat.err_sym lv_err_v_egrv_0_grd fmy_stat_v_egrv_0_grd.ctr_abc fmy_stat_v_egrv_0_grd.ctr_end_diag fmy_stat_v_egrv_0_grd.err_info_stat.reserved fmy_stat_v_egrv_0_grd.err_info_stat.lv_cdn_diag_stc fmy_stat_v_egrv_0_grd.err_info_stat.lv_lock_diag fmy_stat_v_egrv_0_grd.err_info_stat.lv_err_mem fmy_stat_v_egrv_0_grd.err_info_stat.lv_ready fmy_stat_v_egrv_0_grd.err_info_stat.lv_end_diag fmy_stat_v_egrv_0_grd.err_info_stat.lv_cdn_diag fmy_stat_v_egrv_0_grd.err_info_stat.err_sym lv_err_v_egrv_1_grd fmy_stat_v_egrv_1_grd.ctr_abc fmy_stat_v_egrv_1_grd.ctr_end_diag fmy_stat_v_egrv_1_grd.err_info_stat.reserved fmy_stat_v_egrv_1_grd.err_info_stat.lv_cdn_diag_stc fmy_stat_v_egrv_1_grd.err_info_stat.lv_lock_diag fmy_stat_v_egrv_1_grd.err_info_stat.lv_err_mem fmy_stat_v_egrv_1_grd.err_info_stat.lv_ready fmy_stat_v_egrv_1_grd.err_info_stat.lv_end_diag fmy_stat_v_egrv_1_grd.err_info_stat.lv_cdn_diag fmy_stat_v_egrv_1_grd.err_info_stat.err_sym /end OUT_MEASUREMENT
/end FUNCTION
/begin FUNCTION ERRM_ACAPDIAG "Error Management data for diagnosis ACAPDIAG"
 /begin OUT_MEASUREMENT lv_err_ges_maf_0_max fmy_stat_ges_maf_0_max.ctr_abc fmy_stat_ges_maf_0_max.ctr_end_diag fmy_stat_ges_maf_0_max.err_info_stat.reserved fmy_stat_ges_maf_0_max.err_info_stat.lv_cdn_diag_stc fmy_stat_ges_maf_0_max.err_info_stat.lv_lock_diag fmy_stat_ges_maf_0_max.err_info_stat.lv_err_mem fmy_stat_ges_maf_0_max.err_info_stat.lv_ready fmy_stat_ges_maf_0_max.err_info_stat.lv_end_diag fmy_stat_ges_maf_0_max.err_info_stat.lv_cdn_diag fmy_stat_ges_maf_0_max.err_info_stat.err_sym /end OUT_MEASUREMENT
/end FUNCTION
/begin FUNCTION ERRM_ATCOPLAD "Error Management data for diagnosis ATCOPLAD"
 /begin OUT_MEASUREMENT lv_err_tco_1_2_plaus fmy_stat_tco_1_2_plaus.ctr_abc fmy_stat_tco_1_2_plaus.ctr_end_diag fmy_stat_tco_1_2_plaus.err_info_stat.reserved fmy_stat_tco_1_2_plaus.err_info_stat.lv_cdn_diag_stc fmy_stat_tco_1_2_plaus.err_info_stat.lv_lock_diag fmy_stat_tco_1_2_plaus.err_info_stat.lv_err_mem fmy_stat_tco_1_2_plaus.err_info_stat.lv_ready fmy_stat_tco_1_2_plaus.err_info_stat.lv_end_diag fmy_stat_tco_1_2_plaus.err_info_stat.lv_cdn_diag fmy_stat_tco_1_2_plaus.err_info_stat.err_sym /end OUT_MEASUREMENT
/end FUNCTION
/begin FUNCTION ERRM_AEFPDIAG "Error Management data for diagnosis AEFPDIAG"
 /begin OUT_MEASUREMENT lv_err_efp_rly_dps fmy_stat_efp_rly_dps.ctr_abc fmy_stat_efp_rly_dps.ctr_end_diag fmy_stat_efp_rly_dps.err_info_stat.reserved fmy_stat_efp_rly_dps.err_info_stat.lv_cdn_diag_stc fmy_stat_efp_rly_dps.err_info_stat.lv_lock_diag fmy_stat_efp_rly_dps.err_info_stat.lv_err_mem fmy_stat_efp_rly_dps.err_info_stat.lv_ready fmy_stat_efp_rly_dps.err_info_stat.lv_end_diag fmy_stat_efp_rly_dps.err_info_stat.lv_cdn_diag fmy_stat_efp_rly_dps.err_info_stat.err_sym lv_err_efp_rly_plaus_1 fmy_stat_efp_rly_plaus_1.ctr_abc fmy_stat_efp_rly_plaus_1.ctr_end_diag fmy_stat_efp_rly_plaus_1.err_info_stat.reserved fmy_stat_efp_rly_plaus_1.err_info_stat.lv_cdn_diag_stc fmy_stat_efp_rly_plaus_1.err_info_stat.lv_lock_diag fmy_stat_efp_rly_plaus_1.err_info_stat.lv_err_mem fmy_stat_efp_rly_plaus_1.err_info_stat.lv_ready fmy_stat_efp_rly_plaus_1.err_info_stat.lv_end_diag fmy_stat_efp_rly_plaus_1.err_info_stat.lv_cdn_diag fmy_stat_efp_rly_plaus_1.err_info_stat.err_sym lv_err_efp_rly_plaus_2 fmy_stat_efp_rly_plaus_2.ctr_abc fmy_stat_efp_rly_plaus_2.ctr_end_diag fmy_stat_efp_rly_plaus_2.err_info_stat.reserved fmy_stat_efp_rly_plaus_2.err_info_stat.lv_cdn_diag_stc fmy_stat_efp_rly_plaus_2.err_info_stat.lv_lock_diag fmy_stat_efp_rly_plaus_2.err_info_stat.lv_err_mem fmy_stat_efp_rly_plaus_2.err_info_stat.lv_ready fmy_stat_efp_rly_plaus_2.err_info_stat.lv_end_diag fmy_stat_efp_rly_plaus_2.err_info_stat.lv_cdn_diag fmy_stat_efp_rly_plaus_2.err_info_stat.err_sym /end OUT_MEASUREMENT
/end FUNCTION
/begin FUNCTION ERRM_ASPIDIAG "Error Management data for diagnosis ASPIDIAG"
 /begin OUT_MEASUREMENT lv_err_spi_mps fmy_stat_spi_mps.ctr_abc fmy_stat_spi_mps.ctr_end_diag fmy_stat_spi_mps.err_info_stat.reserved fmy_stat_spi_mps.err_info_stat.lv_cdn_diag_stc fmy_stat_spi_mps.err_info_stat.lv_lock_diag fmy_stat_spi_mps.err_info_stat.lv_err_mem fmy_stat_spi_mps.err_info_stat.lv_ready fmy_stat_spi_mps.err_info_stat.lv_end_diag fmy_stat_spi_mps.err_info_stat.lv_cdn_diag fmy_stat_spi_mps.err_info_stat.err_sym lv_err_spi_oct fmy_stat_spi_oct.ctr_abc fmy_stat_spi_oct.ctr_end_diag fmy_stat_spi_oct.err_info_stat.reserved fmy_stat_spi_oct.err_info_stat.lv_cdn_diag_stc fmy_stat_spi_oct.err_info_stat.lv_lock_diag fmy_stat_spi_oct.err_info_stat.lv_err_mem fmy_stat_spi_oct.err_info_stat.lv_ready fmy_stat_spi_oct.err_info_stat.lv_end_diag fmy_stat_spi_oct.err_info_stat.lv_cdn_diag fmy_stat_spi_oct.err_info_stat.err_sym lv_err_spi_qps fmy_stat_spi_qps.ctr_abc fmy_stat_spi_qps.ctr_end_diag fmy_stat_spi_qps.err_info_stat.reserved fmy_stat_spi_qps.err_info_stat.lv_cdn_diag_stc fmy_stat_spi_qps.err_info_stat.lv_lock_diag fmy_stat_spi_qps.err_info_stat.lv_err_mem fmy_stat_spi_qps.err_info_stat.lv_ready fmy_stat_spi_qps.err_info_stat.lv_end_diag fmy_stat_spi_qps.err_info_stat.lv_cdn_diag fmy_stat_spi_qps.err_info_stat.err_sym /end OUT_MEASUREMENT
/end FUNCTION
/begin FUNCTION ERRM_AEGRBYPD "Error Management data for diagnosis AEGRBYPD"
 /begin OUT_MEASUREMENT lv_err_egr_byp_dps fmy_stat_egr_byp_dps.ctr_abc fmy_stat_egr_byp_dps.ctr_end_diag fmy_stat_egr_byp_dps.err_info_stat.reserved fmy_stat_egr_byp_dps.err_info_stat.lv_cdn_diag_stc fmy_stat_egr_byp_dps.err_info_stat.lv_lock_diag fmy_stat_egr_byp_dps.err_info_stat.lv_err_mem fmy_stat_egr_byp_dps.err_info_stat.lv_ready fmy_stat_egr_byp_dps.err_info_stat.lv_end_diag fmy_stat_egr_byp_dps.err_info_stat.lv_cdn_diag fmy_stat_egr_byp_dps.err_info_stat.err_sym /end OUT_MEASUREMENT
/end FUNCTION
/begin FUNCTION ERRM_AEGRVDHB "Error Management data for diagnosis AEGRVDHB"
 /begin OUT_MEASUREMENT lv_err_egrv_0 fmy_stat_egrv_0.ctr_abc fmy_stat_egrv_0.ctr_end_diag fmy_stat_egrv_0.err_info_stat.reserved fmy_stat_egrv_0.err_info_stat.lv_cdn_diag_stc fmy_stat_egrv_0.err_info_stat.lv_lock_diag fmy_stat_egrv_0.err_info_stat.lv_err_mem fmy_stat_egrv_0.err_info_stat.lv_ready fmy_stat_egrv_0.err_info_stat.lv_end_diag fmy_stat_egrv_0.err_info_stat.lv_cdn_diag fmy_stat_egrv_0.err_info_stat.err_sym /end OUT_MEASUREMENT
/end FUNCTION
/begin FUNCTION ERRM_AINJDIAG "Error Management data for diagnosis AINJDIAG"
 /begin OUT_MEASUREMENT lv_err_pps_ini_0 fmy_stat_pps_ini_0.ctr_abc fmy_stat_pps_ini_0.ctr_end_diag fmy_stat_pps_ini_0.err_info_stat.reserved fmy_stat_pps_ini_0.err_info_stat.lv_cdn_diag_stc fmy_stat_pps_ini_0.err_info_stat.lv_lock_diag fmy_stat_pps_ini_0.err_info_stat.lv_err_mem fmy_stat_pps_ini_0.err_info_stat.lv_ready fmy_stat_pps_ini_0.err_info_stat.lv_end_diag fmy_stat_pps_ini_0.err_info_stat.lv_cdn_diag fmy_stat_pps_ini_0.err_info_stat.err_sym lv_err_pps_ini_tout_0 fmy_stat_pps_ini_tout_0.ctr_abc fmy_stat_pps_ini_tout_0.ctr_end_diag fmy_stat_pps_ini_tout_0.err_info_stat.reserved fmy_stat_pps_ini_tout_0.err_info_stat.lv_cdn_diag_stc fmy_stat_pps_ini_tout_0.err_info_stat.lv_lock_diag fmy_stat_pps_ini_tout_0.err_info_stat.lv_err_mem fmy_stat_pps_ini_tout_0.err_info_stat.lv_ready fmy_stat_pps_ini_tout_0.err_info_stat.lv_end_diag fmy_stat_pps_ini_tout_0.err_info_stat.lv_cdn_diag fmy_stat_pps_ini_tout_0.err_info_stat.err_sym lv_err_pps_plaus_0 fmy_stat_pps_plaus_0.ctr_abc fmy_stat_pps_plaus_0.ctr_end_diag fmy_stat_pps_plaus_0.err_info_stat.reserved fmy_stat_pps_plaus_0.err_info_stat.lv_cdn_diag_stc fmy_stat_pps_plaus_0.err_info_stat.lv_lock_diag fmy_stat_pps_plaus_0.err_info_stat.lv_err_mem fmy_stat_pps_plaus_0.err_info_stat.lv_ready fmy_stat_pps_plaus_0.err_info_stat.lv_end_diag fmy_stat_pps_plaus_0.err_info_stat.lv_cdn_diag fmy_stat_pps_plaus_0.err_info_stat.err_sym lv_err_pps_cal_0 fmy_stat_pps_cal_0.ctr_abc fmy_stat_pps_cal_0.ctr_end_diag fmy_stat_pps_cal_0.err_info_stat.reserved fmy_stat_pps_cal_0.err_info_stat.lv_cdn_diag_stc fmy_stat_pps_cal_0.err_info_stat.lv_lock_diag fmy_stat_pps_cal_0.err_info_stat.lv_err_mem fmy_stat_pps_cal_0.err_info_stat.lv_ready fmy_stat_pps_cal_0.err_info_stat.lv_end_diag fmy_stat_pps_cal_0.err_info_stat.lv_cdn_diag fmy_stat_pps_cal_0.err_info_stat.err_sym lv_err_pps_v_inj_0 fmy_stat_pps_v_inj_0.ctr_abc fmy_stat_pps_v_inj_0.ctr_end_diag fmy_stat_pps_v_inj_0.err_info_stat.reserved fmy_stat_pps_v_inj_0.err_info_stat.lv_cdn_diag_stc fmy_stat_pps_v_inj_0.err_info_stat.lv_lock_diag fmy_stat_pps_v_inj_0.err_info_stat.lv_err_mem fmy_stat_pps_v_inj_0.err_info_stat.lv_ready fmy_stat_pps_v_inj_0.err_info_stat.lv_end_diag fmy_stat_pps_v_inj_0.err_info_stat.lv_cdn_diag fmy_stat_pps_v_inj_0.err_info_stat.err_sym lv_err_pps_wdt_0 fmy_stat_pps_wdt_0.ctr_abc fmy_stat_pps_wdt_0.ctr_end_diag fmy_stat_pps_wdt_0.err_info_stat.reserved fmy_stat_pps_wdt_0.err_info_stat.lv_cdn_diag_stc fmy_stat_pps_wdt_0.err_info_stat.lv_lock_diag fmy_stat_pps_wdt_0.err_info_stat.lv_err_mem fmy_stat_pps_wdt_0.err_info_stat.lv_ready fmy_stat_pps_wdt_0.err_info_stat.lv_end_diag fmy_stat_pps_wdt_0.err_info_stat.lv_cdn_diag fmy_stat_pps_wdt_0.err_info_stat.err_sym lv_err_pps_fsm_0 fmy_stat_pps_fsm_0.ctr_abc fmy_stat_pps_fsm_0.ctr_end_diag fmy_stat_pps_fsm_0.err_info_stat.reserved fmy_stat_pps_fsm_0.err_info_stat.lv_cdn_diag_stc fmy_stat_pps_fsm_0.err_info_stat.lv_lock_diag fmy_stat_pps_fsm_0.err_info_stat.lv_err_mem fmy_stat_pps_fsm_0.err_info_stat.lv_ready fmy_stat_pps_fsm_0.err_info_stat.lv_end_diag fmy_stat_pps_fsm_0.err_info_stat.lv_cdn_diag fmy_stat_pps_fsm_0.err_info_stat.err_sym lv_err_pps_oc_0 fmy_stat_pps_oc_0.ctr_abc fmy_stat_pps_oc_0.ctr_end_diag fmy_stat_pps_oc_0.err_info_stat.reserved fmy_stat_pps_oc_0.err_info_stat.lv_cdn_diag_stc fmy_stat_pps_oc_0.err_info_stat.lv_lock_diag fmy_stat_pps_oc_0.err_info_stat.lv_err_mem fmy_stat_pps_oc_0.err_info_stat.lv_ready fmy_stat_pps_oc_0.err_info_stat.lv_end_diag fmy_stat_pps_oc_0.err_info_stat.lv_cdn_diag fmy_stat_pps_oc_0.err_info_stat.err_sym lv_err_pps_oc_1 fmy_stat_pps_oc_1.ctr_abc fmy_stat_pps_oc_1.ctr_end_diag fmy_stat_pps_oc_1.err_info_stat.reserved fmy_stat_pps_oc_1.err_info_stat.lv_cdn_diag_stc fmy_stat_pps_oc_1.err_info_stat.lv_lock_diag fmy_stat_pps_oc_1.err_info_stat.lv_err_mem fmy_stat_pps_oc_1.err_info_stat.lv_ready fmy_stat_pps_oc_1.err_info_stat.lv_end_diag fmy_stat_pps_oc_1.err_info_stat.lv_cdn_diag fmy_stat_pps_oc_1.err_info_stat.err_sym lv_err_pps_oc_2 fmy_stat_pps_oc_2.ctr_abc fmy_stat_pps_oc_2.ctr_end_diag fmy_stat_pps_oc_2.err_info_stat.reserved fmy_stat_pps_oc_2.err_info_stat.lv_cdn_diag_stc fmy_stat_pps_oc_2.err_info_stat.lv_lock_diag fmy_stat_pps_oc_2.err_info_stat.lv_err_mem fmy_stat_pps_oc_2.err_info_stat.lv_ready fmy_stat_pps_oc_2.err_info_stat.lv_end_diag fmy_stat_pps_oc_2.err_info_stat.lv_cdn_diag fmy_stat_pps_oc_2.err_info_stat.err_sym lv_err_pps_oc_3 fmy_stat_pps_oc_3.ctr_abc fmy_stat_pps_oc_3.ctr_end_diag fmy_stat_pps_oc_3.err_info_stat.reserved fmy_stat_pps_oc_3.err_info_stat.lv_cdn_diag_stc fmy_stat_pps_oc_3.err_info_stat.lv_lock_diag fmy_stat_pps_oc_3.err_info_stat.lv_err_mem fmy_stat_pps_oc_3.err_info_stat.lv_ready fmy_stat_pps_oc_3.err_info_stat.lv_end_diag fmy_stat_pps_oc_3.err_info_stat.lv_cdn_diag fmy_stat_pps_oc_3.err_info_stat.err_sym lv_err_pps_sc_h_l_0 fmy_stat_pps_sc_h_l_0.ctr_abc fmy_stat_pps_sc_h_l_0.ctr_end_diag fmy_stat_pps_sc_h_l_0.err_info_stat.reserved fmy_stat_pps_sc_h_l_0.err_info_stat.lv_cdn_diag_stc fmy_stat_pps_sc_h_l_0.err_info_stat.lv_lock_diag fmy_stat_pps_sc_h_l_0.err_info_stat.lv_err_mem fmy_stat_pps_sc_h_l_0.err_info_stat.lv_ready fmy_stat_pps_sc_h_l_0.err_info_stat.lv_end_diag fmy_stat_pps_sc_h_l_0.err_info_stat.lv_cdn_diag fmy_stat_pps_sc_h_l_0.err_info_stat.err_sym lv_err_pps_sc_h_l_1 fmy_stat_pps_sc_h_l_1.ctr_abc fmy_stat_pps_sc_h_l_1.ctr_end_diag fmy_stat_pps_sc_h_l_1.err_info_stat.reserved fmy_stat_pps_sc_h_l_1.err_info_stat.lv_cdn_diag_stc fmy_stat_pps_sc_h_l_1.err_info_stat.lv_lock_diag fmy_stat_pps_sc_h_l_1.err_info_stat.lv_err_mem fmy_stat_pps_sc_h_l_1.err_info_stat.lv_ready fmy_stat_pps_sc_h_l_1.err_info_stat.lv_end_diag fmy_stat_pps_sc_h_l_1.err_info_stat.lv_cdn_diag fmy_stat_pps_sc_h_l_1.err_info_stat.err_sym lv_err_pps_sc_h_l_2 fmy_stat_pps_sc_h_l_2.ctr_abc fmy_stat_pps_sc_h_l_2.ctr_end_diag fmy_stat_pps_sc_h_l_2.err_info_stat.reserved fmy_stat_pps_sc_h_l_2.err_info_stat.lv_cdn_diag_stc fmy_stat_pps_sc_h_l_2.err_info_stat.lv_lock_diag fmy_stat_pps_sc_h_l_2.err_info_stat.lv_err_mem fmy_stat_pps_sc_h_l_2.err_info_stat.lv_ready fmy_stat_pps_sc_h_l_2.err_info_stat.lv_end_diag fmy_stat_pps_sc_h_l_2.err_info_stat.lv_cdn_diag fmy_stat_pps_sc_h_l_2.err_info_stat.err_sym lv_err_pps_sc_h_l_3 fmy_stat_pps_sc_h_l_3.ctr_abc fmy_stat_pps_sc_h_l_3.ctr_end_diag fmy_stat_pps_sc_h_l_3.err_info_stat.reserved fmy_stat_pps_sc_h_l_3.err_info_stat.lv_cdn_diag_stc fmy_stat_pps_sc_h_l_3.err_info_stat.lv_lock_diag fmy_stat_pps_sc_h_l_3.err_info_stat.lv_err_mem fmy_stat_pps_sc_h_l_3.err_info_stat.lv_ready fmy_stat_pps_sc_h_l_3.err_info_stat.lv_end_diag fmy_stat_pps_sc_h_l_3.err_info_stat.lv_cdn_diag fmy_stat_pps_sc_h_l_3.err_info_stat.err_sym lv_err_pps_sc_h_0 fmy_stat_pps_sc_h_0.ctr_abc fmy_stat_pps_sc_h_0.ctr_end_diag fmy_stat_pps_sc_h_0.err_info_stat.reserved fmy_stat_pps_sc_h_0.err_info_stat.lv_cdn_diag_stc fmy_stat_pps_sc_h_0.err_info_stat.lv_lock_diag fmy_stat_pps_sc_h_0.err_info_stat.lv_err_mem fmy_stat_pps_sc_h_0.err_info_stat.lv_ready fmy_stat_pps_sc_h_0.err_info_stat.lv_end_diag fmy_stat_pps_sc_h_0.err_info_stat.lv_cdn_diag fmy_stat_pps_sc_h_0.err_info_stat.err_sym lv_err_pps_sc_l_0 fmy_stat_pps_sc_l_0.ctr_abc fmy_stat_pps_sc_l_0.ctr_end_diag fmy_stat_pps_sc_l_0.err_info_stat.reserved fmy_stat_pps_sc_l_0.err_info_stat.lv_cdn_diag_stc fmy_stat_pps_sc_l_0.err_info_stat.lv_lock_diag fmy_stat_pps_sc_l_0.err_info_stat.lv_err_mem fmy_stat_pps_sc_l_0.err_info_stat.lv_ready fmy_stat_pps_sc_l_0.err_info_stat.lv_end_diag fmy_stat_pps_sc_l_0.err_info_stat.lv_cdn_diag fmy_stat_pps_sc_l_0.err_info_stat.err_sym /end OUT_MEASUREMENT
/end FUNCTION
/begin FUNCTION ERRM_ATEGTURD "Error Management data for diagnosis ATEGTURD"
 /begin OUT_MEASUREMENT lv_err_v_teg_tur_up_rng fmy_stat_v_teg_tur_up_rng.ctr_abc fmy_stat_v_teg_tur_up_rng.ctr_end_diag fmy_stat_v_teg_tur_up_rng.err_info_stat.reserved fmy_stat_v_teg_tur_up_rng.err_info_stat.lv_cdn_diag_stc fmy_stat_v_teg_tur_up_rng.err_info_stat.lv_lock_diag fmy_stat_v_teg_tur_up_rng.err_info_stat.lv_err_mem fmy_stat_v_teg_tur_up_rng.err_info_stat.lv_ready fmy_stat_v_teg_tur_up_rng.err_info_stat.lv_end_diag fmy_stat_v_teg_tur_up_rng.err_info_stat.lv_cdn_diag fmy_stat_v_teg_tur_up_rng.err_info_stat.err_sym lv_err_teg_tur_up_mes_grd fmy_stat_teg_tur_up_mes_grd.ctr_abc fmy_stat_teg_tur_up_mes_grd.ctr_end_diag fmy_stat_teg_tur_up_mes_grd.err_info_stat.reserved fmy_stat_teg_tur_up_mes_grd.err_info_stat.lv_cdn_diag_stc fmy_stat_teg_tur_up_mes_grd.err_info_stat.lv_lock_diag fmy_stat_teg_tur_up_mes_grd.err_info_stat.lv_err_mem fmy_stat_teg_tur_up_mes_grd.err_info_stat.lv_ready fmy_stat_teg_tur_up_mes_grd.err_info_stat.lv_end_diag fmy_stat_teg_tur_up_mes_grd.err_info_stat.lv_cdn_diag fmy_stat_teg_tur_up_mes_grd.err_info_stat.err_sym /end OUT_MEASUREMENT
/end FUNCTION
/begin FUNCTION ERRM_ADGOSPI "Error Management data for diagnosis ADGOSPI"
 /begin OUT_MEASUREMENT lv_err_bpa fmy_stat_bpa.ctr_abc fmy_stat_bpa.ctr_end_diag fmy_stat_bpa.err_info_stat.reserved fmy_stat_bpa.err_info_stat.lv_cdn_diag_stc fmy_stat_bpa.err_info_stat.lv_lock_diag fmy_stat_bpa.err_info_stat.lv_err_mem fmy_stat_bpa.err_info_stat.lv_ready fmy_stat_bpa.err_info_stat.lv_end_diag fmy_stat_bpa.err_info_stat.lv_cdn_diag fmy_stat_bpa.err_info_stat.err_sym lv_err_gl_rly_dps fmy_stat_gl_rly_dps.ctr_abc fmy_stat_gl_rly_dps.ctr_end_diag fmy_stat_gl_rly_dps.err_info_stat.reserved fmy_stat_gl_rly_dps.err_info_stat.lv_cdn_diag_stc fmy_stat_gl_rly_dps.err_info_stat.lv_lock_diag fmy_stat_gl_rly_dps.err_info_stat.lv_err_mem fmy_stat_gl_rly_dps.err_info_stat.lv_ready fmy_stat_gl_rly_dps.err_info_stat.lv_end_diag fmy_stat_gl_rly_dps.err_info_stat.lv_cdn_diag fmy_stat_gl_rly_dps.err_info_stat.err_sym lv_err_pcv_1 fmy_stat_pcv_1.ctr_abc fmy_stat_pcv_1.ctr_end_diag fmy_stat_pcv_1.err_info_stat.reserved fmy_stat_pcv_1.err_info_stat.lv_cdn_diag_stc fmy_stat_pcv_1.err_info_stat.lv_lock_diag fmy_stat_pcv_1.err_info_stat.lv_err_mem fmy_stat_pcv_1.err_info_stat.lv_ready fmy_stat_pcv_1.err_info_stat.lv_end_diag fmy_stat_pcv_1.err_info_stat.lv_cdn_diag fmy_stat_pcv_1.err_info_stat.err_sym lv_err_pcv_3 fmy_stat_pcv_3.ctr_abc fmy_stat_pcv_3.ctr_end_diag fmy_stat_pcv_3.err_info_stat.reserved fmy_stat_pcv_3.err_info_stat.lv_cdn_diag_stc fmy_stat_pcv_3.err_info_stat.lv_lock_diag fmy_stat_pcv_3.err_info_stat.lv_err_mem fmy_stat_pcv_3.err_info_stat.lv_ready fmy_stat_pcv_3.err_info_stat.lv_end_diag fmy_stat_pcv_3.err_info_stat.lv_cdn_diag fmy_stat_pcv_3.err_info_stat.err_sym lv_err_vcv_1 fmy_stat_vcv_1.ctr_abc fmy_stat_vcv_1.ctr_end_diag fmy_stat_vcv_1.err_info_stat.reserved fmy_stat_vcv_1.err_info_stat.lv_cdn_diag_stc fmy_stat_vcv_1.err_info_stat.lv_lock_diag fmy_stat_vcv_1.err_info_stat.lv_err_mem fmy_stat_vcv_1.err_info_stat.lv_ready fmy_stat_vcv_1.err_info_stat.lv_end_diag fmy_stat_vcv_1.err_info_stat.lv_cdn_diag fmy_stat_vcv_1.err_info_stat.err_sym lv_err_vcv_3 fmy_stat_vcv_3.ctr_abc fmy_stat_vcv_3.ctr_end_diag fmy_stat_vcv_3.err_info_stat.reserved fmy_stat_vcv_3.err_info_stat.lv_cdn_diag_stc fmy_stat_vcv_3.err_info_stat.lv_lock_diag fmy_stat_vcv_3.err_info_stat.lv_err_mem fmy_stat_vcv_3.err_info_stat.lv_ready fmy_stat_vcv_3.err_info_stat.lv_end_diag fmy_stat_vcv_3.err_info_stat.lv_cdn_diag fmy_stat_vcv_3.err_info_stat.err_sym /end OUT_MEASUREMENT
/end FUNCTION
/begin FUNCTION ERRM_ARLYDIAG "Error Management data for diagnosis ARLYDIAG"
 /begin OUT_MEASUREMENT lv_err_rly_main fmy_stat_rly_main.ctr_abc fmy_stat_rly_main.ctr_end_diag fmy_stat_rly_main.err_info_stat.reserved fmy_stat_rly_main.err_info_stat.lv_cdn_diag_stc fmy_stat_rly_main.err_info_stat.lv_lock_diag fmy_stat_rly_main.err_info_stat.lv_err_mem fmy_stat_rly_main.err_info_stat.lv_ready fmy_stat_rly_main.err_info_stat.lv_end_diag fmy_stat_rly_main.err_info_stat.lv_cdn_diag fmy_stat_rly_main.err_info_stat.err_sym lv_err_rly_power fmy_stat_rly_power.ctr_abc fmy_stat_rly_power.ctr_end_diag fmy_stat_rly_power.err_info_stat.reserved fmy_stat_rly_power.err_info_stat.lv_cdn_diag_stc fmy_stat_rly_power.err_info_stat.lv_lock_diag fmy_stat_rly_power.err_info_stat.lv_err_mem fmy_stat_rly_power.err_info_stat.lv_ready fmy_stat_rly_power.err_info_stat.lv_end_diag fmy_stat_rly_power.err_info_stat.lv_cdn_diag fmy_stat_rly_power.err_info_stat.err_sym /end OUT_MEASUREMENT
/end FUNCTION
/begin FUNCTION ERRM_AVBDIAG "Error Management data for diagnosis AVBDIAG"
 /begin OUT_MEASUREMENT fmy_stat_vb.ctr_abc fmy_stat_vb.ctr_end_diag fmy_stat_vb.err_info_stat.reserved fmy_stat_vb.err_info_stat.lv_cdn_diag_stc fmy_stat_vb.err_info_stat.lv_lock_diag fmy_stat_vb.err_info_stat.lv_err_mem fmy_stat_vb.err_info_stat.lv_ready fmy_stat_vb.err_info_stat.lv_end_diag fmy_stat_vb.err_info_stat.lv_cdn_diag fmy_stat_vb.err_info_stat.err_sym /end OUT_MEASUREMENT
/end FUNCTION
/end MODULE
/end PROJECT
