/* -------------------------------------------------------------------------
E T A S
Data Declaration System (DDS)
- ASAP2 export -
DDS-Version 2.3.0
Component-Version Build<000026.02> $Hotfix 4: 2002/04/08 (ident-extension #650, default raster)
CreationDate 19 Sep 2003, 15:23:49
Project SN0
Number PRJ_NUM
Structure 950
Serial Nr. 0
Option Project (DataBase) D:\p\sn0\950_pis\mc1_u\tmp\db
Option Verbose false
Option ASAP2File D:\p\sn0\950_pis\mc1_u\out\cal\sn09503b.a2l
Option IgnoreAddressCheck false
Option ASAP2Version 1.41
Option ExportSoftwareGrouping false
Option ExportComponentGrouping false
Option SuppressFunctionGrouping false
Option SuppressAxisFunctionGrouping false
Option ExportDisplayIdentifier <2>
Option ExportLongIdentifier <0>
Option ExportAnnotation false
Option PartialExportViaFunction
Option MemoryRegionAutoAssignment <0>
Option ExportReference2MemorySegment false
Option AddressOffset <0>
Option IfDataSetList 'ETK_P2'
Option IfDataOutputFormat <0>
Option CalibrationMethodList
Option SuppressEcuAddress false
Option SuppressFloat false
Option SuppressVariantCoding false
Option VariantCodingMode <0>
Option OnlineOnly false
Option ExportHiddenData false
Option Map2PointLinearConv2RatFunc true
Option NonLinearConvMode <0>
Option MapVTabRange2VTab true
Option MaxCompuTabValuePairs <256>
Option DefaultFormat4VerbalConvers...
Option WriteEscapeCharacters false
Option AllowASAP1_3IdentsAlso4NonI... false
Option IgnorePartialIdentLengthCheck true
Option A2MLIncludeMode <0>
------------------------------------------------------------------------- */
ASAP2_VERSION 1 41
/begin PROJECT SN0 "SIMOS PPD"
/begin HEADER "_default_HeaderComment" PROJECT_NO PRJ_NUM /end HEADER
/begin MODULE _default_ModuleName "_default_ModuleLongIdentifier"
/begin MOD_PAR "_default_ModParComment" ADDR_EPK 0x840008 EPK "SN09500"
 /begin MEMORY_SEGMENT _RAM "" VARIABLES RAM EXTERN 0x187d000 0x3000 -1 -1 -1 -1 -1 /begin IF_DATA ETK DP_BLOB 0x187d000 0x3000 /end IF_DATA /end MEMORY_SEGMENT
 /begin MEMORY_SEGMENT _ROM "" DATA FLASH EXTERN 0x840000 0x3d000 -1 -1 -1 -1 -1 /begin IF_DATA ETK DP_BLOB 0x840000 0x3d000 /end IF_DATA /end MEMORY_SEGMENT
 /begin MEMORY_SEGMENT _INT_RAM "" VARIABLES RAM INTERN 0x7f8000 0x8000 -1 -1 -1 -1 -1 /begin IF_DATA ETK DP_BLOB 0x7f8000 0x8000 /end IF_DATA /end MEMORY_SEGMENT
 /begin MEMORY_SEGMENT _INT_RAM_BIT "" VARIABLES RAM INTERN 0x7f8000 0x8000 -1 -1 -1 -1 -1 /begin IF_DATA ETK DP_BLOB 0x7f8000 0x8000 /end IF_DATA /end MEMORY_SEGMENT
 /begin MEMORY_SEGMENT _ECU_CODE1 "" CODE FLASH EXTERN 0x280000 0x180000 -1 -1 -1 -1 -1 /begin IF_DATA ETK DP_BLOB 0x280000 0x180000 /end IF_DATA /end MEMORY_SEGMENT
 /begin MEMORY_SEGMENT _ROM_CAL_AS "" CODE FLASH EXTERN 0x87d000 0x3000 -1 -1 -1 -1 -1 /begin IF_DATA ETK DP_BLOB 0x87d000 0x3000 /end IF_DATA /end MEMORY_SEGMENT
/end MOD_PAR
/begin MOD_COMMON "_default_ModCommonComment" DEPOSIT ABSOLUTE BYTE_ORDER MSB_FIRST ALIGNMENT_BYTE 1 ALIGNMENT_WORD 2 ALIGNMENT_LONG 4 ALIGNMENT_FLOAT32_IEEE 4 ALIGNMENT_FLOAT64_IEEE 8 /end MOD_COMMON
/begin IF_DATA ETK
 /begin SOURCE "Segment Synchronous" 103 1 QP_BLOB 1 0x3c 0x840200 0x187e180 0x187e140 0 0x0 0x0 /end SOURCE
 /begin SOURCE "Time Synchronous Cylinder 10ms" 4 1 QP_BLOB 2 0x5c 0x8402f8 0x187e1bc 0x187e142 10 0x0 0x0 /end SOURCE
 /begin SOURCE "Time Synchronous Cylinder 100ms" 5 1 QP_BLOB 3 0x5c 0x840470 0x187e218 0x187e144 100 0x0 0x0 /end SOURCE
 /begin SOURCE "Bypass Segment Synchronous" 103 1 QP_BLOB 4 0x30 0x8405e8 0x187e274 0x187e146 0 0x10 0x840778 /end SOURCE
 /begin SOURCE "Bypass Time Synchronous" 4 1 QP_BLOB 5 0x30 0x8406b0 0x187e2a4 0x187e148 10 0x20 0x8407a0 /end SOURCE
 /begin TP_BLOB 0x01000001 0x0 0x00000800
  /begin DISTAB_CFG 0xD 0x0111 0x1 0x0187E100 0x1010100 TRG_MOD 0x0 0xB7 0x0 0x0 0x0 /end DISTAB_CFG
  CODE_CHK 0x0 0x0 0x0 0x0 ETK_CFG 0x02 0xE2 0x4E 0xDF 0xEF 0x4E 0xDF 0xEF 0x4E 0xCF 0xFB 0xFE 0xFF 0xFF 0xFB 0xFF 0xFF 0xFF 0xFF 0xFF 0x03 0xFF 0x01 0xFF RESERVED 0x840200 0x0600 EXTERN -1 -1 -1 -1 -1 /end TP_BLOB
/end IF_DATA
/begin MEASUREMENT cyl_id_sam_trig "" UBYTE _CNV_A_R_ZYL_ID_2_CM 1 0. 1. 6. DISPLAY_IDENTIFIER CYL_ID_SAM_TRIG ECU_ADDRESS 0x7fc6fc FORMAT "%0.0" /end MEASUREMENT
/begin MEASUREMENT lv_mil "" UBYTE _CNV_S_2_RANGE______3_CM 1 0. 0. 1. DISPLAY_IDENTIFIER LV_MIL ECU_ADDRESS 0x7fc446 /end MEASUREMENT
/begin MEASUREMENT ar_egrv_pctl_the_bas "" UWORD _CNV_A_R_LINEAR_____7_CM 1 0. 0. 78.08 DISPLAY_IDENTIFIER AR_EGRV_PCTL_THE_BAS ECU_ADDRESS 0x7fcd30 BYTE_ORDER MSB_LAST FORMAT "%5.3" /end MEASUREMENT
/begin MEASUREMENT maf_rel "" UWORD _CNV_A_R_LINEAR_____8_CM 1 0. 0. 99.99847412109381 DISPLAY_IDENTIFIER MAF_REL ECU_ADDRESS 0x7fa86a BYTE_ORDER MSB_LAST FORMAT "%6.4" /end MEASUREMENT
/begin MEASUREMENT maf_rel_sp "" UWORD _CNV_A_R_LINEAR_____8_CM 1 0. 0. 99.99847412109381 DISPLAY_IDENTIFIER MAF_REL_SP ECU_ADDRESS 0x7fa86c BYTE_ORDER MSB_LAST FORMAT "%6.4" /end MEASUREMENT
/begin MEASUREMENT bpapwm_dyn "" SWORD _CNV_A_R_LINEAR_____9_CM 1 0. -100. 99.99695 DISPLAY_IDENTIFIER BPAPWM_DYN ECU_ADDRESS 0x7fa73a BYTE_ORDER MSB_LAST FORMAT "%7.2" /end MEASUREMENT
/begin MEASUREMENT map_sp_lim_grd "" SWORD _CNV_A_R_LINEAR_____10_CM 1 0. -2717.041459 2716.958541 DISPLAY_IDENTIFIER MAP_SP_LIM_GRD ECU_ADDRESS 0x7fa762 BYTE_ORDER MSB_LAST FORMAT "%7.3" /end MEASUREMENT
/begin MEASUREMENT lv_dir_v_hbr[0] "" UBYTE _CNV_S_2_RANGE______11_CM 1 0. 0. 1. DISPLAY_IDENTIFIER LV_DIR_V_HBR_0_ ECU_ADDRESS 0x7fbe66 /end MEASUREMENT
/begin MEASUREMENT lv_dir_v_hbr[1] "" UBYTE _CNV_S_2_RANGE______11_CM 1 0. 0. 1. DISPLAY_IDENTIFIER LV_DIR_V_HBR_1_ ECU_ADDRESS 0x7fbe67 /end MEASUREMENT
/begin MEASUREMENT abs_hbr_pwm[0] "" UWORD _CNV_A_R_LINEAR_____8_CM 1 0. 0. 99.99847412109381 DISPLAY_IDENTIFIER ABS_HBR_PWM_0_ ECU_ADDRESS 0x7f996e BYTE_ORDER MSB_LAST FORMAT "%5.3" /end MEASUREMENT
/begin MEASUREMENT abs_hbr_pwm[1] "" UWORD _CNV_A_R_LINEAR_____8_CM 1 0. 0. 99.99847412109381 DISPLAY_IDENTIFIER ABS_HBR_PWM_1_ ECU_ADDRESS 0x7f9970 BYTE_ORDER MSB_LAST FORMAT "%5.3" /end MEASUREMENT
/begin MEASUREMENT dir_hbr[0] "" UBYTE _CNV_S_2_RANGE______11_CM 1 0. 0. 1. DISPLAY_IDENTIFIER DIR_HBR_0_ ECU_ADDRESS 0x7fb871 /end MEASUREMENT
/begin MEASUREMENT dir_hbr[1] "" UBYTE _CNV_S_2_RANGE______11_CM 1 0. 0. 1. DISPLAY_IDENTIFIER DIR_HBR_1_ ECU_ADDRESS 0x7fb872 /end MEASUREMENT
/begin MEASUREMENT inp_hbr[0] "" SWORD _CNV_A_R_LINEAR_____12_CM 1 0. -100. 99.996948242 DISPLAY_IDENTIFIER INP_HBR_0_ ECU_ADDRESS 0x7f9972 BYTE_ORDER MSB_LAST FORMAT "%7.3" /end MEASUREMENT
/begin MEASUREMENT inp_hbr[1] "" SWORD _CNV_A_R_LINEAR_____12_CM 1 0. -100. 99.996948242 DISPLAY_IDENTIFIER INP_HBR_1_ ECU_ADDRESS 0x7f9974 BYTE_ORDER MSB_LAST FORMAT "%7.3" /end MEASUREMENT
/begin MEASUREMENT fac_cor_hbr[0] "" UWORD _CNV_A_R_LINEAR_____13_CM 1 0. 0. 15.999755 DISPLAY_IDENTIFIER FAC_COR_HBR_0_ ECU_ADDRESS 0x7f9976 BYTE_ORDER MSB_LAST FORMAT "%6.5" /end MEASUREMENT
/begin MEASUREMENT fac_cor_hbr[1] "" UWORD _CNV_A_R_LINEAR_____13_CM 1 0. 0. 15.999755 DISPLAY_IDENTIFIER FAC_COR_HBR_1_ ECU_ADDRESS 0x7f9978 BYTE_ORDER MSB_LAST FORMAT "%6.5" /end MEASUREMENT
/begin MEASUREMENT ar_egrv_pctl_the "" UWORD _CNV_A_R_LINEAR_____7_CM 1 0. 0. 78.08 DISPLAY_IDENTIFIER AR_EGRV_PCTL_THE ECU_ADDRESS 0x7fcd2e BYTE_ORDER MSB_LAST FORMAT "%5.3" /end MEASUREMENT
/begin MEASUREMENT pq_egrv_sp "" UWORD _CNV_A_R_LINEAR_____15_CM 1 0. 0. 3.99993896484375 DISPLAY_IDENTIFIER PQ_EGRV_SP ECU_ADDRESS 0x7fcd32 BYTE_ORDER MSB_LAST FORMAT "%5.4" /end MEASUREMENT
/begin MEASUREMENT abs_hbr_pwm_tmp[0] "" SWORD _CNV_A_R_LINEAR_____12_CM 1 0. -100. 99.996948242 DISPLAY_IDENTIFIER ABS_HBR_PWM_TMP_0_ ECU_ADDRESS 0x7f996a BYTE_ORDER MSB_LAST FORMAT "%7.3" /end MEASUREMENT
/begin MEASUREMENT abs_hbr_pwm_tmp[1] "" SWORD _CNV_A_R_LINEAR_____12_CM 1 0. -100. 99.996948242 DISPLAY_IDENTIFIER ABS_HBR_PWM_TMP_1_ ECU_ADDRESS 0x7f996c BYTE_ORDER MSB_LAST FORMAT "%7.3" /end MEASUREMENT
/begin MEASUREMENT ctr_err_dyn_nr "" UBYTE _CNV_A_R_LINEAR_____0_CM 1 0. 0. 255. DISPLAY_IDENTIFIER FMY_CTR_ERR_DYN_NR ECU_ADDRESS 0x7fc270 FORMAT "%3.0" /end MEASUREMENT
/begin MEASUREMENT ctr_err_his_nr "" UBYTE _CNV_A_R_LINEAR_____0_CM 1 0. 0. 255. DISPLAY_IDENTIFIER FMY_CTR_ERR_HIS_NR ECU_ADDRESS 0x7fc444 FORMAT "%3.0" /end MEASUREMENT
/begin MEASUREMENT fmy_ram_dyn[0].dtc_cod "" UWORD _CNV_A_R_LINEAR_____0_CM 1 0. 0. 65535. DISPLAY_IDENTIFIER FMY_0_DTC_COD ECU_ADDRESS 0x7fc1e4 BYTE_ORDER MSB_LAST FORMAT "%6.0" /end MEASUREMENT
/begin MEASUREMENT fmy_ram_dyn[0].ctr_frc "Frequency counter of failure N" UBYTE _CNV_A_R_LINEAR_____0_CM 1 0. 0. 255. DISPLAY_IDENTIFIER FMY_0_CTR_FRC ECU_ADDRESS 0x7fc1ea FORMAT "%3.0" /end MEASUREMENT
/begin MEASUREMENT fmy_ram_dyn[0].ctr_wup_cyc "Counter for warm-up cycle" UBYTE _CNV_A_R_LINEAR_____0_CM 1 0. 0. 255. DISPLAY_IDENTIFIER FMY_0_CTR_WUP_CYC ECU_ADDRESS 0x7fc1eb FORMAT "%3.0" /end MEASUREMENT
/begin MEASUREMENT fmy_ram_dyn[0].ctr_dc "Counter for driving cycle" UBYTE _CNV_A_R_LINEAR_____0_CM 1 0. 0. 255. DISPLAY_IDENTIFIER FMY_0_CTR_DC ECU_ADDRESS 0x7fc1ec FORMAT "%3.0" /end MEASUREMENT
/begin MEASUREMENT fmy_ram_dyn[0].diag_inst "" UWORD _CNV_S_180_CONV_DIAG__21_CM 1 0. 0. 179. DISPLAY_IDENTIFIER FMY_0_DIAG_INST ECU_ADDRESS 0x7fc1e6 BYTE_ORDER MSB_LAST /end MEASUREMENT
/begin MEASUREMENT fmy_ram_dyn[0].idx_frf "" UBYTE _CNV_A_R_ZYL_ID_2_CM 1 0. 1. 256. DISPLAY_IDENTIFIER FMY_0_IDX_FRF ECU_ADDRESS 0x7fc1ed FORMAT "%3.0" /end MEASUREMENT
/begin MEASUREMENT fmy_ram_dyn[0].err_info_dyn.lv_err_mkd "" UWORD _CNV_S_2_RANGE______11_CM 1 0. 0. 1. DISPLAY_IDENTIFIER FMY_0_LV_ERR_MKD ECU_ADDRESS 0x7fc1e8 BYTE_ORDER MSB_LAST BIT_MASK 0x200 /end MEASUREMENT
/begin MEASUREMENT fmy_ram_dyn[0].err_info_dyn.lv_dc_max "" UWORD _CNV_S_2_RANGE______11_CM 1 0. 0. 1. DISPLAY_IDENTIFIER FMY_0_LV_DC_MAX ECU_ADDRESS 0x7fc1e8 BYTE_ORDER MSB_LAST BIT_MASK 0x100 /end MEASUREMENT
/begin MEASUREMENT fmy_ram_dyn[0].err_info_dyn.lv_err_disa "" UWORD _CNV_S_2_RANGE______11_CM 1 0. 0. 1. DISPLAY_IDENTIFIER FMY_0_LV_ERR_DISA ECU_ADDRESS 0x7fc1e8 BYTE_ORDER MSB_LAST BIT_MASK 0x80 /end MEASUREMENT
/begin MEASUREMENT fmy_ram_dyn[0].err_info_dyn.lv_err_cfm "" UWORD _CNV_S_2_RANGE______11_CM 1 0. 0. 1. DISPLAY_IDENTIFIER FMY_0_LV_ERR_CFM ECU_ADDRESS 0x7fc1e8 BYTE_ORDER MSB_LAST BIT_MASK 0x40 /end MEASUREMENT
/begin MEASUREMENT fmy_ram_dyn[0].err_info_dyn.lv_err_tmp "" UWORD _CNV_S_2_RANGE______11_CM 1 0. 0. 1. DISPLAY_IDENTIFIER FMY_0_LV_ERR_TMP ECU_ADDRESS 0x7fc1e8 BYTE_ORDER MSB_LAST BIT_MASK 0x20 /end MEASUREMENT
/begin MEASUREMENT fmy_ram_dyn[0].err_info_dyn.lv_err_dc "" UWORD _CNV_S_2_RANGE______11_CM 1 0. 0. 1. DISPLAY_IDENTIFIER FMY_0_LV_ERR_DC ECU_ADDRESS 0x7fc1e8 BYTE_ORDER MSB_LAST BIT_MASK 0x10 /end MEASUREMENT
/begin MEASUREMENT fmy_ram_dyn[0].err_info_dyn.err_sym_mem "" UWORD _CNV_S_6_CONV_ERRM__22_CM 1 0. 0. 15. DISPLAY_IDENTIFIER FMY_0_ERR_SYM_MEM ECU_ADDRESS 0x7fc1e8 BYTE_ORDER MSB_LAST BIT_MASK 0xF /end MEASUREMENT
/begin MEASUREMENT fmy_ram_dyn[0].err_info_dyn.err_sym_lst "" UWORD _CNV_S_6_CONV_ERRM__22_CM 1 0. 0. 15. DISPLAY_IDENTIFIER FMY_0_ERR_SYM_LST ECU_ADDRESS 0x7fc1e8 BYTE_ORDER MSB_LAST BIT_MASK 0x7800 /end MEASUREMENT
/begin MEASUREMENT fmy_ram_dyn[0].err_info_dyn.lv_err_pnd "" UWORD _CNV_S_2_RANGE______11_CM 1 0. 0. 1. DISPLAY_IDENTIFIER FMY_0_LV_ERR_PND ECU_ADDRESS 0x7fc1e8 BYTE_ORDER MSB_LAST BIT_MASK 0x400 /end MEASUREMENT
/begin MEASUREMENT fmy_ram_dyn[0].err_info_dyn.lv_cdn_diag_dc "This flag permits to detect that diag conditions have been met during drinving cycle." UWORD _CNV_S_2_RANGE______11_CM 1 0. 0. 1. DISPLAY_IDENTIFIER FMY_0_LV_CDN_DIAG_DC ECU_ADDRESS 0x7fc1e8 BYTE_ORDER MSB_LAST BIT_MASK 0x8000 /end MEASUREMENT
/begin MEASUREMENT fmy_ram_dyn[0].ctr_dc_err_det "Number of driving cycles since DTC detection" UBYTE _CNV_A_R_LINEAR_____1_CM 1 0. 0. 255. DISPLAY_IDENTIFIER FMY_0_CTR_DC_ERR_DET ECU_ADDRESS 0x7fc1ee FORMAT "%3.0" /end MEASUREMENT
/begin MEASUREMENT fmy_ram_dyn[0].ctr_dc_err_det_diag_cdn "Number of driving cycles since DTC detection with diag started within these driving cycle." UBYTE _CNV_A_R_LINEAR_____1_CM 1 0. 0. 255. DISPLAY_IDENTIFIER FMY_0_CTR_DC_ERR_DET_DIAG_CDN ECU_ADDRESS 0x7fc1ef FORMAT "%3.0" /end MEASUREMENT
/begin MEASUREMENT fmy_ram_dyn[0].ctr_dc_err_det_diag_cmpl "Number of driving cycles since DTC detection with diag completed during these driving cycles." UBYTE _CNV_A_R_LINEAR_____1_CM 1 0. 0. 255. DISPLAY_IDENTIFIER FMY_0_CTR_DC_ERR_DET_DIAG_CMPL ECU_ADDRESS 0x7fc1f0 FORMAT "%3.0" /end MEASUREMENT
/begin MEASUREMENT fmy_ram_dyn[0].ctr_wup_act_mil "Number of warm-up cycles +1 since MIL activation for this failure" UBYTE _CNV_A_R_LINEAR_____1_CM 1 0. 0. 255. DISPLAY_IDENTIFIER FMY_0_CTR_WUP_ACT_MIL ECU_ADDRESS 0x7fc1f1 FORMAT "%3.0" /end MEASUREMENT
/begin MEASUREMENT fmy_ram_dyn[1].dtc_cod "" UWORD _CNV_A_R_LINEAR_____0_CM 1 0. 0. 65535. DISPLAY_IDENTIFIER FMY_1_DTC_COD ECU_ADDRESS 0x7fc1f2 BYTE_ORDER MSB_LAST FORMAT "%6.0" /end MEASUREMENT
/begin MEASUREMENT fmy_ram_dyn[1].ctr_frc "Frequency counter of failure N" UBYTE _CNV_A_R_LINEAR_____0_CM 1 0. 0. 255. DISPLAY_IDENTIFIER FMY_1_CTR_FRC ECU_ADDRESS 0x7fc1f8 FORMAT "%3.0" /end MEASUREMENT
/begin MEASUREMENT fmy_ram_dyn[1].ctr_wup_cyc "Counter for warm-up cycle" UBYTE _CNV_A_R_LINEAR_____0_CM 1 0. 0. 255. DISPLAY_IDENTIFIER FMY_1_CTR_WUP_CYC ECU_ADDRESS 0x7fc1f9 FORMAT "%3.0" /end MEASUREMENT
/begin MEASUREMENT fmy_ram_dyn[1].ctr_dc "Counter for driving cycle" UBYTE _CNV_A_R_LINEAR_____0_CM 1 0. 0. 255. DISPLAY_IDENTIFIER FMY_1_CTR_DC ECU_ADDRESS 0x7fc1fa FORMAT "%3.0" /end MEASUREMENT
/begin MEASUREMENT fmy_ram_dyn[1].diag_inst "" UWORD _CNV_S_180_CONV_DIAG__21_CM 1 0. 0. 179. DISPLAY_IDENTIFIER FMY_1_DIAG_INST ECU_ADDRESS 0x7fc1f4 BYTE_ORDER MSB_LAST /end MEASUREMENT
/begin MEASUREMENT fmy_ram_dyn[1].idx_frf "" UBYTE _CNV_A_R_ZYL_ID_2_CM 1 0. 1. 256. DISPLAY_IDENTIFIER FMY_1_IDX_FRF ECU_ADDRESS 0x7fc1fb FORMAT "%3.0" /end MEASUREMENT
/begin MEASUREMENT fmy_ram_dyn[1].err_info_dyn.lv_err_mkd "" UWORD _CNV_S_2_RANGE______11_CM 1 0. 0. 1. DISPLAY_IDENTIFIER FMY_1_LV_ERR_MKD ECU_ADDRESS 0x7fc1f6 BYTE_ORDER MSB_LAST BIT_MASK 0x200 /end MEASUREMENT
/begin MEASUREMENT fmy_ram_dyn[1].err_info_dyn.lv_dc_max "" UWORD _CNV_S_2_RANGE______11_CM 1 0. 0. 1. DISPLAY_IDENTIFIER FMY_1_LV_DC_MAX ECU_ADDRESS 0x7fc1f6 BYTE_ORDER MSB_LAST BIT_MASK 0x100 /end MEASUREMENT
/begin MEASUREMENT fmy_ram_dyn[1].err_info_dyn.lv_err_disa "" UWORD _CNV_S_2_RANGE______11_CM 1 0. 0. 1. DISPLAY_IDENTIFIER FMY_1_LV_ERR_DISA ECU_ADDRESS 0x7fc1f6 BYTE_ORDER MSB_LAST BIT_MASK 0x80 /end MEASUREMENT
/begin MEASUREMENT fmy_ram_dyn[1].err_info_dyn.lv_err_cfm "" UWORD _CNV_S_2_RANGE______11_CM 1 0. 0. 1. DISPLAY_IDENTIFIER FMY_1_LV_ERR_CFM ECU_ADDRESS 0x7fc1f6 BYTE_ORDER MSB_LAST BIT_MASK 0x40 /end MEASUREMENT
/begin MEASUREMENT fmy_ram_dyn[1].err_info_dyn.lv_err_tmp "" UWORD _CNV_S_2_RANGE______11_CM 1 0. 0. 1. DISPLAY_IDENTIFIER FMY_1_LV_ERR_TMP ECU_ADDRESS 0x7fc1f6 BYTE_ORDER MSB_LAST BIT_MASK 0x20 /end MEASUREMENT
/begin MEASUREMENT fmy_ram_dyn[1].err_info_dyn.lv_err_dc "" UWORD _CNV_S_2_RANGE______11_CM 1 0. 0. 1. DISPLAY_IDENTIFIER FMY_1_LV_ERR_DC ECU_ADDRESS 0x7fc1f6 BYTE_ORDER MSB_LAST BIT_MASK 0x10 /end MEASUREMENT
/begin MEASUREMENT fmy_ram_dyn[1].err_info_dyn.err_sym_mem "" UWORD _CNV_S_6_CONV_ERRM__22_CM 1 0. 0. 15. DISPLAY_IDENTIFIER FMY_1_ERR_SYM_MEM ECU_ADDRESS 0x7fc1f6 BYTE_ORDER MSB_LAST BIT_MASK 0xF /end MEASUREMENT
/begin MEASUREMENT fmy_ram_dyn[1].err_info_dyn.err_sym_lst "" UWORD _CNV_S_6_CONV_ERRM__22_CM 1 0. 0. 15. DISPLAY_IDENTIFIER FMY_1_ERR_SYM_LST ECU_ADDRESS 0x7fc1f6 BYTE_ORDER MSB_LAST BIT_MASK 0x7800 /end MEASUREMENT
/begin MEASUREMENT fmy_ram_dyn[1].err_info_dyn.lv_err_pnd "" UWORD _CNV_S_2_RANGE______11_CM 1 0. 0. 1. DISPLAY_IDENTIFIER FMY_1_LV_ERR_PND ECU_ADDRESS 0x7fc1f6 BYTE_ORDER MSB_LAST BIT_MASK 0x400 /end MEASUREMENT
/begin MEASUREMENT fmy_ram_dyn[1].err_info_dyn.lv_cdn_diag_dc "This flag permits to detect that diag conditions have been met during drinving cycle." UWORD _CNV_S_2_RANGE______11_CM 1 0. 0. 1. DISPLAY_IDENTIFIER FMY_1_LV_CDN_DIAG_DC ECU_ADDRESS 0x7fc1f6 BYTE_ORDER MSB_LAST BIT_MASK 0x8000 /end MEASUREMENT
/begin MEASUREMENT fmy_ram_dyn[1].ctr_dc_err_det "Number of driving cycles since DTC detection" UBYTE _CNV_A_R_LINEAR_____1_CM 1 0. 0. 255. DISPLAY_IDENTIFIER FMY_1_CTR_DC_ERR_DET ECU_ADDRESS 0x7fc1fc FORMAT "%3.0" /end MEASUREMENT
/begin MEASUREMENT fmy_ram_dyn[1].ctr_dc_err_det_diag_cdn "Number of driving cycles since DTC detection with diag started within these driving cycle." UBYTE _CNV_A_R_LINEAR_____1_CM 1 0. 0. 255. DISPLAY_IDENTIFIER FMY_1_CTR_DC_ERR_DET_DIAG_CDN ECU_ADDRESS 0x7fc1fd FORMAT "%3.0" /end MEASUREMENT
/begin MEASUREMENT fmy_ram_dyn[1].ctr_dc_err_det_diag_cmpl "Number of driving cycles since DTC detection with diag completed during these driving cycles." UBYTE _CNV_A_R_LINEAR_____1_CM 1 0. 0. 255. DISPLAY_IDENTIFIER FMY_1_CTR_DC_ERR_DET_DIAG_CMPL ECU_ADDRESS 0x7fc1fe FORMAT "%3.0" /end MEASUREMENT
/begin MEASUREMENT fmy_ram_dyn[1].ctr_wup_act_mil "Number of warm-up cycles +1 since MIL activation for this failure" UBYTE _CNV_A_R_LINEAR_____1_CM 1 0. 0. 255. DISPLAY_IDENTIFIER FMY_1_CTR_WUP_ACT_MIL ECU_ADDRESS 0x7fc1ff FORMAT "%3.0" /end MEASUREMENT
/begin MEASUREMENT fmy_ram_dyn[2].dtc_cod "" UWORD _CNV_A_R_LINEAR_____0_CM 1 0. 0. 65535. DISPLAY_IDENTIFIER FMY_2_DTC_COD ECU_ADDRESS 0x7fc200 BYTE_ORDER MSB_LAST FORMAT "%6.0" /end MEASUREMENT
/begin MEASUREMENT fmy_ram_dyn[2].ctr_frc "Frequency counter of failure N" UBYTE _CNV_A_R_LINEAR_____0_CM 1 0. 0. 255. DISPLAY_IDENTIFIER FMY_2_CTR_FRC ECU_ADDRESS 0x7fc206 FORMAT "%3.0" /end MEASUREMENT
/begin MEASUREMENT fmy_ram_dyn[2].ctr_wup_cyc "Counter for warm-up cycle" UBYTE _CNV_A_R_LINEAR_____0_CM 1 0. 0. 255. DISPLAY_IDENTIFIER FMY_2_CTR_WUP_CYC ECU_ADDRESS 0x7fc207 FORMAT "%3.0" /end MEASUREMENT
/begin MEASUREMENT fmy_ram_dyn[2].ctr_dc "Counter for driving cycle" UBYTE _CNV_A_R_LINEAR_____0_CM 1 0. 0. 255. DISPLAY_IDENTIFIER FMY_2_CTR_DC ECU_ADDRESS 0x7fc208 FORMAT "%3.0" /end MEASUREMENT
/begin MEASUREMENT fmy_ram_dyn[2].diag_inst "" UWORD _CNV_S_180_CONV_DIAG__21_CM 1 0. 0. 179. DISPLAY_IDENTIFIER FMY_2_DIAG_INST ECU_ADDRESS 0x7fc202 BYTE_ORDER MSB_LAST /end MEASUREMENT
/begin MEASUREMENT fmy_ram_dyn[2].idx_frf "" UBYTE _CNV_A_R_ZYL_ID_2_CM 1 0. 1. 256. DISPLAY_IDENTIFIER FMY_2_IDX_FRF ECU_ADDRESS 0x7fc209 FORMAT "%3.0" /end MEASUREMENT
/begin MEASUREMENT fmy_ram_dyn[2].err_info_dyn.lv_err_mkd "" UWORD _CNV_S_2_RANGE______11_CM 1 0. 0. 1. DISPLAY_IDENTIFIER FMY_2_LV_ERR_MKD ECU_ADDRESS 0x7fc204 BYTE_ORDER MSB_LAST BIT_MASK 0x200 /end MEASUREMENT
/begin MEASUREMENT fmy_ram_dyn[2].err_info_dyn.lv_dc_max "" UWORD _CNV_S_2_RANGE______11_CM 1 0. 0. 1. DISPLAY_IDENTIFIER FMY_2_LV_DC_MAX ECU_ADDRESS 0x7fc204 BYTE_ORDER MSB_LAST BIT_MASK 0x100 /end MEASUREMENT
/begin MEASUREMENT fmy_ram_dyn[2].err_info_dyn.lv_err_disa "" UWORD _CNV_S_2_RANGE______11_CM 1 0. 0. 1. DISPLAY_IDENTIFIER FMY_2_LV_ERR_DISA ECU_ADDRESS 0x7fc204 BYTE_ORDER MSB_LAST BIT_MASK 0x80 /end MEASUREMENT
/begin MEASUREMENT fmy_ram_dyn[2].err_info_dyn.lv_err_cfm "" UWORD _CNV_S_2_RANGE______11_CM 1 0. 0. 1. DISPLAY_IDENTIFIER FMY_2_LV_ERR_CFM ECU_ADDRESS 0x7fc204 BYTE_ORDER MSB_LAST BIT_MASK 0x40 /end MEASUREMENT
/begin MEASUREMENT fmy_ram_dyn[2].err_info_dyn.lv_err_tmp "" UWORD _CNV_S_2_RANGE______11_CM 1 0. 0. 1. DISPLAY_IDENTIFIER FMY_2_LV_ERR_TMP ECU_ADDRESS 0x7fc204 BYTE_ORDER MSB_LAST BIT_MASK 0x20 /end MEASUREMENT
/begin MEASUREMENT fmy_ram_dyn[2].err_info_dyn.lv_err_dc "" UWORD _CNV_S_2_RANGE______11_CM 1 0. 0. 1. DISPLAY_IDENTIFIER FMY_2_LV_ERR_DC ECU_ADDRESS 0x7fc204 BYTE_ORDER MSB_LAST BIT_MASK 0x10 /end MEASUREMENT
/begin MEASUREMENT fmy_ram_dyn[2].err_info_dyn.err_sym_mem "" UWORD _CNV_S_6_CONV_ERRM__22_CM 1 0. 0. 15. DISPLAY_IDENTIFIER FMY_2_ERR_SYM_MEM ECU_ADDRESS 0x7fc204 BYTE_ORDER MSB_LAST BIT_MASK 0xF /end MEASUREMENT
/begin MEASUREMENT fmy_ram_dyn[2].err_info_dyn.err_sym_lst "" UWORD _CNV_S_6_CONV_ERRM__22_CM 1 0. 0. 15. DISPLAY_IDENTIFIER FMY_2_ERR_SYM_LST ECU_ADDRESS 0x7fc204 BYTE_ORDER MSB_LAST BIT_MASK 0x7800 /end MEASUREMENT
/begin MEASUREMENT fmy_ram_dyn[2].err_info_dyn.lv_err_pnd "" UWORD _CNV_S_2_RANGE______11_CM 1 0. 0. 1. DISPLAY_IDENTIFIER FMY_2_LV_ERR_PND ECU_ADDRESS 0x7fc204 BYTE_ORDER MSB_LAST BIT_MASK 0x400 /end MEASUREMENT
/begin MEASUREMENT fmy_ram_dyn[2].err_info_dyn.lv_cdn_diag_dc "This flag permits to detect that diag conditions have been met during drinving cycle." UWORD _CNV_S_2_RANGE______11_CM 1 0. 0. 1. DISPLAY_IDENTIFIER FMY_2_LV_CDN_DIAG_DC ECU_ADDRESS 0x7fc204 BYTE_ORDER MSB_LAST BIT_MASK 0x8000 /end MEASUREMENT
/begin MEASUREMENT fmy_ram_dyn[2].ctr_dc_err_det "Number of driving cycles since DTC detection" UBYTE _CNV_A_R_LINEAR_____1_CM 1 0. 0. 255. DISPLAY_IDENTIFIER FMY_2_CTR_DC_ERR_DET ECU_ADDRESS 0x7fc20a FORMAT "%3.0" /end MEASUREMENT
/begin MEASUREMENT fmy_ram_dyn[2].ctr_dc_err_det_diag_cdn "Number of driving cycles since DTC detection with diag started within these driving cycle." UBYTE _CNV_A_R_LINEAR_____1_CM 1 0. 0. 255. DISPLAY_IDENTIFIER FMY_2_CTR_DC_ERR_DET_DIAG_CDN ECU_ADDRESS 0x7fc20b FORMAT "%3.0" /end MEASUREMENT
/begin MEASUREMENT fmy_ram_dyn[2].ctr_dc_err_det_diag_cmpl "Number of driving cycles since DTC detection with diag completed during these driving cycles." UBYTE _CNV_A_R_LINEAR_____1_CM 1 0. 0. 255. DISPLAY_IDENTIFIER FMY_2_CTR_DC_ERR_DET_DIAG_CMPL ECU_ADDRESS 0x7fc20c FORMAT "%3.0" /end MEASUREMENT
/begin MEASUREMENT fmy_ram_dyn[2].ctr_wup_act_mil "Number of warm-up cycles +1 since MIL activation for this failure" UBYTE _CNV_A_R_LINEAR_____1_CM 1 0. 0. 255. DISPLAY_IDENTIFIER FMY_2_CTR_WUP_ACT_MIL ECU_ADDRESS 0x7fc20d FORMAT "%3.0" /end MEASUREMENT
/begin MEASUREMENT fmy_ram_dyn[3].dtc_cod "" UWORD _CNV_A_R_LINEAR_____0_CM 1 0. 0. 65535. DISPLAY_IDENTIFIER FMY_3_DTC_COD ECU_ADDRESS 0x7fc20e BYTE_ORDER MSB_LAST FORMAT "%6.0" /end MEASUREMENT
/begin MEASUREMENT fmy_ram_dyn[3].ctr_frc "Frequency counter of failure N" UBYTE _CNV_A_R_LINEAR_____0_CM 1 0. 0. 255. DISPLAY_IDENTIFIER FMY_3_CTR_FRC ECU_ADDRESS 0x7fc214 FORMAT "%3.0" /end MEASUREMENT
/begin MEASUREMENT fmy_ram_dyn[3].ctr_wup_cyc "Counter for warm-up cycle" UBYTE _CNV_A_R_LINEAR_____0_CM 1 0. 0. 255. DISPLAY_IDENTIFIER FMY_3_CTR_WUP_CYC ECU_ADDRESS 0x7fc215 FORMAT "%3.0" /end MEASUREMENT
/begin MEASUREMENT fmy_ram_dyn[3].ctr_dc "Counter for driving cycle" UBYTE _CNV_A_R_LINEAR_____0_CM 1 0. 0. 255. DISPLAY_IDENTIFIER FMY_3_CTR_DC ECU_ADDRESS 0x7fc216 FORMAT "%3.0" /end MEASUREMENT
/begin MEASUREMENT fmy_ram_dyn[3].diag_inst "" UWORD _CNV_S_180_CONV_DIAG__21_CM 1 0. 0. 179. DISPLAY_IDENTIFIER FMY_3_DIAG_INST ECU_ADDRESS 0x7fc210 BYTE_ORDER MSB_LAST /end MEASUREMENT
/begin MEASUREMENT fmy_ram_dyn[3].idx_frf "" UBYTE _CNV_A_R_ZYL_ID_2_CM 1 0. 1. 256. DISPLAY_IDENTIFIER FMY_3_IDX_FRF ECU_ADDRESS 0x7fc217 FORMAT "%3.0" /end MEASUREMENT
/begin MEASUREMENT fmy_ram_dyn[3].err_info_dyn.lv_err_mkd "" UWORD _CNV_S_2_RANGE______11_CM 1 0. 0. 1. DISPLAY_IDENTIFIER FMY_3_LV_ERR_MKD ECU_ADDRESS 0x7fc212 BYTE_ORDER MSB_LAST BIT_MASK 0x200 /end MEASUREMENT
/begin MEASUREMENT fmy_ram_dyn[3].err_info_dyn.lv_dc_max "" UWORD _CNV_S_2_RANGE______11_CM 1 0. 0. 1. DISPLAY_IDENTIFIER FMY_3_LV_DC_MAX ECU_ADDRESS 0x7fc212 BYTE_ORDER MSB_LAST BIT_MASK 0x100 /end MEASUREMENT
/begin MEASUREMENT fmy_ram_dyn[3].err_info_dyn.lv_err_disa "" UWORD _CNV_S_2_RANGE______11_CM 1 0. 0. 1. DISPLAY_IDENTIFIER FMY_3_LV_ERR_DISA ECU_ADDRESS 0x7fc212 BYTE_ORDER MSB_LAST BIT_MASK 0x80 /end MEASUREMENT
/begin MEASUREMENT fmy_ram_dyn[3].err_info_dyn.lv_err_cfm "" UWORD _CNV_S_2_RANGE______11_CM 1 0. 0. 1. DISPLAY_IDENTIFIER FMY_3_LV_ERR_CFM ECU_ADDRESS 0x7fc212 BYTE_ORDER MSB_LAST BIT_MASK 0x40 /end MEASUREMENT
/begin MEASUREMENT fmy_ram_dyn[3].err_info_dyn.lv_err_tmp "" UWORD _CNV_S_2_RANGE______11_CM 1 0. 0. 1. DISPLAY_IDENTIFIER FMY_3_LV_ERR_TMP ECU_ADDRESS 0x7fc212 BYTE_ORDER MSB_LAST BIT_MASK 0x20 /end MEASUREMENT
/begin MEASUREMENT fmy_ram_dyn[3].err_info_dyn.lv_err_dc "" UWORD _CNV_S_2_RANGE______11_CM 1 0. 0. 1. DISPLAY_IDENTIFIER FMY_3_LV_ERR_DC ECU_ADDRESS 0x7fc212 BYTE_ORDER MSB_LAST BIT_MASK 0x10 /end MEASUREMENT
/begin MEASUREMENT fmy_ram_dyn[3].err_info_dyn.err_sym_mem "" UWORD _CNV_S_6_CONV_ERRM__22_CM 1 0. 0. 15. DISPLAY_IDENTIFIER FMY_3_ERR_SYM_MEM ECU_ADDRESS 0x7fc212 BYTE_ORDER MSB_LAST BIT_MASK 0xF /end MEASUREMENT
/begin MEASUREMENT fmy_ram_dyn[3].err_info_dyn.err_sym_lst "" UWORD _CNV_S_6_CONV_ERRM__22_CM 1 0. 0. 15. DISPLAY_IDENTIFIER FMY_3_ERR_SYM_LST ECU_ADDRESS 0x7fc212 BYTE_ORDER MSB_LAST BIT_MASK 0x7800 /end MEASUREMENT
/begin MEASUREMENT fmy_ram_dyn[3].err_info_dyn.lv_err_pnd "" UWORD _CNV_S_2_RANGE______11_CM 1 0. 0. 1. DISPLAY_IDENTIFIER FMY_3_LV_ERR_PND ECU_ADDRESS 0x7fc212 BYTE_ORDER MSB_LAST BIT_MASK 0x400 /end MEASUREMENT
/begin MEASUREMENT fmy_ram_dyn[3].err_info_dyn.lv_cdn_diag_dc "This flag permits to detect that diag conditions have been met during drinving cycle." UWORD _CNV_S_2_RANGE______11_CM 1 0. 0. 1. DISPLAY_IDENTIFIER FMY_3_LV_CDN_DIAG_DC ECU_ADDRESS 0x7fc212 BYTE_ORDER MSB_LAST BIT_MASK 0x8000 /end MEASUREMENT
/begin MEASUREMENT fmy_ram_dyn[3].ctr_dc_err_det "Number of driving cycles since DTC detection" UBYTE _CNV_A_R_LINEAR_____1_CM 1 0. 0. 255. DISPLAY_IDENTIFIER FMY_3_CTR_DC_ERR_DET ECU_ADDRESS 0x7fc218 FORMAT "%3.0" /end MEASUREMENT
/begin MEASUREMENT fmy_ram_dyn[3].ctr_dc_err_det_diag_cdn "Number of driving cycles since DTC detection with diag started within these driving cycle." UBYTE _CNV_A_R_LINEAR_____1_CM 1 0. 0. 255. DISPLAY_IDENTIFIER FMY_3_CTR_DC_ERR_DET_DIAG_CDN ECU_ADDRESS 0x7fc219 FORMAT "%3.0" /end MEASUREMENT
/begin MEASUREMENT fmy_ram_dyn[3].ctr_dc_err_det_diag_cmpl "Number of driving cycles since DTC detection with diag completed during these driving cycles." UBYTE _CNV_A_R_LINEAR_____1_CM 1 0. 0. 255. DISPLAY_IDENTIFIER FMY_3_CTR_DC_ERR_DET_DIAG_CMPL ECU_ADDRESS 0x7fc21a FORMAT "%3.0" /end MEASUREMENT
/begin MEASUREMENT fmy_ram_dyn[3].ctr_wup_act_mil "Number of warm-up cycles +1 since MIL activation for this failure" UBYTE _CNV_A_R_LINEAR_____1_CM 1 0. 0. 255. DISPLAY_IDENTIFIER FMY_3_CTR_WUP_ACT_MIL ECU_ADDRESS 0x7fc21b FORMAT "%3.0" /end MEASUREMENT
/begin MEASUREMENT fmy_ram_dyn[4].dtc_cod "" UWORD _CNV_A_R_LINEAR_____0_CM 1 0. 0. 65535. DISPLAY_IDENTIFIER FMY_4_DTC_COD ECU_ADDRESS 0x7fc21c BYTE_ORDER MSB_LAST FORMAT "%6.0" /end MEASUREMENT
/begin MEASUREMENT fmy_ram_dyn[4].ctr_frc "Frequency counter of failure N" UBYTE _CNV_A_R_LINEAR_____0_CM 1 0. 0. 255. DISPLAY_IDENTIFIER FMY_4_CTR_FRC ECU_ADDRESS 0x7fc222 FORMAT "%3.0" /end MEASUREMENT
/begin MEASUREMENT fmy_ram_dyn[4].ctr_wup_cyc "Counter for warm-up cycle" UBYTE _CNV_A_R_LINEAR_____0_CM 1 0. 0. 255. DISPLAY_IDENTIFIER FMY_4_CTR_WUP_CYC ECU_ADDRESS 0x7fc223 FORMAT "%3.0" /end MEASUREMENT
/begin MEASUREMENT fmy_ram_dyn[4].ctr_dc "Counter for driving cycle" UBYTE _CNV_A_R_LINEAR_____0_CM 1 0. 0. 255. DISPLAY_IDENTIFIER FMY_4_CTR_DC ECU_ADDRESS 0x7fc224 FORMAT "%3.0" /end MEASUREMENT
/begin MEASUREMENT fmy_ram_dyn[4].diag_inst "" UWORD _CNV_S_180_CONV_DIAG__21_CM 1 0. 0. 179. DISPLAY_IDENTIFIER FMY_4_DIAG_INST ECU_ADDRESS 0x7fc21e BYTE_ORDER MSB_LAST /end MEASUREMENT
/begin MEASUREMENT fmy_ram_dyn[4].idx_frf "" UBYTE _CNV_A_R_ZYL_ID_2_CM 1 0. 1. 256. DISPLAY_IDENTIFIER FMY_4_IDX_FRF ECU_ADDRESS 0x7fc225 FORMAT "%3.0" /end MEASUREMENT
/begin MEASUREMENT fmy_ram_dyn[4].err_info_dyn.lv_err_mkd "" UWORD _CNV_S_2_RANGE______11_CM 1 0. 0. 1. DISPLAY_IDENTIFIER FMY_4_LV_ERR_MKD ECU_ADDRESS 0x7fc220 BYTE_ORDER MSB_LAST BIT_MASK 0x200 /end MEASUREMENT
/begin MEASUREMENT fmy_ram_dyn[4].err_info_dyn.lv_dc_max "" UWORD _CNV_S_2_RANGE______11_CM 1 0. 0. 1. DISPLAY_IDENTIFIER FMY_4_LV_DC_MAX ECU_ADDRESS 0x7fc220 BYTE_ORDER MSB_LAST BIT_MASK 0x100 /end MEASUREMENT
/begin MEASUREMENT fmy_ram_dyn[4].err_info_dyn.lv_err_disa "" UWORD _CNV_S_2_RANGE______11_CM 1 0. 0. 1. DISPLAY_IDENTIFIER FMY_4_LV_ERR_DISA ECU_ADDRESS 0x7fc220 BYTE_ORDER MSB_LAST BIT_MASK 0x80 /end MEASUREMENT
/begin MEASUREMENT fmy_ram_dyn[4].err_info_dyn.lv_err_cfm "" UWORD _CNV_S_2_RANGE______11_CM 1 0. 0. 1. DISPLAY_IDENTIFIER FMY_4_LV_ERR_CFM ECU_ADDRESS 0x7fc220 BYTE_ORDER MSB_LAST BIT_MASK 0x40 /end MEASUREMENT
/begin MEASUREMENT fmy_ram_dyn[4].err_info_dyn.lv_err_tmp "" UWORD _CNV_S_2_RANGE______11_CM 1 0. 0. 1. DISPLAY_IDENTIFIER FMY_4_LV_ERR_TMP ECU_ADDRESS 0x7fc220 BYTE_ORDER MSB_LAST BIT_MASK 0x20 /end MEASUREMENT
/begin MEASUREMENT fmy_ram_dyn[4].err_info_dyn.lv_err_dc "" UWORD _CNV_S_2_RANGE______11_CM 1 0. 0. 1. DISPLAY_IDENTIFIER FMY_4_LV_ERR_DC ECU_ADDRESS 0x7fc220 BYTE_ORDER MSB_LAST BIT_MASK 0x10 /end MEASUREMENT
/begin MEASUREMENT fmy_ram_dyn[4].err_info_dyn.err_sym_mem "" UWORD _CNV_S_6_CONV_ERRM__22_CM 1 0. 0. 15. DISPLAY_IDENTIFIER FMY_4_ERR_SYM_MEM ECU_ADDRESS 0x7fc220 BYTE_ORDER MSB_LAST BIT_MASK 0xF /end MEASUREMENT
/begin MEASUREMENT fmy_ram_dyn[4].err_info_dyn.err_sym_lst "" UWORD _CNV_S_6_CONV_ERRM__22_CM 1 0. 0. 15. DISPLAY_IDENTIFIER FMY_4_ERR_SYM_LST ECU_ADDRESS 0x7fc220 BYTE_ORDER MSB_LAST BIT_MASK 0x7800 /end MEASUREMENT
/begin MEASUREMENT fmy_ram_dyn[4].err_info_dyn.lv_err_pnd "" UWORD _CNV_S_2_RANGE______11_CM 1 0. 0. 1. DISPLAY_IDENTIFIER FMY_4_LV_ERR_PND ECU_ADDRESS 0x7fc220 BYTE_ORDER MSB_LAST BIT_MASK 0x400 /end MEASUREMENT
/begin MEASUREMENT fmy_ram_dyn[4].err_info_dyn.lv_cdn_diag_dc "This flag permits to detect that diag conditions have been met during drinving cycle." UWORD _CNV_S_2_RANGE______11_CM 1 0. 0. 1. DISPLAY_IDENTIFIER FMY_4_LV_CDN_DIAG_DC ECU_ADDRESS 0x7fc220 BYTE_ORDER MSB_LAST BIT_MASK 0x8000 /end MEASUREMENT
/begin MEASUREMENT fmy_ram_dyn[4].ctr_dc_err_det "Number of driving cycles since DTC detection" UBYTE _CNV_A_R_LINEAR_____1_CM 1 0. 0. 255. DISPLAY_IDENTIFIER FMY_4_CTR_DC_ERR_DET ECU_ADDRESS 0x7fc226 FORMAT "%3.0" /end MEASUREMENT
/begin MEASUREMENT fmy_ram_dyn[4].ctr_dc_err_det_diag_cdn "Number of driving cycles since DTC detection with diag started within these driving cycle." UBYTE _CNV_A_R_LINEAR_____1_CM 1 0. 0. 255. DISPLAY_IDENTIFIER FMY_4_CTR_DC_ERR_DET_DIAG_CDN ECU_ADDRESS 0x7fc227 FORMAT "%3.0" /end MEASUREMENT
/begin MEASUREMENT fmy_ram_dyn[4].ctr_dc_err_det_diag_cmpl "Number of driving cycles since DTC detection with diag completed during these driving cycles." UBYTE _CNV_A_R_LINEAR_____1_CM 1 0. 0. 255. DISPLAY_IDENTIFIER FMY_4_CTR_DC_ERR_DET_DIAG_CMPL ECU_ADDRESS 0x7fc228 FORMAT "%3.0" /end MEASUREMENT
/begin MEASUREMENT fmy_ram_dyn[4].ctr_wup_act_mil "Number of warm-up cycles +1 since MIL activation for this failure" UBYTE _CNV_A_R_LINEAR_____1_CM 1 0. 0. 255. DISPLAY_IDENTIFIER FMY_4_CTR_WUP_ACT_MIL ECU_ADDRESS 0x7fc229 FORMAT "%3.0" /end MEASUREMENT
/begin MEASUREMENT fmy_ram_dyn[5].dtc_cod "" UWORD _CNV_A_R_LINEAR_____0_CM 1 0. 0. 65535. DISPLAY_IDENTIFIER FMY_5_DTC_COD ECU_ADDRESS 0x7fc22a BYTE_ORDER MSB_LAST FORMAT "%6.0" /end MEASUREMENT
/begin MEASUREMENT fmy_ram_dyn[5].ctr_frc "Frequency counter of failure N" UBYTE _CNV_A_R_LINEAR_____0_CM 1 0. 0. 255. DISPLAY_IDENTIFIER FMY_5_CTR_FRC ECU_ADDRESS 0x7fc230 FORMAT "%3.0" /end MEASUREMENT
/begin MEASUREMENT fmy_ram_dyn[5].ctr_wup_cyc "Counter for warm-up cycle" UBYTE _CNV_A_R_LINEAR_____0_CM 1 0. 0. 255. DISPLAY_IDENTIFIER FMY_5_CTR_WUP_CYC ECU_ADDRESS 0x7fc231 FORMAT "%3.0" /end MEASUREMENT
/begin MEASUREMENT fmy_ram_dyn[5].ctr_dc "Counter for driving cycle" UBYTE _CNV_A_R_LINEAR_____0_CM 1 0. 0. 255. DISPLAY_IDENTIFIER FMY_5_CTR_DC ECU_ADDRESS 0x7fc232 FORMAT "%3.0" /end MEASUREMENT
/begin MEASUREMENT fmy_ram_dyn[5].diag_inst "" UWORD _CNV_S_180_CONV_DIAG__21_CM 1 0. 0. 179. DISPLAY_IDENTIFIER FMY_5_DIAG_INST ECU_ADDRESS 0x7fc22c BYTE_ORDER MSB_LAST /end MEASUREMENT
/begin MEASUREMENT fmy_ram_dyn[5].idx_frf "" UBYTE _CNV_A_R_ZYL_ID_2_CM 1 0. 1. 256. DISPLAY_IDENTIFIER FMY_5_IDX_FRF ECU_ADDRESS 0x7fc233 FORMAT "%3.0" /end MEASUREMENT
/begin MEASUREMENT fmy_ram_dyn[5].err_info_dyn.lv_err_mkd "" UWORD _CNV_S_2_RANGE______11_CM 1 0. 0. 1. DISPLAY_IDENTIFIER FMY_5_LV_ERR_MKD ECU_ADDRESS 0x7fc22e BYTE_ORDER MSB_LAST BIT_MASK 0x200 /end MEASUREMENT
/begin MEASUREMENT fmy_ram_dyn[5].err_info_dyn.lv_dc_max "" UWORD _CNV_S_2_RANGE______11_CM 1 0. 0. 1. DISPLAY_IDENTIFIER FMY_5_LV_DC_MAX ECU_ADDRESS 0x7fc22e BYTE_ORDER MSB_LAST BIT_MASK 0x100 /end MEASUREMENT
/begin MEASUREMENT fmy_ram_dyn[5].err_info_dyn.lv_err_disa "" UWORD _CNV_S_2_RANGE______11_CM 1 0. 0. 1. DISPLAY_IDENTIFIER FMY_5_LV_ERR_DISA ECU_ADDRESS 0x7fc22e BYTE_ORDER MSB_LAST BIT_MASK 0x80 /end MEASUREMENT
/begin MEASUREMENT fmy_ram_dyn[5].err_info_dyn.lv_err_cfm "" UWORD _CNV_S_2_RANGE______11_CM 1 0. 0. 1. DISPLAY_IDENTIFIER FMY_5_LV_ERR_CFM ECU_ADDRESS 0x7fc22e BYTE_ORDER MSB_LAST BIT_MASK 0x40 /end MEASUREMENT
/begin MEASUREMENT fmy_ram_dyn[5].err_info_dyn.lv_err_tmp "" UWORD _CNV_S_2_RANGE______11_CM 1 0. 0. 1. DISPLAY_IDENTIFIER FMY_5_LV_ERR_TMP ECU_ADDRESS 0x7fc22e BYTE_ORDER MSB_LAST BIT_MASK 0x20 /end MEASUREMENT
/begin MEASUREMENT fmy_ram_dyn[5].err_info_dyn.lv_err_dc "" UWORD _CNV_S_2_RANGE______11_CM 1 0. 0. 1. DISPLAY_IDENTIFIER FMY_5_LV_ERR_DC ECU_ADDRESS 0x7fc22e BYTE_ORDER MSB_LAST BIT_MASK 0x10 /end MEASUREMENT
/begin MEASUREMENT fmy_ram_dyn[5].err_info_dyn.err_sym_mem "" UWORD _CNV_S_6_CONV_ERRM__22_CM 1 0. 0. 15. DISPLAY_IDENTIFIER FMY_5_ERR_SYM_MEM ECU_ADDRESS 0x7fc22e BYTE_ORDER MSB_LAST BIT_MASK 0xF /end MEASUREMENT
/begin MEASUREMENT fmy_ram_dyn[5].err_info_dyn.err_sym_lst "" UWORD _CNV_S_6_CONV_ERRM__22_CM 1 0. 0. 15. DISPLAY_IDENTIFIER FMY_5_ERR_SYM_LST ECU_ADDRESS 0x7fc22e BYTE_ORDER MSB_LAST BIT_MASK 0x7800 /end MEASUREMENT
/begin MEASUREMENT fmy_ram_dyn[5].err_info_dyn.lv_err_pnd "" UWORD _CNV_S_2_RANGE______11_CM 1 0. 0. 1. DISPLAY_IDENTIFIER FMY_5_LV_ERR_PND ECU_ADDRESS 0x7fc22e BYTE_ORDER MSB_LAST BIT_MASK 0x400 /end MEASUREMENT
/begin MEASUREMENT fmy_ram_dyn[5].err_info_dyn.lv_cdn_diag_dc "This flag permits to detect that diag conditions have been met during drinving cycle." UWORD _CNV_S_2_RANGE______11_CM 1 0. 0. 1. DISPLAY_IDENTIFIER FMY_5_LV_CDN_DIAG_DC ECU_ADDRESS 0x7fc22e BYTE_ORDER MSB_LAST BIT_MASK 0x8000 /end MEASUREMENT
/begin MEASUREMENT fmy_ram_dyn[5].ctr_dc_err_det "Number of driving cycles since DTC detection" UBYTE _CNV_A_R_LINEAR_____1_CM 1 0. 0. 255. DISPLAY_IDENTIFIER FMY_5_CTR_DC_ERR_DET ECU_ADDRESS 0x7fc234 FORMAT "%3.0" /end MEASUREMENT
/begin MEASUREMENT fmy_ram_dyn[5].ctr_dc_err_det_diag_cdn "Number of driving cycles since DTC detection with diag started within these driving cycle." UBYTE _CNV_A_R_LINEAR_____1_CM 1 0. 0. 255. DISPLAY_IDENTIFIER FMY_5_CTR_DC_ERR_DET_DIAG_CDN ECU_ADDRESS 0x7fc235 FORMAT "%3.0" /end MEASUREMENT
/begin MEASUREMENT fmy_ram_dyn[5].ctr_dc_err_det_diag_cmpl "Number of driving cycles since DTC detection with diag completed during these driving cycles." UBYTE _CNV_A_R_LINEAR_____1_CM 1 0. 0. 255. DISPLAY_IDENTIFIER FMY_5_CTR_DC_ERR_DET_DIAG_CMPL ECU_ADDRESS 0x7fc236 FORMAT "%3.0" /end MEASUREMENT
/begin MEASUREMENT fmy_ram_dyn[5].ctr_wup_act_mil "Number of warm-up cycles +1 since MIL activation for this failure" UBYTE _CNV_A_R_LINEAR_____1_CM 1 0. 0. 255. DISPLAY_IDENTIFIER FMY_5_CTR_WUP_ACT_MIL ECU_ADDRESS 0x7fc237 FORMAT "%3.0" /end MEASUREMENT
/begin MEASUREMENT fmy_ram_dyn[6].dtc_cod "" UWORD _CNV_A_R_LINEAR_____0_CM 1 0. 0. 65535. DISPLAY_IDENTIFIER FMY_6_DTC_COD ECU_ADDRESS 0x7fc238 BYTE_ORDER MSB_LAST FORMAT "%6.0" /end MEASUREMENT
/begin MEASUREMENT fmy_ram_dyn[6].ctr_frc "Frequency counter of failure N" UBYTE _CNV_A_R_LINEAR_____0_CM 1 0. 0. 255. DISPLAY_IDENTIFIER FMY_6_CTR_FRC ECU_ADDRESS 0x7fc23e FORMAT "%3.0" /end MEASUREMENT
/begin MEASUREMENT fmy_ram_dyn[6].ctr_wup_cyc "Counter for warm-up cycle" UBYTE _CNV_A_R_LINEAR_____0_CM 1 0. 0. 255. DISPLAY_IDENTIFIER FMY_6_CTR_WUP_CYC ECU_ADDRESS 0x7fc23f FORMAT "%3.0" /end MEASUREMENT
/begin MEASUREMENT fmy_ram_dyn[6].ctr_dc "Counter for driving cycle" UBYTE _CNV_A_R_LINEAR_____0_CM 1 0. 0. 255. DISPLAY_IDENTIFIER FMY_6_CTR_DC ECU_ADDRESS 0x7fc240 FORMAT "%3.0" /end MEASUREMENT
/begin MEASUREMENT fmy_ram_dyn[6].diag_inst "" UWORD _CNV_S_180_CONV_DIAG__21_CM 1 0. 0. 179. DISPLAY_IDENTIFIER FMY_6_DIAG_INST ECU_ADDRESS 0x7fc23a BYTE_ORDER MSB_LAST /end MEASUREMENT
/begin MEASUREMENT fmy_ram_dyn[6].idx_frf "" UBYTE _CNV_A_R_ZYL_ID_2_CM 1 0. 1. 256. DISPLAY_IDENTIFIER FMY_6_IDX_FRF ECU_ADDRESS 0x7fc241 FORMAT "%3.0" /end MEASUREMENT
/begin MEASUREMENT fmy_ram_dyn[6].err_info_dyn.lv_err_mkd "" UWORD _CNV_S_2_RANGE______11_CM 1 0. 0. 1. DISPLAY_IDENTIFIER FMY_6_LV_ERR_MKD ECU_ADDRESS 0x7fc23c BYTE_ORDER MSB_LAST BIT_MASK 0x200 /end MEASUREMENT
/begin MEASUREMENT fmy_ram_dyn[6].err_info_dyn.lv_dc_max "" UWORD _CNV_S_2_RANGE______11_CM 1 0. 0. 1. DISPLAY_IDENTIFIER FMY_6_LV_DC_MAX ECU_ADDRESS 0x7fc23c BYTE_ORDER MSB_LAST BIT_MASK 0x100 /end MEASUREMENT
/begin MEASUREMENT fmy_ram_dyn[6].err_info_dyn.lv_err_disa "" UWORD _CNV_S_2_RANGE______11_CM 1 0. 0. 1. DISPLAY_IDENTIFIER FMY_6_LV_ERR_DISA ECU_ADDRESS 0x7fc23c BYTE_ORDER MSB_LAST BIT_MASK 0x80 /end MEASUREMENT
/begin MEASUREMENT fmy_ram_dyn[6].err_info_dyn.lv_err_cfm "" UWORD _CNV_S_2_RANGE______11_CM 1 0. 0. 1. DISPLAY_IDENTIFIER FMY_6_LV_ERR_CFM ECU_ADDRESS 0x7fc23c BYTE_ORDER MSB_LAST BIT_MASK 0x40 /end MEASUREMENT
/begin MEASUREMENT fmy_ram_dyn[6].err_info_dyn.lv_err_tmp "" UWORD _CNV_S_2_RANGE______11_CM 1 0. 0. 1. DISPLAY_IDENTIFIER FMY_6_LV_ERR_TMP ECU_ADDRESS 0x7fc23c BYTE_ORDER MSB_LAST BIT_MASK 0x20 /end MEASUREMENT
/begin MEASUREMENT fmy_ram_dyn[6].err_info_dyn.lv_err_dc "" UWORD _CNV_S_2_RANGE______11_CM 1 0. 0. 1. DISPLAY_IDENTIFIER FMY_6_LV_ERR_DC ECU_ADDRESS 0x7fc23c BYTE_ORDER MSB_LAST BIT_MASK 0x10 /end MEASUREMENT
/begin MEASUREMENT fmy_ram_dyn[6].err_info_dyn.err_sym_mem "" UWORD _CNV_S_6_CONV_ERRM__22_CM 1 0. 0. 15. DISPLAY_IDENTIFIER FMY_6_ERR_SYM_MEM ECU_ADDRESS 0x7fc23c BYTE_ORDER MSB_LAST BIT_MASK 0xF /end MEASUREMENT
/begin MEASUREMENT fmy_ram_dyn[6].err_info_dyn.err_sym_lst "" UWORD _CNV_S_6_CONV_ERRM__22_CM 1 0. 0. 15. DISPLAY_IDENTIFIER FMY_6_ERR_SYM_LST ECU_ADDRESS 0x7fc23c BYTE_ORDER MSB_LAST BIT_MASK 0x7800 /end MEASUREMENT
/begin MEASUREMENT fmy_ram_dyn[6].err_info_dyn.lv_err_pnd "" UWORD _CNV_S_2_RANGE______11_CM 1 0. 0. 1. DISPLAY_IDENTIFIER FMY_6_LV_ERR_PND ECU_ADDRESS 0x7fc23c BYTE_ORDER MSB_LAST BIT_MASK 0x400 /end MEASUREMENT
/begin MEASUREMENT fmy_ram_dyn[6].err_info_dyn.lv_cdn_diag_dc "This flag permits to detect that diag conditions have been met during drinving cycle." UWORD _CNV_S_2_RANGE______11_CM 1 0. 0. 1. DISPLAY_IDENTIFIER FMY_6_LV_CDN_DIAG_DC ECU_ADDRESS 0x7fc23c BYTE_ORDER MSB_LAST BIT_MASK 0x8000 /end MEASUREMENT
/begin MEASUREMENT fmy_ram_dyn[6].ctr_dc_err_det "Number of driving cycles since DTC detection" UBYTE _CNV_A_R_LINEAR_____1_CM 1 0. 0. 255. DISPLAY_IDENTIFIER FMY_6_CTR_DC_ERR_DET ECU_ADDRESS 0x7fc242 FORMAT "%3.0" /end MEASUREMENT
/begin MEASUREMENT fmy_ram_dyn[6].ctr_dc_err_det_diag_cdn "Number of driving cycles since DTC detection with diag started within these driving cycle." UBYTE _CNV_A_R_LINEAR_____1_CM 1 0. 0. 255. DISPLAY_IDENTIFIER FMY_6_CTR_DC_ERR_DET_DIAG_CDN ECU_ADDRESS 0x7fc243 FORMAT "%3.0" /end MEASUREMENT
/begin MEASUREMENT fmy_ram_dyn[6].ctr_dc_err_det_diag_cmpl "Number of driving cycles since DTC detection with diag completed during these driving cycles." UBYTE _CNV_A_R_LINEAR_____1_CM 1 0. 0. 255. DISPLAY_IDENTIFIER FMY_6_CTR_DC_ERR_DET_DIAG_CMPL ECU_ADDRESS 0x7fc244 FORMAT "%3.0" /end MEASUREMENT
/begin MEASUREMENT fmy_ram_dyn[6].ctr_wup_act_mil "Number of warm-up cycles +1 since MIL activation for this failure" UBYTE _CNV_A_R_LINEAR_____1_CM 1 0. 0. 255. DISPLAY_IDENTIFIER FMY_6_CTR_WUP_ACT_MIL ECU_ADDRESS 0x7fc245 FORMAT "%3.0" /end MEASUREMENT
/begin MEASUREMENT fmy_ram_dyn[7].dtc_cod "" UWORD _CNV_A_R_LINEAR_____0_CM 1 0. 0. 65535. DISPLAY_IDENTIFIER FMY_7_DTC_COD ECU_ADDRESS 0x7fc246 BYTE_ORDER MSB_LAST FORMAT "%6.0" /end MEASUREMENT
/begin MEASUREMENT fmy_ram_dyn[7].ctr_frc "Frequency counter of failure N" UBYTE _CNV_A_R_LINEAR_____0_CM 1 0. 0. 255. DISPLAY_IDENTIFIER FMY_7_CTR_FRC ECU_ADDRESS 0x7fc24c FORMAT "%3.0" /end MEASUREMENT
/begin MEASUREMENT fmy_ram_dyn[7].ctr_wup_cyc "Counter for warm-up cycle" UBYTE _CNV_A_R_LINEAR_____0_CM 1 0. 0. 255. DISPLAY_IDENTIFIER FMY_7_CTR_WUP_CYC ECU_ADDRESS 0x7fc24d FORMAT "%3.0" /end MEASUREMENT
/begin MEASUREMENT fmy_ram_dyn[7].ctr_dc "Counter for driving cycle" UBYTE _CNV_A_R_LINEAR_____0_CM 1 0. 0. 255. DISPLAY_IDENTIFIER FMY_7_CTR_DC ECU_ADDRESS 0x7fc24e FORMAT "%3.0" /end MEASUREMENT
/begin MEASUREMENT fmy_ram_dyn[7].diag_inst "" UWORD _CNV_S_180_CONV_DIAG__21_CM 1 0. 0. 179. DISPLAY_IDENTIFIER FMY_7_DIAG_INST ECU_ADDRESS 0x7fc248 BYTE_ORDER MSB_LAST /end MEASUREMENT
/begin MEASUREMENT fmy_ram_dyn[7].idx_frf "" UBYTE _CNV_A_R_ZYL_ID_2_CM 1 0. 1. 256. DISPLAY_IDENTIFIER FMY_7_IDX_FRF ECU_ADDRESS 0x7fc24f FORMAT "%3.0" /end MEASUREMENT
/begin MEASUREMENT fmy_ram_dyn[7].err_info_dyn.lv_err_mkd "" UWORD _CNV_S_2_RANGE______11_CM 1 0. 0. 1. DISPLAY_IDENTIFIER FMY_7_LV_ERR_MKD ECU_ADDRESS 0x7fc24a BYTE_ORDER MSB_LAST BIT_MASK 0x200 /end MEASUREMENT
/begin MEASUREMENT fmy_ram_dyn[7].err_info_dyn.lv_dc_max "" UWORD _CNV_S_2_RANGE______11_CM 1 0. 0. 1. DISPLAY_IDENTIFIER FMY_7_LV_DC_MAX ECU_ADDRESS 0x7fc24a BYTE_ORDER MSB_LAST BIT_MASK 0x100 /end MEASUREMENT
/begin MEASUREMENT fmy_ram_dyn[7].err_info_dyn.lv_err_disa "" UWORD _CNV_S_2_RANGE______11_CM 1 0. 0. 1. DISPLAY_IDENTIFIER FMY_7_LV_ERR_DISA ECU_ADDRESS 0x7fc24a BYTE_ORDER MSB_LAST BIT_MASK 0x80 /end MEASUREMENT
/begin MEASUREMENT fmy_ram_dyn[7].err_info_dyn.lv_err_cfm "" UWORD _CNV_S_2_RANGE______11_CM 1 0. 0. 1. DISPLAY_IDENTIFIER FMY_7_LV_ERR_CFM ECU_ADDRESS 0x7fc24a BYTE_ORDER MSB_LAST BIT_MASK 0x40 /end MEASUREMENT
/begin MEASUREMENT fmy_ram_dyn[7].err_info_dyn.lv_err_tmp "" UWORD _CNV_S_2_RANGE______11_CM 1 0. 0. 1. DISPLAY_IDENTIFIER FMY_7_LV_ERR_TMP ECU_ADDRESS 0x7fc24a BYTE_ORDER MSB_LAST BIT_MASK 0x20 /end MEASUREMENT
/begin MEASUREMENT fmy_ram_dyn[7].err_info_dyn.lv_err_dc "" UWORD _CNV_S_2_RANGE______11_CM 1 0. 0. 1. DISPLAY_IDENTIFIER FMY_7_LV_ERR_DC ECU_ADDRESS 0x7fc24a BYTE_ORDER MSB_LAST BIT_MASK 0x10 /end MEASUREMENT
/begin MEASUREMENT fmy_ram_dyn[7].err_info_dyn.err_sym_mem "" UWORD _CNV_S_6_CONV_ERRM__22_CM 1 0. 0. 15. DISPLAY_IDENTIFIER FMY_7_ERR_SYM_MEM ECU_ADDRESS 0x7fc24a BYTE_ORDER MSB_LAST BIT_MASK 0xF /end MEASUREMENT
/begin MEASUREMENT fmy_ram_dyn[7].err_info_dyn.err_sym_lst "" UWORD _CNV_S_6_CONV_ERRM__22_CM 1 0. 0. 15. DISPLAY_IDENTIFIER FMY_7_ERR_SYM_LST ECU_ADDRESS 0x7fc24a BYTE_ORDER MSB_LAST BIT_MASK 0x7800 /end MEASUREMENT
/begin MEASUREMENT fmy_ram_dyn[7].err_info_dyn.lv_err_pnd "" UWORD _CNV_S_2_RANGE______11_CM 1 0. 0. 1. DISPLAY_IDENTIFIER FMY_7_LV_ERR_PND ECU_ADDRESS 0x7fc24a BYTE_ORDER MSB_LAST BIT_MASK 0x400 /end MEASUREMENT
/begin MEASUREMENT fmy_ram_dyn[7].err_info_dyn.lv_cdn_diag_dc "This flag permits to detect that diag conditions have been met during drinving cycle." UWORD _CNV_S_2_RANGE______11_CM 1 0. 0. 1. DISPLAY_IDENTIFIER FMY_7_LV_CDN_DIAG_DC ECU_ADDRESS 0x7fc24a BYTE_ORDER MSB_LAST BIT_MASK 0x8000 /end MEASUREMENT
/begin MEASUREMENT fmy_ram_dyn[7].ctr_dc_err_det "Number of driving cycles since DTC detection" UBYTE _CNV_A_R_LINEAR_____1_CM 1 0. 0. 255. DISPLAY_IDENTIFIER FMY_7_CTR_DC_ERR_DET ECU_ADDRESS 0x7fc250 FORMAT "%3.0" /end MEASUREMENT
/begin MEASUREMENT fmy_ram_dyn[7].ctr_dc_err_det_diag_cdn "Number of driving cycles since DTC detection with diag started within these driving cycle." UBYTE _CNV_A_R_LINEAR_____1_CM 1 0. 0. 255. DISPLAY_IDENTIFIER FMY_7_CTR_DC_ERR_DET_DIAG_CDN ECU_ADDRESS 0x7fc251 FORMAT "%3.0" /end MEASUREMENT
/begin MEASUREMENT fmy_ram_dyn[7].ctr_dc_err_det_diag_cmpl "Number of driving cycles since DTC detection with diag completed during these driving cycles." UBYTE _CNV_A_R_LINEAR_____1_CM 1 0. 0. 255. DISPLAY_IDENTIFIER FMY_7_CTR_DC_ERR_DET_DIAG_CMPL ECU_ADDRESS 0x7fc252 FORMAT "%3.0" /end MEASUREMENT
/begin MEASUREMENT fmy_ram_dyn[7].ctr_wup_act_mil "Number of warm-up cycles +1 since MIL activation for this failure" UBYTE _CNV_A_R_LINEAR_____1_CM 1 0. 0. 255. DISPLAY_IDENTIFIER FMY_7_CTR_WUP_ACT_MIL ECU_ADDRESS 0x7fc253 FORMAT "%3.0" /end MEASUREMENT
/begin MEASUREMENT fmy_ram_dyn[8].dtc_cod "" UWORD _CNV_A_R_LINEAR_____0_CM 1 0. 0. 65535. DISPLAY_IDENTIFIER FMY_8_DTC_COD ECU_ADDRESS 0x7fc254 BYTE_ORDER MSB_LAST FORMAT "%6.0" /end MEASUREMENT
/begin MEASUREMENT fmy_ram_dyn[8].ctr_frc "Frequency counter of failure N" UBYTE _CNV_A_R_LINEAR_____0_CM 1 0. 0. 255. DISPLAY_IDENTIFIER FMY_8_CTR_FRC ECU_ADDRESS 0x7fc25a FORMAT "%3.0" /end MEASUREMENT
/begin MEASUREMENT fmy_ram_dyn[8].ctr_wup_cyc "Counter for warm-up cycle" UBYTE _CNV_A_R_LINEAR_____0_CM 1 0. 0. 255. DISPLAY_IDENTIFIER FMY_8_CTR_WUP_CYC ECU_ADDRESS 0x7fc25b FORMAT "%3.0" /end MEASUREMENT
/begin MEASUREMENT fmy_ram_dyn[8].ctr_dc "Counter for driving cycle" UBYTE _CNV_A_R_LINEAR_____0_CM 1 0. 0. 255. DISPLAY_IDENTIFIER FMY_8_CTR_DC ECU_ADDRESS 0x7fc25c FORMAT "%3.0" /end MEASUREMENT
/begin MEASUREMENT fmy_ram_dyn[8].diag_inst "" UWORD _CNV_S_180_CONV_DIAG__21_CM 1 0. 0. 179. DISPLAY_IDENTIFIER FMY_8_DIAG_INST ECU_ADDRESS 0x7fc256 BYTE_ORDER MSB_LAST /end MEASUREMENT
/begin MEASUREMENT fmy_ram_dyn[8].idx_frf "" UBYTE _CNV_A_R_ZYL_ID_2_CM 1 0. 1. 256. DISPLAY_IDENTIFIER FMY_8_IDX_FRF ECU_ADDRESS 0x7fc25d FORMAT "%3.0" /end MEASUREMENT
/begin MEASUREMENT fmy_ram_dyn[8].err_info_dyn.lv_err_mkd "" UWORD _CNV_S_2_RANGE______11_CM 1 0. 0. 1. DISPLAY_IDENTIFIER FMY_8_LV_ERR_MKD ECU_ADDRESS 0x7fc258 BYTE_ORDER MSB_LAST BIT_MASK 0x200 /end MEASUREMENT
/begin MEASUREMENT fmy_ram_dyn[8].err_info_dyn.lv_dc_max "" UWORD _CNV_S_2_RANGE______11_CM 1 0. 0. 1. DISPLAY_IDENTIFIER FMY_8_LV_DC_MAX ECU_ADDRESS 0x7fc258 BYTE_ORDER MSB_LAST BIT_MASK 0x100 /end MEASUREMENT
/begin MEASUREMENT fmy_ram_dyn[8].err_info_dyn.lv_err_disa "" UWORD _CNV_S_2_RANGE______11_CM 1 0. 0. 1. DISPLAY_IDENTIFIER FMY_8_LV_ERR_DISA ECU_ADDRESS 0x7fc258 BYTE_ORDER MSB_LAST BIT_MASK 0x80 /end MEASUREMENT
/begin MEASUREMENT fmy_ram_dyn[8].err_info_dyn.lv_err_cfm "" UWORD _CNV_S_2_RANGE______11_CM 1 0. 0. 1. DISPLAY_IDENTIFIER FMY_8_LV_ERR_CFM ECU_ADDRESS 0x7fc258 BYTE_ORDER MSB_LAST BIT_MASK 0x40 /end MEASUREMENT
/begin MEASUREMENT fmy_ram_dyn[8].err_info_dyn.lv_err_tmp "" UWORD _CNV_S_2_RANGE______11_CM 1 0. 0. 1. DISPLAY_IDENTIFIER FMY_8_LV_ERR_TMP ECU_ADDRESS 0x7fc258 BYTE_ORDER MSB_LAST BIT_MASK 0x20 /end MEASUREMENT
/begin MEASUREMENT fmy_ram_dyn[8].err_info_dyn.lv_err_dc "" UWORD _CNV_S_2_RANGE______11_CM 1 0. 0. 1. DISPLAY_IDENTIFIER FMY_8_LV_ERR_DC ECU_ADDRESS 0x7fc258 BYTE_ORDER MSB_LAST BIT_MASK 0x10 /end MEASUREMENT
/begin MEASUREMENT fmy_ram_dyn[8].err_info_dyn.err_sym_mem "" UWORD _CNV_S_6_CONV_ERRM__22_CM 1 0. 0. 15. DISPLAY_IDENTIFIER FMY_8_ERR_SYM_MEM ECU_ADDRESS 0x7fc258 BYTE_ORDER MSB_LAST BIT_MASK 0xF /end MEASUREMENT
/begin MEASUREMENT fmy_ram_dyn[8].err_info_dyn.err_sym_lst "" UWORD _CNV_S_6_CONV_ERRM__22_CM 1 0. 0. 15. DISPLAY_IDENTIFIER FMY_8_ERR_SYM_LST ECU_ADDRESS 0x7fc258 BYTE_ORDER MSB_LAST BIT_MASK 0x7800 /end MEASUREMENT
/begin MEASUREMENT fmy_ram_dyn[8].err_info_dyn.lv_err_pnd "" UWORD _CNV_S_2_RANGE______11_CM 1 0. 0. 1. DISPLAY_IDENTIFIER FMY_8_LV_ERR_PND ECU_ADDRESS 0x7fc258 BYTE_ORDER MSB_LAST BIT_MASK 0x400 /end MEASUREMENT
/begin MEASUREMENT fmy_ram_dyn[8].err_info_dyn.lv_cdn_diag_dc "This flag permits to detect that diag conditions have been met during drinving cycle." UWORD _CNV_S_2_RANGE______11_CM 1 0. 0. 1. DISPLAY_IDENTIFIER FMY_8_LV_CDN_DIAG_DC ECU_ADDRESS 0x7fc258 BYTE_ORDER MSB_LAST BIT_MASK 0x8000 /end MEASUREMENT
/begin MEASUREMENT fmy_ram_dyn[8].ctr_dc_err_det "Number of driving cycles since DTC detection" UBYTE _CNV_A_R_LINEAR_____1_CM 1 0. 0. 255. DISPLAY_IDENTIFIER FMY_8_CTR_DC_ERR_DET ECU_ADDRESS 0x7fc25e FORMAT "%3.0" /end MEASUREMENT
/begin MEASUREMENT fmy_ram_dyn[8].ctr_dc_err_det_diag_cdn "Number of driving cycles since DTC detection with diag started within these driving cycle." UBYTE _CNV_A_R_LINEAR_____1_CM 1 0. 0. 255. DISPLAY_IDENTIFIER FMY_8_CTR_DC_ERR_DET_DIAG_CDN ECU_ADDRESS 0x7fc25f FORMAT "%3.0" /end MEASUREMENT
/begin MEASUREMENT fmy_ram_dyn[8].ctr_dc_err_det_diag_cmpl "Number of driving cycles since DTC detection with diag completed during these driving cycles." UBYTE _CNV_A_R_LINEAR_____1_CM 1 0. 0. 255. DISPLAY_IDENTIFIER FMY_8_CTR_DC_ERR_DET_DIAG_CMPL ECU_ADDRESS 0x7fc260 FORMAT "%3.0" /end MEASUREMENT
/begin MEASUREMENT fmy_ram_dyn[8].ctr_wup_act_mil "Number of warm-up cycles +1 since MIL activation for this failure" UBYTE _CNV_A_R_LINEAR_____1_CM 1 0. 0. 255. DISPLAY_IDENTIFIER FMY_8_CTR_WUP_ACT_MIL ECU_ADDRESS 0x7fc261 FORMAT "%3.0" /end MEASUREMENT
/begin MEASUREMENT fmy_ram_dyn[9].dtc_cod "" UWORD _CNV_A_R_LINEAR_____0_CM 1 0. 0. 65535. DISPLAY_IDENTIFIER FMY_9_DTC_COD ECU_ADDRESS 0x7fc262 BYTE_ORDER MSB_LAST FORMAT "%6.0" /end MEASUREMENT
/begin MEASUREMENT fmy_ram_dyn[9].ctr_frc "Frequency counter of failure N" UBYTE _CNV_A_R_LINEAR_____0_CM 1 0. 0. 255. DISPLAY_IDENTIFIER FMY_9_CTR_FRC ECU_ADDRESS 0x7fc268 FORMAT "%3.0" /end MEASUREMENT
/begin MEASUREMENT fmy_ram_dyn[9].ctr_wup_cyc "Counter for warm-up cycle" UBYTE _CNV_A_R_LINEAR_____0_CM 1 0. 0. 255. DISPLAY_IDENTIFIER FMY_9_CTR_WUP_CYC ECU_ADDRESS 0x7fc269 FORMAT "%3.0" /end MEASUREMENT
/begin MEASUREMENT fmy_ram_dyn[9].ctr_dc "Counter for driving cycle" UBYTE _CNV_A_R_LINEAR_____0_CM 1 0. 0. 255. DISPLAY_IDENTIFIER FMY_9_CTR_DC ECU_ADDRESS 0x7fc26a FORMAT "%3.0" /end MEASUREMENT
/begin MEASUREMENT fmy_ram_dyn[9].diag_inst "" UWORD _CNV_S_180_CONV_DIAG__21_CM 1 0. 0. 179. DISPLAY_IDENTIFIER FMY_9_DIAG_INST ECU_ADDRESS 0x7fc264 BYTE_ORDER MSB_LAST /end MEASUREMENT
/begin MEASUREMENT fmy_ram_dyn[9].idx_frf "" UBYTE _CNV_A_R_ZYL_ID_2_CM 1 0. 1. 256. DISPLAY_IDENTIFIER FMY_9_IDX_FRF ECU_ADDRESS 0x7fc26b FORMAT "%3.0" /end MEASUREMENT
/begin MEASUREMENT fmy_ram_dyn[9].err_info_dyn.lv_err_mkd "" UWORD _CNV_S_2_RANGE______11_CM 1 0. 0. 1. DISPLAY_IDENTIFIER FMY_9_LV_ERR_MKD ECU_ADDRESS 0x7fc266 BYTE_ORDER MSB_LAST BIT_MASK 0x200 /end MEASUREMENT
/begin MEASUREMENT fmy_ram_dyn[9].err_info_dyn.lv_dc_max "" UWORD _CNV_S_2_RANGE______11_CM 1 0. 0. 1. DISPLAY_IDENTIFIER FMY_9_LV_DC_MAX ECU_ADDRESS 0x7fc266 BYTE_ORDER MSB_LAST BIT_MASK 0x100 /end MEASUREMENT
/begin MEASUREMENT fmy_ram_dyn[9].err_info_dyn.lv_err_disa "" UWORD _CNV_S_2_RANGE______11_CM 1 0. 0. 1. DISPLAY_IDENTIFIER FMY_9_LV_ERR_DISA ECU_ADDRESS 0x7fc266 BYTE_ORDER MSB_LAST BIT_MASK 0x80 /end MEASUREMENT
/begin MEASUREMENT fmy_ram_dyn[9].err_info_dyn.lv_err_cfm "" UWORD _CNV_S_2_RANGE______11_CM 1 0. 0. 1. DISPLAY_IDENTIFIER FMY_9_LV_ERR_CFM ECU_ADDRESS 0x7fc266 BYTE_ORDER MSB_LAST BIT_MASK 0x40 /end MEASUREMENT
/begin MEASUREMENT fmy_ram_dyn[9].err_info_dyn.lv_err_tmp "" UWORD _CNV_S_2_RANGE______11_CM 1 0. 0. 1. DISPLAY_IDENTIFIER FMY_9_LV_ERR_TMP ECU_ADDRESS 0x7fc266 BYTE_ORDER MSB_LAST BIT_MASK 0x20 /end MEASUREMENT
/begin MEASUREMENT fmy_ram_dyn[9].err_info_dyn.lv_err_dc "" UWORD _CNV_S_2_RANGE______11_CM 1 0. 0. 1. DISPLAY_IDENTIFIER FMY_9_LV_ERR_DC ECU_ADDRESS 0x7fc266 BYTE_ORDER MSB_LAST BIT_MASK 0x10 /end MEASUREMENT
/begin MEASUREMENT fmy_ram_dyn[9].err_info_dyn.err_sym_mem "" UWORD _CNV_S_6_CONV_ERRM__22_CM 1 0. 0. 15. DISPLAY_IDENTIFIER FMY_9_ERR_SYM_MEM ECU_ADDRESS 0x7fc266 BYTE_ORDER MSB_LAST BIT_MASK 0xF /end MEASUREMENT
/begin MEASUREMENT fmy_ram_dyn[9].err_info_dyn.err_sym_lst "" UWORD _CNV_S_6_CONV_ERRM__22_CM 1 0. 0. 15. DISPLAY_IDENTIFIER FMY_9_ERR_SYM_LST ECU_ADDRESS 0x7fc266 BYTE_ORDER MSB_LAST BIT_MASK 0x7800 /end MEASUREMENT
/begin MEASUREMENT fmy_ram_dyn[9].err_info_dyn.lv_err_pnd "" UWORD _CNV_S_2_RANGE______11_CM 1 0. 0. 1. DISPLAY_IDENTIFIER FMY_9_LV_ERR_PND ECU_ADDRESS 0x7fc266 BYTE_ORDER MSB_LAST BIT_MASK 0x400 /end MEASUREMENT
/begin MEASUREMENT fmy_ram_dyn[9].err_info_dyn.lv_cdn_diag_dc "This flag permits to detect that diag conditions have been met during drinving cycle." UWORD _CNV_S_2_RANGE______11_CM 1 0. 0. 1. DISPLAY_IDENTIFIER FMY_9_LV_CDN_DIAG_DC ECU_ADDRESS 0x7fc266 BYTE_ORDER MSB_LAST BIT_MASK 0x8000 /end MEASUREMENT
/begin MEASUREMENT fmy_ram_dyn[9].ctr_dc_err_det "Number of driving cycles since DTC detection" UBYTE _CNV_A_R_LINEAR_____1_CM 1 0. 0. 255. DISPLAY_IDENTIFIER FMY_9_CTR_DC_ERR_DET ECU_ADDRESS 0x7fc26c FORMAT "%3.0" /end MEASUREMENT
/begin MEASUREMENT fmy_ram_dyn[9].ctr_dc_err_det_diag_cdn "Number of driving cycles since DTC detection with diag started within these driving cycle." UBYTE _CNV_A_R_LINEAR_____1_CM 1 0. 0. 255. DISPLAY_IDENTIFIER FMY_9_CTR_DC_ERR_DET_DIAG_CDN ECU_ADDRESS 0x7fc26d FORMAT "%3.0" /end MEASUREMENT
/begin MEASUREMENT fmy_ram_dyn[9].ctr_dc_err_det_diag_cmpl "Number of driving cycles since DTC detection with diag completed during these driving cycles." UBYTE _CNV_A_R_LINEAR_____1_CM 1 0. 0. 255. DISPLAY_IDENTIFIER FMY_9_CTR_DC_ERR_DET_DIAG_CMPL ECU_ADDRESS 0x7fc26e FORMAT "%3.0" /end MEASUREMENT
/begin MEASUREMENT fmy_ram_dyn[9].ctr_wup_act_mil "Number of warm-up cycles +1 since MIL activation for this failure" UBYTE _CNV_A_R_LINEAR_____1_CM 1 0. 0. 255. DISPLAY_IDENTIFIER FMY_9_CTR_WUP_ACT_MIL ECU_ADDRESS 0x7fc26f FORMAT "%3.0" /end MEASUREMENT
/begin MEASUREMENT tbl_frf[0].envd.header "" UBYTE _CNV_A_R_LINEAR_____0_CM 1 0. 0. 255. DISPLAY_IDENTIFIER FMY_FRF_1_ENVD_HD ECU_ADDRESS 0x7fc275 FORMAT "%3.0" /end MEASUREMENT
/begin MEASUREMENT tbl_frf[0].envd.cus_set[0][0] "" UBYTE _CNV_A_R_LINEAR_____0_CM 1 0. 0. 255. DISPLAY_IDENTIFIER FMY_FRF_1_ENVD_CUS_SET_1_CMN_1_ ECU_ADDRESS 0x7fc276 FORMAT "%3.0" /end MEASUREMENT
/begin MEASUREMENT tbl_frf[0].envd.cus_set[0][1] "" UBYTE _CNV_A_R_LINEAR_____0_CM 1 0. 0. 255. DISPLAY_IDENTIFIER FMY_FRF_1_ENVD_CUS_SET_1_CMN_2_ ECU_ADDRESS 0x7fc277 FORMAT "%3.0" /end MEASUREMENT
/begin MEASUREMENT tbl_frf[0].envd.cus_set[0][2] "" UBYTE _CNV_A_R_LINEAR_____0_CM 1 0. 0. 255. DISPLAY_IDENTIFIER FMY_FRF_1_ENVD_CUS_SET_1_CMN_3_ ECU_ADDRESS 0x7fc278 FORMAT "%3.0" /end MEASUREMENT
/begin MEASUREMENT tbl_frf[0].envd.cus_set[0][3] "" UBYTE _CNV_A_R_LINEAR_____0_CM 1 0. 0. 255. DISPLAY_IDENTIFIER FMY_FRF_1_ENVD_CUS_SET_1_CMN_4_ ECU_ADDRESS 0x7fc279 FORMAT "%3.0" /end MEASUREMENT
/begin MEASUREMENT tbl_frf[0].envd.cus_set[0][4] "" UBYTE _CNV_A_R_LINEAR_____0_CM 1 0. 0. 255. DISPLAY_IDENTIFIER FMY_FRF_1_ENVD_CUS_SET_1_CMN_5_ ECU_ADDRESS 0x7fc27a FORMAT "%3.0" /end MEASUREMENT
/begin MEASUREMENT tbl_frf[0].envd.cus_set[0][5] "" UBYTE _CNV_A_R_LINEAR_____0_CM 1 0. 0. 255. DISPLAY_IDENTIFIER FMY_FRF_1_ENVD_CUS_SET_1_CMN_6_ ECU_ADDRESS 0x7fc27b FORMAT "%3.0" /end MEASUREMENT
/begin MEASUREMENT tbl_frf[0].envd.cus_set[0][6] "" UBYTE _CNV_A_R_LINEAR_____0_CM 1 0. 0. 255. DISPLAY_IDENTIFIER FMY_FRF_1_ENVD_CUS_SET_1_SPC_1_ ECU_ADDRESS 0x7fc27c FORMAT "%3.0" /end MEASUREMENT
/begin MEASUREMENT tbl_frf[0].envd.cus_set[0][7] "" UBYTE _CNV_A_R_LINEAR_____0_CM 1 0. 0. 255. DISPLAY_IDENTIFIER FMY_FRF_1_ENVD_CUS_SET_1_SPC_2_ ECU_ADDRESS 0x7fc27d FORMAT "%3.0" /end MEASUREMENT
/begin MEASUREMENT tbl_frf[0].envd.cus_set[0][8] "" UBYTE _CNV_A_R_LINEAR_____0_CM 1 0. 0. 255. DISPLAY_IDENTIFIER FMY_FRF_1_ENVD_CUS_SET_1_SPC_3_ ECU_ADDRESS 0x7fc27e FORMAT "%3.0" /end MEASUREMENT
/begin MEASUREMENT tbl_frf[0].envd.cus_set[0][9] "" UBYTE _CNV_A_R_LINEAR_____0_CM 1 0. 0. 255. DISPLAY_IDENTIFIER FMY_FRF_1_ENVD_CUS_SET_1_SPC_4_ ECU_ADDRESS 0x7fc27f FORMAT "%3.0" /end MEASUREMENT
/begin MEASUREMENT tbl_frf[0].envd.cus_set[0][10] "" UBYTE _CNV_A_R_LINEAR_____0_CM 1 0. 0. 255. DISPLAY_IDENTIFIER FMY_FRF_1_ENVD_CUS_SET_1_SPC_5_ ECU_ADDRESS 0x7fc280 FORMAT "%3.0" /end MEASUREMENT
/begin MEASUREMENT tbl_frf[0].envd.cus_set[0][11] "" UBYTE _CNV_A_R_LINEAR_____0_CM 1 0. 0. 255. DISPLAY_IDENTIFIER FMY_FRF_1_ENVD_CUS_SET_1_SPC_6_ ECU_ADDRESS 0x7fc281 FORMAT "%3.0" /end MEASUREMENT
/begin MEASUREMENT tbl_frf[0].envd.cus_set[0][12] "" UBYTE _CNV_A_R_LINEAR_____0_CM 1 0. 0. 255. DISPLAY_IDENTIFIER FMY_FRF_1_ENVD_CUS_SET_1_SPC_7_ ECU_ADDRESS 0x7fc282 FORMAT "%3.0" /end MEASUREMENT
/begin MEASUREMENT tbl_frf[0].envd.cus_set[0][13] "" UBYTE _CNV_A_R_LINEAR_____0_CM 1 0. 0. 255. DISPLAY_IDENTIFIER FMY_FRF_1_ENVD_CUS_SET_1_SPC_8_ ECU_ADDRESS 0x7fc283 FORMAT "%3.0" /end MEASUREMENT
/begin MEASUREMENT tbl_frf[0].envd.cus_set[1][0] "" UBYTE _CNV_A_R_LINEAR_____0_CM 1 0. 0. 255. DISPLAY_IDENTIFIER FMY_FRF_1_ENVD_CUS_SET_2_CMN_1_ ECU_ADDRESS 0x7fc284 FORMAT "%3.0" /end MEASUREMENT
/begin MEASUREMENT tbl_frf[0].envd.cus_set[1][1] "" UBYTE _CNV_A_R_LINEAR_____0_CM 1 0. 0. 255. DISPLAY_IDENTIFIER FMY_FRF_1_ENVD_CUS_SET_2_CMN_2_ ECU_ADDRESS 0x7fc285 FORMAT "%3.0" /end MEASUREMENT
/begin MEASUREMENT tbl_frf[0].envd.cus_set[1][2] "" UBYTE _CNV_A_R_LINEAR_____0_CM 1 0. 0. 255. DISPLAY_IDENTIFIER FMY_FRF_1_ENVD_CUS_SET_2_CMN_3_ ECU_ADDRESS 0x7fc286 FORMAT "%3.0" /end MEASUREMENT
/begin MEASUREMENT tbl_frf[0].envd.cus_set[1][3] "" UBYTE _CNV_A_R_LINEAR_____0_CM 1 0. 0. 255. DISPLAY_IDENTIFIER FMY_FRF_1_ENVD_CUS_SET_2_CMN_4_ ECU_ADDRESS 0x7fc287 FORMAT "%3.0" /end MEASUREMENT
/begin MEASUREMENT tbl_frf[0].envd.cus_set[1][4] "" UBYTE _CNV_A_R_LINEAR_____0_CM 1 0. 0. 255. DISPLAY_IDENTIFIER FMY_FRF_1_ENVD_CUS_SET_2_CMN_5_ ECU_ADDRESS 0x7fc288 FORMAT "%3.0" /end MEASUREMENT
/begin MEASUREMENT tbl_frf[0].envd.cus_set[1][5] "" UBYTE _CNV_A_R_LINEAR_____0_CM 1 0. 0. 255. DISPLAY_IDENTIFIER FMY_FRF_1_ENVD_CUS_SET_2_CMN_6_ ECU_ADDRESS 0x7fc289 FORMAT "%3.0" /end MEASUREMENT
/begin MEASUREMENT tbl_frf[0].envd.cus_set[1][6] "" UBYTE _CNV_A_R_LINEAR_____0_CM 1 0. 0. 255. DISPLAY_IDENTIFIER FMY_FRF_1_ENVD_CUS_SET_2_SPC_1_ ECU_ADDRESS 0x7fc28a FORMAT "%3.0" /end MEASUREMENT
/begin MEASUREMENT tbl_frf[0].envd.cus_set[1][7] "" UBYTE _CNV_A_R_LINEAR_____0_CM 1 0. 0. 255. DISPLAY_IDENTIFIER FMY_FRF_1_ENVD_CUS_SET_2_SPC_2_ ECU_ADDRESS 0x7fc28b FORMAT "%3.0" /end MEASUREMENT
/begin MEASUREMENT tbl_frf[0].envd.cus_set[1][8] "" UBYTE _CNV_A_R_LINEAR_____0_CM 1 0. 0. 255. DISPLAY_IDENTIFIER FMY_FRF_1_ENVD_CUS_SET_2_SPC_3_ ECU_ADDRESS 0x7fc28c FORMAT "%3.0" /end MEASUREMENT
/begin MEASUREMENT tbl_frf[0].envd.cus_set[1][9] "" UBYTE _CNV_A_R_LINEAR_____0_CM 1 0. 0. 255. DISPLAY_IDENTIFIER FMY_FRF_1_ENVD_CUS_SET_2_SPC_4_ ECU_ADDRESS 0x7fc28d FORMAT "%3.0" /end MEASUREMENT
/begin MEASUREMENT tbl_frf[0].envd.cus_set[1][10] "" UBYTE _CNV_A_R_LINEAR_____0_CM 1 0. 0. 255. DISPLAY_IDENTIFIER FMY_FRF_1_ENVD_CUS_SET_2_SPC_5_ ECU_ADDRESS 0x7fc28e FORMAT "%3.0" /end MEASUREMENT
/begin MEASUREMENT tbl_frf[0].envd.cus_set[1][11] "" UBYTE _CNV_A_R_LINEAR_____0_CM 1 0. 0. 255. DISPLAY_IDENTIFIER FMY_FRF_1_ENVD_CUS_SET_2_SPC_6_ ECU_ADDRESS 0x7fc28f FORMAT "%3.0" /end MEASUREMENT
/begin MEASUREMENT tbl_frf[0].envd.cus_set[1][12] "" UBYTE _CNV_A_R_LINEAR_____0_CM 1 0. 0. 255. DISPLAY_IDENTIFIER FMY_FRF_1_ENVD_CUS_SET_2_SPC_7_ ECU_ADDRESS 0x7fc290 FORMAT "%3.0" /end MEASUREMENT
/begin MEASUREMENT tbl_frf[0].envd.cus_set[1][13] "" UBYTE _CNV_A_R_LINEAR_____0_CM 1 0. 0. 255. DISPLAY_IDENTIFIER FMY_FRF_1_ENVD_CUS_SET_2_SPC_8_ ECU_ADDRESS 0x7fc291 FORMAT "%3.0" /end MEASUREMENT
/begin MEASUREMENT tbl_frf[0].envd.cmn_cus[0] "" UBYTE _CNV_A_R_LINEAR_____0_CM 1 0. 0. 255. DISPLAY_IDENTIFIER FMY_FRF_1_ENVD_CUS_CMN_1_ ECU_ADDRESS 0x7fc292 FORMAT "%3.0" /end MEASUREMENT
/begin MEASUREMENT tbl_frf[0].envd.obd[0] "" UBYTE _CNV_A_R_LINEAR_____0_CM 1 0. 0. 255. DISPLAY_IDENTIFIER FMY_FRF_1_ENVD_OBD_1_ ECU_ADDRESS 0x7fc293 FORMAT "%3.0" /end MEASUREMENT
/begin MEASUREMENT tbl_frf[0].envd.obd[1] "" UBYTE _CNV_A_R_LINEAR_____0_CM 1 0. 0. 255. DISPLAY_IDENTIFIER FMY_FRF_1_ENVD_OBD_2_ ECU_ADDRESS 0x7fc294 FORMAT "%3.0" /end MEASUREMENT
/begin MEASUREMENT tbl_frf[0].envd.obd[2] "" UBYTE _CNV_A_R_LINEAR_____0_CM 1 0. 0. 255. DISPLAY_IDENTIFIER FMY_FRF_1_ENVD_OBD_3_ ECU_ADDRESS 0x7fc295 FORMAT "%3.0" /end MEASUREMENT
/begin MEASUREMENT tbl_frf[0].envd.obd[3] "" UBYTE _CNV_A_R_LINEAR_____0_CM 1 0. 0. 255. DISPLAY_IDENTIFIER FMY_FRF_1_ENVD_OBD_4_ ECU_ADDRESS 0x7fc296 FORMAT "%3.0" /end MEASUREMENT
/begin MEASUREMENT tbl_frf[0].envd.obd[4] "" UBYTE _CNV_A_R_LINEAR_____0_CM 1 0. 0. 255. DISPLAY_IDENTIFIER FMY_FRF_1_ENVD_OBD_5_ ECU_ADDRESS 0x7fc297 FORMAT "%3.0" /end MEASUREMENT
/begin MEASUREMENT tbl_frf[0].envd.obd[5] "" UBYTE _CNV_A_R_LINEAR_____0_CM 1 0. 0. 255. DISPLAY_IDENTIFIER FMY_FRF_1_ENVD_OBD_6_ ECU_ADDRESS 0x7fc298 FORMAT "%3.0" /end MEASUREMENT
/begin MEASUREMENT tbl_frf[0].envd.obd[6] "" UBYTE _CNV_A_R_LINEAR_____0_CM 1 0. 0. 255. DISPLAY_IDENTIFIER FMY_FRF_1_ENVD_OBD_7_ ECU_ADDRESS 0x7fc299 FORMAT "%3.0" /end MEASUREMENT
/begin MEASUREMENT tbl_frf[0].envd.obd[7] "" UBYTE _CNV_A_R_LINEAR_____0_CM 1 0. 0. 255. DISPLAY_IDENTIFIER FMY_FRF_1_ENVD_OBD_8_ ECU_ADDRESS 0x7fc29a FORMAT "%3.0" /end MEASUREMENT
/begin MEASUREMENT tbl_frf[1].envd.header "" UBYTE _CNV_A_R_LINEAR_____0_CM 1 0. 0. 255. DISPLAY_IDENTIFIER FMY_FRF_2_ENVD_HD ECU_ADDRESS 0x7fc29b FORMAT "%3.0" /end MEASUREMENT
/begin MEASUREMENT tbl_frf[1].envd.cus_set[0][0] "" UBYTE _CNV_A_R_LINEAR_____0_CM 1 0. 0. 255. DISPLAY_IDENTIFIER FMY_FRF_2_ENVD_CUS_SET_1_CMN_1_ ECU_ADDRESS 0x7fc29c FORMAT "%3.0" /end MEASUREMENT
/begin MEASUREMENT tbl_frf[1].envd.cus_set[0][1] "" UBYTE _CNV_A_R_LINEAR_____0_CM 1 0. 0. 255. DISPLAY_IDENTIFIER FMY_FRF_2_ENVD_CUS_SET_1_CMN_2_ ECU_ADDRESS 0x7fc29d FORMAT "%3.0" /end MEASUREMENT
/begin MEASUREMENT tbl_frf[1].envd.cus_set[0][2] "" UBYTE _CNV_A_R_LINEAR_____0_CM 1 0. 0. 255. DISPLAY_IDENTIFIER FMY_FRF_2_ENVD_CUS_SET_1_CMN_3_ ECU_ADDRESS 0x7fc29e FORMAT "%3.0" /end MEASUREMENT
/begin MEASUREMENT tbl_frf[1].envd.cus_set[0][3] "" UBYTE _CNV_A_R_LINEAR_____0_CM 1 0. 0. 255. DISPLAY_IDENTIFIER FMY_FRF_2_ENVD_CUS_SET_1_CMN_4_ ECU_ADDRESS 0x7fc29f FORMAT "%3.0" /end MEASUREMENT
/begin MEASUREMENT tbl_frf[1].envd.cus_set[0][4] "" UBYTE _CNV_A_R_LINEAR_____0_CM 1 0. 0. 255. DISPLAY_IDENTIFIER FMY_FRF_2_ENVD_CUS_SET_1_CMN_5_ ECU_ADDRESS 0x7fc2a0 FORMAT "%3.0" /end MEASUREMENT
/begin MEASUREMENT tbl_frf[1].envd.cus_set[0][5] "" UBYTE _CNV_A_R_LINEAR_____0_CM 1 0. 0. 255. DISPLAY_IDENTIFIER FMY_FRF_2_ENVD_CUS_SET_1_CMN_6_ ECU_ADDRESS 0x7fc2a1 FORMAT "%3.0" /end MEASUREMENT
/begin MEASUREMENT tbl_frf[1].envd.cus_set[0][6] "" UBYTE _CNV_A_R_LINEAR_____0_CM 1 0. 0. 255. DISPLAY_IDENTIFIER FMY_FRF_2_ENVD_CUS_SET_1_SPC_1_ ECU_ADDRESS 0x7fc2a2 FORMAT "%3.0" /end MEASUREMENT
/begin MEASUREMENT tbl_frf[1].envd.cus_set[0][7] "" UBYTE _CNV_A_R_LINEAR_____0_CM 1 0. 0. 255. DISPLAY_IDENTIFIER FMY_FRF_2_ENVD_CUS_SET_1_SPC_2_ ECU_ADDRESS 0x7fc2a3 FORMAT "%3.0" /end MEASUREMENT
/begin MEASUREMENT tbl_frf[1].envd.cus_set[0][8] "" UBYTE _CNV_A_R_LINEAR_____0_CM 1 0. 0. 255. DISPLAY_IDENTIFIER FMY_FRF_2_ENVD_CUS_SET_1_SPC_3_ ECU_ADDRESS 0x7fc2a4 FORMAT "%3.0" /end MEASUREMENT
/begin MEASUREMENT tbl_frf[1].envd.cus_set[0][9] "" UBYTE _CNV_A_R_LINEAR_____0_CM 1 0. 0. 255. DISPLAY_IDENTIFIER FMY_FRF_2_ENVD_CUS_SET_1_SPC_4_ ECU_ADDRESS 0x7fc2a5 FORMAT "%3.0" /end MEASUREMENT
/begin MEASUREMENT tbl_frf[1].envd.cus_set[0][10] "" UBYTE _CNV_A_R_LINEAR_____0_CM 1 0. 0. 255. DISPLAY_IDENTIFIER FMY_FRF_2_ENVD_CUS_SET_1_SPC_5_ ECU_ADDRESS 0x7fc2a6 FORMAT "%3.0" /end MEASUREMENT
/begin MEASUREMENT tbl_frf[1].envd.cus_set[0][11] "" UBYTE _CNV_A_R_LINEAR_____0_CM 1 0. 0. 255. DISPLAY_IDENTIFIER FMY_FRF_2_ENVD_CUS_SET_1_SPC_6_ ECU_ADDRESS 0x7fc2a7 FORMAT "%3.0" /end MEASUREMENT
/begin MEASUREMENT tbl_frf[1].envd.cus_set[0][12] "" UBYTE _CNV_A_R_LINEAR_____0_CM 1 0. 0. 255. DISPLAY_IDENTIFIER FMY_FRF_2_ENVD_CUS_SET_1_SPC_7_ ECU_ADDRESS 0x7fc2a8 FORMAT "%3.0" /end MEASUREMENT
/begin MEASUREMENT tbl_frf[1].envd.cus_set[0][13] "" UBYTE _CNV_A_R_LINEAR_____0_CM 1 0. 0. 255. DISPLAY_IDENTIFIER FMY_FRF_2_ENVD_CUS_SET_1_SPC_8_ ECU_ADDRESS 0x7fc2a9 FORMAT "%3.0" /end MEASUREMENT
/begin MEASUREMENT tbl_frf[1].envd.cus_set[1][0] "" UBYTE _CNV_A_R_LINEAR_____0_CM 1 0. 0. 255. DISPLAY_IDENTIFIER FMY_FRF_2_ENVD_CUS_SET_2_CMN_1_ ECU_ADDRESS 0x7fc2aa FORMAT "%3.0" /end MEASUREMENT
/begin MEASUREMENT tbl_frf[1].envd.cus_set[1][1] "" UBYTE _CNV_A_R_LINEAR_____0_CM 1 0. 0. 255. DISPLAY_IDENTIFIER FMY_FRF_2_ENVD_CUS_SET_2_CMN_2_ ECU_ADDRESS 0x7fc2ab FORMAT "%3.0" /end MEASUREMENT
/begin MEASUREMENT tbl_frf[1].envd.cus_set[1][2] "" UBYTE _CNV_A_R_LINEAR_____0_CM 1 0. 0. 255. DISPLAY_IDENTIFIER FMY_FRF_2_ENVD_CUS_SET_2_CMN_3_ ECU_ADDRESS 0x7fc2ac FORMAT "%3.0" /end MEASUREMENT
/begin MEASUREMENT tbl_frf[1].envd.cus_set[1][3] "" UBYTE _CNV_A_R_LINEAR_____0_CM 1 0. 0. 255. DISPLAY_IDENTIFIER FMY_FRF_2_ENVD_CUS_SET_2_CMN_4_ ECU_ADDRESS 0x7fc2ad FORMAT "%3.0" /end MEASUREMENT
/begin MEASUREMENT tbl_frf[1].envd.cus_set[1][4] "" UBYTE _CNV_A_R_LINEAR_____0_CM 1 0. 0. 255. DISPLAY_IDENTIFIER FMY_FRF_2_ENVD_CUS_SET_2_CMN_5_ ECU_ADDRESS 0x7fc2ae FORMAT "%3.0" /end MEASUREMENT
/begin MEASUREMENT tbl_frf[1].envd.cus_set[1][5] "" UBYTE _CNV_A_R_LINEAR_____0_CM 1 0. 0. 255. DISPLAY_IDENTIFIER FMY_FRF_2_ENVD_CUS_SET_2_CMN_6_ ECU_ADDRESS 0x7fc2af FORMAT "%3.0" /end MEASUREMENT
/begin MEASUREMENT tbl_frf[1].envd.cus_set[1][6] "" UBYTE _CNV_A_R_LINEAR_____0_CM 1 0. 0. 255. DISPLAY_IDENTIFIER FMY_FRF_2_ENVD_CUS_SET_2_SPC_1_ ECU_ADDRESS 0x7fc2b0 FORMAT "%3.0" /end MEASUREMENT
/begin MEASUREMENT tbl_frf[1].envd.cus_set[1][7] "" UBYTE _CNV_A_R_LINEAR_____0_CM 1 0. 0. 255. DISPLAY_IDENTIFIER FMY_FRF_2_ENVD_CUS_SET_2_SPC_2_ ECU_ADDRESS 0x7fc2b1 FORMAT "%3.0" /end MEASUREMENT
/begin MEASUREMENT tbl_frf[1].envd.cus_set[1][8] "" UBYTE _CNV_A_R_LINEAR_____0_CM 1 0. 0. 255. DISPLAY_IDENTIFIER FMY_FRF_2_ENVD_CUS_SET_2_SPC_3_ ECU_ADDRESS 0x7fc2b2 FORMAT "%3.0" /end MEASUREMENT
/begin MEASUREMENT tbl_frf[1].envd.cus_set[1][9] "" UBYTE _CNV_A_R_LINEAR_____0_CM 1 0. 0. 255. DISPLAY_IDENTIFIER FMY_FRF_2_ENVD_CUS_SET_2_SPC_4_ ECU_ADDRESS 0x7fc2b3 FORMAT "%3.0" /end MEASUREMENT
/begin MEASUREMENT tbl_frf[1].envd.cus_set[1][10] "" UBYTE _CNV_A_R_LINEAR_____0_CM 1 0. 0. 255. DISPLAY_IDENTIFIER FMY_FRF_2_ENVD_CUS_SET_2_SPC_5_ ECU_ADDRESS 0x7fc2b4 FORMAT "%3.0" /end MEASUREMENT
/begin MEASUREMENT tbl_frf[1].envd.cus_set[1][11] "" UBYTE _CNV_A_R_LINEAR_____0_CM 1 0. 0. 255. DISPLAY_IDENTIFIER FMY_FRF_2_ENVD_CUS_SET_2_SPC_6_ ECU_ADDRESS 0x7fc2b5 FORMAT "%3.0" /end MEASUREMENT
/begin MEASUREMENT tbl_frf[1].envd.cus_set[1][12] "" UBYTE _CNV_A_R_LINEAR_____0_CM 1 0. 0. 255. DISPLAY_IDENTIFIER FMY_FRF_2_ENVD_CUS_SET_2_SPC_7_ ECU_ADDRESS 0x7fc2b6 FORMAT "%3.0" /end MEASUREMENT
/begin MEASUREMENT tbl_frf[1].envd.cus_set[1][13] "" UBYTE _CNV_A_R_LINEAR_____0_CM 1 0. 0. 255. DISPLAY_IDENTIFIER FMY_FRF_2_ENVD_CUS_SET_2_SPC_8_ ECU_ADDRESS 0x7fc2b7 FORMAT "%3.0" /end MEASUREMENT
/begin MEASUREMENT tbl_frf[1].envd.cmn_cus[0] "" UBYTE _CNV_A_R_LINEAR_____0_CM 1 0. 0. 255. DISPLAY_IDENTIFIER FMY_FRF_2_ENVD_CUS_CMN_1_ ECU_ADDRESS 0x7fc2b8 FORMAT "%3.0" /end MEASUREMENT
/begin MEASUREMENT tbl_frf[1].envd.obd[0] "" UBYTE _CNV_A_R_LINEAR_____0_CM 1 0. 0. 255. DISPLAY_IDENTIFIER FMY_FRF_2_ENVD_OBD_1_ ECU_ADDRESS 0x7fc2b9 FORMAT "%3.0" /end MEASUREMENT
/begin MEASUREMENT tbl_frf[1].envd.obd[1] "" UBYTE _CNV_A_R_LINEAR_____0_CM 1 0. 0. 255. DISPLAY_IDENTIFIER FMY_FRF_2_ENVD_OBD_2_ ECU_ADDRESS 0x7fc2ba FORMAT "%3.0" /end MEASUREMENT
/begin MEASUREMENT tbl_frf[1].envd.obd[2] "" UBYTE _CNV_A_R_LINEAR_____0_CM 1 0. 0. 255. DISPLAY_IDENTIFIER FMY_FRF_2_ENVD_OBD_3_ ECU_ADDRESS 0x7fc2bb FORMAT "%3.0" /end MEASUREMENT
/begin MEASUREMENT tbl_frf[1].envd.obd[3] "" UBYTE _CNV_A_R_LINEAR_____0_CM 1 0. 0. 255. DISPLAY_IDENTIFIER FMY_FRF_2_ENVD_OBD_4_ ECU_ADDRESS 0x7fc2bc FORMAT "%3.0" /end MEASUREMENT
/begin MEASUREMENT tbl_frf[1].envd.obd[4] "" UBYTE _CNV_A_R_LINEAR_____0_CM 1 0. 0. 255. DISPLAY_IDENTIFIER FMY_FRF_2_ENVD_OBD_5_ ECU_ADDRESS 0x7fc2bd FORMAT "%3.0" /end MEASUREMENT
/begin MEASUREMENT tbl_frf[1].envd.obd[5] "" UBYTE _CNV_A_R_LINEAR_____0_CM 1 0. 0. 255. DISPLAY_IDENTIFIER FMY_FRF_2_ENVD_OBD_6_ ECU_ADDRESS 0x7fc2be FORMAT "%3.0" /end MEASUREMENT
/begin MEASUREMENT tbl_frf[1].envd.obd[6] "" UBYTE _CNV_A_R_LINEAR_____0_CM 1 0. 0. 255. DISPLAY_IDENTIFIER FMY_FRF_2_ENVD_OBD_7_ ECU_ADDRESS 0x7fc2bf FORMAT "%3.0" /end MEASUREMENT
/begin MEASUREMENT tbl_frf[1].envd.obd[7] "" UBYTE _CNV_A_R_LINEAR_____0_CM 1 0. 0. 255. DISPLAY_IDENTIFIER FMY_FRF_2_ENVD_OBD_8_ ECU_ADDRESS 0x7fc2c0 FORMAT "%3.0" /end MEASUREMENT
/begin MEASUREMENT tbl_frf[2].envd.header "" UBYTE _CNV_A_R_LINEAR_____0_CM 1 0. 0. 255. DISPLAY_IDENTIFIER FMY_FRF_3_ENVD_HD ECU_ADDRESS 0x7fc2c1 FORMAT "%3.0" /end MEASUREMENT
/begin MEASUREMENT tbl_frf[2].envd.cus_set[0][0] "" UBYTE _CNV_A_R_LINEAR_____0_CM 1 0. 0. 255. DISPLAY_IDENTIFIER FMY_FRF_3_ENVD_CUS_SET_1_CMN_1_ ECU_ADDRESS 0x7fc2c2 FORMAT "%3.0" /end MEASUREMENT
/begin MEASUREMENT tbl_frf[2].envd.cus_set[0][1] "" UBYTE _CNV_A_R_LINEAR_____0_CM 1 0. 0. 255. DISPLAY_IDENTIFIER FMY_FRF_3_ENVD_CUS_SET_1_CMN_2_ ECU_ADDRESS 0x7fc2c3 FORMAT "%3.0" /end MEASUREMENT
/begin MEASUREMENT tbl_frf[2].envd.cus_set[0][2] "" UBYTE _CNV_A_R_LINEAR_____0_CM 1 0. 0. 255. DISPLAY_IDENTIFIER FMY_FRF_3_ENVD_CUS_SET_1_CMN_3_ ECU_ADDRESS 0x7fc2c4 FORMAT "%3.0" /end MEASUREMENT
/begin MEASUREMENT tbl_frf[2].envd.cus_set[0][3] "" UBYTE _CNV_A_R_LINEAR_____0_CM 1 0. 0. 255. DISPLAY_IDENTIFIER FMY_FRF_3_ENVD_CUS_SET_1_CMN_4_ ECU_ADDRESS 0x7fc2c5 FORMAT "%3.0" /end MEASUREMENT
/begin MEASUREMENT tbl_frf[2].envd.cus_set[0][4] "" UBYTE _CNV_A_R_LINEAR_____0_CM 1 0. 0. 255. DISPLAY_IDENTIFIER FMY_FRF_3_ENVD_CUS_SET_1_CMN_5_ ECU_ADDRESS 0x7fc2c6 FORMAT "%3.0" /end MEASUREMENT
/begin MEASUREMENT tbl_frf[2].envd.cus_set[0][5] "" UBYTE _CNV_A_R_LINEAR_____0_CM 1 0. 0. 255. DISPLAY_IDENTIFIER FMY_FRF_3_ENVD_CUS_SET_1_CMN_6_ ECU_ADDRESS 0x7fc2c7 FORMAT "%3.0" /end MEASUREMENT
/begin MEASUREMENT tbl_frf[2].envd.cus_set[0][6] "" UBYTE _CNV_A_R_LINEAR_____0_CM 1 0. 0. 255. DISPLAY_IDENTIFIER FMY_FRF_3_ENVD_CUS_SET_1_SPC_1_ ECU_ADDRESS 0x7fc2c8 FORMAT "%3.0" /end MEASUREMENT
/begin MEASUREMENT tbl_frf[2].envd.cus_set[0][7] "" UBYTE _CNV_A_R_LINEAR_____0_CM 1 0. 0. 255. DISPLAY_IDENTIFIER FMY_FRF_3_ENVD_CUS_SET_1_SPC_2_ ECU_ADDRESS 0x7fc2c9 FORMAT "%3.0" /end MEASUREMENT
/begin MEASUREMENT tbl_frf[2].envd.cus_set[0][8] "" UBYTE _CNV_A_R_LINEAR_____0_CM 1 0. 0. 255. DISPLAY_IDENTIFIER FMY_FRF_3_ENVD_CUS_SET_1_SPC_3_ ECU_ADDRESS 0x7fc2ca FORMAT "%3.0" /end MEASUREMENT
/begin MEASUREMENT tbl_frf[2].envd.cus_set[0][9] "" UBYTE _CNV_A_R_LINEAR_____0_CM 1 0. 0. 255. DISPLAY_IDENTIFIER FMY_FRF_3_ENVD_CUS_SET_1_SPC_4_ ECU_ADDRESS 0x7fc2cb FORMAT "%3.0" /end MEASUREMENT
/begin MEASUREMENT tbl_frf[2].envd.cus_set[0][10] "" UBYTE _CNV_A_R_LINEAR_____0_CM 1 0. 0. 255. DISPLAY_IDENTIFIER FMY_FRF_3_ENVD_CUS_SET_1_SPC_5_ ECU_ADDRESS 0x7fc2cc FORMAT "%3.0" /end MEASUREMENT
/begin MEASUREMENT tbl_frf[2].envd.cus_set[0][11] "" UBYTE _CNV_A_R_LINEAR_____0_CM 1 0. 0. 255. DISPLAY_IDENTIFIER FMY_FRF_3_ENVD_CUS_SET_1_SPC_6_ ECU_ADDRESS 0x7fc2cd FORMAT "%3.0" /end MEASUREMENT
/begin MEASUREMENT tbl_frf[2].envd.cus_set[0][12] "" UBYTE _CNV_A_R_LINEAR_____0_CM 1 0. 0. 255. DISPLAY_IDENTIFIER FMY_FRF_3_ENVD_CUS_SET_1_SPC_7_ ECU_ADDRESS 0x7fc2ce FORMAT "%3.0" /end MEASUREMENT
/begin MEASUREMENT tbl_frf[2].envd.cus_set[0][13] "" UBYTE _CNV_A_R_LINEAR_____0_CM 1 0. 0. 255. DISPLAY_IDENTIFIER FMY_FRF_3_ENVD_CUS_SET_1_SPC_8_ ECU_ADDRESS 0x7fc2cf FORMAT "%3.0" /end MEASUREMENT
/begin MEASUREMENT tbl_frf[2].envd.cus_set[1][0] "" UBYTE _CNV_A_R_LINEAR_____0_CM 1 0. 0. 255. DISPLAY_IDENTIFIER FMY_FRF_3_ENVD_CUS_SET_2_CMN_1_ ECU_ADDRESS 0x7fc2d0 FORMAT "%3.0" /end MEASUREMENT
/begin MEASUREMENT tbl_frf[2].envd.cus_set[1][1] "" UBYTE _CNV_A_R_LINEAR_____0_CM 1 0. 0. 255. DISPLAY_IDENTIFIER FMY_FRF_3_ENVD_CUS_SET_2_CMN_2_ ECU_ADDRESS 0x7fc2d1 FORMAT "%3.0" /end MEASUREMENT
/begin MEASUREMENT tbl_frf[2].envd.cus_set[1][2] "" UBYTE _CNV_A_R_LINEAR_____0_CM 1 0. 0. 255. DISPLAY_IDENTIFIER FMY_FRF_3_ENVD_CUS_SET_2_CMN_3_ ECU_ADDRESS 0x7fc2d2 FORMAT "%3.0" /end MEASUREMENT
/begin MEASUREMENT tbl_frf[2].envd.cus_set[1][3] "" UBYTE _CNV_A_R_LINEAR_____0_CM 1 0. 0. 255. DISPLAY_IDENTIFIER FMY_FRF_3_ENVD_CUS_SET_2_CMN_4_ ECU_ADDRESS 0x7fc2d3 FORMAT "%3.0" /end MEASUREMENT
/begin MEASUREMENT tbl_frf[2].envd.cus_set[1][4] "" UBYTE _CNV_A_R_LINEAR_____0_CM 1 0. 0. 255. DISPLAY_IDENTIFIER FMY_FRF_3_ENVD_CUS_SET_2_CMN_5_ ECU_ADDRESS 0x7fc2d4 FORMAT "%3.0" /end MEASUREMENT
/begin MEASUREMENT tbl_frf[2].envd.cus_set[1][5] "" UBYTE _CNV_A_R_LINEAR_____0_CM 1 0. 0. 255. DISPLAY_IDENTIFIER FMY_FRF_3_ENVD_CUS_SET_2_CMN_6_ ECU_ADDRESS 0x7fc2d5 FORMAT "%3.0" /end MEASUREMENT
/begin MEASUREMENT tbl_frf[2].envd.cus_set[1][6] "" UBYTE _CNV_A_R_LINEAR_____0_CM 1 0. 0. 255. DISPLAY_IDENTIFIER FMY_FRF_3_ENVD_CUS_SET_2_SPC_1_ ECU_ADDRESS 0x7fc2d6 FORMAT "%3.0" /end MEASUREMENT
/begin MEASUREMENT tbl_frf[2].envd.cus_set[1][7] "" UBYTE _CNV_A_R_LINEAR_____0_CM 1 0. 0. 255. DISPLAY_IDENTIFIER FMY_FRF_3_ENVD_CUS_SET_2_SPC_2_ ECU_ADDRESS 0x7fc2d7 FORMAT "%3.0" /end MEASUREMENT
/begin MEASUREMENT tbl_frf[2].envd.cus_set[1][8] "" UBYTE _CNV_A_R_LINEAR_____0_CM 1 0. 0. 255. DISPLAY_IDENTIFIER FMY_FRF_3_ENVD_CUS_SET_2_SPC_3_ ECU_ADDRESS 0x7fc2d8 FORMAT "%3.0" /end MEASUREMENT
/begin MEASUREMENT tbl_frf[2].envd.cus_set[1][9] "" UBYTE _CNV_A_R_LINEAR_____0_CM 1 0. 0. 255. DISPLAY_IDENTIFIER FMY_FRF_3_ENVD_CUS_SET_2_SPC_4_ ECU_ADDRESS 0x7fc2d9 FORMAT "%3.0" /end MEASUREMENT
/begin MEASUREMENT tbl_frf[2].envd.cus_set[1][10] "" UBYTE _CNV_A_R_LINEAR_____0_CM 1 0. 0. 255. DISPLAY_IDENTIFIER FMY_FRF_3_ENVD_CUS_SET_2_SPC_5_ ECU_ADDRESS 0x7fc2da FORMAT "%3.0" /end MEASUREMENT
/begin MEASUREMENT tbl_frf[2].envd.cus_set[1][11] "" UBYTE _CNV_A_R_LINEAR_____0_CM 1 0. 0. 255. DISPLAY_IDENTIFIER FMY_FRF_3_ENVD_CUS_SET_2_SPC_6_ ECU_ADDRESS 0x7fc2db FORMAT "%3.0" /end MEASUREMENT
/begin MEASUREMENT tbl_frf[2].envd.cus_set[1][12] "" UBYTE _CNV_A_R_LINEAR_____0_CM 1 0. 0. 255. DISPLAY_IDENTIFIER FMY_FRF_3_ENVD_CUS_SET_2_SPC_7_ ECU_ADDRESS 0x7fc2dc FORMAT "%3.0" /end MEASUREMENT
/begin MEASUREMENT tbl_frf[2].envd.cus_set[1][13] "" UBYTE _CNV_A_R_LINEAR_____0_CM 1 0. 0. 255. DISPLAY_IDENTIFIER FMY_FRF_3_ENVD_CUS_SET_2_SPC_8_ ECU_ADDRESS 0x7fc2dd FORMAT "%3.0" /end MEASUREMENT
/begin MEASUREMENT tbl_frf[2].envd.cmn_cus[0] "" UBYTE _CNV_A_R_LINEAR_____0_CM 1 0. 0. 255. DISPLAY_IDENTIFIER FMY_FRF_3_ENVD_CUS_CMN_1_ ECU_ADDRESS 0x7fc2de FORMAT "%3.0" /end MEASUREMENT
/begin MEASUREMENT tbl_frf[2].envd.obd[0] "" UBYTE _CNV_A_R_LINEAR_____0_CM 1 0. 0. 255. DISPLAY_IDENTIFIER FMY_FRF_3_ENVD_OBD_1_ ECU_ADDRESS 0x7fc2df FORMAT "%3.0" /end MEASUREMENT
/begin MEASUREMENT tbl_frf[2].envd.obd[1] "" UBYTE _CNV_A_R_LINEAR_____0_CM 1 0. 0. 255. DISPLAY_IDENTIFIER FMY_FRF_3_ENVD_OBD_2_ ECU_ADDRESS 0x7fc2e0 FORMAT "%3.0" /end MEASUREMENT
/begin MEASUREMENT tbl_frf[2].envd.obd[2] "" UBYTE _CNV_A_R_LINEAR_____0_CM 1 0. 0. 255. DISPLAY_IDENTIFIER FMY_FRF_3_ENVD_OBD_3_ ECU_ADDRESS 0x7fc2e1 FORMAT "%3.0" /end MEASUREMENT
/begin MEASUREMENT tbl_frf[2].envd.obd[3] "" UBYTE _CNV_A_R_LINEAR_____0_CM 1 0. 0. 255. DISPLAY_IDENTIFIER FMY_FRF_3_ENVD_OBD_4_ ECU_ADDRESS 0x7fc2e2 FORMAT "%3.0" /end MEASUREMENT
/begin MEASUREMENT tbl_frf[2].envd.obd[4] "" UBYTE _CNV_A_R_LINEAR_____0_CM 1 0. 0. 255. DISPLAY_IDENTIFIER FMY_FRF_3_ENVD_OBD_5_ ECU_ADDRESS 0x7fc2e3 FORMAT "%3.0" /end MEASUREMENT
/begin MEASUREMENT tbl_frf[2].envd.obd[5] "" UBYTE _CNV_A_R_LINEAR_____0_CM 1 0. 0. 255. DISPLAY_IDENTIFIER FMY_FRF_3_ENVD_OBD_6_ ECU_ADDRESS 0x7fc2e4 FORMAT "%3.0" /end MEASUREMENT
/begin MEASUREMENT tbl_frf[2].envd.obd[6] "" UBYTE _CNV_A_R_LINEAR_____0_CM 1 0. 0. 255. DISPLAY_IDENTIFIER FMY_FRF_3_ENVD_OBD_7_ ECU_ADDRESS 0x7fc2e5 FORMAT "%3.0" /end MEASUREMENT
/begin MEASUREMENT tbl_frf[2].envd.obd[7] "" UBYTE _CNV_A_R_LINEAR_____0_CM 1 0. 0. 255. DISPLAY_IDENTIFIER FMY_FRF_3_ENVD_OBD_8_ ECU_ADDRESS 0x7fc2e6 FORMAT "%3.0" /end MEASUREMENT
/begin MEASUREMENT tbl_frf[3].envd.header "" UBYTE _CNV_A_R_LINEAR_____0_CM 1 0. 0. 255. DISPLAY_IDENTIFIER FMY_FRF_4_ENVD_HD ECU_ADDRESS 0x7fc2e7 FORMAT "%3.0" /end MEASUREMENT
/begin MEASUREMENT tbl_frf[3].envd.cus_set[0][0] "" UBYTE _CNV_A_R_LINEAR_____0_CM 1 0. 0. 255. DISPLAY_IDENTIFIER FMY_FRF_4_ENVD_CUS_SET_1_CMN_1_ ECU_ADDRESS 0x7fc2e8 FORMAT "%3.0" /end MEASUREMENT
/begin MEASUREMENT tbl_frf[3].envd.cus_set[0][1] "" UBYTE _CNV_A_R_LINEAR_____0_CM 1 0. 0. 255. DISPLAY_IDENTIFIER FMY_FRF_4_ENVD_CUS_SET_1_CMN_2_ ECU_ADDRESS 0x7fc2e9 FORMAT "%3.0" /end MEASUREMENT
/begin MEASUREMENT tbl_frf[3].envd.cus_set[0][2] "" UBYTE _CNV_A_R_LINEAR_____0_CM 1 0. 0. 255. DISPLAY_IDENTIFIER FMY_FRF_4_ENVD_CUS_SET_1_CMN_3_ ECU_ADDRESS 0x7fc2ea FORMAT "%3.0" /end MEASUREMENT
/begin MEASUREMENT tbl_frf[3].envd.cus_set[0][3] "" UBYTE _CNV_A_R_LINEAR_____0_CM 1 0. 0. 255. DISPLAY_IDENTIFIER FMY_FRF_4_ENVD_CUS_SET_1_CMN_4_ ECU_ADDRESS 0x7fc2eb FORMAT "%3.0" /end MEASUREMENT
/begin MEASUREMENT tbl_frf[3].envd.cus_set[0][4] "" UBYTE _CNV_A_R_LINEAR_____0_CM 1 0. 0. 255. DISPLAY_IDENTIFIER FMY_FRF_4_ENVD_CUS_SET_1_CMN_5_ ECU_ADDRESS 0x7fc2ec FORMAT "%3.0" /end MEASUREMENT
/begin MEASUREMENT tbl_frf[3].envd.cus_set[0][5] "" UBYTE _CNV_A_R_LINEAR_____0_CM 1 0. 0. 255. DISPLAY_IDENTIFIER FMY_FRF_4_ENVD_CUS_SET_1_CMN_6_ ECU_ADDRESS 0x7fc2ed FORMAT "%3.0" /end MEASUREMENT
/begin MEASUREMENT tbl_frf[3].envd.cus_set[0][6] "" UBYTE _CNV_A_R_LINEAR_____0_CM 1 0. 0. 255. DISPLAY_IDENTIFIER FMY_FRF_4_ENVD_CUS_SET_1_SPC_1_ ECU_ADDRESS 0x7fc2ee FORMAT "%3.0" /end MEASUREMENT
/begin MEASUREMENT tbl_frf[3].envd.cus_set[0][7] "" UBYTE _CNV_A_R_LINEAR_____0_CM 1 0. 0. 255. DISPLAY_IDENTIFIER FMY_FRF_4_ENVD_CUS_SET_1_SPC_2_ ECU_ADDRESS 0x7fc2ef FORMAT "%3.0" /end MEASUREMENT
/begin MEASUREMENT tbl_frf[3].envd.cus_set[0][8] "" UBYTE _CNV_A_R_LINEAR_____0_CM 1 0. 0. 255. DISPLAY_IDENTIFIER FMY_FRF_4_ENVD_CUS_SET_1_SPC_3_ ECU_ADDRESS 0x7fc2f0 FORMAT "%3.0" /end MEASUREMENT
/begin MEASUREMENT tbl_frf[3].envd.cus_set[0][9] "" UBYTE _CNV_A_R_LINEAR_____0_CM 1 0. 0. 255. DISPLAY_IDENTIFIER FMY_FRF_4_ENVD_CUS_SET_1_SPC_4_ ECU_ADDRESS 0x7fc2f1 FORMAT "%3.0" /end MEASUREMENT
/begin MEASUREMENT tbl_frf[3].envd.cus_set[0][10] "" UBYTE _CNV_A_R_LINEAR_____0_CM 1 0. 0. 255. DISPLAY_IDENTIFIER FMY_FRF_4_ENVD_CUS_SET_1_SPC_5_ ECU_ADDRESS 0x7fc2f2 FORMAT "%3.0" /end MEASUREMENT
/begin MEASUREMENT tbl_frf[3].envd.cus_set[0][11] "" UBYTE _CNV_A_R_LINEAR_____0_CM 1 0. 0. 255. DISPLAY_IDENTIFIER FMY_FRF_4_ENVD_CUS_SET_1_SPC_6_ ECU_ADDRESS 0x7fc2f3 FORMAT "%3.0" /end MEASUREMENT
/begin MEASUREMENT tbl_frf[3].envd.cus_set[0][12] "" UBYTE _CNV_A_R_LINEAR_____0_CM 1 0. 0. 255. DISPLAY_IDENTIFIER FMY_FRF_4_ENVD_CUS_SET_1_SPC_7_ ECU_ADDRESS 0x7fc2f4 FORMAT "%3.0" /end MEASUREMENT
/begin MEASUREMENT tbl_frf[3].envd.cus_set[0][13] "" UBYTE _CNV_A_R_LINEAR_____0_CM 1 0. 0. 255. DISPLAY_IDENTIFIER FMY_FRF_4_ENVD_CUS_SET_1_SPC_8_ ECU_ADDRESS 0x7fc2f5 FORMAT "%3.0" /end MEASUREMENT
/begin MEASUREMENT tbl_frf[3].envd.cus_set[1][0] "" UBYTE _CNV_A_R_LINEAR_____0_CM 1 0. 0. 255. DISPLAY_IDENTIFIER FMY_FRF_4_ENVD_CUS_SET_2_CMN_1_ ECU_ADDRESS 0x7fc2f6 FORMAT "%3.0" /end MEASUREMENT
/begin MEASUREMENT tbl_frf[3].envd.cus_set[1][1] "" UBYTE _CNV_A_R_LINEAR_____0_CM 1 0. 0. 255. DISPLAY_IDENTIFIER FMY_FRF_4_ENVD_CUS_SET_2_CMN_2_ ECU_ADDRESS 0x7fc2f7 FORMAT "%3.0" /end MEASUREMENT
/begin MEASUREMENT tbl_frf[3].envd.cus_set[1][2] "" UBYTE _CNV_A_R_LINEAR_____0_CM 1 0. 0. 255. DISPLAY_IDENTIFIER FMY_FRF_4_ENVD_CUS_SET_2_CMN_3_ ECU_ADDRESS 0x7fc2f8 FORMAT "%3.0" /end MEASUREMENT
/begin MEASUREMENT tbl_frf[3].envd.cus_set[1][3] "" UBYTE _CNV_A_R_LINEAR_____0_CM 1 0. 0. 255. DISPLAY_IDENTIFIER FMY_FRF_4_ENVD_CUS_SET_2_CMN_4_ ECU_ADDRESS 0x7fc2f9 FORMAT "%3.0" /end MEASUREMENT
/begin MEASUREMENT tbl_frf[3].envd.cus_set[1][4] "" UBYTE _CNV_A_R_LINEAR_____0_CM 1 0. 0. 255. DISPLAY_IDENTIFIER FMY_FRF_4_ENVD_CUS_SET_2_CMN_5_ ECU_ADDRESS 0x7fc2fa FORMAT "%3.0" /end MEASUREMENT
/begin MEASUREMENT tbl_frf[3].envd.cus_set[1][5] "" UBYTE _CNV_A_R_LINEAR_____0_CM 1 0. 0. 255. DISPLAY_IDENTIFIER FMY_FRF_4_ENVD_CUS_SET_2_CMN_6_ ECU_ADDRESS 0x7fc2fb FORMAT "%3.0" /end MEASUREMENT
/begin MEASUREMENT tbl_frf[3].envd.cus_set[1][6] "" UBYTE _CNV_A_R_LINEAR_____0_CM 1 0. 0. 255. DISPLAY_IDENTIFIER FMY_FRF_4_ENVD_CUS_SET_2_SPC_1_ ECU_ADDRESS 0x7fc2fc FORMAT "%3.0" /end MEASUREMENT
/begin MEASUREMENT tbl_frf[3].envd.cus_set[1][7] "" UBYTE _CNV_A_R_LINEAR_____0_CM 1 0. 0. 255. DISPLAY_IDENTIFIER FMY_FRF_4_ENVD_CUS_SET_2_SPC_2_ ECU_ADDRESS 0x7fc2fd FORMAT "%3.0" /end MEASUREMENT
/begin MEASUREMENT tbl_frf[3].envd.cus_set[1][8] "" UBYTE _CNV_A_R_LINEAR_____0_CM 1 0. 0. 255. DISPLAY_IDENTIFIER FMY_FRF_4_ENVD_CUS_SET_2_SPC_3_ ECU_ADDRESS 0x7fc2fe FORMAT "%3.0" /end MEASUREMENT
/begin MEASUREMENT tbl_frf[3].envd.cus_set[1][9] "" UBYTE _CNV_A_R_LINEAR_____0_CM 1 0. 0. 255. DISPLAY_IDENTIFIER FMY_FRF_4_ENVD_CUS_SET_2_SPC_4_ ECU_ADDRESS 0x7fc2ff FORMAT "%3.0" /end MEASUREMENT
/begin MEASUREMENT tbl_frf[3].envd.cus_set[1][10] "" UBYTE _CNV_A_R_LINEAR_____0_CM 1 0. 0. 255. DISPLAY_IDENTIFIER FMY_FRF_4_ENVD_CUS_SET_2_SPC_5_ ECU_ADDRESS 0x7fc300 FORMAT "%3.0" /end MEASUREMENT
/begin MEASUREMENT tbl_frf[3].envd.cus_set[1][11] "" UBYTE _CNV_A_R_LINEAR_____0_CM 1 0. 0. 255. DISPLAY_IDENTIFIER FMY_FRF_4_ENVD_CUS_SET_2_SPC_6_ ECU_ADDRESS 0x7fc301 FORMAT "%3.0" /end MEASUREMENT
/begin MEASUREMENT tbl_frf[3].envd.cus_set[1][12] "" UBYTE _CNV_A_R_LINEAR_____0_CM 1 0. 0. 255. DISPLAY_IDENTIFIER FMY_FRF_4_ENVD_CUS_SET_2_SPC_7_ ECU_ADDRESS 0x7fc302 FORMAT "%3.0" /end MEASUREMENT
/begin MEASUREMENT tbl_frf[3].envd.cus_set[1][13] "" UBYTE _CNV_A_R_LINEAR_____0_CM 1 0. 0. 255. DISPLAY_IDENTIFIER FMY_FRF_4_ENVD_CUS_SET_2_SPC_8_ ECU_ADDRESS 0x7fc303 FORMAT "%3.0" /end MEASUREMENT
/begin MEASUREMENT tbl_frf[3].envd.cmn_cus[0] "" UBYTE _CNV_A_R_LINEAR_____0_CM 1 0. 0. 255. DISPLAY_IDENTIFIER FMY_FRF_4_ENVD_CUS_CMN_1_ ECU_ADDRESS 0x7fc304 FORMAT "%3.0" /end MEASUREMENT
/begin MEASUREMENT tbl_frf[3].envd.obd[0] "" UBYTE _CNV_A_R_LINEAR_____0_CM 1 0. 0. 255. DISPLAY_IDENTIFIER FMY_FRF_4_ENVD_OBD_1_ ECU_ADDRESS 0x7fc305 FORMAT "%3.0" /end MEASUREMENT
/begin MEASUREMENT tbl_frf[3].envd.obd[1] "" UBYTE _CNV_A_R_LINEAR_____0_CM 1 0. 0. 255. DISPLAY_IDENTIFIER FMY_FRF_4_ENVD_OBD_2_ ECU_ADDRESS 0x7fc306 FORMAT "%3.0" /end MEASUREMENT
/begin MEASUREMENT tbl_frf[3].envd.obd[2] "" UBYTE _CNV_A_R_LINEAR_____0_CM 1 0. 0. 255. DISPLAY_IDENTIFIER FMY_FRF_4_ENVD_OBD_3_ ECU_ADDRESS 0x7fc307 FORMAT "%3.0" /end MEASUREMENT
/begin MEASUREMENT tbl_frf[3].envd.obd[3] "" UBYTE _CNV_A_R_LINEAR_____0_CM 1 0. 0. 255. DISPLAY_IDENTIFIER FMY_FRF_4_ENVD_OBD_4_ ECU_ADDRESS 0x7fc308 FORMAT "%3.0" /end MEASUREMENT
/begin MEASUREMENT tbl_frf[3].envd.obd[4] "" UBYTE _CNV_A_R_LINEAR_____0_CM 1 0. 0. 255. DISPLAY_IDENTIFIER FMY_FRF_4_ENVD_OBD_5_ ECU_ADDRESS 0x7fc309 FORMAT "%3.0" /end MEASUREMENT
/begin MEASUREMENT tbl_frf[3].envd.obd[5] "" UBYTE _CNV_A_R_LINEAR_____0_CM 1 0. 0. 255. DISPLAY_IDENTIFIER FMY_FRF_4_ENVD_OBD_6_ ECU_ADDRESS 0x7fc30a FORMAT "%3.0" /end MEASUREMENT
/begin MEASUREMENT tbl_frf[3].envd.obd[6] "" UBYTE _CNV_A_R_LINEAR_____0_CM 1 0. 0. 255. DISPLAY_IDENTIFIER FMY_FRF_4_ENVD_OBD_7_ ECU_ADDRESS 0x7fc30b FORMAT "%3.0" /end MEASUREMENT
/begin MEASUREMENT tbl_frf[3].envd.obd[7] "" UBYTE _CNV_A_R_LINEAR_____0_CM 1 0. 0. 255. DISPLAY_IDENTIFIER FMY_FRF_4_ENVD_OBD_8_ ECU_ADDRESS 0x7fc30c FORMAT "%3.0" /end MEASUREMENT
/begin MEASUREMENT tbl_frf[4].envd.header "" UBYTE _CNV_A_R_LINEAR_____0_CM 1 0. 0. 255. DISPLAY_IDENTIFIER FMY_FRF_5_ENVD_HD ECU_ADDRESS 0x7fc30d FORMAT "%3.0" /end MEASUREMENT
/begin MEASUREMENT tbl_frf[4].envd.cus_set[0][0] "" UBYTE _CNV_A_R_LINEAR_____0_CM 1 0. 0. 255. DISPLAY_IDENTIFIER FMY_FRF_5_ENVD_CUS_SET_1_CMN_1_ ECU_ADDRESS 0x7fc30e FORMAT "%3.0" /end MEASUREMENT
/begin MEASUREMENT tbl_frf[4].envd.cus_set[0][1] "" UBYTE _CNV_A_R_LINEAR_____0_CM 1 0. 0. 255. DISPLAY_IDENTIFIER FMY_FRF_5_ENVD_CUS_SET_1_CMN_2_ ECU_ADDRESS 0x7fc30f FORMAT "%3.0" /end MEASUREMENT
/begin MEASUREMENT tbl_frf[4].envd.cus_set[0][2] "" UBYTE _CNV_A_R_LINEAR_____0_CM 1 0. 0. 255. DISPLAY_IDENTIFIER FMY_FRF_5_ENVD_CUS_SET_1_CMN_3_ ECU_ADDRESS 0x7fc310 FORMAT "%3.0" /end MEASUREMENT
/begin MEASUREMENT tbl_frf[4].envd.cus_set[0][3] "" UBYTE _CNV_A_R_LINEAR_____0_CM 1 0. 0. 255. DISPLAY_IDENTIFIER FMY_FRF_5_ENVD_CUS_SET_1_CMN_4_ ECU_ADDRESS 0x7fc311 FORMAT "%3.0" /end MEASUREMENT
/begin MEASUREMENT tbl_frf[4].envd.cus_set[0][4] "" UBYTE _CNV_A_R_LINEAR_____0_CM 1 0. 0. 255. DISPLAY_IDENTIFIER FMY_FRF_5_ENVD_CUS_SET_1_CMN_5_ ECU_ADDRESS 0x7fc312 FORMAT "%3.0" /end MEASUREMENT
/begin MEASUREMENT tbl_frf[4].envd.cus_set[0][5] "" UBYTE _CNV_A_R_LINEAR_____0_CM 1 0. 0. 255. DISPLAY_IDENTIFIER FMY_FRF_5_ENVD_CUS_SET_1_CMN_6_ ECU_ADDRESS 0x7fc313 FORMAT "%3.0" /end MEASUREMENT
/begin MEASUREMENT tbl_frf[4].envd.cus_set[0][6] "" UBYTE _CNV_A_R_LINEAR_____0_CM 1 0. 0. 255. DISPLAY_IDENTIFIER FMY_FRF_5_ENVD_CUS_SET_1_SPC_1_ ECU_ADDRESS 0x7fc314 FORMAT "%3.0" /end MEASUREMENT
/begin MEASUREMENT tbl_frf[4].envd.cus_set[0][7] "" UBYTE _CNV_A_R_LINEAR_____0_CM 1 0. 0. 255. DISPLAY_IDENTIFIER FMY_FRF_5_ENVD_CUS_SET_1_SPC_2_ ECU_ADDRESS 0x7fc315 FORMAT "%3.0" /end MEASUREMENT
/begin MEASUREMENT tbl_frf[4].envd.cus_set[0][8] "" UBYTE _CNV_A_R_LINEAR_____0_CM 1 0. 0. 255. DISPLAY_IDENTIFIER FMY_FRF_5_ENVD_CUS_SET_1_SPC_3_ ECU_ADDRESS 0x7fc316 FORMAT "%3.0" /end MEASUREMENT
/begin MEASUREMENT tbl_frf[4].envd.cus_set[0][9] "" UBYTE _CNV_A_R_LINEAR_____0_CM 1 0. 0. 255. DISPLAY_IDENTIFIER FMY_FRF_5_ENVD_CUS_SET_1_SPC_4_ ECU_ADDRESS 0x7fc317 FORMAT "%3.0" /end MEASUREMENT
/begin MEASUREMENT tbl_frf[4].envd.cus_set[0][10] "" UBYTE _CNV_A_R_LINEAR_____0_CM 1 0. 0. 255. DISPLAY_IDENTIFIER FMY_FRF_5_ENVD_CUS_SET_1_SPC_5_ ECU_ADDRESS 0x7fc318 FORMAT "%3.0" /end MEASUREMENT
/begin MEASUREMENT tbl_frf[4].envd.cus_set[0][11] "" UBYTE _CNV_A_R_LINEAR_____0_CM 1 0. 0. 255. DISPLAY_IDENTIFIER FMY_FRF_5_ENVD_CUS_SET_1_SPC_6_ ECU_ADDRESS 0x7fc319 FORMAT "%3.0" /end MEASUREMENT
/begin MEASUREMENT tbl_frf[4].envd.cus_set[0][12] "" UBYTE _CNV_A_R_LINEAR_____0_CM 1 0. 0. 255. DISPLAY_IDENTIFIER FMY_FRF_5_ENVD_CUS_SET_1_SPC_7_ ECU_ADDRESS 0x7fc31a FORMAT "%3.0" /end MEASUREMENT
/begin MEASUREMENT tbl_frf[4].envd.cus_set[0][13] "" UBYTE _CNV_A_R_LINEAR_____0_CM 1 0. 0. 255. DISPLAY_IDENTIFIER FMY_FRF_5_ENVD_CUS_SET_1_SPC_8_ ECU_ADDRESS 0x7fc31b FORMAT "%3.0" /end MEASUREMENT
/begin MEASUREMENT tbl_frf[4].envd.cus_set[1][0] "" UBYTE _CNV_A_R_LINEAR_____0_CM 1 0. 0. 255. DISPLAY_IDENTIFIER FMY_FRF_5_ENVD_CUS_SET_2_CMN_1_ ECU_ADDRESS 0x7fc31c FORMAT "%3.0" /end MEASUREMENT
/begin MEASUREMENT tbl_frf[4].envd.cus_set[1][1] "" UBYTE _CNV_A_R_LINEAR_____0_CM 1 0. 0. 255. DISPLAY_IDENTIFIER FMY_FRF_5_ENVD_CUS_SET_2_CMN_2_ ECU_ADDRESS 0x7fc31d FORMAT "%3.0" /end MEASUREMENT
/begin MEASUREMENT tbl_frf[4].envd.cus_set[1][2] "" UBYTE _CNV_A_R_LINEAR_____0_CM 1 0. 0. 255. DISPLAY_IDENTIFIER FMY_FRF_5_ENVD_CUS_SET_2_CMN_3_ ECU_ADDRESS 0x7fc31e FORMAT "%3.0" /end MEASUREMENT
/begin MEASUREMENT tbl_frf[4].envd.cus_set[1][3] "" UBYTE _CNV_A_R_LINEAR_____0_CM 1 0. 0. 255. DISPLAY_IDENTIFIER FMY_FRF_5_ENVD_CUS_SET_2_CMN_4_ ECU_ADDRESS 0x7fc31f FORMAT "%3.0" /end MEASUREMENT
/begin MEASUREMENT tbl_frf[4].envd.cus_set[1][4] "" UBYTE _CNV_A_R_LINEAR_____0_CM 1 0. 0. 255. DISPLAY_IDENTIFIER FMY_FRF_5_ENVD_CUS_SET_2_CMN_5_ ECU_ADDRESS 0x7fc320 FORMAT "%3.0" /end MEASUREMENT
/begin MEASUREMENT tbl_frf[4].envd.cus_set[1][5] "" UBYTE _CNV_A_R_LINEAR_____0_CM 1 0. 0. 255. DISPLAY_IDENTIFIER FMY_FRF_5_ENVD_CUS_SET_2_CMN_6_ ECU_ADDRESS 0x7fc321 FORMAT "%3.0" /end MEASUREMENT
/begin MEASUREMENT tbl_frf[4].envd.cus_set[1][6] "" UBYTE _CNV_A_R_LINEAR_____0_CM 1 0. 0. 255. DISPLAY_IDENTIFIER FMY_FRF_5_ENVD_CUS_SET_2_SPC_1_ ECU_ADDRESS 0x7fc322 FORMAT "%3.0" /end MEASUREMENT
/begin MEASUREMENT tbl_frf[4].envd.cus_set[1][7] "" UBYTE _CNV_A_R_LINEAR_____0_CM 1 0. 0. 255. DISPLAY_IDENTIFIER FMY_FRF_5_ENVD_CUS_SET_2_SPC_2_ ECU_ADDRESS 0x7fc323 FORMAT "%3.0" /end MEASUREMENT
/begin MEASUREMENT tbl_frf[4].envd.cus_set[1][8] "" UBYTE _CNV_A_R_LINEAR_____0_CM 1 0. 0. 255. DISPLAY_IDENTIFIER FMY_FRF_5_ENVD_CUS_SET_2_SPC_3_ ECU_ADDRESS 0x7fc324 FORMAT "%3.0" /end MEASUREMENT
/begin MEASUREMENT tbl_frf[4].envd.cus_set[1][9] "" UBYTE _CNV_A_R_LINEAR_____0_CM 1 0. 0. 255. DISPLAY_IDENTIFIER FMY_FRF_5_ENVD_CUS_SET_2_SPC_4_ ECU_ADDRESS 0x7fc325 FORMAT "%3.0" /end MEASUREMENT
/begin MEASUREMENT tbl_frf[4].envd.cus_set[1][10] "" UBYTE _CNV_A_R_LINEAR_____0_CM 1 0. 0. 255. DISPLAY_IDENTIFIER FMY_FRF_5_ENVD_CUS_SET_2_SPC_5_ ECU_ADDRESS 0x7fc326 FORMAT "%3.0" /end MEASUREMENT
/begin MEASUREMENT tbl_frf[4].envd.cus_set[1][11] "" UBYTE _CNV_A_R_LINEAR_____0_CM 1 0. 0. 255. DISPLAY_IDENTIFIER FMY_FRF_5_ENVD_CUS_SET_2_SPC_6_ ECU_ADDRESS 0x7fc327 FORMAT "%3.0" /end MEASUREMENT
/begin MEASUREMENT tbl_frf[4].envd.cus_set[1][12] "" UBYTE _CNV_A_R_LINEAR_____0_CM 1 0. 0. 255. DISPLAY_IDENTIFIER FMY_FRF_5_ENVD_CUS_SET_2_SPC_7_ ECU_ADDRESS 0x7fc328 FORMAT "%3.0" /end MEASUREMENT
/begin MEASUREMENT tbl_frf[4].envd.cus_set[1][13] "" UBYTE _CNV_A_R_LINEAR_____0_CM 1 0. 0. 255. DISPLAY_IDENTIFIER FMY_FRF_5_ENVD_CUS_SET_2_SPC_8_ ECU_ADDRESS 0x7fc329 FORMAT "%3.0" /end MEASUREMENT
/begin MEASUREMENT tbl_frf[4].envd.cmn_cus[0] "" UBYTE _CNV_A_R_LINEAR_____0_CM 1 0. 0. 255. DISPLAY_IDENTIFIER FMY_FRF_5_ENVD_CUS_CMN_1_ ECU_ADDRESS 0x7fc32a FORMAT "%3.0" /end MEASUREMENT
/begin MEASUREMENT tbl_frf[4].envd.obd[0] "" UBYTE _CNV_A_R_LINEAR_____0_CM 1 0. 0. 255. DISPLAY_IDENTIFIER FMY_FRF_5_ENVD_OBD_1_ ECU_ADDRESS 0x7fc32b FORMAT "%3.0" /end MEASUREMENT
/begin MEASUREMENT tbl_frf[4].envd.obd[1] "" UBYTE _CNV_A_R_LINEAR_____0_CM 1 0. 0. 255. DISPLAY_IDENTIFIER FMY_FRF_5_ENVD_OBD_2_ ECU_ADDRESS 0x7fc32c FORMAT "%3.0" /end MEASUREMENT
/begin MEASUREMENT tbl_frf[4].envd.obd[2] "" UBYTE _CNV_A_R_LINEAR_____0_CM 1 0. 0. 255. DISPLAY_IDENTIFIER FMY_FRF_5_ENVD_OBD_3_ ECU_ADDRESS 0x7fc32d FORMAT "%3.0" /end MEASUREMENT
/begin MEASUREMENT tbl_frf[4].envd.obd[3] "" UBYTE _CNV_A_R_LINEAR_____0_CM 1 0. 0. 255. DISPLAY_IDENTIFIER FMY_FRF_5_ENVD_OBD_4_ ECU_ADDRESS 0x7fc32e FORMAT "%3.0" /end MEASUREMENT
/begin MEASUREMENT tbl_frf[4].envd.obd[4] "" UBYTE _CNV_A_R_LINEAR_____0_CM 1 0. 0. 255. DISPLAY_IDENTIFIER FMY_FRF_5_ENVD_OBD_5_ ECU_ADDRESS 0x7fc32f FORMAT "%3.0" /end MEASUREMENT
/begin MEASUREMENT tbl_frf[4].envd.obd[5] "" UBYTE _CNV_A_R_LINEAR_____0_CM 1 0. 0. 255. DISPLAY_IDENTIFIER FMY_FRF_5_ENVD_OBD_6_ ECU_ADDRESS 0x7fc330 FORMAT "%3.0" /end MEASUREMENT
/begin MEASUREMENT tbl_frf[4].envd.obd[6] "" UBYTE _CNV_A_R_LINEAR_____0_CM 1 0. 0. 255. DISPLAY_IDENTIFIER FMY_FRF_5_ENVD_OBD_7_ ECU_ADDRESS 0x7fc331 FORMAT "%3.0" /end MEASUREMENT
/begin MEASUREMENT tbl_frf[4].envd.obd[7] "" UBYTE _CNV_A_R_LINEAR_____0_CM 1 0. 0. 255. DISPLAY_IDENTIFIER FMY_FRF_5_ENVD_OBD_8_ ECU_ADDRESS 0x7fc332 FORMAT "%3.0" /end MEASUREMENT
/begin MEASUREMENT tbl_frf[5].envd.header "" UBYTE _CNV_A_R_LINEAR_____0_CM 1 0. 0. 255. DISPLAY_IDENTIFIER FMY_FRF_6_ENVD_HD ECU_ADDRESS 0x7fc333 FORMAT "%3.0" /end MEASUREMENT
/begin MEASUREMENT tbl_frf[5].envd.cus_set[0][0] "" UBYTE _CNV_A_R_LINEAR_____0_CM 1 0. 0. 255. DISPLAY_IDENTIFIER FMY_FRF_6_ENVD_CUS_SET_1_CMN_1_ ECU_ADDRESS 0x7fc334 FORMAT "%3.0" /end MEASUREMENT
/begin MEASUREMENT tbl_frf[5].envd.cus_set[0][1] "" UBYTE _CNV_A_R_LINEAR_____0_CM 1 0. 0. 255. DISPLAY_IDENTIFIER FMY_FRF_6_ENVD_CUS_SET_1_CMN_2_ ECU_ADDRESS 0x7fc335 FORMAT "%3.0" /end MEASUREMENT
/begin MEASUREMENT tbl_frf[5].envd.cus_set[0][2] "" UBYTE _CNV_A_R_LINEAR_____0_CM 1 0. 0. 255. DISPLAY_IDENTIFIER FMY_FRF_6_ENVD_CUS_SET_1_CMN_3_ ECU_ADDRESS 0x7fc336 FORMAT "%3.0" /end MEASUREMENT
/begin MEASUREMENT tbl_frf[5].envd.cus_set[0][3] "" UBYTE _CNV_A_R_LINEAR_____0_CM 1 0. 0. 255. DISPLAY_IDENTIFIER FMY_FRF_6_ENVD_CUS_SET_1_CMN_4_ ECU_ADDRESS 0x7fc337 FORMAT "%3.0" /end MEASUREMENT
/begin MEASUREMENT tbl_frf[5].envd.cus_set[0][4] "" UBYTE _CNV_A_R_LINEAR_____0_CM 1 0. 0. 255. DISPLAY_IDENTIFIER FMY_FRF_6_ENVD_CUS_SET_1_CMN_5_ ECU_ADDRESS 0x7fc338 FORMAT "%3.0" /end MEASUREMENT
/begin MEASUREMENT tbl_frf[5].envd.cus_set[0][5] "" UBYTE _CNV_A_R_LINEAR_____0_CM 1 0. 0. 255. DISPLAY_IDENTIFIER FMY_FRF_6_ENVD_CUS_SET_1_CMN_6_ ECU_ADDRESS 0x7fc339 FORMAT "%3.0" /end MEASUREMENT
/begin MEASUREMENT tbl_frf[5].envd.cus_set[0][6] "" UBYTE _CNV_A_R_LINEAR_____0_CM 1 0. 0. 255. DISPLAY_IDENTIFIER FMY_FRF_6_ENVD_CUS_SET_1_SPC_1_ ECU_ADDRESS 0x7fc33a FORMAT "%3.0" /end MEASUREMENT
/begin MEASUREMENT tbl_frf[5].envd.cus_set[0][7] "" UBYTE _CNV_A_R_LINEAR_____0_CM 1 0. 0. 255. DISPLAY_IDENTIFIER FMY_FRF_6_ENVD_CUS_SET_1_SPC_2_ ECU_ADDRESS 0x7fc33b FORMAT "%3.0" /end MEASUREMENT
/begin MEASUREMENT tbl_frf[5].envd.cus_set[0][8] "" UBYTE _CNV_A_R_LINEAR_____0_CM 1 0. 0. 255. DISPLAY_IDENTIFIER FMY_FRF_6_ENVD_CUS_SET_1_SPC_3_ ECU_ADDRESS 0x7fc33c FORMAT "%3.0" /end MEASUREMENT
/begin MEASUREMENT tbl_frf[5].envd.cus_set[0][9] "" UBYTE _CNV_A_R_LINEAR_____0_CM 1 0. 0. 255. DISPLAY_IDENTIFIER FMY_FRF_6_ENVD_CUS_SET_1_SPC_4_ ECU_ADDRESS 0x7fc33d FORMAT "%3.0" /end MEASUREMENT
/begin MEASUREMENT tbl_frf[5].envd.cus_set[0][10] "" UBYTE _CNV_A_R_LINEAR_____0_CM 1 0. 0. 255. DISPLAY_IDENTIFIER FMY_FRF_6_ENVD_CUS_SET_1_SPC_5_ ECU_ADDRESS 0x7fc33e FORMAT "%3.0" /end MEASUREMENT
/begin MEASUREMENT tbl_frf[5].envd.cus_set[0][11] "" UBYTE _CNV_A_R_LINEAR_____0_CM 1 0. 0. 255. DISPLAY_IDENTIFIER FMY_FRF_6_ENVD_CUS_SET_1_SPC_6_ ECU_ADDRESS 0x7fc33f FORMAT "%3.0" /end MEASUREMENT
/begin MEASUREMENT tbl_frf[5].envd.cus_set[0][12] "" UBYTE _CNV_A_R_LINEAR_____0_CM 1 0. 0. 255. DISPLAY_IDENTIFIER FMY_FRF_6_ENVD_CUS_SET_1_SPC_7_ ECU_ADDRESS 0x7fc340 FORMAT "%3.0" /end MEASUREMENT
/begin MEASUREMENT tbl_frf[5].envd.cus_set[0][13] "" UBYTE _CNV_A_R_LINEAR_____0_CM 1 0. 0. 255. DISPLAY_IDENTIFIER FMY_FRF_6_ENVD_CUS_SET_1_SPC_8_ ECU_ADDRESS 0x7fc341 FORMAT "%3.0" /end MEASUREMENT
/begin MEASUREMENT tbl_frf[5].envd.cus_set[1][0] "" UBYTE _CNV_A_R_LINEAR_____0_CM 1 0. 0. 255. DISPLAY_IDENTIFIER FMY_FRF_6_ENVD_CUS_SET_2_CMN_1_ ECU_ADDRESS 0x7fc342 FORMAT "%3.0" /end MEASUREMENT
/begin MEASUREMENT tbl_frf[5].envd.cus_set[1][1] "" UBYTE _CNV_A_R_LINEAR_____0_CM 1 0. 0. 255. DISPLAY_IDENTIFIER FMY_FRF_6_ENVD_CUS_SET_2_CMN_2_ ECU_ADDRESS 0x7fc343 FORMAT "%3.0" /end MEASUREMENT
/begin MEASUREMENT tbl_frf[5].envd.cus_set[1][2] "" UBYTE _CNV_A_R_LINEAR_____0_CM 1 0. 0. 255. DISPLAY_IDENTIFIER FMY_FRF_6_ENVD_CUS_SET_2_CMN_3_ ECU_ADDRESS 0x7fc344 FORMAT "%3.0" /end MEASUREMENT
/begin MEASUREMENT tbl_frf[5].envd.cus_set[1][3] "" UBYTE _CNV_A_R_LINEAR_____0_CM 1 0. 0. 255. DISPLAY_IDENTIFIER FMY_FRF_6_ENVD_CUS_SET_2_CMN_4_ ECU_ADDRESS 0x7fc345 FORMAT "%3.0" /end MEASUREMENT
/begin MEASUREMENT tbl_frf[5].envd.cus_set[1][4] "" UBYTE _CNV_A_R_LINEAR_____0_CM 1 0. 0. 255. DISPLAY_IDENTIFIER FMY_FRF_6_ENVD_CUS_SET_2_CMN_5_ ECU_ADDRESS 0x7fc346 FORMAT "%3.0" /end MEASUREMENT
/begin MEASUREMENT tbl_frf[5].envd.cus_set[1][5] "" UBYTE _CNV_A_R_LINEAR_____0_CM 1 0. 0. 255. DISPLAY_IDENTIFIER FMY_FRF_6_ENVD_CUS_SET_2_CMN_6_ ECU_ADDRESS 0x7fc347 FORMAT "%3.0" /end MEASUREMENT
/begin MEASUREMENT tbl_frf[5].envd.cus_set[1][6] "" UBYTE _CNV_A_R_LINEAR_____0_CM 1 0. 0. 255. DISPLAY_IDENTIFIER FMY_FRF_6_ENVD_CUS_SET_2_SPC_1_ ECU_ADDRESS 0x7fc348 FORMAT "%3.0" /end MEASUREMENT
/begin MEASUREMENT tbl_frf[5].envd.cus_set[1][7] "" UBYTE _CNV_A_R_LINEAR_____0_CM 1 0. 0. 255. DISPLAY_IDENTIFIER FMY_FRF_6_ENVD_CUS_SET_2_SPC_2_ ECU_ADDRESS 0x7fc349 FORMAT "%3.0" /end MEASUREMENT
/begin MEASUREMENT tbl_frf[5].envd.cus_set[1][8] "" UBYTE _CNV_A_R_LINEAR_____0_CM 1 0. 0. 255. DISPLAY_IDENTIFIER FMY_FRF_6_ENVD_CUS_SET_2_SPC_3_ ECU_ADDRESS 0x7fc34a FORMAT "%3.0" /end MEASUREMENT
/begin MEASUREMENT tbl_frf[5].envd.cus_set[1][9] "" UBYTE _CNV_A_R_LINEAR_____0_CM 1 0. 0. 255. DISPLAY_IDENTIFIER FMY_FRF_6_ENVD_CUS_SET_2_SPC_4_ ECU_ADDRESS 0x7fc34b FORMAT "%3.0" /end MEASUREMENT
/begin MEASUREMENT tbl_frf[5].envd.cus_set[1][10] "" UBYTE _CNV_A_R_LINEAR_____0_CM 1 0. 0. 255. DISPLAY_IDENTIFIER FMY_FRF_6_ENVD_CUS_SET_2_SPC_5_ ECU_ADDRESS 0x7fc34c FORMAT "%3.0" /end MEASUREMENT
/begin MEASUREMENT tbl_frf[5].envd.cus_set[1][11] "" UBYTE _CNV_A_R_LINEAR_____0_CM 1 0. 0. 255. DISPLAY_IDENTIFIER FMY_FRF_6_ENVD_CUS_SET_2_SPC_6_ ECU_ADDRESS 0x7fc34d FORMAT "%3.0" /end MEASUREMENT
/begin MEASUREMENT tbl_frf[5].envd.cus_set[1][12] "" UBYTE _CNV_A_R_LINEAR_____0_CM 1 0. 0. 255. DISPLAY_IDENTIFIER FMY_FRF_6_ENVD_CUS_SET_2_SPC_7_ ECU_ADDRESS 0x7fc34e FORMAT "%3.0" /end MEASUREMENT
/begin MEASUREMENT tbl_frf[5].envd.cus_set[1][13] "" UBYTE _CNV_A_R_LINEAR_____0_CM 1 0. 0. 255. DISPLAY_IDENTIFIER FMY_FRF_6_ENVD_CUS_SET_2_SPC_8_ ECU_ADDRESS 0x7fc34f FORMAT "%3.0" /end MEASUREMENT
/begin MEASUREMENT tbl_frf[5].envd.cmn_cus[0] "" UBYTE _CNV_A_R_LINEAR_____0_CM 1 0. 0. 255. DISPLAY_IDENTIFIER FMY_FRF_6_ENVD_CUS_CMN_1_ ECU_ADDRESS 0x7fc350 FORMAT "%3.0" /end MEASUREMENT
/begin MEASUREMENT tbl_frf[5].envd.obd[0] "" UBYTE _CNV_A_R_LINEAR_____0_CM 1 0. 0. 255. DISPLAY_IDENTIFIER FMY_FRF_6_ENVD_OBD_1_ ECU_ADDRESS 0x7fc351 FORMAT "%3.0" /end MEASUREMENT
/begin MEASUREMENT tbl_frf[5].envd.obd[1] "" UBYTE _CNV_A_R_LINEAR_____0_CM 1 0. 0. 255. DISPLAY_IDENTIFIER FMY_FRF_6_ENVD_OBD_2_ ECU_ADDRESS 0x7fc352 FORMAT "%3.0" /end MEASUREMENT
/begin MEASUREMENT tbl_frf[5].envd.obd[2] "" UBYTE _CNV_A_R_LINEAR_____0_CM 1 0. 0. 255. DISPLAY_IDENTIFIER FMY_FRF_6_ENVD_OBD_3_ ECU_ADDRESS 0x7fc353 FORMAT "%3.0" /end MEASUREMENT
/begin MEASUREMENT tbl_frf[5].envd.obd[3] "" UBYTE _CNV_A_R_LINEAR_____0_CM 1 0. 0. 255. DISPLAY_IDENTIFIER FMY_FRF_6_ENVD_OBD_4_ ECU_ADDRESS 0x7fc354 FORMAT "%3.0" /end MEASUREMENT
/begin MEASUREMENT tbl_frf[5].envd.obd[4] "" UBYTE _CNV_A_R_LINEAR_____0_CM 1 0. 0. 255. DISPLAY_IDENTIFIER FMY_FRF_6_ENVD_OBD_5_ ECU_ADDRESS 0x7fc355 FORMAT "%3.0" /end MEASUREMENT
/begin MEASUREMENT tbl_frf[5].envd.obd[5] "" UBYTE _CNV_A_R_LINEAR_____0_CM 1 0. 0. 255. DISPLAY_IDENTIFIER FMY_FRF_6_ENVD_OBD_6_ ECU_ADDRESS 0x7fc356 FORMAT "%3.0" /end MEASUREMENT
/begin MEASUREMENT tbl_frf[5].envd.obd[6] "" UBYTE _CNV_A_R_LINEAR_____0_CM 1 0. 0. 255. DISPLAY_IDENTIFIER FMY_FRF_6_ENVD_OBD_7_ ECU_ADDRESS 0x7fc357 FORMAT "%3.0" /end MEASUREMENT
/begin MEASUREMENT tbl_frf[5].envd.obd[7] "" UBYTE _CNV_A_R_LINEAR_____0_CM 1 0. 0. 255. DISPLAY_IDENTIFIER FMY_FRF_6_ENVD_OBD_8_ ECU_ADDRESS 0x7fc358 FORMAT "%3.0" /end MEASUREMENT
/begin MEASUREMENT tbl_frf[6].envd.header "" UBYTE _CNV_A_R_LINEAR_____0_CM 1 0. 0. 255. DISPLAY_IDENTIFIER FMY_FRF_7_ENVD_HD ECU_ADDRESS 0x7fc359 FORMAT "%3.0" /end MEASUREMENT
/begin MEASUREMENT tbl_frf[6].envd.cus_set[0][0] "" UBYTE _CNV_A_R_LINEAR_____0_CM 1 0. 0. 255. DISPLAY_IDENTIFIER FMY_FRF_7_ENVD_CUS_SET_1_CMN_1_ ECU_ADDRESS 0x7fc35a FORMAT "%3.0" /end MEASUREMENT
/begin MEASUREMENT tbl_frf[6].envd.cus_set[0][1] "" UBYTE _CNV_A_R_LINEAR_____0_CM 1 0. 0. 255. DISPLAY_IDENTIFIER FMY_FRF_7_ENVD_CUS_SET_1_CMN_2_ ECU_ADDRESS 0x7fc35b FORMAT "%3.0" /end MEASUREMENT
/begin MEASUREMENT tbl_frf[6].envd.cus_set[0][2] "" UBYTE _CNV_A_R_LINEAR_____0_CM 1 0. 0. 255. DISPLAY_IDENTIFIER FMY_FRF_7_ENVD_CUS_SET_1_CMN_3_ ECU_ADDRESS 0x7fc35c FORMAT "%3.0" /end MEASUREMENT
/begin MEASUREMENT tbl_frf[6].envd.cus_set[0][3] "" UBYTE _CNV_A_R_LINEAR_____0_CM 1 0. 0. 255. DISPLAY_IDENTIFIER FMY_FRF_7_ENVD_CUS_SET_1_CMN_4_ ECU_ADDRESS 0x7fc35d FORMAT "%3.0" /end MEASUREMENT
/begin MEASUREMENT tbl_frf[6].envd.cus_set[0][4] "" UBYTE _CNV_A_R_LINEAR_____0_CM 1 0. 0. 255. DISPLAY_IDENTIFIER FMY_FRF_7_ENVD_CUS_SET_1_CMN_5_ ECU_ADDRESS 0x7fc35e FORMAT "%3.0" /end MEASUREMENT
/begin MEASUREMENT tbl_frf[6].envd.cus_set[0][5] "" UBYTE _CNV_A_R_LINEAR_____0_CM 1 0. 0. 255. DISPLAY_IDENTIFIER FMY_FRF_7_ENVD_CUS_SET_1_CMN_6_ ECU_ADDRESS 0x7fc35f FORMAT "%3.0" /end MEASUREMENT
/begin MEASUREMENT tbl_frf[6].envd.cus_set[0][6] "" UBYTE _CNV_A_R_LINEAR_____0_CM 1 0. 0. 255. DISPLAY_IDENTIFIER FMY_FRF_7_ENVD_CUS_SET_1_SPC_1_ ECU_ADDRESS 0x7fc360 FORMAT "%3.0" /end MEASUREMENT
/begin MEASUREMENT tbl_frf[6].envd.cus_set[0][7] "" UBYTE _CNV_A_R_LINEAR_____0_CM 1 0. 0. 255. DISPLAY_IDENTIFIER FMY_FRF_7_ENVD_CUS_SET_1_SPC_2_ ECU_ADDRESS 0x7fc361 FORMAT "%3.0" /end MEASUREMENT
/begin MEASUREMENT tbl_frf[6].envd.cus_set[0][8] "" UBYTE _CNV_A_R_LINEAR_____0_CM 1 0. 0. 255. DISPLAY_IDENTIFIER FMY_FRF_7_ENVD_CUS_SET_1_SPC_3_ ECU_ADDRESS 0x7fc362 FORMAT "%3.0" /end MEASUREMENT
/begin MEASUREMENT tbl_frf[6].envd.cus_set[0][9] "" UBYTE _CNV_A_R_LINEAR_____0_CM 1 0. 0. 255. DISPLAY_IDENTIFIER FMY_FRF_7_ENVD_CUS_SET_1_SPC_4_ ECU_ADDRESS 0x7fc363 FORMAT "%3.0" /end MEASUREMENT
/begin MEASUREMENT tbl_frf[6].envd.cus_set[0][10] "" UBYTE _CNV_A_R_LINEAR_____0_CM 1 0. 0. 255. DISPLAY_IDENTIFIER FMY_FRF_7_ENVD_CUS_SET_1_SPC_5_ ECU_ADDRESS 0x7fc364 FORMAT "%3.0" /end MEASUREMENT
/begin MEASUREMENT tbl_frf[6].envd.cus_set[0][11] "" UBYTE _CNV_A_R_LINEAR_____0_CM 1 0. 0. 255. DISPLAY_IDENTIFIER FMY_FRF_7_ENVD_CUS_SET_1_SPC_6_ ECU_ADDRESS 0x7fc365 FORMAT "%3.0" /end MEASUREMENT
/begin MEASUREMENT tbl_frf[6].envd.cus_set[0][12] "" UBYTE _CNV_A_R_LINEAR_____0_CM 1 0. 0. 255. DISPLAY_IDENTIFIER FMY_FRF_7_ENVD_CUS_SET_1_SPC_7_ ECU_ADDRESS 0x7fc366 FORMAT "%3.0" /end MEASUREMENT
/begin MEASUREMENT tbl_frf[6].envd.cus_set[0][13] "" UBYTE _CNV_A_R_LINEAR_____0_CM 1 0. 0. 255. DISPLAY_IDENTIFIER FMY_FRF_7_ENVD_CUS_SET_1_SPC_8_ ECU_ADDRESS 0x7fc367 FORMAT "%3.0" /end MEASUREMENT
/begin MEASUREMENT tbl_frf[6].envd.cus_set[1][0] "" UBYTE _CNV_A_R_LINEAR_____0_CM 1 0. 0. 255. DISPLAY_IDENTIFIER FMY_FRF_7_ENVD_CUS_SET_2_CMN_1_ ECU_ADDRESS 0x7fc368 FORMAT "%3.0" /end MEASUREMENT
/begin MEASUREMENT tbl_frf[6].envd.cus_set[1][1] "" UBYTE _CNV_A_R_LINEAR_____0_CM 1 0. 0. 255. DISPLAY_IDENTIFIER FMY_FRF_7_ENVD_CUS_SET_2_CMN_2_ ECU_ADDRESS 0x7fc369 FORMAT "%3.0" /end MEASUREMENT
/begin MEASUREMENT tbl_frf[6].envd.cus_set[1][2] "" UBYTE _CNV_A_R_LINEAR_____0_CM 1 0. 0. 255. DISPLAY_IDENTIFIER FMY_FRF_7_ENVD_CUS_SET_2_CMN_3_ ECU_ADDRESS 0x7fc36a FORMAT "%3.0" /end MEASUREMENT
/begin MEASUREMENT tbl_frf[6].envd.cus_set[1][3] "" UBYTE _CNV_A_R_LINEAR_____0_CM 1 0. 0. 255. DISPLAY_IDENTIFIER FMY_FRF_7_ENVD_CUS_SET_2_CMN_4_ ECU_ADDRESS 0x7fc36b FORMAT "%3.0" /end MEASUREMENT
/begin MEASUREMENT tbl_frf[6].envd.cus_set[1][4] "" UBYTE _CNV_A_R_LINEAR_____0_CM 1 0. 0. 255. DISPLAY_IDENTIFIER FMY_FRF_7_ENVD_CUS_SET_2_CMN_5_ ECU_ADDRESS 0x7fc36c FORMAT "%3.0" /end MEASUREMENT
/begin MEASUREMENT tbl_frf[6].envd.cus_set[1][5] "" UBYTE _CNV_A_R_LINEAR_____0_CM 1 0. 0. 255. DISPLAY_IDENTIFIER FMY_FRF_7_ENVD_CUS_SET_2_CMN_6_ ECU_ADDRESS 0x7fc36d FORMAT "%3.0" /end MEASUREMENT
/begin MEASUREMENT tbl_frf[6].envd.cus_set[1][6] "" UBYTE _CNV_A_R_LINEAR_____0_CM 1 0. 0. 255. DISPLAY_IDENTIFIER FMY_FRF_7_ENVD_CUS_SET_2_SPC_1_ ECU_ADDRESS 0x7fc36e FORMAT "%3.0" /end MEASUREMENT
/begin MEASUREMENT tbl_frf[6].envd.cus_set[1][7] "" UBYTE _CNV_A_R_LINEAR_____0_CM 1 0. 0. 255. DISPLAY_IDENTIFIER FMY_FRF_7_ENVD_CUS_SET_2_SPC_2_ ECU_ADDRESS 0x7fc36f FORMAT "%3.0" /end MEASUREMENT
/begin MEASUREMENT tbl_frf[6].envd.cus_set[1][8] "" UBYTE _CNV_A_R_LINEAR_____0_CM 1 0. 0. 255. DISPLAY_IDENTIFIER FMY_FRF_7_ENVD_CUS_SET_2_SPC_3_ ECU_ADDRESS 0x7fc370 FORMAT "%3.0" /end MEASUREMENT
/begin MEASUREMENT tbl_frf[6].envd.cus_set[1][9] "" UBYTE _CNV_A_R_LINEAR_____0_CM 1 0. 0. 255. DISPLAY_IDENTIFIER FMY_FRF_7_ENVD_CUS_SET_2_SPC_4_ ECU_ADDRESS 0x7fc371 FORMAT "%3.0" /end MEASUREMENT
/begin MEASUREMENT tbl_frf[6].envd.cus_set[1][10] "" UBYTE _CNV_A_R_LINEAR_____0_CM 1 0. 0. 255. DISPLAY_IDENTIFIER FMY_FRF_7_ENVD_CUS_SET_2_SPC_5_ ECU_ADDRESS 0x7fc372 FORMAT "%3.0" /end MEASUREMENT
/begin MEASUREMENT tbl_frf[6].envd.cus_set[1][11] "" UBYTE _CNV_A_R_LINEAR_____0_CM 1 0. 0. 255. DISPLAY_IDENTIFIER FMY_FRF_7_ENVD_CUS_SET_2_SPC_6_ ECU_ADDRESS 0x7fc373 FORMAT "%3.0" /end MEASUREMENT
/begin MEASUREMENT tbl_frf[6].envd.cus_set[1][12] "" UBYTE _CNV_A_R_LINEAR_____0_CM 1 0. 0. 255. DISPLAY_IDENTIFIER FMY_FRF_7_ENVD_CUS_SET_2_SPC_7_ ECU_ADDRESS 0x7fc374 FORMAT "%3.0" /end MEASUREMENT
/begin MEASUREMENT tbl_frf[6].envd.cus_set[1][13] "" UBYTE _CNV_A_R_LINEAR_____0_CM 1 0. 0. 255. DISPLAY_IDENTIFIER FMY_FRF_7_ENVD_CUS_SET_2_SPC_8_ ECU_ADDRESS 0x7fc375 FORMAT "%3.0" /end MEASUREMENT
/begin MEASUREMENT tbl_frf[6].envd.cmn_cus[0] "" UBYTE _CNV_A_R_LINEAR_____0_CM 1 0. 0. 255. DISPLAY_IDENTIFIER FMY_FRF_7_ENVD_CUS_CMN_1_ ECU_ADDRESS 0x7fc376 FORMAT "%3.0" /end MEASUREMENT
/begin MEASUREMENT tbl_frf[6].envd.obd[0] "" UBYTE _CNV_A_R_LINEAR_____0_CM 1 0. 0. 255. DISPLAY_IDENTIFIER FMY_FRF_7_ENVD_OBD_1_ ECU_ADDRESS 0x7fc377 FORMAT "%3.0" /end MEASUREMENT
/begin MEASUREMENT tbl_frf[6].envd.obd[1] "" UBYTE _CNV_A_R_LINEAR_____0_CM 1 0. 0. 255. DISPLAY_IDENTIFIER FMY_FRF_7_ENVD_OBD_2_ ECU_ADDRESS 0x7fc378 FORMAT "%3.0" /end MEASUREMENT
/begin MEASUREMENT tbl_frf[6].envd.obd[2] "" UBYTE _CNV_A_R_LINEAR_____0_CM 1 0. 0. 255. DISPLAY_IDENTIFIER FMY_FRF_7_ENVD_OBD_3_ ECU_ADDRESS 0x7fc379 FORMAT "%3.0" /end MEASUREMENT
/begin MEASUREMENT tbl_frf[6].envd.obd[3] "" UBYTE _CNV_A_R_LINEAR_____0_CM 1 0. 0. 255. DISPLAY_IDENTIFIER FMY_FRF_7_ENVD_OBD_4_ ECU_ADDRESS 0x7fc37a FORMAT "%3.0" /end MEASUREMENT
/begin MEASUREMENT tbl_frf[6].envd.obd[4] "" UBYTE _CNV_A_R_LINEAR_____0_CM 1 0. 0. 255. DISPLAY_IDENTIFIER FMY_FRF_7_ENVD_OBD_5_ ECU_ADDRESS 0x7fc37b FORMAT "%3.0" /end MEASUREMENT
/begin MEASUREMENT tbl_frf[6].envd.obd[5] "" UBYTE _CNV_A_R_LINEAR_____0_CM 1 0. 0. 255. DISPLAY_IDENTIFIER FMY_FRF_7_ENVD_OBD_6_ ECU_ADDRESS 0x7fc37c FORMAT "%3.0" /end MEASUREMENT
/begin MEASUREMENT tbl_frf[6].envd.obd[6] "" UBYTE _CNV_A_R_LINEAR_____0_CM 1 0. 0. 255. DISPLAY_IDENTIFIER FMY_FRF_7_ENVD_OBD_7_ ECU_ADDRESS 0x7fc37d FORMAT "%3.0" /end MEASUREMENT
/begin MEASUREMENT tbl_frf[6].envd.obd[7] "" UBYTE _CNV_A_R_LINEAR_____0_CM 1 0. 0. 255. DISPLAY_IDENTIFIER FMY_FRF_7_ENVD_OBD_8_ ECU_ADDRESS 0x7fc37e FORMAT "%3.0" /end MEASUREMENT
/begin MEASUREMENT tbl_frf[7].envd.header "" UBYTE _CNV_A_R_LINEAR_____0_CM 1 0. 0. 255. DISPLAY_IDENTIFIER FMY_FRF_8_ENVD_HD ECU_ADDRESS 0x7fc37f FORMAT "%3.0" /end MEASUREMENT
/begin MEASUREMENT tbl_frf[7].envd.cus_set[0][0] "" UBYTE _CNV_A_R_LINEAR_____0_CM 1 0. 0. 255. DISPLAY_IDENTIFIER FMY_FRF_8_ENVD_CUS_SET_1_CMN_1_ ECU_ADDRESS 0x7fc380 FORMAT "%3.0" /end MEASUREMENT
/begin MEASUREMENT tbl_frf[7].envd.cus_set[0][1] "" UBYTE _CNV_A_R_LINEAR_____0_CM 1 0. 0. 255. DISPLAY_IDENTIFIER FMY_FRF_8_ENVD_CUS_SET_1_CMN_2_ ECU_ADDRESS 0x7fc381 FORMAT "%3.0" /end MEASUREMENT
/begin MEASUREMENT tbl_frf[7].envd.cus_set[0][2] "" UBYTE _CNV_A_R_LINEAR_____0_CM 1 0. 0. 255. DISPLAY_IDENTIFIER FMY_FRF_8_ENVD_CUS_SET_1_CMN_3_ ECU_ADDRESS 0x7fc382 FORMAT "%3.0" /end MEASUREMENT
/begin MEASUREMENT tbl_frf[7].envd.cus_set[0][3] "" UBYTE _CNV_A_R_LINEAR_____0_CM 1 0. 0. 255. DISPLAY_IDENTIFIER FMY_FRF_8_ENVD_CUS_SET_1_CMN_4_ ECU_ADDRESS 0x7fc383 FORMAT "%3.0" /end MEASUREMENT
/begin MEASUREMENT tbl_frf[7].envd.cus_set[0][4] "" UBYTE _CNV_A_R_LINEAR_____0_CM 1 0. 0. 255. DISPLAY_IDENTIFIER FMY_FRF_8_ENVD_CUS_SET_1_CMN_5_ ECU_ADDRESS 0x7fc384 FORMAT "%3.0" /end MEASUREMENT
/begin MEASUREMENT tbl_frf[7].envd.cus_set[0][5] "" UBYTE _CNV_A_R_LINEAR_____0_CM 1 0. 0. 255. DISPLAY_IDENTIFIER FMY_FRF_8_ENVD_CUS_SET_1_CMN_6_ ECU_ADDRESS 0x7fc385 FORMAT "%3.0" /end MEASUREMENT
/begin MEASUREMENT tbl_frf[7].envd.cus_set[0][6] "" UBYTE _CNV_A_R_LINEAR_____0_CM 1 0. 0. 255. DISPLAY_IDENTIFIER FMY_FRF_8_ENVD_CUS_SET_1_SPC_1_ ECU_ADDRESS 0x7fc386 FORMAT "%3.0" /end MEASUREMENT
/begin MEASUREMENT tbl_frf[7].envd.cus_set[0][7] "" UBYTE _CNV_A_R_LINEAR_____0_CM 1 0. 0. 255. DISPLAY_IDENTIFIER FMY_FRF_8_ENVD_CUS_SET_1_SPC_2_ ECU_ADDRESS 0x7fc387 FORMAT "%3.0" /end MEASUREMENT
/begin MEASUREMENT tbl_frf[7].envd.cus_set[0][8] "" UBYTE _CNV_A_R_LINEAR_____0_CM 1 0. 0. 255. DISPLAY_IDENTIFIER FMY_FRF_8_ENVD_CUS_SET_1_SPC_3_ ECU_ADDRESS 0x7fc388 FORMAT "%3.0" /end MEASUREMENT
/begin MEASUREMENT tbl_frf[7].envd.cus_set[0][9] "" UBYTE _CNV_A_R_LINEAR_____0_CM 1 0. 0. 255. DISPLAY_IDENTIFIER FMY_FRF_8_ENVD_CUS_SET_1_SPC_4_ ECU_ADDRESS 0x7fc389 FORMAT "%3.0" /end MEASUREMENT
/begin MEASUREMENT tbl_frf[7].envd.cus_set[0][10] "" UBYTE _CNV_A_R_LINEAR_____0_CM 1 0. 0. 255. DISPLAY_IDENTIFIER FMY_FRF_8_ENVD_CUS_SET_1_SPC_5_ ECU_ADDRESS 0x7fc38a FORMAT "%3.0" /end MEASUREMENT
/begin MEASUREMENT tbl_frf[7].envd.cus_set[0][11] "" UBYTE _CNV_A_R_LINEAR_____0_CM 1 0. 0. 255. DISPLAY_IDENTIFIER FMY_FRF_8_ENVD_CUS_SET_1_SPC_6_ ECU_ADDRESS 0x7fc38b FORMAT "%3.0" /end MEASUREMENT
/begin MEASUREMENT tbl_frf[7].envd.cus_set[0][12] "" UBYTE _CNV_A_R_LINEAR_____0_CM 1 0. 0. 255. DISPLAY_IDENTIFIER FMY_FRF_8_ENVD_CUS_SET_1_SPC_7_ ECU_ADDRESS 0x7fc38c FORMAT "%3.0" /end MEASUREMENT
/begin MEASUREMENT tbl_frf[7].envd.cus_set[0][13] "" UBYTE _CNV_A_R_LINEAR_____0_CM 1 0. 0. 255. DISPLAY_IDENTIFIER FMY_FRF_8_ENVD_CUS_SET_1_SPC_8_ ECU_ADDRESS 0x7fc38d FORMAT "%3.0" /end MEASUREMENT
/begin MEASUREMENT tbl_frf[7].envd.cus_set[1][0] "" UBYTE _CNV_A_R_LINEAR_____0_CM 1 0. 0. 255. DISPLAY_IDENTIFIER FMY_FRF_8_ENVD_CUS_SET_2_CMN_1_ ECU_ADDRESS 0x7fc38e FORMAT "%3.0" /end MEASUREMENT
/begin MEASUREMENT tbl_frf[7].envd.cus_set[1][1] "" UBYTE _CNV_A_R_LINEAR_____0_CM 1 0. 0. 255. DISPLAY_IDENTIFIER FMY_FRF_8_ENVD_CUS_SET_2_CMN_2_ ECU_ADDRESS 0x7fc38f FORMAT "%3.0" /end MEASUREMENT
/begin MEASUREMENT tbl_frf[7].envd.cus_set[1][2] "" UBYTE _CNV_A_R_LINEAR_____0_CM 1 0. 0. 255. DISPLAY_IDENTIFIER FMY_FRF_8_ENVD_CUS_SET_2_CMN_3_ ECU_ADDRESS 0x7fc390 FORMAT "%3.0" /end MEASUREMENT
/begin MEASUREMENT tbl_frf[7].envd.cus_set[1][3] "" UBYTE _CNV_A_R_LINEAR_____0_CM 1 0. 0. 255. DISPLAY_IDENTIFIER FMY_FRF_8_ENVD_CUS_SET_2_CMN_4_ ECU_ADDRESS 0x7fc391 FORMAT "%3.0" /end MEASUREMENT
/begin MEASUREMENT tbl_frf[7].envd.cus_set[1][4] "" UBYTE _CNV_A_R_LINEAR_____0_CM 1 0. 0. 255. DISPLAY_IDENTIFIER FMY_FRF_8_ENVD_CUS_SET_2_CMN_5_ ECU_ADDRESS 0x7fc392 FORMAT "%3.0" /end MEASUREMENT
/begin MEASUREMENT tbl_frf[7].envd.cus_set[1][5] "" UBYTE _CNV_A_R_LINEAR_____0_CM 1 0. 0. 255. DISPLAY_IDENTIFIER FMY_FRF_8_ENVD_CUS_SET_2_CMN_6_ ECU_ADDRESS 0x7fc393 FORMAT "%3.0" /end MEASUREMENT
/begin MEASUREMENT tbl_frf[7].envd.cus_set[1][6] "" UBYTE _CNV_A_R_LINEAR_____0_CM 1 0. 0. 255. DISPLAY_IDENTIFIER FMY_FRF_8_ENVD_CUS_SET_2_SPC_1_ ECU_ADDRESS 0x7fc394 FORMAT "%3.0" /end MEASUREMENT
/begin MEASUREMENT tbl_frf[7].envd.cus_set[1][7] "" UBYTE _CNV_A_R_LINEAR_____0_CM 1 0. 0. 255. DISPLAY_IDENTIFIER FMY_FRF_8_ENVD_CUS_SET_2_SPC_2_ ECU_ADDRESS 0x7fc395 FORMAT "%3.0" /end MEASUREMENT
/begin MEASUREMENT tbl_frf[7].envd.cus_set[1][8] "" UBYTE _CNV_A_R_LINEAR_____0_CM 1 0. 0. 255. DISPLAY_IDENTIFIER FMY_FRF_8_ENVD_CUS_SET_2_SPC_3_ ECU_ADDRESS 0x7fc396 FORMAT "%3.0" /end MEASUREMENT
/begin MEASUREMENT tbl_frf[7].envd.cus_set[1][9] "" UBYTE _CNV_A_R_LINEAR_____0_CM 1 0. 0. 255. DISPLAY_IDENTIFIER FMY_FRF_8_ENVD_CUS_SET_2_SPC_4_ ECU_ADDRESS 0x7fc397 FORMAT "%3.0" /end MEASUREMENT
/begin MEASUREMENT tbl_frf[7].envd.cus_set[1][10] "" UBYTE _CNV_A_R_LINEAR_____0_CM 1 0. 0. 255. DISPLAY_IDENTIFIER FMY_FRF_8_ENVD_CUS_SET_2_SPC_5_ ECU_ADDRESS 0x7fc398 FORMAT "%3.0" /end MEASUREMENT
/begin MEASUREMENT tbl_frf[7].envd.cus_set[1][11] "" UBYTE _CNV_A_R_LINEAR_____0_CM 1 0. 0. 255. DISPLAY_IDENTIFIER FMY_FRF_8_ENVD_CUS_SET_2_SPC_6_ ECU_ADDRESS 0x7fc399 FORMAT "%3.0" /end MEASUREMENT
/begin MEASUREMENT tbl_frf[7].envd.cus_set[1][12] "" UBYTE _CNV_A_R_LINEAR_____0_CM 1 0. 0. 255. DISPLAY_IDENTIFIER FMY_FRF_8_ENVD_CUS_SET_2_SPC_7_ ECU_ADDRESS 0x7fc39a FORMAT "%3.0" /end MEASUREMENT
/begin MEASUREMENT tbl_frf[7].envd.cus_set[1][13] "" UBYTE _CNV_A_R_LINEAR_____0_CM 1 0. 0. 255. DISPLAY_IDENTIFIER FMY_FRF_8_ENVD_CUS_SET_2_SPC_8_ ECU_ADDRESS 0x7fc39b FORMAT "%3.0" /end MEASUREMENT
/begin MEASUREMENT tbl_frf[7].envd.cmn_cus[0] "" UBYTE _CNV_A_R_LINEAR_____0_CM 1 0. 0. 255. DISPLAY_IDENTIFIER FMY_FRF_8_ENVD_CUS_CMN_1_ ECU_ADDRESS 0x7fc39c FORMAT "%3.0" /end MEASUREMENT
/begin MEASUREMENT tbl_frf[7].envd.obd[0] "" UBYTE _CNV_A_R_LINEAR_____0_CM 1 0. 0. 255. DISPLAY_IDENTIFIER FMY_FRF_8_ENVD_OBD_1_ ECU_ADDRESS 0x7fc39d FORMAT "%3.0" /end MEASUREMENT
/begin MEASUREMENT tbl_frf[7].envd.obd[1] "" UBYTE _CNV_A_R_LINEAR_____0_CM 1 0. 0. 255. DISPLAY_IDENTIFIER FMY_FRF_8_ENVD_OBD_2_ ECU_ADDRESS 0x7fc39e FORMAT "%3.0" /end MEASUREMENT
/begin MEASUREMENT tbl_frf[7].envd.obd[2] "" UBYTE _CNV_A_R_LINEAR_____0_CM 1 0. 0. 255. DISPLAY_IDENTIFIER FMY_FRF_8_ENVD_OBD_3_ ECU_ADDRESS 0x7fc39f FORMAT "%3.0" /end MEASUREMENT
/begin MEASUREMENT tbl_frf[7].envd.obd[3] "" UBYTE _CNV_A_R_LINEAR_____0_CM 1 0. 0. 255. DISPLAY_IDENTIFIER FMY_FRF_8_ENVD_OBD_4_ ECU_ADDRESS 0x7fc3a0 FORMAT "%3.0" /end MEASUREMENT
/begin MEASUREMENT tbl_frf[7].envd.obd[4] "" UBYTE _CNV_A_R_LINEAR_____0_CM 1 0. 0. 255. DISPLAY_IDENTIFIER FMY_FRF_8_ENVD_OBD_5_ ECU_ADDRESS 0x7fc3a1 FORMAT "%3.0" /end MEASUREMENT
/begin MEASUREMENT tbl_frf[7].envd.obd[5] "" UBYTE _CNV_A_R_LINEAR_____0_CM 1 0. 0. 255. DISPLAY_IDENTIFIER FMY_FRF_8_ENVD_OBD_6_ ECU_ADDRESS 0x7fc3a2 FORMAT "%3.0" /end MEASUREMENT
/begin MEASUREMENT tbl_frf[7].envd.obd[6] "" UBYTE _CNV_A_R_LINEAR_____0_CM 1 0. 0. 255. DISPLAY_IDENTIFIER FMY_FRF_8_ENVD_OBD_7_ ECU_ADDRESS 0x7fc3a3 FORMAT "%3.0" /end MEASUREMENT
/begin MEASUREMENT tbl_frf[7].envd.obd[7] "" UBYTE _CNV_A_R_LINEAR_____0_CM 1 0. 0. 255. DISPLAY_IDENTIFIER FMY_FRF_8_ENVD_OBD_8_ ECU_ADDRESS 0x7fc3a4 FORMAT "%3.0" /end MEASUREMENT
/begin MEASUREMENT tbl_frf[8].envd.header "" UBYTE _CNV_A_R_LINEAR_____0_CM 1 0. 0. 255. DISPLAY_IDENTIFIER FMY_FRF_9_ENVD_HD ECU_ADDRESS 0x7fc3a5 FORMAT "%3.0" /end MEASUREMENT
/begin MEASUREMENT tbl_frf[8].envd.cus_set[0][0] "" UBYTE _CNV_A_R_LINEAR_____0_CM 1 0. 0. 255. DISPLAY_IDENTIFIER FMY_FRF_9_ENVD_CUS_SET_1_CMN_1_ ECU_ADDRESS 0x7fc3a6 FORMAT "%3.0" /end MEASUREMENT
/begin MEASUREMENT tbl_frf[8].envd.cus_set[0][1] "" UBYTE _CNV_A_R_LINEAR_____0_CM 1 0. 0. 255. DISPLAY_IDENTIFIER FMY_FRF_9_ENVD_CUS_SET_1_CMN_2_ ECU_ADDRESS 0x7fc3a7 FORMAT "%3.0" /end MEASUREMENT
/begin MEASUREMENT tbl_frf[8].envd.cus_set[0][2] "" UBYTE _CNV_A_R_LINEAR_____0_CM 1 0. 0. 255. DISPLAY_IDENTIFIER FMY_FRF_9_ENVD_CUS_SET_1_CMN_3_ ECU_ADDRESS 0x7fc3a8 FORMAT "%3.0" /end MEASUREMENT
/begin MEASUREMENT tbl_frf[8].envd.cus_set[0][3] "" UBYTE _CNV_A_R_LINEAR_____0_CM 1 0. 0. 255. DISPLAY_IDENTIFIER FMY_FRF_9_ENVD_CUS_SET_1_CMN_4_ ECU_ADDRESS 0x7fc3a9 FORMAT "%3.0" /end MEASUREMENT
/begin MEASUREMENT tbl_frf[8].envd.cus_set[0][4] "" UBYTE _CNV_A_R_LINEAR_____0_CM 1 0. 0. 255. DISPLAY_IDENTIFIER FMY_FRF_9_ENVD_CUS_SET_1_CMN_5_ ECU_ADDRESS 0x7fc3aa FORMAT "%3.0" /end MEASUREMENT
/begin MEASUREMENT tbl_frf[8].envd.cus_set[0][5] "" UBYTE _CNV_A_R_LINEAR_____0_CM 1 0. 0. 255. DISPLAY_IDENTIFIER FMY_FRF_9_ENVD_CUS_SET_1_CMN_6_ ECU_ADDRESS 0x7fc3ab FORMAT "%3.0" /end MEASUREMENT
/begin MEASUREMENT tbl_frf[8].envd.cus_set[0][6] "" UBYTE _CNV_A_R_LINEAR_____0_CM 1 0. 0. 255. DISPLAY_IDENTIFIER FMY_FRF_9_ENVD_CUS_SET_1_SPC_1_ ECU_ADDRESS 0x7fc3ac FORMAT "%3.0" /end MEASUREMENT
/begin MEASUREMENT tbl_frf[8].envd.cus_set[0][7] "" UBYTE _CNV_A_R_LINEAR_____0_CM 1 0. 0. 255. DISPLAY_IDENTIFIER FMY_FRF_9_ENVD_CUS_SET_1_SPC_2_ ECU_ADDRESS 0x7fc3ad FORMAT "%3.0" /end MEASUREMENT
/begin MEASUREMENT tbl_frf[8].envd.cus_set[0][8] "" UBYTE _CNV_A_R_LINEAR_____0_CM 1 0. 0. 255. DISPLAY_IDENTIFIER FMY_FRF_9_ENVD_CUS_SET_1_SPC_3_ ECU_ADDRESS 0x7fc3ae FORMAT "%3.0" /end MEASUREMENT
/begin MEASUREMENT tbl_frf[8].envd.cus_set[0][9] "" UBYTE _CNV_A_R_LINEAR_____0_CM 1 0. 0. 255. DISPLAY_IDENTIFIER FMY_FRF_9_ENVD_CUS_SET_1_SPC_4_ ECU_ADDRESS 0x7fc3af FORMAT "%3.0" /end MEASUREMENT
/begin MEASUREMENT tbl_frf[8].envd.cus_set[0][10] "" UBYTE _CNV_A_R_LINEAR_____0_CM 1 0. 0. 255. DISPLAY_IDENTIFIER FMY_FRF_9_ENVD_CUS_SET_1_SPC_5_ ECU_ADDRESS 0x7fc3b0 FORMAT "%3.0" /end MEASUREMENT
/begin MEASUREMENT tbl_frf[8].envd.cus_set[0][11] "" UBYTE _CNV_A_R_LINEAR_____0_CM 1 0. 0. 255. DISPLAY_IDENTIFIER FMY_FRF_9_ENVD_CUS_SET_1_SPC_6_ ECU_ADDRESS 0x7fc3b1 FORMAT "%3.0" /end MEASUREMENT
/begin MEASUREMENT tbl_frf[8].envd.cus_set[0][12] "" UBYTE _CNV_A_R_LINEAR_____0_CM 1 0. 0. 255. DISPLAY_IDENTIFIER FMY_FRF_9_ENVD_CUS_SET_1_SPC_7_ ECU_ADDRESS 0x7fc3b2 FORMAT "%3.0" /end MEASUREMENT
/begin MEASUREMENT tbl_frf[8].envd.cus_set[0][13] "" UBYTE _CNV_A_R_LINEAR_____0_CM 1 0. 0. 255. DISPLAY_IDENTIFIER FMY_FRF_9_ENVD_CUS_SET_1_SPC_8_ ECU_ADDRESS 0x7fc3b3 FORMAT "%3.0" /end MEASUREMENT
/begin MEASUREMENT tbl_frf[8].envd.cus_set[1][0] "" UBYTE _CNV_A_R_LINEAR_____0_CM 1 0. 0. 255. DISPLAY_IDENTIFIER FMY_FRF_9_ENVD_CUS_SET_2_CMN_1_ ECU_ADDRESS 0x7fc3b4 FORMAT "%3.0" /end MEASUREMENT
/begin MEASUREMENT tbl_frf[8].envd.cus_set[1][1] "" UBYTE _CNV_A_R_LINEAR_____0_CM 1 0. 0. 255. DISPLAY_IDENTIFIER FMY_FRF_9_ENVD_CUS_SET_2_CMN_2_ ECU_ADDRESS 0x7fc3b5 FORMAT "%3.0" /end MEASUREMENT
/begin MEASUREMENT tbl_frf[8].envd.cus_set[1][2] "" UBYTE _CNV_A_R_LINEAR_____0_CM 1 0. 0. 255. DISPLAY_IDENTIFIER FMY_FRF_9_ENVD_CUS_SET_2_CMN_3_ ECU_ADDRESS 0x7fc3b6 FORMAT "%3.0" /end MEASUREMENT
/begin MEASUREMENT tbl_frf[8].envd.cus_set[1][3] "" UBYTE _CNV_A_R_LINEAR_____0_CM 1 0. 0. 255. DISPLAY_IDENTIFIER FMY_FRF_9_ENVD_CUS_SET_2_CMN_4_ ECU_ADDRESS 0x7fc3b7 FORMAT "%3.0" /end MEASUREMENT
/begin MEASUREMENT tbl_frf[8].envd.cus_set[1][4] "" UBYTE _CNV_A_R_LINEAR_____0_CM 1 0. 0. 255. DISPLAY_IDENTIFIER FMY_FRF_9_ENVD_CUS_SET_2_CMN_5_ ECU_ADDRESS 0x7fc3b8 FORMAT "%3.0" /end MEASUREMENT
/begin MEASUREMENT tbl_frf[8].envd.cus_set[1][5] "" UBYTE _CNV_A_R_LINEAR_____0_CM 1 0. 0. 255. DISPLAY_IDENTIFIER FMY_FRF_9_ENVD_CUS_SET_2_CMN_6_ ECU_ADDRESS 0x7fc3b9 FORMAT "%3.0" /end MEASUREMENT
/begin MEASUREMENT tbl_frf[8].envd.cus_set[1][6] "" UBYTE _CNV_A_R_LINEAR_____0_CM 1 0. 0. 255. DISPLAY_IDENTIFIER FMY_FRF_9_ENVD_CUS_SET_2_SPC_1_ ECU_ADDRESS 0x7fc3ba FORMAT "%3.0" /end MEASUREMENT
/begin MEASUREMENT tbl_frf[8].envd.cus_set[1][7] "" UBYTE _CNV_A_R_LINEAR_____0_CM 1 0. 0. 255. DISPLAY_IDENTIFIER FMY_FRF_9_ENVD_CUS_SET_2_SPC_2_ ECU_ADDRESS 0x7fc3bb FORMAT "%3.0" /end MEASUREMENT
/begin MEASUREMENT tbl_frf[8].envd.cus_set[1][8] "" UBYTE _CNV_A_R_LINEAR_____0_CM 1 0. 0. 255. DISPLAY_IDENTIFIER FMY_FRF_9_ENVD_CUS_SET_2_SPC_3_ ECU_ADDRESS 0x7fc3bc FORMAT "%3.0" /end MEASUREMENT
/begin MEASUREMENT tbl_frf[8].envd.cus_set[1][9] "" UBYTE _CNV_A_R_LINEAR_____0_CM 1 0. 0. 255. DISPLAY_IDENTIFIER FMY_FRF_9_ENVD_CUS_SET_2_SPC_4_ ECU_ADDRESS 0x7fc3bd FORMAT "%3.0" /end MEASUREMENT
/begin MEASUREMENT tbl_frf[8].envd.cus_set[1][10] "" UBYTE _CNV_A_R_LINEAR_____0_CM 1 0. 0. 255. DISPLAY_IDENTIFIER FMY_FRF_9_ENVD_CUS_SET_2_SPC_5_ ECU_ADDRESS 0x7fc3be FORMAT "%3.0" /end MEASUREMENT
/begin MEASUREMENT tbl_frf[8].envd.cus_set[1][11] "" UBYTE _CNV_A_R_LINEAR_____0_CM 1 0. 0. 255. DISPLAY_IDENTIFIER FMY_FRF_9_ENVD_CUS_SET_2_SPC_6_ ECU_ADDRESS 0x7fc3bf FORMAT "%3.0" /end MEASUREMENT
/begin MEASUREMENT tbl_frf[8].envd.cus_set[1][12] "" UBYTE _CNV_A_R_LINEAR_____0_CM 1 0. 0. 255. DISPLAY_IDENTIFIER FMY_FRF_9_ENVD_CUS_SET_2_SPC_7_ ECU_ADDRESS 0x7fc3c0 FORMAT "%3.0" /end MEASUREMENT
/begin MEASUREMENT tbl_frf[8].envd.cus_set[1][13] "" UBYTE _CNV_A_R_LINEAR_____0_CM 1 0. 0. 255. DISPLAY_IDENTIFIER FMY_FRF_9_ENVD_CUS_SET_2_SPC_8_ ECU_ADDRESS 0x7fc3c1 FORMAT "%3.0" /end MEASUREMENT
/begin MEASUREMENT tbl_frf[8].envd.cmn_cus[0] "" UBYTE _CNV_A_R_LINEAR_____0_CM 1 0. 0. 255. DISPLAY_IDENTIFIER FMY_FRF_9_ENVD_CUS_CMN_1_ ECU_ADDRESS 0x7fc3c2 FORMAT "%3.0" /end MEASUREMENT
/begin MEASUREMENT tbl_frf[8].envd.obd[0] "" UBYTE _CNV_A_R_LINEAR_____0_CM 1 0. 0. 255. DISPLAY_IDENTIFIER FMY_FRF_9_ENVD_OBD_1_ ECU_ADDRESS 0x7fc3c3 FORMAT "%3.0" /end MEASUREMENT
/begin MEASUREMENT tbl_frf[8].envd.obd[1] "" UBYTE _CNV_A_R_LINEAR_____0_CM 1 0. 0. 255. DISPLAY_IDENTIFIER FMY_FRF_9_ENVD_OBD_2_ ECU_ADDRESS 0x7fc3c4 FORMAT "%3.0" /end MEASUREMENT
/begin MEASUREMENT tbl_frf[8].envd.obd[2] "" UBYTE _CNV_A_R_LINEAR_____0_CM 1 0. 0. 255. DISPLAY_IDENTIFIER FMY_FRF_9_ENVD_OBD_3_ ECU_ADDRESS 0x7fc3c5 FORMAT "%3.0" /end MEASUREMENT
/begin MEASUREMENT tbl_frf[8].envd.obd[3] "" UBYTE _CNV_A_R_LINEAR_____0_CM 1 0. 0. 255. DISPLAY_IDENTIFIER FMY_FRF_9_ENVD_OBD_4_ ECU_ADDRESS 0x7fc3c6 FORMAT "%3.0" /end MEASUREMENT
/begin MEASUREMENT tbl_frf[8].envd.obd[4] "" UBYTE _CNV_A_R_LINEAR_____0_CM 1 0. 0. 255. DISPLAY_IDENTIFIER FMY_FRF_9_ENVD_OBD_5_ ECU_ADDRESS 0x7fc3c7 FORMAT "%3.0" /end MEASUREMENT
/begin MEASUREMENT tbl_frf[8].envd.obd[5] "" UBYTE _CNV_A_R_LINEAR_____0_CM 1 0. 0. 255. DISPLAY_IDENTIFIER FMY_FRF_9_ENVD_OBD_6_ ECU_ADDRESS 0x7fc3c8 FORMAT "%3.0" /end MEASUREMENT
/begin MEASUREMENT tbl_frf[8].envd.obd[6] "" UBYTE _CNV_A_R_LINEAR_____0_CM 1 0. 0. 255. DISPLAY_IDENTIFIER FMY_FRF_9_ENVD_OBD_7_ ECU_ADDRESS 0x7fc3c9 FORMAT "%3.0" /end MEASUREMENT
/begin MEASUREMENT tbl_frf[8].envd.obd[7] "" UBYTE _CNV_A_R_LINEAR_____0_CM 1 0. 0. 255. DISPLAY_IDENTIFIER FMY_FRF_9_ENVD_OBD_8_ ECU_ADDRESS 0x7fc3ca FORMAT "%3.0" /end MEASUREMENT
/begin MEASUREMENT tbl_frf[9].envd.header "" UBYTE _CNV_A_R_LINEAR_____0_CM 1 0. 0. 255. DISPLAY_IDENTIFIER FMY_FRF_10_ENVD_HD ECU_ADDRESS 0x7fc3cb FORMAT "%3.0" /end MEASUREMENT
/begin MEASUREMENT tbl_frf[9].envd.cus_set[0][0] "" UBYTE _CNV_A_R_LINEAR_____0_CM 1 0. 0. 255. DISPLAY_IDENTIFIER FMY_FRF_10_ENVD_CUS_SET_1_CMN_1_ ECU_ADDRESS 0x7fc3cc FORMAT "%3.0" /end MEASUREMENT
/begin MEASUREMENT tbl_frf[9].envd.cus_set[0][1] "" UBYTE _CNV_A_R_LINEAR_____0_CM 1 0. 0. 255. DISPLAY_IDENTIFIER FMY_FRF_10_ENVD_CUS_SET_1_CMN_2_ ECU_ADDRESS 0x7fc3cd FORMAT "%3.0" /end MEASUREMENT
/begin MEASUREMENT tbl_frf[9].envd.cus_set[0][2] "" UBYTE _CNV_A_R_LINEAR_____0_CM 1 0. 0. 255. DISPLAY_IDENTIFIER FMY_FRF_10_ENVD_CUS_SET_1_CMN_3_ ECU_ADDRESS 0x7fc3ce FORMAT "%3.0" /end MEASUREMENT
/begin MEASUREMENT tbl_frf[9].envd.cus_set[0][3] "" UBYTE _CNV_A_R_LINEAR_____0_CM 1 0. 0. 255. DISPLAY_IDENTIFIER FMY_FRF_10_ENVD_CUS_SET_1_CMN_4_ ECU_ADDRESS 0x7fc3cf FORMAT "%3.0" /end MEASUREMENT
/begin MEASUREMENT tbl_frf[9].envd.cus_set[0][4] "" UBYTE _CNV_A_R_LINEAR_____0_CM 1 0. 0. 255. DISPLAY_IDENTIFIER FMY_FRF_10_ENVD_CUS_SET_1_CMN_5_ ECU_ADDRESS 0x7fc3d0 FORMAT "%3.0" /end MEASUREMENT
/begin MEASUREMENT tbl_frf[9].envd.cus_set[0][5] "" UBYTE _CNV_A_R_LINEAR_____0_CM 1 0. 0. 255. DISPLAY_IDENTIFIER FMY_FRF_10_ENVD_CUS_SET_1_CMN_6_ ECU_ADDRESS 0x7fc3d1 FORMAT "%3.0" /end MEASUREMENT
/begin MEASUREMENT tbl_frf[9].envd.cus_set[0][6] "" UBYTE _CNV_A_R_LINEAR_____0_CM 1 0. 0. 255. DISPLAY_IDENTIFIER FMY_FRF_10_ENVD_CUS_SET_1_SPC_1_ ECU_ADDRESS 0x7fc3d2 FORMAT "%3.0" /end MEASUREMENT
/begin MEASUREMENT tbl_frf[9].envd.cus_set[0][7] "" UBYTE _CNV_A_R_LINEAR_____0_CM 1 0. 0. 255. DISPLAY_IDENTIFIER FMY_FRF_10_ENVD_CUS_SET_1_SPC_2_ ECU_ADDRESS 0x7fc3d3 FORMAT "%3.0" /end MEASUREMENT
/begin MEASUREMENT tbl_frf[9].envd.cus_set[0][8] "" UBYTE _CNV_A_R_LINEAR_____0_CM 1 0. 0. 255. DISPLAY_IDENTIFIER FMY_FRF_10_ENVD_CUS_SET_1_SPC_3_ ECU_ADDRESS 0x7fc3d4 FORMAT "%3.0" /end MEASUREMENT
/begin MEASUREMENT tbl_frf[9].envd.cus_set[0][9] "" UBYTE _CNV_A_R_LINEAR_____0_CM 1 0. 0. 255. DISPLAY_IDENTIFIER FMY_FRF_10_ENVD_CUS_SET_1_SPC_4_ ECU_ADDRESS 0x7fc3d5 FORMAT "%3.0" /end MEASUREMENT
/begin MEASUREMENT tbl_frf[9].envd.cus_set[0][10] "" UBYTE _CNV_A_R_LINEAR_____0_CM 1 0. 0. 255. DISPLAY_IDENTIFIER FMY_FRF_10_ENVD_CUS_SET_1_SPC_5_ ECU_ADDRESS 0x7fc3d6 FORMAT "%3.0" /end MEASUREMENT
/begin MEASUREMENT tbl_frf[9].envd.cus_set[0][11] "" UBYTE _CNV_A_R_LINEAR_____0_CM 1 0. 0. 255. DISPLAY_IDENTIFIER FMY_FRF_10_ENVD_CUS_SET_1_SPC_6_ ECU_ADDRESS 0x7fc3d7 FORMAT "%3.0" /end MEASUREMENT
/begin MEASUREMENT tbl_frf[9].envd.cus_set[0][12] "" UBYTE _CNV_A_R_LINEAR_____0_CM 1 0. 0. 255. DISPLAY_IDENTIFIER FMY_FRF_10_ENVD_CUS_SET_1_SPC_7_ ECU_ADDRESS 0x7fc3d8 FORMAT "%3.0" /end MEASUREMENT
/begin MEASUREMENT tbl_frf[9].envd.cus_set[0][13] "" UBYTE _CNV_A_R_LINEAR_____0_CM 1 0. 0. 255. DISPLAY_IDENTIFIER FMY_FRF_10_ENVD_CUS_SET_1_SPC_8_ ECU_ADDRESS 0x7fc3d9 FORMAT "%3.0" /end MEASUREMENT
/begin MEASUREMENT tbl_frf[9].envd.cus_set[1][0] "" UBYTE _CNV_A_R_LINEAR_____0_CM 1 0. 0. 255. DISPLAY_IDENTIFIER FMY_FRF_10_ENVD_CUS_SET_2_CMN_1_ ECU_ADDRESS 0x7fc3da FORMAT "%3.0" /end MEASUREMENT
/begin MEASUREMENT tbl_frf[9].envd.cus_set[1][1] "" UBYTE _CNV_A_R_LINEAR_____0_CM 1 0. 0. 255. DISPLAY_IDENTIFIER FMY_FRF_10_ENVD_CUS_SET_2_CMN_2_ ECU_ADDRESS 0x7fc3db FORMAT "%3.0" /end MEASUREMENT
/begin MEASUREMENT tbl_frf[9].envd.cus_set[1][2] "" UBYTE _CNV_A_R_LINEAR_____0_CM 1 0. 0. 255. DISPLAY_IDENTIFIER FMY_FRF_10_ENVD_CUS_SET_2_CMN_3_ ECU_ADDRESS 0x7fc3dc FORMAT "%3.0" /end MEASUREMENT
/begin MEASUREMENT tbl_frf[9].envd.cus_set[1][3] "" UBYTE _CNV_A_R_LINEAR_____0_CM 1 0. 0. 255. DISPLAY_IDENTIFIER FMY_FRF_10_ENVD_CUS_SET_2_CMN_4_ ECU_ADDRESS 0x7fc3dd FORMAT "%3.0" /end MEASUREMENT
/begin MEASUREMENT tbl_frf[9].envd.cus_set[1][4] "" UBYTE _CNV_A_R_LINEAR_____0_CM 1 0. 0. 255. DISPLAY_IDENTIFIER FMY_FRF_10_ENVD_CUS_SET_2_CMN_5_ ECU_ADDRESS 0x7fc3de FORMAT "%3.0" /end MEASUREMENT
/begin MEASUREMENT tbl_frf[9].envd.cus_set[1][5] "" UBYTE _CNV_A_R_LINEAR_____0_CM 1 0. 0. 255. DISPLAY_IDENTIFIER FMY_FRF_10_ENVD_CUS_SET_2_CMN_6_ ECU_ADDRESS 0x7fc3df FORMAT "%3.0" /end MEASUREMENT
/begin MEASUREMENT tbl_frf[9].envd.cus_set[1][6] "" UBYTE _CNV_A_R_LINEAR_____0_CM 1 0. 0. 255. DISPLAY_IDENTIFIER FMY_FRF_10_ENVD_CUS_SET_2_SPC_1_ ECU_ADDRESS 0x7fc3e0 FORMAT "%3.0" /end MEASUREMENT
/begin MEASUREMENT tbl_frf[9].envd.cus_set[1][7] "" UBYTE _CNV_A_R_LINEAR_____0_CM 1 0. 0. 255. DISPLAY_IDENTIFIER FMY_FRF_10_ENVD_CUS_SET_2_SPC_2_ ECU_ADDRESS 0x7fc3e1 FORMAT "%3.0" /end MEASUREMENT
/begin MEASUREMENT tbl_frf[9].envd.cus_set[1][8] "" UBYTE _CNV_A_R_LINEAR_____0_CM 1 0. 0. 255. DISPLAY_IDENTIFIER FMY_FRF_10_ENVD_CUS_SET_2_SPC_3_ ECU_ADDRESS 0x7fc3e2 FORMAT "%3.0" /end MEASUREMENT
/begin MEASUREMENT tbl_frf[9].envd.cus_set[1][9] "" UBYTE _CNV_A_R_LINEAR_____0_CM 1 0. 0. 255. DISPLAY_IDENTIFIER FMY_FRF_10_ENVD_CUS_SET_2_SPC_4_ ECU_ADDRESS 0x7fc3e3 FORMAT "%3.0" /end MEASUREMENT
/begin MEASUREMENT tbl_frf[9].envd.cus_set[1][10] "" UBYTE _CNV_A_R_LINEAR_____0_CM 1 0. 0. 255. DISPLAY_IDENTIFIER FMY_FRF_10_ENVD_CUS_SET_2_SPC_5_ ECU_ADDRESS 0x7fc3e4 FORMAT "%3.0" /end MEASUREMENT
/begin MEASUREMENT tbl_frf[9].envd.cus_set[1][11] "" UBYTE _CNV_A_R_LINEAR_____0_CM 1 0. 0. 255. DISPLAY_IDENTIFIER FMY_FRF_10_ENVD_CUS_SET_2_SPC_6_ ECU_ADDRESS 0x7fc3e5 FORMAT "%3.0" /end MEASUREMENT
/begin MEASUREMENT tbl_frf[9].envd.cus_set[1][12] "" UBYTE _CNV_A_R_LINEAR_____0_CM 1 0. 0. 255. DISPLAY_IDENTIFIER FMY_FRF_10_ENVD_CUS_SET_2_SPC_7_ ECU_ADDRESS 0x7fc3e6 FORMAT "%3.0" /end MEASUREMENT
/begin MEASUREMENT tbl_frf[9].envd.cus_set[1][13] "" UBYTE _CNV_A_R_LINEAR_____0_CM 1 0. 0. 255. DISPLAY_IDENTIFIER FMY_FRF_10_ENVD_CUS_SET_2_SPC_8_ ECU_ADDRESS 0x7fc3e7 FORMAT "%3.0" /end MEASUREMENT
/begin MEASUREMENT tbl_frf[9].envd.cmn_cus[0] "" UBYTE _CNV_A_R_LINEAR_____0_CM 1 0. 0. 255. DISPLAY_IDENTIFIER FMY_FRF_10_ENVD_CUS_CMN_1_ ECU_ADDRESS 0x7fc3e8 FORMAT "%3.0" /end MEASUREMENT
/begin MEASUREMENT tbl_frf[9].envd.obd[0] "" UBYTE _CNV_A_R_LINEAR_____0_CM 1 0. 0. 255. DISPLAY_IDENTIFIER FMY_FRF_10_ENVD_OBD_1_ ECU_ADDRESS 0x7fc3e9 FORMAT "%3.0" /end MEASUREMENT
/begin MEASUREMENT tbl_frf[9].envd.obd[1] "" UBYTE _CNV_A_R_LINEAR_____0_CM 1 0. 0. 255. DISPLAY_IDENTIFIER FMY_FRF_10_ENVD_OBD_2_ ECU_ADDRESS 0x7fc3ea FORMAT "%3.0" /end MEASUREMENT
/begin MEASUREMENT tbl_frf[9].envd.obd[2] "" UBYTE _CNV_A_R_LINEAR_____0_CM 1 0. 0. 255. DISPLAY_IDENTIFIER FMY_FRF_10_ENVD_OBD_3_ ECU_ADDRESS 0x7fc3eb FORMAT "%3.0" /end MEASUREMENT
/begin MEASUREMENT tbl_frf[9].envd.obd[3] "" UBYTE _CNV_A_R_LINEAR_____0_CM 1 0. 0. 255. DISPLAY_IDENTIFIER FMY_FRF_10_ENVD_OBD_4_ ECU_ADDRESS 0x7fc3ec FORMAT "%3.0" /end MEASUREMENT
/begin MEASUREMENT tbl_frf[9].envd.obd[4] "" UBYTE _CNV_A_R_LINEAR_____0_CM 1 0. 0. 255. DISPLAY_IDENTIFIER FMY_FRF_10_ENVD_OBD_5_ ECU_ADDRESS 0x7fc3ed FORMAT "%3.0" /end MEASUREMENT
/begin MEASUREMENT tbl_frf[9].envd.obd[5] "" UBYTE _CNV_A_R_LINEAR_____0_CM 1 0. 0. 255. DISPLAY_IDENTIFIER FMY_FRF_10_ENVD_OBD_6_ ECU_ADDRESS 0x7fc3ee FORMAT "%3.0" /end MEASUREMENT
/begin MEASUREMENT tbl_frf[9].envd.obd[6] "" UBYTE _CNV_A_R_LINEAR_____0_CM 1 0. 0. 255. DISPLAY_IDENTIFIER FMY_FRF_10_ENVD_OBD_7_ ECU_ADDRESS 0x7fc3ef FORMAT "%3.0" /end MEASUREMENT
/begin MEASUREMENT tbl_frf[9].envd.obd[7] "" UBYTE _CNV_A_R_LINEAR_____0_CM 1 0. 0. 255. DISPLAY_IDENTIFIER FMY_FRF_10_ENVD_OBD_8_ ECU_ADDRESS 0x7fc3f0 FORMAT "%3.0" /end MEASUREMENT
/begin MEASUREMENT fmy_his[0][0] "" UBYTE _CNV_A_R_LINEAR_____0_CM 1 0. 0. 255. DISPLAY_IDENTIFIER FMY_HIS_1_1_ ECU_ADDRESS 0x7fc41c FORMAT "%3.0" /end MEASUREMENT
/begin MEASUREMENT fmy_his[0][1] "" UBYTE _CNV_A_R_LINEAR_____0_CM 1 0. 0. 255. DISPLAY_IDENTIFIER FMY_HIS_1_2_ ECU_ADDRESS 0x7fc41d FORMAT "%3.0" /end MEASUREMENT
/begin MEASUREMENT fmy_his[0][2] "" UBYTE _CNV_A_R_LINEAR_____0_CM 1 0. 0. 255. DISPLAY_IDENTIFIER FMY_HIS_1_3_ ECU_ADDRESS 0x7fc41e FORMAT "%3.0" /end MEASUREMENT
/begin MEASUREMENT fmy_his[0][3] "" UBYTE _CNV_A_R_LINEAR_____0_CM 1 0. 0. 255. DISPLAY_IDENTIFIER FMY_HIS_1_4_ ECU_ADDRESS 0x7fc41f FORMAT "%3.0" /end MEASUREMENT
/begin MEASUREMENT fmy_his[1][0] "" UBYTE _CNV_A_R_LINEAR_____0_CM 1 0. 0. 255. DISPLAY_IDENTIFIER FMY_HIS_2_1_ ECU_ADDRESS 0x7fc420 FORMAT "%3.0" /end MEASUREMENT
/begin MEASUREMENT fmy_his[1][1] "" UBYTE _CNV_A_R_LINEAR_____0_CM 1 0. 0. 255. DISPLAY_IDENTIFIER FMY_HIS_2_2_ ECU_ADDRESS 0x7fc421 FORMAT "%3.0" /end MEASUREMENT
/begin MEASUREMENT fmy_his[1][2] "" UBYTE _CNV_A_R_LINEAR_____0_CM 1 0. 0. 255. DISPLAY_IDENTIFIER FMY_HIS_2_3_ ECU_ADDRESS 0x7fc422 FORMAT "%3.0" /end MEASUREMENT
/begin MEASUREMENT fmy_his[1][3] "" UBYTE _CNV_A_R_LINEAR_____0_CM 1 0. 0. 255. DISPLAY_IDENTIFIER FMY_HIS_2_4_ ECU_ADDRESS 0x7fc423 FORMAT "%3.0" /end MEASUREMENT
/begin MEASUREMENT fmy_his[2][0] "" UBYTE _CNV_A_R_LINEAR_____0_CM 1 0. 0. 255. DISPLAY_IDENTIFIER FMY_HIS_3_1_ ECU_ADDRESS 0x7fc424 FORMAT "%3.0" /end MEASUREMENT
/begin MEASUREMENT fmy_his[2][1] "" UBYTE _CNV_A_R_LINEAR_____0_CM 1 0. 0. 255. DISPLAY_IDENTIFIER FMY_HIS_3_2_ ECU_ADDRESS 0x7fc425 FORMAT "%3.0" /end MEASUREMENT
/begin MEASUREMENT fmy_his[2][2] "" UBYTE _CNV_A_R_LINEAR_____0_CM 1 0. 0. 255. DISPLAY_IDENTIFIER FMY_HIS_3_3_ ECU_ADDRESS 0x7fc426 FORMAT "%3.0" /end MEASUREMENT
/begin MEASUREMENT fmy_his[2][3] "" UBYTE _CNV_A_R_LINEAR_____0_CM 1 0. 0. 255. DISPLAY_IDENTIFIER FMY_HIS_3_4_ ECU_ADDRESS 0x7fc427 FORMAT "%3.0" /end MEASUREMENT
/begin MEASUREMENT fmy_his[3][0] "" UBYTE _CNV_A_R_LINEAR_____0_CM 1 0. 0. 255. DISPLAY_IDENTIFIER FMY_HIS_4_1_ ECU_ADDRESS 0x7fc428 FORMAT "%3.0" /end MEASUREMENT
/begin MEASUREMENT fmy_his[3][1] "" UBYTE _CNV_A_R_LINEAR_____0_CM 1 0. 0. 255. DISPLAY_IDENTIFIER FMY_HIS_4_2_ ECU_ADDRESS 0x7fc429 FORMAT "%3.0" /end MEASUREMENT
/begin MEASUREMENT fmy_his[3][2] "" UBYTE _CNV_A_R_LINEAR_____0_CM 1 0. 0. 255. DISPLAY_IDENTIFIER FMY_HIS_4_3_ ECU_ADDRESS 0x7fc42a FORMAT "%3.0" /end MEASUREMENT
/begin MEASUREMENT fmy_his[3][3] "" UBYTE _CNV_A_R_LINEAR_____0_CM 1 0. 0. 255. DISPLAY_IDENTIFIER FMY_HIS_4_4_ ECU_ADDRESS 0x7fc42b FORMAT "%3.0" /end MEASUREMENT
/begin MEASUREMENT fmy_his[4][0] "" UBYTE _CNV_A_R_LINEAR_____0_CM 1 0. 0. 255. DISPLAY_IDENTIFIER FMY_HIS_5_1_ ECU_ADDRESS 0x7fc42c FORMAT "%3.0" /end MEASUREMENT
/begin MEASUREMENT fmy_his[4][1] "" UBYTE _CNV_A_R_LINEAR_____0_CM 1 0. 0. 255. DISPLAY_IDENTIFIER FMY_HIS_5_2_ ECU_ADDRESS 0x7fc42d FORMAT "%3.0" /end MEASUREMENT
/begin MEASUREMENT fmy_his[4][2] "" UBYTE _CNV_A_R_LINEAR_____0_CM 1 0. 0. 255. DISPLAY_IDENTIFIER FMY_HIS_5_3_ ECU_ADDRESS 0x7fc42e FORMAT "%3.0" /end MEASUREMENT
/begin MEASUREMENT fmy_his[4][3] "" UBYTE _CNV_A_R_LINEAR_____0_CM 1 0. 0. 255. DISPLAY_IDENTIFIER FMY_HIS_5_4_ ECU_ADDRESS 0x7fc42f FORMAT "%3.0" /end MEASUREMENT
/begin MEASUREMENT fmy_his[5][0] "" UBYTE _CNV_A_R_LINEAR_____0_CM 1 0. 0. 255. DISPLAY_IDENTIFIER FMY_HIS_6_1_ ECU_ADDRESS 0x7fc430 FORMAT "%3.0" /end MEASUREMENT
/begin MEASUREMENT fmy_his[5][1] "" UBYTE _CNV_A_R_LINEAR_____0_CM 1 0. 0. 255. DISPLAY_IDENTIFIER FMY_HIS_6_2_ ECU_ADDRESS 0x7fc431 FORMAT "%3.0" /end MEASUREMENT
/begin MEASUREMENT fmy_his[5][2] "" UBYTE _CNV_A_R_LINEAR_____0_CM 1 0. 0. 255. DISPLAY_IDENTIFIER FMY_HIS_6_3_ ECU_ADDRESS 0x7fc432 FORMAT "%3.0" /end MEASUREMENT
/begin MEASUREMENT fmy_his[5][3] "" UBYTE _CNV_A_R_LINEAR_____0_CM 1 0. 0. 255. DISPLAY_IDENTIFIER FMY_HIS_6_4_ ECU_ADDRESS 0x7fc433 FORMAT "%3.0" /end MEASUREMENT
/begin MEASUREMENT fmy_his[6][0] "" UBYTE _CNV_A_R_LINEAR_____0_CM 1 0. 0. 255. DISPLAY_IDENTIFIER FMY_HIS_7_1_ ECU_ADDRESS 0x7fc434 FORMAT "%3.0" /end MEASUREMENT
/begin MEASUREMENT fmy_his[6][1] "" UBYTE _CNV_A_R_LINEAR_____0_CM 1 0. 0. 255. DISPLAY_IDENTIFIER FMY_HIS_7_2_ ECU_ADDRESS 0x7fc435 FORMAT "%3.0" /end MEASUREMENT
/begin MEASUREMENT fmy_his[6][2] "" UBYTE _CNV_A_R_LINEAR_____0_CM 1 0. 0. 255. DISPLAY_IDENTIFIER FMY_HIS_7_3_ ECU_ADDRESS 0x7fc436 FORMAT "%3.0" /end MEASUREMENT
/begin MEASUREMENT fmy_his[6][3] "" UBYTE _CNV_A_R_LINEAR_____0_CM 1 0. 0. 255. DISPLAY_IDENTIFIER FMY_HIS_7_4_ ECU_ADDRESS 0x7fc437 FORMAT "%3.0" /end MEASUREMENT
/begin MEASUREMENT fmy_his[7][0] "" UBYTE _CNV_A_R_LINEAR_____0_CM 1 0. 0. 255. DISPLAY_IDENTIFIER FMY_HIS_8_1_ ECU_ADDRESS 0x7fc438 FORMAT "%3.0" /end MEASUREMENT
/begin MEASUREMENT fmy_his[7][1] "" UBYTE _CNV_A_R_LINEAR_____0_CM 1 0. 0. 255. DISPLAY_IDENTIFIER FMY_HIS_8_2_ ECU_ADDRESS 0x7fc439 FORMAT "%3.0" /end MEASUREMENT
/begin MEASUREMENT fmy_his[7][2] "" UBYTE _CNV_A_R_LINEAR_____0_CM 1 0. 0. 255. DISPLAY_IDENTIFIER FMY_HIS_8_3_ ECU_ADDRESS 0x7fc43a FORMAT "%3.0" /end MEASUREMENT
/begin MEASUREMENT fmy_his[7][3] "" UBYTE _CNV_A_R_LINEAR_____0_CM 1 0. 0. 255. DISPLAY_IDENTIFIER FMY_HIS_8_4_ ECU_ADDRESS 0x7fc43b FORMAT "%3.0" /end MEASUREMENT
/begin MEASUREMENT fmy_his[8][0] "" UBYTE _CNV_A_R_LINEAR_____0_CM 1 0. 0. 255. DISPLAY_IDENTIFIER FMY_HIS_9_1_ ECU_ADDRESS 0x7fc43c FORMAT "%3.0" /end MEASUREMENT
/begin MEASUREMENT fmy_his[8][1] "" UBYTE _CNV_A_R_LINEAR_____0_CM 1 0. 0. 255. DISPLAY_IDENTIFIER FMY_HIS_9_2_ ECU_ADDRESS 0x7fc43d FORMAT "%3.0" /end MEASUREMENT
/begin MEASUREMENT fmy_his[8][2] "" UBYTE _CNV_A_R_LINEAR_____0_CM 1 0. 0. 255. DISPLAY_IDENTIFIER FMY_HIS_9_3_ ECU_ADDRESS 0x7fc43e FORMAT "%3.0" /end MEASUREMENT
/begin MEASUREMENT fmy_his[8][3] "" UBYTE _CNV_A_R_LINEAR_____0_CM 1 0. 0. 255. DISPLAY_IDENTIFIER FMY_HIS_9_4_ ECU_ADDRESS 0x7fc43f FORMAT "%3.0" /end MEASUREMENT
/begin MEASUREMENT fmy_his[9][0] "" UBYTE _CNV_A_R_LINEAR_____0_CM 1 0. 0. 255. DISPLAY_IDENTIFIER FMY_HIS_10_1_ ECU_ADDRESS 0x7fc440 FORMAT "%3.0" /end MEASUREMENT
/begin MEASUREMENT fmy_his[9][1] "" UBYTE _CNV_A_R_LINEAR_____0_CM 1 0. 0. 255. DISPLAY_IDENTIFIER FMY_HIS_10_2_ ECU_ADDRESS 0x7fc441 FORMAT "%3.0" /end MEASUREMENT
/begin MEASUREMENT fmy_his[9][2] "" UBYTE _CNV_A_R_LINEAR_____0_CM 1 0. 0. 255. DISPLAY_IDENTIFIER FMY_HIS_10_3_ ECU_ADDRESS 0x7fc442 FORMAT "%3.0" /end MEASUREMENT
/begin MEASUREMENT fmy_his[9][3] "" UBYTE _CNV_A_R_LINEAR_____0_CM 1 0. 0. 255. DISPLAY_IDENTIFIER FMY_HIS_10_4_ ECU_ADDRESS 0x7fc443 FORMAT "%3.0" /end MEASUREMENT
/begin MEASUREMENT fmy_his_cod[0] "DTC of failure in history memory" UWORD _CNV_A_R_LINEAR_____0_CM 1 0. 0. 65535. DISPLAY_IDENTIFIER FMY_HIS_1_COD ECU_ADDRESS 0x7fc408 BYTE_ORDER MSB_LAST FORMAT "%5.0" /end MEASUREMENT
/begin MEASUREMENT fmy_his_cod[1] "DTC of failure in history memory" UWORD _CNV_A_R_LINEAR_____0_CM 1 0. 0. 65535. DISPLAY_IDENTIFIER FMY_HIS_2_COD ECU_ADDRESS 0x7fc40a BYTE_ORDER MSB_LAST FORMAT "%5.0" /end MEASUREMENT
/begin MEASUREMENT fmy_his_cod[2] "DTC of failure in history memory" UWORD _CNV_A_R_LINEAR_____0_CM 1 0. 0. 65535. DISPLAY_IDENTIFIER FMY_HIS_3_COD ECU_ADDRESS 0x7fc40c BYTE_ORDER MSB_LAST FORMAT "%5.0" /end MEASUREMENT
/begin MEASUREMENT fmy_his_cod[3] "DTC of failure in history memory" UWORD _CNV_A_R_LINEAR_____0_CM 1 0. 0. 65535. DISPLAY_IDENTIFIER FMY_HIS_4_COD ECU_ADDRESS 0x7fc40e BYTE_ORDER MSB_LAST FORMAT "%5.0" /end MEASUREMENT
/begin MEASUREMENT fmy_his_cod[4] "DTC of failure in history memory" UWORD _CNV_A_R_LINEAR_____0_CM 1 0. 0. 65535. DISPLAY_IDENTIFIER FMY_HIS_5_COD ECU_ADDRESS 0x7fc410 BYTE_ORDER MSB_LAST FORMAT "%5.0" /end MEASUREMENT
/begin MEASUREMENT fmy_his_cod[5] "DTC of failure in history memory" UWORD _CNV_A_R_LINEAR_____0_CM 1 0. 0. 65535. DISPLAY_IDENTIFIER FMY_HIS_6_COD ECU_ADDRESS 0x7fc412 BYTE_ORDER MSB_LAST FORMAT "%5.0" /end MEASUREMENT
/begin MEASUREMENT fmy_his_cod[6] "DTC of failure in history memory" UWORD _CNV_A_R_LINEAR_____0_CM 1 0. 0. 65535. DISPLAY_IDENTIFIER FMY_HIS_7_COD ECU_ADDRESS 0x7fc414 BYTE_ORDER MSB_LAST FORMAT "%5.0" /end MEASUREMENT
/begin MEASUREMENT fmy_his_cod[7] "DTC of failure in history memory" UWORD _CNV_A_R_LINEAR_____0_CM 1 0. 0. 65535. DISPLAY_IDENTIFIER FMY_HIS_8_COD ECU_ADDRESS 0x7fc416 BYTE_ORDER MSB_LAST FORMAT "%5.0" /end MEASUREMENT
/begin MEASUREMENT fmy_his_cod[8] "DTC of failure in history memory" UWORD _CNV_A_R_LINEAR_____0_CM 1 0. 0. 65535. DISPLAY_IDENTIFIER FMY_HIS_9_COD ECU_ADDRESS 0x7fc418 BYTE_ORDER MSB_LAST FORMAT "%5.0" /end MEASUREMENT
/begin MEASUREMENT fmy_his_cod[9] "DTC of failure in history memory" UWORD _CNV_A_R_LINEAR_____0_CM 1 0. 0. 65535. DISPLAY_IDENTIFIER FMY_HIS_10_COD ECU_ADDRESS 0x7fc41a BYTE_ORDER MSB_LAST FORMAT "%5.0" /end MEASUREMENT
/begin MEASUREMENT lv_dc "" UBYTE _CNV_S_2_RANGE______23_CM 1 0. 0. 1. DISPLAY_IDENTIFIER LV_DC ECU_ADDRESS 0x7fc272 /end MEASUREMENT
/begin MEASUREMENT lv_state_wup "" UBYTE _CNV_S_2_RANGE______3_CM 1 0. 0. 1. DISPLAY_IDENTIFIER LV_STATE_WUP ECU_ADDRESS 0x7fc273 /end MEASUREMENT
/begin MEASUREMENT lv_wup_cyc "" UBYTE _CNV_S_2_RANGE______23_CM 1 0. 0. 1. DISPLAY_IDENTIFIER LV_WUP_CYC ECU_ADDRESS 0x7fc274 /end MEASUREMENT
/begin MEASUREMENT dly_mil_ready "Delay time to unable MIL blinking during pre-drive check mode" UWORD _CNV_A_R_LINEAR_____6_CM 1 0. 0. 32767500. DISPLAY_IDENTIFIER DLY_MIL_READY ECU_ADDRESS 0x7fc452 BYTE_ORDER MSB_LAST FORMAT "%8.0" /end MEASUREMENT
/begin MEASUREMENT state_mil "State of WAL_2 illumination commanded by error management" UBYTE _CNV_S_3_RANGE______24_CM 1 0. 0. 2. DISPLAY_IDENTIFIER STATE_MIL ECU_ADDRESS 0x7fc448 /end MEASUREMENT
/begin MEASUREMENT state_wal_1 "State of WAL_1 illumination commanded by error management" UBYTE _CNV_S_2_RANGE______11_CM 1 0. 0. 1. DISPLAY_IDENTIFIER STATE_WAL_1 ECU_ADDRESS 0x7fc44b /end MEASUREMENT
/begin MEASUREMENT state_wal_2 "State of WAL_2 illumination commanded by error management" UBYTE _CNV_S_2_RANGE______11_CM 1 0. 0. 1. DISPLAY_IDENTIFIER STATE_WAL_2 ECU_ADDRESS 0x7fc44e /end MEASUREMENT
/begin MEASUREMENT obd_state_1 "Readiness Code completion status 1" UBYTE _CNV_A_R_LINEAR_____1_CM 1 0. 0. 255. DISPLAY_IDENTIFIER OBD_STATE_1 ECU_ADDRESS 0x7fccac FORMAT "%3.0" /end MEASUREMENT
/begin MEASUREMENT obd_state_2 "Readiness Code completion status 2" UBYTE _CNV_A_R_LINEAR_____1_CM 1 0. 0. 255. DISPLAY_IDENTIFIER OBD_STATE_2 ECU_ADDRESS 0x7fccad FORMAT "%3.0" /end MEASUREMENT
/begin MEASUREMENT lv_wal_1 "Boolean indicating WAL_1 physical output" UBYTE _CNV_S_2_RANGE______11_CM 1 0. 0. 1. DISPLAY_IDENTIFIER LV_WAL_1 ECU_ADDRESS 0x7fc449 /end MEASUREMENT
/begin MEASUREMENT lv_wal_2 "Boolean indicating WAL_2 physical output" UBYTE _CNV_S_2_RANGE______11_CM 1 0. 0. 1. DISPLAY_IDENTIFIER LV_WAL_2 ECU_ADDRESS 0x7fc44c /end MEASUREMENT
/begin MEASUREMENT lv_mil_fll_ready "Boolean indicating MIL shall blink during pre-drive check mode phase 2" UBYTE _CNV_S_2_RANGE______11_CM 1 0. 0. 1. DISPLAY_IDENTIFIER LV_MIL_FLL_READY ECU_ADDRESS 0x7fc450 /end MEASUREMENT
/begin MEASUREMENT t_dtc_clr "Time since diagnostic trouble codes cleared." UWORD _CNV_A_R_LINEAR_____25_CM 1 0. 0. 65535. DISPLAY_IDENTIFIER T_DTC_CLR ECU_ADDRESS 0x7fc47a BYTE_ORDER MSB_LAST FORMAT "%5.0" /end MEASUREMENT
/begin MEASUREMENT state_ena_obd "Monitor enable status for the current driving cycle" UWORD _CNV_A_R_LINEAR_____1_CM 1 0. 0. 65535. DISPLAY_IDENTIFIER STATE_ENA_OBD ECU_ADDRESS 0x7fc47e BYTE_ORDER MSB_LAST FORMAT "%5.0" /end MEASUREMENT
/begin MEASUREMENT state_cmpl_obd "Monitor completion status for the current driving cycle" UWORD _CNV_A_R_LINEAR_____1_CM 1 0. 0. 65535. DISPLAY_IDENTIFIER STATE_CMPL_OBD ECU_ADDRESS 0x7fc47c BYTE_ORDER MSB_LAST FORMAT "%5.0" /end MEASUREMENT
/begin MEASUREMENT dist_act_wal_1 "Global distance traveled while the WAL_1 is illuminated." UWORD _CNV_A_R_LINEAR_____26_CM 1 0. 0. 65535. DISPLAY_IDENTIFIER DIST_ACT_WAL_1 ECU_ADDRESS 0x7fc46a BYTE_ORDER MSB_LAST FORMAT "%5.0" /end MEASUREMENT
/begin MEASUREMENT dist_act_wal_2 "Global distance traveled while the WAL_2 is illuminated." UWORD _CNV_A_R_LINEAR_____26_CM 1 0. 0. 65535. DISPLAY_IDENTIFIER DIST_ACT_WAL_2 ECU_ADDRESS 0x7fc470 BYTE_ORDER MSB_LAST FORMAT "%5.0" /end MEASUREMENT
/begin MEASUREMENT dist_act_mil "Global distance traveled while the MIL is illuminated." UWORD _CNV_A_R_LINEAR_____26_CM 1 0. 0. 65535. DISPLAY_IDENTIFIER DIST_ACT_MIL ECU_ADDRESS 0x7fc460 BYTE_ORDER MSB_LAST FORMAT "%5.0" /end MEASUREMENT
/begin MEASUREMENT t_act_mil "Minutes run by the engine while MIL activated" UWORD _CNV_A_R_LINEAR_____25_CM 1 0. 0. 65535. DISPLAY_IDENTIFIER T_ACT_MIL ECU_ADDRESS 0x7fc466 BYTE_ORDER MSB_LAST FORMAT "%5.0" /end MEASUREMENT
/begin MEASUREMENT t_act_mil_60 "Seconds run by the engine while MIL activated fot t_act_mil calculation." UBYTE _CNV_A_R_LINEAR_____27_CM 1 0. 0. 60. DISPLAY_IDENTIFIER T_ACT_MIL_60 ECU_ADDRESS 0x7fc464 FORMAT "%2.0" /end MEASUREMENT
/begin MEASUREMENT dist_dtc_clr "Distance since DTC cleared." UWORD _CNV_A_R_LINEAR_____26_CM 1 0. 0. 65535. DISPLAY_IDENTIFIER DIST_DTC_CLR ECU_ADDRESS 0x7fc476 BYTE_ORDER MSB_LAST FORMAT "%5.0" /end MEASUREMENT
/begin MEASUREMENT dist_rel_dtc_clr "Distance at following event : DTC cleared." UWORD _CNV_A_R_LINEAR_____26_CM 1 0. 0. 65535. DISPLAY_IDENTIFIER DIST_REL_DTC_CLR ECU_ADDRESS 0x7fc478 BYTE_ORDER MSB_LAST FORMAT "%5.0" /end MEASUREMENT
/begin MEASUREMENT ctr_wup_dtc_clr "Number of warms-up since DTC cleared" UBYTE _CNV_A_R_LINEAR_____1_CM 1 0. 0. 255. DISPLAY_IDENTIFIER CTR_WUP_DTC_CLR ECU_ADDRESS 0x7fc474 FORMAT "%3.0" /end MEASUREMENT
/begin MEASUREMENT lv_abc_inh "" UBYTE _CNV_S_2_RANGE______23_CM 1 0. 0. 1. DISPLAY_IDENTIFIER LV_ABC_INH ECU_ADDRESS 0x7fc4da /end MEASUREMENT
/begin MEASUREMENT lv_inh_wup_cyc "" UBYTE _CNV_S_2_RANGE______23_CM 1 0. 0. 1. DISPLAY_IDENTIFIER LV_INH_WUP_CYC ECU_ADDRESS 0x7fc4db /end MEASUREMENT
/begin MEASUREMENT lv_err_pvs_pred "" UBYTE _CNV_S_2_RANGE______11_CM 1 0. 0. 1. DISPLAY_IDENTIFIER LV_ERR_PVS_PRED ECU_ADDRESS 0x7fcdf3 /end MEASUREMENT
/begin MEASUREMENT lv_err_pvs_1 "" UBYTE _CNV_S_2_RANGE______11_CM 1 0. 0. 1. DISPLAY_IDENTIFIER LV_ERR_PVS_1 ECU_ADDRESS 0x7fcdf1 /end MEASUREMENT
/begin MEASUREMENT lv_err_pvs_2 "" UBYTE _CNV_S_2_RANGE______11_CM 1 0. 0. 1. DISPLAY_IDENTIFIER LV_ERR_PVS_2 ECU_ADDRESS 0x7fcdf2 /end MEASUREMENT
/begin MEASUREMENT lv_lih_pvs_move "" UBYTE _CNV_S_2_RANGE______11_CM 1 0. 0. 1. DISPLAY_IDENTIFIER LV_LIH_PVS_MOVE ECU_ADDRESS 0x7fcdf4 /end MEASUREMENT
/begin MEASUREMENT lv_act_pvs_lih "" UBYTE _CNV_S_2_RANGE______11_CM 1 0. 0. 1. DISPLAY_IDENTIFIER LV_ACT_PVS_LIH ECU_ADDRESS 0x7fcdfa /end MEASUREMENT
/begin MEASUREMENT lv_pvs_bls_bts_plaus "" UBYTE _CNV_S_2_RANGE______11_CM 1 0. 0. 1. DISPLAY_IDENTIFIER LV_PVS_BLS_BTS_PLAUS ECU_ADDRESS 0x7fcdf6 /end MEASUREMENT
/begin MEASUREMENT lv_pvs_h_r "" UBYTE _CNV_S_2_RANGE______11_CM 1 0. 0. 1. DISPLAY_IDENTIFIER LV_PVS_H_R ECU_ADDRESS 0x7fce06 /end MEASUREMENT
/begin MEASUREMENT lv_pvs_h_r_1 "" UBYTE _CNV_S_2_RANGE______11_CM 1 0. 0. 1. DISPLAY_IDENTIFIER LV_PVS_H_R_1 ECU_ADDRESS 0x7fce04 /end MEASUREMENT
/begin MEASUREMENT lv_pvs_h_r_2 "" UBYTE _CNV_S_2_RANGE______11_CM 1 0. 0. 1. DISPLAY_IDENTIFIER LV_PVS_H_R_2 ECU_ADDRESS 0x7fce05 /end MEASUREMENT
/begin MEASUREMENT v_pvs_min "" UWORD _CNV_A_R_LINEAR_____28_CM 1 0. 0. 4.9951171875 DISPLAY_IDENTIFIER V_PVS_MIN ECU_ADDRESS 0x7fcd1c BYTE_ORDER MSB_LAST FORMAT "%3.2" /end MEASUREMENT
/begin MEASUREMENT v_pvs_mmv_1 "" UWORD _CNV_A_R_LINEAR_____28_CM 1 0. 0. 4.9951171875 DISPLAY_IDENTIFIER V_PVS_MMV_1 ECU_ADDRESS 0x7fcd1e BYTE_ORDER MSB_LAST FORMAT "%3.2" /end MEASUREMENT
/begin MEASUREMENT v_pvs_mmv_2 "" UWORD _CNV_A_R_LINEAR_____28_CM 1 0. 0. 4.9951171875 DISPLAY_IDENTIFIER V_PVS_MMV_2 ECU_ADDRESS 0x7fcd20 BYTE_ORDER MSB_LAST FORMAT "%3.2" /end MEASUREMENT
/begin MEASUREMENT ctr_move "" UBYTE _CNV_A_R_LINEAR_____0_CM 1 0. 0. 255. DISPLAY_IDENTIFIER CTR_MOVE ECU_ADDRESS 0x7fcdfc FORMAT "%3.0" /end MEASUREMENT
/begin MEASUREMENT lv_err_pvs "" UBYTE _CNV_S_2_RANGE______11_CM 1 0. 0. 1. DISPLAY_IDENTIFIER LV_ERR_PVS ECU_ADDRESS 0x7fcdf0 /end MEASUREMENT
/begin MEASUREMENT lv_err_vcc_pvs_1 "" UBYTE _CNV_S_2_RANGE______23_CM 1 0. 0. 1. DISPLAY_IDENTIFIER LV_ERR_VCC_PVS_1 ECU_ADDRESS 0x7fcdf8 /end MEASUREMENT
/begin MEASUREMENT lv_err_vcc_pvs_2 "" UBYTE _CNV_S_2_RANGE______23_CM 1 0. 0. 1. DISPLAY_IDENTIFIER LV_ERR_VCC_PVS_2 ECU_ADDRESS 0x7fcdf9 /end MEASUREMENT
/begin MEASUREMENT lv_lih_bls_bts "" UBYTE _CNV_S_2_RANGE______11_CM 1 0. 0. 1. DISPLAY_IDENTIFIER LV_LIH_BLS_BTS ECU_ADDRESS 0x7fcdf5 /end MEASUREMENT
/begin MEASUREMENT vcc_1 "" UWORD _CNV_A_R_LINEAR_____36_CM 1 0. 0. 9.990233999999999 DISPLAY_IDENTIFIER VCC_1 ECU_ADDRESS 0x7f986c BYTE_ORDER MSB_LAST FORMAT "%3.2" /end MEASUREMENT
/begin MEASUREMENT vcc_2 "" UWORD _CNV_A_R_LINEAR_____36_CM 1 0. 0. 9.990233999999999 DISPLAY_IDENTIFIER VCC_2 ECU_ADDRESS 0x7f986e BYTE_ORDER MSB_LAST FORMAT "%3.2" /end MEASUREMENT
/begin MEASUREMENT amp "" UWORD _CNV_A_R_LINEAR_____45_CM 1 0. 0. 5434. DISPLAY_IDENTIFIER AMP ECU_ADDRESS 0x7fa104 BYTE_ORDER MSB_LAST FORMAT "%4.3" /end MEASUREMENT
/begin MEASUREMENT amp_mes "" UWORD _CNV_A_R_LINEAR_____45_CM 1 0. 0. 5434. DISPLAY_IDENTIFIER AMP_MES ECU_ADDRESS 0x7fa106 BYTE_ORDER MSB_LAST FORMAT "%4.3" /end MEASUREMENT
/begin MEASUREMENT v_amp "" UWORD _CNV_A_R_LINEAR_____28_CM 1 0. 0. 4.9951171875 DISPLAY_IDENTIFIER V_AMP ECU_ADDRESS 0x7fa108 BYTE_ORDER MSB_LAST FORMAT "%3.2" /end MEASUREMENT
/begin MEASUREMENT tco_sp_ect "" UBYTE _CNV_A_R_LINEAR_____18_CM 1 0. -50. 205. DISPLAY_IDENTIFIER TCO_SP_ECT ECU_ADDRESS 0x7fbf3e FORMAT "%3.0" /end MEASUREMENT
/begin MEASUREMENT ctr_bas_cyl_bal[0] "" UBYTE _CNV_A_R_LINEAR_____0_CM 1 0. 0. 255. DISPLAY_IDENTIFIER CTR_BAS_CYL_BAL_0_ ECU_ADDRESS 0x7fb82b FORMAT "%3.0" /end MEASUREMENT
/begin MEASUREMENT ctr_bas_cyl_bal[1] "" UBYTE _CNV_A_R_LINEAR_____0_CM 1 0. 0. 255. DISPLAY_IDENTIFIER CTR_BAS_CYL_BAL_1_ ECU_ADDRESS 0x7fb82c FORMAT "%3.0" /end MEASUREMENT
/begin MEASUREMENT ctr_bas_cyl_bal[2] "" UBYTE _CNV_A_R_LINEAR_____0_CM 1 0. 0. 255. DISPLAY_IDENTIFIER CTR_BAS_CYL_BAL_2_ ECU_ADDRESS 0x7fb82d FORMAT "%3.0" /end MEASUREMENT
/begin MEASUREMENT ctr_eve_cyl_bal[0] "" UBYTE _CNV_A_R_LINEAR_____0_CM 1 0. 0. 255. DISPLAY_IDENTIFIER CTR_EVE_CYL_BAL_0_ ECU_ADDRESS 0x7fb82f FORMAT "%3.0" /end MEASUREMENT
/begin MEASUREMENT ctr_eve_cyl_bal[1] "" UBYTE _CNV_A_R_LINEAR_____0_CM 1 0. 0. 255. DISPLAY_IDENTIFIER CTR_EVE_CYL_BAL_1_ ECU_ADDRESS 0x7fb830 FORMAT "%3.0" /end MEASUREMENT
/begin MEASUREMENT ctr_eve_cyl_bal[2] "" UBYTE _CNV_A_R_LINEAR_____0_CM 1 0. 0. 255. DISPLAY_IDENTIFIER CTR_EVE_CYL_BAL_2_ ECU_ADDRESS 0x7fb831 FORMAT "%3.0" /end MEASUREMENT
/begin MEASUREMENT fac_is_fil "" UWORD _CNV_A_R_LINEAR_____14_CM 1 0. 0. 0.9999847412109381 DISPLAY_IDENTIFIER FAC_IS_FIL ECU_ADDRESS 0x7fa9a4 BYTE_ORDER MSB_LAST FORMAT "%5.3" /end MEASUREMENT
/begin MEASUREMENT lv_act_is_fil_is "" UBYTE _CNV_S_2_RANGE______23_CM 1 0. 0. 1. DISPLAY_IDENTIFIER LV_ACT_IS_FIL_IS ECU_ADDRESS 0x7fbeb8 /end MEASUREMENT
/begin MEASUREMENT n_sp_is_fil "" UWORD _CNV_A_R_LINEAR_____5_CM 1 0. 0. 6375. DISPLAY_IDENTIFIER N_SP_IS_FIL ECU_ADDRESS 0x7f9ce4 BYTE_ORDER MSB_LAST FORMAT "%4.0" /end MEASUREMENT
/begin MEASUREMENT vs_n_grd "" SWORD _CNV_A_R_LINEAR_____69_CM 1 0. -5.e-002 4.9998474e-002 DISPLAY_IDENTIFIER VS_N_GRD ECU_ADDRESS 0x7fb3da BYTE_ORDER MSB_LAST FORMAT "%7.6" /end MEASUREMENT
/begin MEASUREMENT vs_n_grd_fil "" SWORD _CNV_A_R_LINEAR_____69_CM 1 0. -5.e-002 4.9998474e-002 DISPLAY_IDENTIFIER VS_N_GRD_FIL ECU_ADDRESS 0x7fb3dc BYTE_ORDER MSB_LAST FORMAT "%7.6" /end MEASUREMENT
/begin MEASUREMENT lv_dt "" UBYTE _CNV_S_2_RANGE______11_CM 1 0. 0. 1. DISPLAY_IDENTIFIER LV_DT ECU_ADDRESS 0x7fbb50 /end MEASUREMENT
/begin MEASUREMENT lv_vs_n_con "" UBYTE _CNV_S_2_RANGE______11_CM 1 0. 0. 1. DISPLAY_IDENTIFIER LV_VS_N_CON ECU_ADDRESS 0x7fbb52 /end MEASUREMENT
/begin MEASUREMENT dri "" UBYTE _CNV_P_8_TABLE_______68_CM 1 0. 0. 15. DISPLAY_IDENTIFIER DRI ECU_ADDRESS 0x7fbb4f FORMAT "%2.0" /end MEASUREMENT
/begin MEASUREMENT gear "" UBYTE _CNV_P_8_TABLE_______68_CM 1 0. 0. 15. DISPLAY_IDENTIFIER GEAR ECU_ADDRESS 0x7fbb51 FORMAT "%2.0" /end MEASUREMENT
/begin MEASUREMENT vs "" UBYTE _CNV_A_R_LINEAR_____34_CM 1 0. 0. 255. DISPLAY_IDENTIFIER VS ECU_ADDRESS 0x7fce86 FORMAT "%3.0" /end MEASUREMENT
/begin MEASUREMENT vs_h_res "" UWORD _CNV_A_R_LINEAR_____71_CM 1 0. 0. 655.35 DISPLAY_IDENTIFIER VS_H_RES ECU_ADDRESS 0x7fcdb2 BYTE_ORDER MSB_LAST FORMAT "%5.2" /end MEASUREMENT
/begin MEASUREMENT vs_bas "" UWORD _CNV_A_R_LINEAR_____71_CM 1 0. 0. 655.35 DISPLAY_IDENTIFIER VS_BAS ECU_ADDRESS 0x7fcdb4 BYTE_ORDER MSB_LAST FORMAT "%5.2" /end MEASUREMENT
/begin MEASUREMENT lv_vs_run "" UBYTE _CNV_S_2_RANGE______11_CM 1 0. 0. 1. DISPLAY_IDENTIFIER LV_VS_RUN ECU_ADDRESS 0x7fce8d /end MEASUREMENT
/begin MEASUREMENT vs_n "" UWORD _CNV_A_R_LINEAR_____70_CM 1 0. 0. 0.1 DISPLAY_IDENTIFIER VS_N ECU_ADDRESS 0x7fcdb6 BYTE_ORDER MSB_LAST FORMAT "%6.5" /end MEASUREMENT
/begin MEASUREMENT n_mv_vs_sens "" UWORD _CNV_A_R_LINEAR_____5_CM 1 0. 0. 6375. DISPLAY_IDENTIFIER N_MV_VS_SENS ECU_ADDRESS 0x7fcdbe BYTE_ORDER MSB_LAST FORMAT "%4.0" /end MEASUREMENT
/begin MEASUREMENT vs_fil "" UWORD _CNV_A_R_LINEAR_____71_CM 1 0. 0. 655.35 DISPLAY_IDENTIFIER VS_FIL ECU_ADDRESS 0x7fcdb8 BYTE_ORDER MSB_LAST FORMAT "%5.2" /end MEASUREMENT
/begin MEASUREMENT vs_ac "" UBYTE _CNV_A_R_LINEAR_____72_CM 1 0. -14. 6.4 DISPLAY_IDENTIFIER VS_AC ECU_ADDRESS 0x7fce87 FORMAT "%5.2" /end MEASUREMENT
/begin MEASUREMENT t_vs_cor_diag "" UWORD _CNV_A_R_LINEAR_____19_CM 1 0. 0. 6553.5 DISPLAY_IDENTIFIER T_VS_COR_DIAG ECU_ADDRESS 0x7fa638 BYTE_ORDER MSB_LAST FORMAT "%5.1" /end MEASUREMENT
/begin MEASUREMENT fac_vs_adj "" UWORD _CNV_A_R_LINEAR_____76_CM 1 0. 0. 65535. DISPLAY_IDENTIFIER FAC_VS_ADJ ECU_ADDRESS 0x7fa162 BYTE_ORDER MSB_LAST FORMAT "%5.0" /end MEASUREMENT
/begin MEASUREMENT vs_conf "" UBYTE _CNV_A_R_LINEAR_____0_CM 1 0. 0. 15. DISPLAY_IDENTIFIER VS_CONF ECU_ADDRESS 0x7fbb6c FORMAT "%2.0" /end MEASUREMENT
/begin MEASUREMENT lv_can_vs_abs "" UBYTE _CNV_A_R_LINEAR_____0_CM 1 0. 0. 1. DISPLAY_IDENTIFIER LV_CAN_VS_ABS ECU_ADDRESS 0x7fbb6d FORMAT "%1.0" /end MEASUREMENT
/begin MEASUREMENT lv_can_ac_abs "" UBYTE _CNV_A_R_LINEAR_____0_CM 1 0. 0. 1. DISPLAY_IDENTIFIER LV_CAN_AC_ABS ECU_ADDRESS 0x7fbb6e FORMAT "%1.0" /end MEASUREMENT
/begin MEASUREMENT lv_can_dist_abs "" UBYTE _CNV_A_R_LINEAR_____0_CM 1 0. 0. 1. DISPLAY_IDENTIFIER LV_CAN_DIST_ABS ECU_ADDRESS 0x7fbb6f FORMAT "%1.0" /end MEASUREMENT
/begin MEASUREMENT tq_conv "" SWORD _CNV_A_R_LINEAR_____52_CM 1 0. -1024. 1023.96875 DISPLAY_IDENTIFIER TQ_CONV ECU_ADDRESS 0x7fa2b2 BYTE_ORDER MSB_LAST FORMAT "%7.2" /end MEASUREMENT
/begin MEASUREMENT tqi_n_max "" SWORD _CNV_A_R_LINEAR_____52_CM 1 0. 0. 1023.96875 DISPLAY_IDENTIFIER TQI_N_MAX ECU_ADDRESS 0x7fa0c4 BYTE_ORDER MSB_LAST FORMAT "%7.2" /end MEASUREMENT
/begin MEASUREMENT tqi_p_max "" SWORD _CNV_A_R_LINEAR_____52_CM 1 0. -1024. 1023.96875 DISPLAY_IDENTIFIER TQI_P_MAX ECU_ADDRESS 0x7fa2b4 BYTE_ORDER MSB_LAST FORMAT "%7.2" /end MEASUREMENT
/begin MEASUREMENT tqi_vs_max "" SWORD _CNV_A_R_LINEAR_____52_CM 1 0. -1024. 1023.96875 DISPLAY_IDENTIFIER TQI_VS_MAX ECU_ADDRESS 0x7fa2b6 BYTE_ORDER MSB_LAST FORMAT "%7.2" /end MEASUREMENT
/begin MEASUREMENT eff_bas "" UWORD _CNV_A_R_LINEAR_____48_CM 1 0. 0. 1.9999696 DISPLAY_IDENTIFIER EFF_BAS ECU_ADDRESS 0x7fa2b8 BYTE_ORDER MSB_LAST FORMAT "%5.4" /end MEASUREMENT
/begin MEASUREMENT tq_loss "" SWORD _CNV_A_R_LINEAR_____52_CM 1 0. -1024. 1023.96875 DISPLAY_IDENTIFIER TQ_LOSS ECU_ADDRESS 0x7fa2ea BYTE_ORDER MSB_LAST FORMAT "%7.2" /end MEASUREMENT
/begin MEASUREMENT tqfr_mmv "" SWORD _CNV_A_R_LINEAR_____52_CM 1 0. -1024. 1023.96875 DISPLAY_IDENTIFIER TQFR_MMV ECU_ADDRESS 0x7fcdee BYTE_ORDER MSB_LAST FORMAT "%7.2" /end MEASUREMENT
/begin MEASUREMENT tqfr_bas "" SWORD _CNV_A_R_LINEAR_____52_CM 1 0. -1024. 1023.96875 DISPLAY_IDENTIFIER TQFR_BAS ECU_ADDRESS 0x7fcde6 BYTE_ORDER MSB_LAST FORMAT "%7.2" /end MEASUREMENT
/begin MEASUREMENT tqfr_add_toil "" SWORD _CNV_A_R_LINEAR_____52_CM 1 0. -1024. 1023.96875 DISPLAY_IDENTIFIER TQFR_ADD_TOIL ECU_ADDRESS 0x7fcdec BYTE_ORDER MSB_LAST FORMAT "%7.2" /end MEASUREMENT
/begin MEASUREMENT tqfr_add_tco "" SWORD _CNV_A_R_LINEAR_____52_CM 1 0. -1024. 1023.96875 DISPLAY_IDENTIFIER TQFR_ADD_TCO ECU_ADDRESS 0x7fcdea BYTE_ORDER MSB_LAST FORMAT "%7.2" /end MEASUREMENT
/begin MEASUREMENT tqfr_add_env "" SWORD _CNV_A_R_LINEAR_____52_CM 1 0. -1024. 1023.96875 DISPLAY_IDENTIFIER TQFR_ADD_ENV ECU_ADDRESS 0x7fcde8 BYTE_ORDER MSB_LAST FORMAT "%7.2" /end MEASUREMENT
/begin MEASUREMENT tq_max_sca "" SWORD _CNV_A_R_LINEAR_____52_CM 1 0. -1024. 1023.96875 DISPLAY_IDENTIFIER TQ_MAX_SCA ECU_ADDRESS 0x7fa28e BYTE_ORDER MSB_LAST FORMAT "%7.2" /end MEASUREMENT
/begin MEASUREMENT tq_max_clu "" SWORD _CNV_A_R_LINEAR_____52_CM 1 0. -1024. 1023.96875 DISPLAY_IDENTIFIER TQ_MAX_CLU ECU_ADDRESS 0x7fa28c BYTE_ORDER MSB_LAST FORMAT "%7.2" /end MEASUREMENT
/begin MEASUREMENT tq_min_clu "" SWORD _CNV_A_R_LINEAR_____52_CM 1 0. -1024. 1023.96875 DISPLAY_IDENTIFIER TQ_MIN_CLU ECU_ADDRESS 0x7fa290 BYTE_ORDER MSB_LAST FORMAT "%7.2" /end MEASUREMENT
/begin MEASUREMENT tq_min_sca "" SWORD _CNV_A_R_LINEAR_____52_CM 1 0. -1024. 1023.96875 DISPLAY_IDENTIFIER TQ_MIN_SCA ECU_ADDRESS 0x7fa292 BYTE_ORDER MSB_LAST FORMAT "%7.2" /end MEASUREMENT
/begin MEASUREMENT fac_tq_req_clu_cor "o v" UWORD _CNV_A_R_LINEAR_____48_CM 1 0. 0. 1.9999696 DISPLAY_IDENTIFIER FAC_TQ_REQ_CLU_COR ECU_ADDRESS 0x7fa294 BYTE_ORDER MSB_LAST FORMAT "%6.5" /end MEASUREMENT
/begin MEASUREMENT tq_req_clu "o v" SWORD _CNV_A_R_LINEAR_____52_CM 1 0. -1024. 1023.96875 DISPLAY_IDENTIFIER TQ_REQ_CLU ECU_ADDRESS 0x7fa296 BYTE_ORDER MSB_LAST FORMAT "%6.2" /end MEASUREMENT
/begin MEASUREMENT tq_dif_req "o v" SWORD _CNV_A_R_LINEAR_____52_CM 1 0. -1024. 1023.96875 DISPLAY_IDENTIFIER TQ_DIF_REQ ECU_ADDRESS 0x7fa298 BYTE_ORDER MSB_LAST FORMAT "%6.2" /end MEASUREMENT
/begin MEASUREMENT fac_tq_tra "o v" UWORD _CNV_A_R_LINEAR_____48_CM 1 0. 0. 1.9999696 DISPLAY_IDENTIFIER FAC_TQ_TRA ECU_ADDRESS 0x7fa29a BYTE_ORDER MSB_LAST FORMAT "%6.5" /end MEASUREMENT
/begin MEASUREMENT fac_pv_av "v" UWORD _CNV_A_R_LINEAR_____48_CM 1 0. 0. 1.9999696 DISPLAY_IDENTIFIER FAC_PV_AV ECU_ADDRESS 0x7fb47c BYTE_ORDER MSB_LAST FORMAT "%6.5" /end MEASUREMENT
/begin MEASUREMENT fac_n_dif "v" UWORD _CNV_A_R_LINEAR_____48_CM 1 0. 0. 1.9999696 DISPLAY_IDENTIFIER FAC_N_DIF ECU_ADDRESS 0x7fb47e BYTE_ORDER MSB_LAST FORMAT "%6.5" /end MEASUREMENT
/begin MEASUREMENT lv_tq_tcs_req_inc_inter "" UBYTE _CNV_S_2_RANGE______11_CM 1 0. 0. 1. DISPLAY_IDENTIFIER LV_TQ_TCS_REQ_INC_INTER ECU_ADDRESS 0x7fbfde /end MEASUREMENT
/begin MEASUREMENT lv_tq_tcs_req_dec_inter "" UBYTE _CNV_S_2_RANGE______11_CM 1 0. 0. 1. DISPLAY_IDENTIFIER LV_TQ_TCS_REQ_DEC_INTER ECU_ADDRESS 0x7fbfdd /end MEASUREMENT
/begin MEASUREMENT lv_tq_tcs_req_dec_it "" UBYTE _CNV_S_2_RANGE______11_CM 1 0. 0. 1. DISPLAY_IDENTIFIER LV_TQ_TCS_REQ_DEC_IT ECU_ADDRESS 0x7fbfdf /end MEASUREMENT
/begin MEASUREMENT lv_tq_tcs_req_inc_it "" UBYTE _CNV_S_2_RANGE______11_CM 1 0. 0. 1. DISPLAY_IDENTIFIER LV_TQ_TCS_REQ_INC_IT ECU_ADDRESS 0x7fbfe0 /end MEASUREMENT
/begin MEASUREMENT lv_tcs_dec_ena "" UBYTE _CNV_S_2_RANGE______11_CM 1 0. 0. 1. DISPLAY_IDENTIFIER LV_TCS_DEC_ENA ECU_ADDRESS 0x7fbfd4 /end MEASUREMENT
/begin MEASUREMENT lv_tcs_inc_ena "" UBYTE _CNV_S_2_RANGE______11_CM 1 0. 0. 1. DISPLAY_IDENTIFIER LV_TCS_INC_ENA ECU_ADDRESS 0x7fbfd5 /end MEASUREMENT
/begin MEASUREMENT tqi_esp_sub "" SWORD _CNV_A_R_LINEAR_____52_CM 1 0. -1024. 1023.96875 DISPLAY_IDENTIFIER TQI_ESP_SUB ECU_ADDRESS 0x7fa2e0 BYTE_ORDER MSB_LAST FORMAT "%7.2" /end MEASUREMENT
/begin MEASUREMENT tq_esp_sub "" SWORD _CNV_A_R_LINEAR_____52_CM 1 0. -1024. 1023.96875 DISPLAY_IDENTIFIER TQ_ESP_SUB ECU_ADDRESS 0x7fa2de BYTE_ORDER MSB_LAST FORMAT "%7.2" /end MEASUREMENT
/begin MEASUREMENT lv_tq_esp_req_min "" UBYTE _CNV_S_2_RANGE______11_CM 1 0. 0. 1. DISPLAY_IDENTIFIER LV_TQ_ESP_REQ_MIN ECU_ADDRESS 0x7fbbec /end MEASUREMENT
/begin MEASUREMENT lv_tq_esp_req_max "" UBYTE _CNV_S_2_RANGE______11_CM 1 0. 0. 1. DISPLAY_IDENTIFIER LV_TQ_ESP_REQ_MAX ECU_ADDRESS 0x7fbbed /end MEASUREMENT
/begin MEASUREMENT lv_tq_esp_act "" UBYTE _CNV_S_2_RANGE______11_CM 1 0. 0. 1. DISPLAY_IDENTIFIER LV_TQ_ESP_ACT ECU_ADDRESS 0x7fbbeb /end MEASUREMENT
/begin MEASUREMENT lv_tcs_inc "" UBYTE _CNV_S_2_RANGE______11_CM 1 0. 0. 1. DISPLAY_IDENTIFIER LV_TCS_INC ECU_ADDRESS 0x7fbbee /end MEASUREMENT
/begin MEASUREMENT tq_tcs_inter "" SWORD _CNV_A_R_LINEAR_____52_CM 1 0. -1024. 1023.96875 DISPLAY_IDENTIFIER TQ_TCS_INTER ECU_ADDRESS 0x7fb4ce BYTE_ORDER MSB_LAST FORMAT "%7.2" /end MEASUREMENT
/begin MEASUREMENT lv_tcs_ramp_end "" UBYTE _CNV_S_2_RANGE______11_CM 1 0. 0. 1. DISPLAY_IDENTIFIER LV_TCS_RAMP_END ECU_ADDRESS 0x7fbfd6 /end MEASUREMENT
/begin MEASUREMENT lv_tcs_ramp "" UBYTE _CNV_S_2_RANGE______11_CM 1 0. 0. 1. DISPLAY_IDENTIFIER LV_TCS_RAMP ECU_ADDRESS 0x7fbbef /end MEASUREMENT
/begin MEASUREMENT lv_cmd_tcs_ramp_end "" UBYTE _CNV_S_2_RANGE______11_CM 1 0. 0. 1. DISPLAY_IDENTIFIER LV_CMD_TCS_RAMP_END ECU_ADDRESS 0x7fbfd7 /end MEASUREMENT
/begin MEASUREMENT lv_tcs_ramp_lih "" UBYTE _CNV_S_2_RANGE______11_CM 1 0. 0. 1. DISPLAY_IDENTIFIER LV_TCS_RAMP_LIH ECU_ADDRESS 0x7fbfd8 /end MEASUREMENT
/begin MEASUREMENT lv_tcs_ramp_tq_lim "" UBYTE _CNV_S_2_RANGE______11_CM 1 0. 0. 1. DISPLAY_IDENTIFIER LV_TCS_RAMP_TQ_LIM ECU_ADDRESS 0x7fbfdb /end MEASUREMENT
/begin MEASUREMENT lv_tcs_ramp_t_lim "" UBYTE _CNV_S_2_RANGE______11_CM 1 0. 0. 1. DISPLAY_IDENTIFIER LV_TCS_RAMP_T_LIM ECU_ADDRESS 0x7fbfd9 /end MEASUREMENT
/begin MEASUREMENT t_tcs_ramp "" UBYTE _CNV_A_R_LINEAR_____56_CM 1 0. 0. 2.55 DISPLAY_IDENTIFIER T_TCS_RAMP ECU_ADDRESS 0x7fbfd2 FORMAT "%3.2" /end MEASUREMENT
/begin MEASUREMENT t_tcs_inc "" UWORD _CNV_A_R_LINEAR_____56_CM 1 0. 0. 655.35 DISPLAY_IDENTIFIER T_TCS_INC ECU_ADDRESS 0x7fb4d2 BYTE_ORDER MSB_LAST FORMAT "%5.2" /end MEASUREMENT
/begin MEASUREMENT lv_cmd_tcs_ramp_tq_lim "" UBYTE _CNV_S_2_RANGE______11_CM 1 0. 0. 1. DISPLAY_IDENTIFIER LV_CMD_TCS_RAMP_TQ_LIM ECU_ADDRESS 0x7fbfdc /end MEASUREMENT
/begin MEASUREMENT lv_cmd_tcs_ramp_t_lim "" UBYTE _CNV_S_2_RANGE______11_CM 1 0. 0. 1. DISPLAY_IDENTIFIER LV_CMD_TCS_RAMP_T_LIM ECU_ADDRESS 0x7fbfda /end MEASUREMENT
/begin MEASUREMENT tq_inc_sum_tcs "" UWORD _CNV_A_R_LINEAR_____90_CM 1 0. 0. 16383.75 DISPLAY_IDENTIFIER TQ_INC_SUM_TCS ECU_ADDRESS 0x7fa2e2 BYTE_ORDER MSB_LAST FORMAT "%7.2" /end MEASUREMENT
/begin MEASUREMENT tq_tcs_req_inter "" SWORD _CNV_A_R_LINEAR_____52_CM 1 0. -1024. 1023.96875 DISPLAY_IDENTIFIER TQ_TCS_REQ_INTER ECU_ADDRESS 0x7fb4d0 BYTE_ORDER MSB_LAST FORMAT "%7.2" /end MEASUREMENT
/begin MEASUREMENT tq_req_etcu "" SWORD _CNV_A_R_LINEAR_____52_CM 1 0. -1024. 1023.96875 DISPLAY_IDENTIFIER TQ_REQ_ETCU ECU_ADDRESS 0x7fa29c BYTE_ORDER MSB_LAST FORMAT "%7.2" /end MEASUREMENT
/begin MEASUREMENT n_sp_etcu_inter "" UWORD _CNV_A_R_LINEAR_____5_CM 1 0. 0. 6375. DISPLAY_IDENTIFIER N_SP_ETCU_INTER ECU_ADDRESS 0x7fa29e BYTE_ORDER MSB_LAST FORMAT "%4.0" /end MEASUREMENT
/begin MEASUREMENT lv_req_n_ctl_etcu "" UBYTE _CNV_S_2_RANGE______11_CM 1 0. 0. 1. DISPLAY_IDENTIFIER LV_REQ_N_CTL_ETCU ECU_ADDRESS 0x7fbbdc /end MEASUREMENT
/begin MEASUREMENT lv_etcu_dec_req "" UBYTE _CNV_S_2_RANGE______11_CM 1 0. 0. 1. DISPLAY_IDENTIFIER LV_ETCU_DEC_REQ ECU_ADDRESS 0x7fbbdb /end MEASUREMENT
/begin MEASUREMENT lv_etcu_inc_req "" UBYTE _CNV_S_2_RANGE______11_CM 1 0. 0. 1. DISPLAY_IDENTIFIER LV_ETCU_INC_REQ ECU_ADDRESS 0x7fbbda /end MEASUREMENT
/begin MEASUREMENT vs_sum_dist "" ULONG _CNV_A_R_LINEAR_____113_CM 1 0. 0. 119304.6471 DISPLAY_IDENTIFIER VS_SUM_DIST ECU_ADDRESS 0x7fccc0 BYTE_ORDER MSB_LAST FORMAT "%11.5" /end MEASUREMENT
/begin MEASUREMENT dist "" ULONG _CNV_A_R_LINEAR_____114_CM 1 0. 0. 429496729.5 DISPLAY_IDENTIFIER DIST ECU_ADDRESS 0x7fccc4 BYTE_ORDER MSB_LAST FORMAT "%10.1" /end MEASUREMENT
/begin MEASUREMENT ctr_vs_dist "" UWORD _CNV_A_R_LINEAR_____115_CM 1 0. 0. 6.5535 DISPLAY_IDENTIFIER CTR_VS_DIST ECU_ADDRESS 0x7fcd5a BYTE_ORDER MSB_LAST FORMAT "%5.4" /end MEASUREMENT
/begin MEASUREMENT lv_inh_inj_prev1 "" UBYTE _CNV_S_2_RANGE______11_CM 1 0. 0. 1. DISPLAY_IDENTIFIER LV_INH_INJ_PREV1 ECU_ADDRESS 0x7fbb7f /end MEASUREMENT
/begin MEASUREMENT lv_inh_inj_prev2 "" UBYTE _CNV_S_2_RANGE______11_CM 1 0. 0. 1. DISPLAY_IDENTIFIER LV_INH_INJ_PREV2 ECU_ADDRESS 0x7fbb80 /end MEASUREMENT
/begin MEASUREMENT lv_inh_inj_main1 "" UBYTE _CNV_S_2_RANGE______11_CM 1 0. 0. 1. DISPLAY_IDENTIFIER LV_INH_INJ_MAIN1 ECU_ADDRESS 0x7fbb81 /end MEASUREMENT
/begin MEASUREMENT lv_inh_inj_main2 "" UBYTE _CNV_S_2_RANGE______11_CM 1 0. 0. 1. DISPLAY_IDENTIFIER LV_INH_INJ_MAIN2 ECU_ADDRESS 0x7fbb82 /end MEASUREMENT
/begin MEASUREMENT lv_inh_inj_post1 "" UBYTE _CNV_S_2_RANGE______11_CM 1 0. 0. 1. DISPLAY_IDENTIFIER LV_INH_INJ_POST1 ECU_ADDRESS 0x7fbb83 /end MEASUREMENT
/begin MEASUREMENT lv_inh_inj_post2 "" UBYTE _CNV_S_2_RANGE______11_CM 1 0. 0. 1. DISPLAY_IDENTIFIER LV_INH_INJ_POST2 ECU_ADDRESS 0x7fbb84 /end MEASUREMENT
/begin MEASUREMENT v_tco "" UWORD _CNV_A_R_LINEAR_____28_CM 1 0. 0. 4.9951171875 DISPLAY_IDENTIFIER V_TCO ECU_ADDRESS 0x7fcda8 BYTE_ORDER MSB_LAST FORMAT "%3.2" /end MEASUREMENT
/begin MEASUREMENT mfw_egr_kgh "" UWORD _CNV_A_R_LINEAR_____110_CM 1 0. 0. 1023.984375 DISPLAY_IDENTIFIER MFW_EGR_KGH ECU_ADDRESS 0x7fa8b2 BYTE_ORDER MSB_LAST FORMAT "%6.2" /end MEASUREMENT
/begin MEASUREMENT mfw_egr_sp_kgh "" UWORD _CNV_A_R_LINEAR_____110_CM 1 0. 0. 1023.984375 DISPLAY_IDENTIFIER MFW_EGR_SP_KGH ECU_ADDRESS 0x7fa8b0 BYTE_ORDER MSB_LAST FORMAT "%6.2" /end MEASUREMENT
/begin MEASUREMENT temp_egr_sp "" UWORD _CNV_A_R_LINEAR_____157_CM 1 0. 0. 1023.984375 DISPLAY_IDENTIFIER TEMP_EGR_SP ECU_ADDRESS 0x7f9960 BYTE_ORDER MSB_LAST FORMAT "%6.2" /end MEASUREMENT
/begin MEASUREMENT temp_egr "" UWORD _CNV_A_R_LINEAR_____157_CM 1 0. 0. 1023.984375 DISPLAY_IDENTIFIER TEMP_EGR ECU_ADDRESS 0x7f9962 BYTE_ORDER MSB_LAST FORMAT "%6.2" /end MEASUREMENT
/begin MEASUREMENT temp_up_egrv "" UWORD _CNV_A_R_LINEAR_____157_CM 1 0. 0. 1023.984375 DISPLAY_IDENTIFIER TEMP_UP_EGRV ECU_ADDRESS 0x7fa8ac BYTE_ORDER MSB_LAST FORMAT "%6.2" /end MEASUREMENT
/begin COMPU_METHOD _CNV_A_R_LINEAR_____0_CM "" RAT_FUNC "%6.3" "[-]" COEFFS 0 1. 0. 0 0 1 /end COMPU_METHOD
/begin COMPU_METHOD _CNV_A_R_LINEAR_____1_CM "" RAT_FUNC "%6.3" "-" COEFFS 0 1. 0. 0 0 1 /end COMPU_METHOD
/begin COMPU_METHOD _CNV_A_R_ZYL_ID_2_CM "" RAT_FUNC "%6.3" "[-]" COEFFS 0 1. -1. 0 0 1 /end COMPU_METHOD
/begin COMPU_METHOD _CNV_S_2_RANGE______3_CM "" TAB_VERB "%6.3" "[-]" COMPU_TAB_REF _CNV_S_2_RANGE______3 /end COMPU_METHOD
/begin COMPU_VTAB _CNV_S_2_RANGE______3 "" TAB_VERB 2 0 "" 1 "1" /end COMPU_VTAB
/begin COMPU_METHOD _CNV_A_R_LINEAR_____5_CM "" RAT_FUNC "%6.3" "[rpm]" COEFFS 0 1. 0. 0 0 1 /end COMPU_METHOD
/begin COMPU_METHOD _CNV_A_R_LINEAR_____6_CM "" RAT_FUNC "%6.3" "[ms]" COEFFS 0 2.e-003 0. 0 0 1 /end COMPU_METHOD
/begin COMPU_METHOD _CNV_A_R_LINEAR_____7_CM "" RAT_FUNC "%6.3" "[cm^2]" COEFFS 0 839.3314549180328 0. 0 0 1 /end COMPU_METHOD
/begin COMPU_METHOD _CNV_A_R_LINEAR_____8_CM "" RAT_FUNC "%6.3" "[%]" COEFFS 0 655.3599999999997 0. 0 0 1 /end COMPU_METHOD
/begin COMPU_METHOD _CNV_A_R_LINEAR_____9_CM "" RAT_FUNC "%6.3" "[%]" COEFFS 0 327.6799971199561 -2.880043939512689e-004 0 0 1 /end COMPU_METHOD
/begin COMPU_METHOD _CNV_A_R_LINEAR_____10_CM "" RAT_FUNC "%6.3" "[hPa]" COEFFS 0 12.06017666543982 2.864369889721274e-006 0 0 1 /end COMPU_METHOD
/begin COMPU_METHOD _CNV_S_2_RANGE______11_CM "" TAB_VERB "%6.3" "[-]" COMPU_TAB_REF _CNV_S_2_RANGE______11 /end COMPU_METHOD
/begin COMPU_VTAB _CNV_S_2_RANGE______11 "" TAB_VERB 2 0 "0" 1 "1" /end COMPU_VTAB
/begin COMPU_METHOD _CNV_A_R_LINEAR_____12_CM "" RAT_FUNC "%6.3" "[%]" COEFFS 0 327.6800000003072 3.071909304708242e-008 0 0 1 /end COMPU_METHOD
/begin COMPU_METHOD _CNV_A_R_LINEAR_____13_CM "" RAT_FUNC "%6.3" "[-]" COEFFS 0 4096.000220003369 0. 0 0 1 /end COMPU_METHOD
/begin COMPU_METHOD _CNV_A_R_LINEAR_____14_CM "" RAT_FUNC "%6.3" "[-]" COEFFS 0 65535.99999999996 0. 0 0 1 /end COMPU_METHOD
/begin COMPU_METHOD _CNV_A_R_LINEAR_____15_CM "" RAT_FUNC "%6.3" "[-]" COEFFS 0 16384. 0. 0 0 1 /end COMPU_METHOD
/begin COMPU_METHOD _CNV_A_R_LINEAR_____18_CM "" RAT_FUNC "%6.3" "[°C]" COEFFS 0 1. 50. 0 0 1 /end COMPU_METHOD
/begin COMPU_METHOD _CNV_A_R_LINEAR_____19_CM "" RAT_FUNC "%6.3" "[s]" COEFFS 0 10. 0. 0 0 1 /end COMPU_METHOD
/begin COMPU_METHOD _CNV_S_180_CONV_DIAG__21_CM "" TAB_VERB "%6.3" "[-]" COMPU_TAB_REF _CNV_S_180_CONV_DIAG__21 /end COMPU_METHOD
/begin COMPU_VTAB _CNV_S_180_CONV_DIAG__21 "" TAB_VERB 180 0 "NO_ERROR" 1 "IMOB" 2 "ECU_4" 3 "ECU_2" 4 "V_DCDC_RNG" 5 "PVS_L_1" 6 "PVS_L_2" 7 "PVS_H_1" 8 "PVS_H_2" 9 "PVS_RATIO" 10 "PVS_MOVE" 11 "PVS_BLS_BTS" 12 "VCC_1" 13 "VCC_2" 14 "V_DIP_PF_RNG" 15 "DIP_PF_MES_GRD" 16 "DIP_PF_MES_ES" 17 "V_TCO_1_RNG" 18 "V_TCO_2_RNG" 19 "TCO_1_MES_GRD" 20 "TCO_2_MES_GRD" 21 "TCO_MES_PLAUS" 22 "EGR_CTL_MIN" 23 "EGR_CTL_MAX" 24 "V_AMP_RNG" 25 "AMP_MES_GRD" 26 "V_TFU_RNG" 27 "TFU_MES_GRD" 28 "TFU_MES_PLAUS" 29 "V_MAP_RNG" 30 "MAP_AMP_OFS" 31 "MAP_IS_OFS" 32 "MAP_MES_GRD" 33 "MAF_KGH_PLAUS" 34 "MAF_0_RNG" 35 "V_TPC_RNG" 36 "TPC_MES_PLAUS" 37 "V_TAC_RNG" 38 "TAC_MES_GRD" 39 "MF_IS_OBD" 40 "CYL_BAL_0" 41 "CYL_BAL_1" 42 "CYL_BAL_2" 43 "CYL_BAL_3" 44 "EGRV_0_CTL" 45 "V_EGRV_0_BOL_AD" 46 "THR_0_CTL" 47 "V_THR_0_BOL_AD" 48 "BPA_0_CTL" 49 "V_BPA_0_BOL_AD" 50 "BYP_0_CTL" 51 "V_BYP_0_BOL_AD" 52 "MAP_CTL_MIN" 53 "MAP_CTL_MAX" 54 "EGR_IS_SLOW_OBD" 55 "MAF_EGR_THR_OBD" 56 "MAF_DIF_EGR_THR_OBD" 57 "MAP_DIF_EGR_THR_OBD" 58 "VS" 59 "CS" 60 "BLS" 61 "BLS_BTS_DECE" 62 "BLS_BTS_PLAUS" 63 "CAN_TCS" 64 "CAN_TCU" 65 "CAN_ACU" 66 "CAN_CCU" 67 "CAN_ICL" 68 "CAN_VECU" 69 "CAN_SMLS" 70 "CAN_BOFF" 71 "CAN_IF_CFT" 72 "CAN_EILU" 73 "CAN_DCC" 74 "CAN_WHL" 75 "CAN_SYS_INFO" 76 "CAN_NOM_SYS" 77 "CAN_TOT" 78 "VARCOD" 79 "ACP_MES_RNG" 80 "ACP_MES_GRD" 81 "V_TBA_RNG" 82 "TBA_MES_GRD" 83 "DUCY_ALTER_PWM_RNG" 84 "DUCY_ALTER_PWM_GRD" 85 "V_EGRV_0_RNG" 86 "V_EGRV_1_RNG" 87 "V_EGRV_0_GRD" 88 "V_EGRV_1_GRD" 89 "GES_MAF_0_MAX" 90 "TCO_1_2_PLAUS" 91 "EFP_RLY_DPS" 92 "EFP_RLY_PLAUS_1" 93 "EFP_RLY_PLAUS_2" 94 "SPI_MPS" 95 "SPI_OCT" 96 "SPI_QPS" 97 "EGR_BYP_DPS" 98 "EGRV_0" 99 "PPS_INI_0" 100 "PPS_INI_TOUT_0" 101 "PPS_PLAUS_0" 102 "PPS_CAL_0" 103 "PPS_V_INJ_0" 104 "PPS_WDT_0" 105 "PPS_FSM_0" 106 "PPS_OC_0" 107 "PPS_OC_1" 108 "PPS_OC_2" 109 "PPS_OC_3" 110 "PPS_SC_H_L_0" 111 "PPS_SC_H_L_1" 112 "PPS_SC_H_L_2" 113 "PPS_SC_H_L_3" 114 "PPS_SC_H_0" 115 "PPS_SC_L_0" 116 "V_TEG_TUR_UP_RNG" 117 "TEG_TUR_UP_MES_GRD" 118 "BPA" 119 "EGRV" 120 "FSD_1" 121 "GL_RLY_DPS" 122 "MIS_A" 123 "MIS_B1" 124 "MIS_B4" 125 "PCV_1" 126 "PCV_2" 127 "PCV_3" 128 "RLY_MAIN" 129 "RLY_POWER" 130 "THR" 131 "VAR_COD" 132 "VB" 133 "VCV_1" 134 "VCV_2" 135 "VCV_3" 136 "CONV_MON_1" 137 "N_32_MON_1" 138 "PVS_MON_1" 139 "FCUT_MON_1" 140 "TQI_N_MAX_MON_1" 141 "SERV_MON_1" 142 "POST_INH_MON" 143 "CRU_INH_MON" 144 "CAN_INH_MON" 145 "MON_3" 146 "PER_CAM_IN_1" 147 "SYN_CAM_IN_1" 148 "REF_CRK_CAM_IN_1" 149 "CRK_TOOTH" 150 "CRK_TOOTH_PER" 151 "CRK_SYN" 152 "CRK_PLAUS" 153 "PLAUS_CAM_IN_1" 154 "SYN_CRK_CAM_IN_1" 155 "LSH_UP_1" 156 "LSH_DOWN_1" 157 "SCG_LS_DOWN_1" 158 "SCP_LS_DOWN_1" 159 "OC_LS_DOWN_1" 160 "OBD_LSH_DOWN_1" 161 "LAM_ADJ_1" 162 "CHK_LS_DOWN_1" 163 "PUC_LS_DOWN_1" 164 "FL_LS_DOWN_1" 165 "EL_LSL_UP_1" 166 "OC_LSL_UP_1" 167 "LSL_UP_IF_1" 168 "AIR_LSL_UP_1" 169 "TTIP_OBD_LS_UP_1" 170 "DYN_VLD_LS_UP_1" 171 "PUC_VLD_LS_UP_1" 172 "OBD_VLD_LSH_UP_1" 173 "SHIFT_AFL_LSL_UP_1" 174 "SHIFT_AFR_LSL_UP_1" 175 "LSH_LSL_UP_1" 176 "SWT_LS_DOWN_1" 177 "PUE_LS_DOWN_1" 178 "CHG_LS_UP" 179 "CHG_LS_DOWN" /end COMPU_VTAB
/begin COMPU_METHOD _CNV_S_6_CONV_ERRM__22_CM "" TAB_VERB "%6.3" "[-]" COMPU_TAB_REF _CNV_S_6_CONV_ERRM__22 /end COMPU_METHOD
/begin COMPU_VTAB _CNV_S_6_CONV_ERRM__22 "" TAB_VERB 6 0 "NO_SYM" 1 "SYM_0" 2 "SYM_1" 4 "SYM_2" 8 "SYM_3" 15 "BENCH_MODE" /end COMPU_VTAB
/begin COMPU_METHOD _CNV_S_2_RANGE______23_CM "" TAB_VERB "%6.3" "[-]" COMPU_TAB_REF _CNV_S_2_RANGE______23 /end COMPU_METHOD
/begin COMPU_VTAB _CNV_S_2_RANGE______23 "" TAB_VERB 2 0 "passive" 1 "active" /end COMPU_VTAB
/begin COMPU_METHOD _CNV_S_3_RANGE______24_CM "" TAB_VERB "%6.3" "[-]" COMPU_TAB_REF _CNV_S_3_RANGE______24 /end COMPU_METHOD
/begin COMPU_VTAB _CNV_S_3_RANGE______24 "" TAB_VERB 3 0 "MIL OFF" 1 "MIL ON" 2 "MIL BLINKING" /end COMPU_VTAB
/begin COMPU_METHOD _CNV_A_R_LINEAR_____25_CM "" RAT_FUNC "%6.3" "min" COEFFS 0 1. 0. 0 0 1 /end COMPU_METHOD
/begin COMPU_METHOD _CNV_A_R_LINEAR_____26_CM "" RAT_FUNC "%6.3" "km" COEFFS 0 1. 0. 0 0 1 /end COMPU_METHOD
/begin COMPU_METHOD _CNV_A_R_LINEAR_____27_CM "" RAT_FUNC "%6.3" "s" COEFFS 0 1. 0. 0 0 1 /end COMPU_METHOD
/begin COMPU_METHOD _CNV_A_R_LINEAR_____28_CM "" RAT_FUNC "%6.3" "[V]" COEFFS 0 204.8 0. 0 0 1 /end COMPU_METHOD
/begin COMPU_METHOD _CNV_A_R_LINEAR_____34_CM "" RAT_FUNC "%6.3" "[km/h]" COEFFS 0 1. 0. 0 0 1 /end COMPU_METHOD
/begin COMPU_METHOD _CNV_A_R_LINEAR_____36_CM "" RAT_FUNC "%6.3" "[V]" COEFFS 0 102.4000038437538 0. 0 0 1 /end COMPU_METHOD
/begin COMPU_METHOD _CNV_A_R_LINEAR_____45_CM "" RAT_FUNC "%6.3" "[hPa]" COEFFS 0 12.06017666543982 0. 0 0 1 /end COMPU_METHOD
/begin COMPU_METHOD _CNV_A_R_LINEAR_____48_CM "" RAT_FUNC "%6.3" "[-]" COEFFS 0 32767.99807357072 0. 0 0 1 /end COMPU_METHOD
/begin COMPU_METHOD _CNV_A_R_LINEAR_____52_CM "" RAT_FUNC "%6.3" "[Nm]" COEFFS 0 32. 0. 0 0 1 /end COMPU_METHOD
/begin COMPU_METHOD _CNV_A_R_LINEAR_____56_CM "" RAT_FUNC "%6.3" "[s]" COEFFS 0 100. 0. 0 0 1 /end COMPU_METHOD
/begin COMPU_METHOD _CNV_P_8_TABLE_______68_CM "" TAB_NOINTP "%6.3" "[-]" COMPU_TAB_REF _CNV_P_8_TABLE_______68 /end COMPU_METHOD
/begin COMPU_TAB _CNV_P_8_TABLE_______68 "" TAB_NOINTP 8 0 0. 1 1. 2 2. 3 3. 4 4. 5 5. 6 6. 15 15. /end COMPU_TAB
/begin COMPU_METHOD _CNV_A_R_LINEAR_____69_CM "" RAT_FUNC "%6.3" "[(km/h)/rpm]" COEFFS 0 655360.0007936121 3.96806062781252e-005 0 0 1 /end COMPU_METHOD
/begin COMPU_METHOD _CNV_A_R_LINEAR_____70_CM "" RAT_FUNC "%6.3" "[(km/h)/rpm]" COEFFS 0 655350. 0. 0 0 1 /end COMPU_METHOD
/begin COMPU_METHOD _CNV_A_R_LINEAR_____71_CM "" RAT_FUNC "%6.3" "[km/h]" COEFFS 0 100. 0. 0 0 1 /end COMPU_METHOD
/begin COMPU_METHOD _CNV_A_R_LINEAR_____72_CM "" RAT_FUNC "%6.3" "[m/(s*s)]" COEFFS 0 12.5 175. 0 0 1 /end COMPU_METHOD
/begin COMPU_METHOD _CNV_A_R_LINEAR_____76_CM "" RAT_FUNC "%6.3" "[1/km]" COEFFS 0 1. 0. 0 0 1 /end COMPU_METHOD
/begin COMPU_METHOD _CNV_A_R_LINEAR_____90_CM "" RAT_FUNC "%6.3" "[Nm]" COEFFS 0 4. 0. 0 0 1 /end COMPU_METHOD
/begin COMPU_METHOD _CNV_A_R_LINEAR_____110_CM "" RAT_FUNC "%6.3" "[kg/h]" COEFFS 0 64. 0. 0 0 1 /end COMPU_METHOD
/begin COMPU_METHOD _CNV_A_R_LINEAR_____113_CM "" RAT_FUNC "%6.3" "[m]" COEFFS 0 35999.99999497086 0. 0 0 1 /end COMPU_METHOD
/begin COMPU_METHOD _CNV_A_R_LINEAR_____114_CM "" RAT_FUNC "%6.3" "[km]" COEFFS 0 10. 0. 0 0 1 /end COMPU_METHOD
/begin COMPU_METHOD _CNV_A_R_LINEAR_____115_CM "" RAT_FUNC "%6.3" "[km]" COEFFS 0 10000. 0. 0 0 1 /end COMPU_METHOD
/begin COMPU_METHOD _CNV_A_R_LINEAR_____157_CM "" RAT_FUNC "%6.3" "[°C]" COEFFS 0 64. 0. 0 0 1 /end COMPU_METHOD
/begin FUNCTION ATIC_20_timing "" /end FUNCTION
/begin FUNCTION CR_Generic ""
 /begin OUT_MEASUREMENT cyl_id_sam_trig lv_mil ar_egrv_pctl_the_bas maf_rel maf_rel_sp bpapwm_dyn map_sp_lim_grd lv_dir_v_hbr[0] lv_dir_v_hbr[1] abs_hbr_pwm[0] abs_hbr_pwm[1] dir_hbr[0] dir_hbr[1] inp_hbr[0] inp_hbr[1] fac_cor_hbr[0] fac_cor_hbr[1] ar_egrv_pctl_the pq_egrv_sp abs_hbr_pwm_tmp[0] abs_hbr_pwm_tmp[1] ctr_err_dyn_nr ctr_err_his_nr fmy_ram_dyn[0].dtc_cod fmy_ram_dyn[0].ctr_frc fmy_ram_dyn[0].ctr_wup_cyc fmy_ram_dyn[0].ctr_dc fmy_ram_dyn[0].diag_inst fmy_ram_dyn[0].idx_frf fmy_ram_dyn[0].err_info_dyn.lv_err_mkd fmy_ram_dyn[0].err_info_dyn.lv_dc_max fmy_ram_dyn[0].err_info_dyn.lv_err_disa fmy_ram_dyn[0].err_info_dyn.lv_err_cfm fmy_ram_dyn[0].err_info_dyn.lv_err_tmp fmy_ram_dyn[0].err_info_dyn.lv_err_dc fmy_ram_dyn[0].err_info_dyn.err_sym_mem fmy_ram_dyn[0].err_info_dyn.err_sym_lst fmy_ram_dyn[0].err_info_dyn.lv_err_pnd fmy_ram_dyn[0].err_info_dyn.lv_cdn_diag_dc fmy_ram_dyn[0].ctr_dc_err_det fmy_ram_dyn[0].ctr_dc_err_det_diag_cdn fmy_ram_dyn[0].ctr_dc_err_det_diag_cmpl fmy_ram_dyn[0].ctr_wup_act_mil fmy_ram_dyn[1].dtc_cod fmy_ram_dyn[1].ctr_frc fmy_ram_dyn[1].ctr_wup_cyc fmy_ram_dyn[1].ctr_dc fmy_ram_dyn[1].diag_inst fmy_ram_dyn[1].idx_frf fmy_ram_dyn[1].err_info_dyn.lv_err_mkd fmy_ram_dyn[1].err_info_dyn.lv_dc_max fmy_ram_dyn[1].err_info_dyn.lv_err_disa fmy_ram_dyn[1].err_info_dyn.lv_err_cfm fmy_ram_dyn[1].err_info_dyn.lv_err_tmp fmy_ram_dyn[1].err_info_dyn.lv_err_dc fmy_ram_dyn[1].err_info_dyn.err_sym_mem fmy_ram_dyn[1].err_info_dyn.err_sym_lst fmy_ram_dyn[1].err_info_dyn.lv_err_pnd fmy_ram_dyn[1].err_info_dyn.lv_cdn_diag_dc fmy_ram_dyn[1].ctr_dc_err_det fmy_ram_dyn[1].ctr_dc_err_det_diag_cdn fmy_ram_dyn[1].ctr_dc_err_det_diag_cmpl fmy_ram_dyn[1].ctr_wup_act_mil fmy_ram_dyn[2].dtc_cod fmy_ram_dyn[2].ctr_frc fmy_ram_dyn[2].ctr_wup_cyc fmy_ram_dyn[2].ctr_dc fmy_ram_dyn[2].diag_inst fmy_ram_dyn[2].idx_frf fmy_ram_dyn[2].err_info_dyn.lv_err_mkd fmy_ram_dyn[2].err_info_dyn.lv_dc_max fmy_ram_dyn[2].err_info_dyn.lv_err_disa fmy_ram_dyn[2].err_info_dyn.lv_err_cfm fmy_ram_dyn[2].err_info_dyn.lv_err_tmp fmy_ram_dyn[2].err_info_dyn.lv_err_dc fmy_ram_dyn[2].err_info_dyn.err_sym_mem fmy_ram_dyn[2].err_info_dyn.err_sym_lst fmy_ram_dyn[2].err_info_dyn.lv_err_pnd fmy_ram_dyn[2].err_info_dyn.lv_cdn_diag_dc fmy_ram_dyn[2].ctr_dc_err_det fmy_ram_dyn[2].ctr_dc_err_det_diag_cdn fmy_ram_dyn[2].ctr_dc_err_det_diag_cmpl fmy_ram_dyn[2].ctr_wup_act_mil fmy_ram_dyn[3].dtc_cod fmy_ram_dyn[3].ctr_frc fmy_ram_dyn[3].ctr_wup_cyc fmy_ram_dyn[3].ctr_dc fmy_ram_dyn[3].diag_inst fmy_ram_dyn[3].idx_frf fmy_ram_dyn[3].err_info_dyn.lv_err_mkd fmy_ram_dyn[3].err_info_dyn.lv_dc_max fmy_ram_dyn[3].err_info_dyn.lv_err_disa fmy_ram_dyn[3].err_info_dyn.lv_err_cfm fmy_ram_dyn[3].err_info_dyn.lv_err_tmp fmy_ram_dyn[3].err_info_dyn.lv_err_dc fmy_ram_dyn[3].err_info_dyn.err_sym_mem fmy_ram_dyn[3].err_info_dyn.err_sym_lst fmy_ram_dyn[3].err_info_dyn.lv_err_pnd fmy_ram_dyn[3].err_info_dyn.lv_cdn_diag_dc fmy_ram_dyn[3].ctr_dc_err_det fmy_ram_dyn[3].ctr_dc_err_det_diag_cdn fmy_ram_dyn[3].ctr_dc_err_det_diag_cmpl fmy_ram_dyn[3].ctr_wup_act_mil fmy_ram_dyn[4].dtc_cod fmy_ram_dyn[4].ctr_frc fmy_ram_dyn[4].ctr_wup_cyc fmy_ram_dyn[4].ctr_dc fmy_ram_dyn[4].diag_inst fmy_ram_dyn[4].idx_frf fmy_ram_dyn[4].err_info_dyn.lv_err_mkd fmy_ram_dyn[4].err_info_dyn.lv_dc_max fmy_ram_dyn[4].err_info_dyn.lv_err_disa fmy_ram_dyn[4].err_info_dyn.lv_err_cfm fmy_ram_dyn[4].err_info_dyn.lv_err_tmp fmy_ram_dyn[4].err_info_dyn.lv_err_dc fmy_ram_dyn[4].err_info_dyn.err_sym_mem fmy_ram_dyn[4].err_info_dyn.err_sym_lst fmy_ram_dyn[4].err_info_dyn.lv_err_pnd fmy_ram_dyn[4].err_info_dyn.lv_cdn_diag_dc fmy_ram_dyn[4].ctr_dc_err_det fmy_ram_dyn[4].ctr_dc_err_det_diag_cdn fmy_ram_dyn[4].ctr_dc_err_det_diag_cmpl fmy_ram_dyn[4].ctr_wup_act_mil fmy_ram_dyn[5].dtc_cod fmy_ram_dyn[5].ctr_frc fmy_ram_dyn[5].ctr_wup_cyc fmy_ram_dyn[5].ctr_dc fmy_ram_dyn[5].diag_inst fmy_ram_dyn[5].idx_frf fmy_ram_dyn[5].err_info_dyn.lv_err_mkd fmy_ram_dyn[5].err_info_dyn.lv_dc_max fmy_ram_dyn[5].err_info_dyn.lv_err_disa fmy_ram_dyn[5].err_info_dyn.lv_err_cfm fmy_ram_dyn[5].err_info_dyn.lv_err_tmp fmy_ram_dyn[5].err_info_dyn.lv_err_dc fmy_ram_dyn[5].err_info_dyn.err_sym_mem fmy_ram_dyn[5].err_info_dyn.err_sym_lst fmy_ram_dyn[5].err_info_dyn.lv_err_pnd fmy_ram_dyn[5].err_info_dyn.lv_cdn_diag_dc fmy_ram_dyn[5].ctr_dc_err_det fmy_ram_dyn[5].ctr_dc_err_det_diag_cdn fmy_ram_dyn[5].ctr_dc_err_det_diag_cmpl fmy_ram_dyn[5].ctr_wup_act_mil fmy_ram_dyn[6].dtc_cod fmy_ram_dyn[6].ctr_frc fmy_ram_dyn[6].ctr_wup_cyc fmy_ram_dyn[6].ctr_dc fmy_ram_dyn[6].diag_inst fmy_ram_dyn[6].idx_frf fmy_ram_dyn[6].err_info_dyn.lv_err_mkd fmy_ram_dyn[6].err_info_dyn.lv_dc_max fmy_ram_dyn[6].err_info_dyn.lv_err_disa fmy_ram_dyn[6].err_info_dyn.lv_err_cfm fmy_ram_dyn[6].err_info_dyn.lv_err_tmp fmy_ram_dyn[6].err_info_dyn.lv_err_dc fmy_ram_dyn[6].err_info_dyn.err_sym_mem fmy_ram_dyn[6].err_info_dyn.err_sym_lst fmy_ram_dyn[6].err_info_dyn.lv_err_pnd fmy_ram_dyn[6].err_info_dyn.lv_cdn_diag_dc fmy_ram_dyn[6].ctr_dc_err_det fmy_ram_dyn[6].ctr_dc_err_det_diag_cdn fmy_ram_dyn[6].ctr_dc_err_det_diag_cmpl fmy_ram_dyn[6].ctr_wup_act_mil fmy_ram_dyn[7].dtc_cod fmy_ram_dyn[7].ctr_frc fmy_ram_dyn[7].ctr_wup_cyc fmy_ram_dyn[7].ctr_dc fmy_ram_dyn[7].diag_inst fmy_ram_dyn[7].idx_frf fmy_ram_dyn[7].err_info_dyn.lv_err_mkd fmy_ram_dyn[7].err_info_dyn.lv_dc_max fmy_ram_dyn[7].err_info_dyn.lv_err_disa fmy_ram_dyn[7].err_info_dyn.lv_err_cfm fmy_ram_dyn[7].err_info_dyn.lv_err_tmp fmy_ram_dyn[7].err_info_dyn.lv_err_dc fmy_ram_dyn[7].err_info_dyn.err_sym_mem fmy_ram_dyn[7].err_info_dyn.err_sym_lst fmy_ram_dyn[7].err_info_dyn.lv_err_pnd fmy_ram_dyn[7].err_info_dyn.lv_cdn_diag_dc fmy_ram_dyn[7].ctr_dc_err_det fmy_ram_dyn[7].ctr_dc_err_det_diag_cdn fmy_ram_dyn[7].ctr_dc_err_det_diag_cmpl fmy_ram_dyn[7].ctr_wup_act_mil fmy_ram_dyn[8].dtc_cod fmy_ram_dyn[8].ctr_frc fmy_ram_dyn[8].ctr_wup_cyc fmy_ram_dyn[8].ctr_dc fmy_ram_dyn[8].diag_inst fmy_ram_dyn[8].idx_frf fmy_ram_dyn[8].err_info_dyn.lv_err_mkd fmy_ram_dyn[8].err_info_dyn.lv_dc_max fmy_ram_dyn[8].err_info_dyn.lv_err_disa fmy_ram_dyn[8].err_info_dyn.lv_err_cfm fmy_ram_dyn[8].err_info_dyn.lv_err_tmp fmy_ram_dyn[8].err_info_dyn.lv_err_dc fmy_ram_dyn[8].err_info_dyn.err_sym_mem fmy_ram_dyn[8].err_info_dyn.err_sym_lst fmy_ram_dyn[8].err_info_dyn.lv_err_pnd fmy_ram_dyn[8].err_info_dyn.lv_cdn_diag_dc fmy_ram_dyn[8].ctr_dc_err_det fmy_ram_dyn[8].ctr_dc_err_det_diag_cdn fmy_ram_dyn[8].ctr_dc_err_det_diag_cmpl fmy_ram_dyn[8].ctr_wup_act_mil fmy_ram_dyn[9].dtc_cod fmy_ram_dyn[9].ctr_frc fmy_ram_dyn[9].ctr_wup_cyc fmy_ram_dyn[9].ctr_dc fmy_ram_dyn[9].diag_inst fmy_ram_dyn[9].idx_frf fmy_ram_dyn[9].err_info_dyn.lv_err_mkd fmy_ram_dyn[9].err_info_dyn.lv_dc_max fmy_ram_dyn[9].err_info_dyn.lv_err_disa fmy_ram_dyn[9].err_info_dyn.lv_err_cfm fmy_ram_dyn[9].err_info_dyn.lv_err_tmp fmy_ram_dyn[9].err_info_dyn.lv_err_dc fmy_ram_dyn[9].err_info_dyn.err_sym_mem fmy_ram_dyn[9].err_info_dyn.err_sym_lst fmy_ram_dyn[9].err_info_dyn.lv_err_pnd fmy_ram_dyn[9].err_info_dyn.lv_cdn_diag_dc fmy_ram_dyn[9].ctr_dc_err_det fmy_ram_dyn[9].ctr_dc_err_det_diag_cdn fmy_ram_dyn[9].ctr_dc_err_det_diag_cmpl fmy_ram_dyn[9].ctr_wup_act_mil tbl_frf[0].envd.header tbl_frf[0].envd.cus_set[0][0] tbl_frf[0].envd.cus_set[0][1] tbl_frf[0].envd.cus_set[0][2] tbl_frf[0].envd.cus_set[0][3] tbl_frf[0].envd.cus_set[0][4] tbl_frf[0].envd.cus_set[0][5] tbl_frf[0].envd.cus_set[0][6] tbl_frf[0].envd.cus_set[0][7] tbl_frf[0].envd.cus_set[0][8] tbl_frf[0].envd.cus_set[0][9] tbl_frf[0].envd.cus_set[0][10] tbl_frf[0].envd.cus_set[0][11] tbl_frf[0].envd.cus_set[0][12] tbl_frf[0].envd.cus_set[0][13] tbl_frf[0].envd.cus_set[1][0] tbl_frf[0].envd.cus_set[1][1] tbl_frf[0].envd.cus_set[1][2] tbl_frf[0].envd.cus_set[1][3] tbl_frf[0].envd.cus_set[1][4] tbl_frf[0].envd.cus_set[1][5] tbl_frf[0].envd.cus_set[1][6] tbl_frf[0].envd.cus_set[1][7] tbl_frf[0].envd.cus_set[1][8] tbl_frf[0].envd.cus_set[1][9] tbl_frf[0].envd.cus_set[1][10] tbl_frf[0].envd.cus_set[1][11] tbl_frf[0].envd.cus_set[1][12] tbl_frf[0].envd.cus_set[1][13] tbl_frf[0].envd.cmn_cus[0] tbl_frf[0].envd.obd[0] tbl_frf[0].envd.obd[1] tbl_frf[0].envd.obd[2] tbl_frf[0].envd.obd[3] tbl_frf[0].envd.obd[4] tbl_frf[0].envd.obd[5] tbl_frf[0].envd.obd[6] tbl_frf[0].envd.obd[7] tbl_frf[1].envd.header tbl_frf[1].envd.cus_set[0][0] tbl_frf[1].envd.cus_set[0][1] tbl_frf[1].envd.cus_set[0][2] tbl_frf[1].envd.cus_set[0][3] tbl_frf[1].envd.cus_set[0][4] tbl_frf[1].envd.cus_set[0][5] tbl_frf[1].envd.cus_set[0][6] tbl_frf[1].envd.cus_set[0][7] tbl_frf[1].envd.cus_set[0][8] tbl_frf[1].envd.cus_set[0][9] tbl_frf[1].envd.cus_set[0][10] tbl_frf[1].envd.cus_set[0][11] tbl_frf[1].envd.cus_set[0][12] tbl_frf[1].envd.cus_set[0][13] tbl_frf[1].envd.cus_set[1][0] tbl_frf[1].envd.cus_set[1][1] tbl_frf[1].envd.cus_set[1][2] tbl_frf[1].envd.cus_set[1][3] tbl_frf[1].envd.cus_set[1][4] tbl_frf[1].envd.cus_set[1][5] tbl_frf[1].envd.cus_set[1][6] tbl_frf[1].envd.cus_set[1][7] tbl_frf[1].envd.cus_set[1][8] tbl_frf[1].envd.cus_set[1][9] tbl_frf[1].envd.cus_set[1][10] tbl_frf[1].envd.cus_set[1][11] tbl_frf[1].envd.cus_set[1][12] tbl_frf[1].envd.cus_set[1][13] tbl_frf[1].envd.cmn_cus[0] tbl_frf[1].envd.obd[0] tbl_frf[1].envd.obd[1] tbl_frf[1].envd.obd[2] tbl_frf[1].envd.obd[3] tbl_frf[1].envd.obd[4] tbl_frf[1].envd.obd[5] tbl_frf[1].envd.obd[6] tbl_frf[1].envd.obd[7] tbl_frf[2].envd.header tbl_frf[2].envd.cus_set[0][0] tbl_frf[2].envd.cus_set[0][1] tbl_frf[2].envd.cus_set[0][2] tbl_frf[2].envd.cus_set[0][3] tbl_frf[2].envd.cus_set[0][4] tbl_frf[2].envd.cus_set[0][5] tbl_frf[2].envd.cus_set[0][6] tbl_frf[2].envd.cus_set[0][7] tbl_frf[2].envd.cus_set[0][8] tbl_frf[2].envd.cus_set[0][9] tbl_frf[2].envd.cus_set[0][10] tbl_frf[2].envd.cus_set[0][11] tbl_frf[2].envd.cus_set[0][12] tbl_frf[2].envd.cus_set[0][13] tbl_frf[2].envd.cus_set[1][0] tbl_frf[2].envd.cus_set[1][1] tbl_frf[2].envd.cus_set[1][2] tbl_frf[2].envd.cus_set[1][3] tbl_frf[2].envd.cus_set[1][4] tbl_frf[2].envd.cus_set[1][5] tbl_frf[2].envd.cus_set[1][6] tbl_frf[2].envd.cus_set[1][7] tbl_frf[2].envd.cus_set[1][8] tbl_frf[2].envd.cus_set[1][9] tbl_frf[2].envd.cus_set[1][10] tbl_frf[2].envd.cus_set[1][11] tbl_frf[2].envd.cus_set[1][12] tbl_frf[2].envd.cus_set[1][13] tbl_frf[2].envd.cmn_cus[0] tbl_frf[2].envd.obd[0] tbl_frf[2].envd.obd[1] tbl_frf[2].envd.obd[2] tbl_frf[2].envd.obd[3] tbl_frf[2].envd.obd[4] tbl_frf[2].envd.obd[5] tbl_frf[2].envd.obd[6] tbl_frf[2].envd.obd[7] tbl_frf[3].envd.header tbl_frf[3].envd.cus_set[0][0] tbl_frf[3].envd.cus_set[0][1] tbl_frf[3].envd.cus_set[0][2] tbl_frf[3].envd.cus_set[0][3] tbl_frf[3].envd.cus_set[0][4] tbl_frf[3].envd.cus_set[0][5] tbl_frf[3].envd.cus_set[0][6] tbl_frf[3].envd.cus_set[0][7] tbl_frf[3].envd.cus_set[0][8] tbl_frf[3].envd.cus_set[0][9] tbl_frf[3].envd.cus_set[0][10] tbl_frf[3].envd.cus_set[0][11] tbl_frf[3].envd.cus_set[0][12] tbl_frf[3].envd.cus_set[0][13] tbl_frf[3].envd.cus_set[1][0] tbl_frf[3].envd.cus_set[1][1] tbl_frf[3].envd.cus_set[1][2] tbl_frf[3].envd.cus_set[1][3] tbl_frf[3].envd.cus_set[1][4] tbl_frf[3].envd.cus_set[1][5] tbl_frf[3].envd.cus_set[1][6] tbl_frf[3].envd.cus_set[1][7] tbl_frf[3].envd.cus_set[1][8] tbl_frf[3].envd.cus_set[1][9] tbl_frf[3].envd.cus_set[1][10] tbl_frf[3].envd.cus_set[1][11] tbl_frf[3].envd.cus_set[1][12] tbl_frf[3].envd.cus_set[1][13] tbl_frf[3].envd.cmn_cus[0] tbl_frf[3].envd.obd[0] tbl_frf[3].envd.obd[1] tbl_frf[3].envd.obd[2] tbl_frf[3].envd.obd[3] tbl_frf[3].envd.obd[4] tbl_frf[3].envd.obd[5] tbl_frf[3].envd.obd[6] tbl_frf[3].envd.obd[7] tbl_frf[4].envd.header tbl_frf[4].envd.cus_set[0][0] tbl_frf[4].envd.cus_set[0][1] tbl_frf[4].envd.cus_set[0][2] tbl_frf[4].envd.cus_set[0][3] tbl_frf[4].envd.cus_set[0][4] tbl_frf[4].envd.cus_set[0][5] tbl_frf[4].envd.cus_set[0][6] tbl_frf[4].envd.cus_set[0][7] tbl_frf[4].envd.cus_set[0][8] tbl_frf[4].envd.cus_set[0][9] tbl_frf[4].envd.cus_set[0][10] tbl_frf[4].envd.cus_set[0][11] tbl_frf[4].envd.cus_set[0][12] tbl_frf[4].envd.cus_set[0][13] tbl_frf[4].envd.cus_set[1][0] tbl_frf[4].envd.cus_set[1][1] tbl_frf[4].envd.cus_set[1][2] tbl_frf[4].envd.cus_set[1][3] tbl_frf[4].envd.cus_set[1][4] tbl_frf[4].envd.cus_set[1][5] tbl_frf[4].envd.cus_set[1][6] tbl_frf[4].envd.cus_set[1][7] tbl_frf[4].envd.cus_set[1][8] tbl_frf[4].envd.cus_set[1][9] tbl_frf[4].envd.cus_set[1][10] tbl_frf[4].envd.cus_set[1][11] tbl_frf[4].envd.cus_set[1][12] tbl_frf[4].envd.cus_set[1][13] tbl_frf[4].envd.cmn_cus[0] tbl_frf[4].envd.obd[0] tbl_frf[4].envd.obd[1] tbl_frf[4].envd.obd[2] tbl_frf[4].envd.obd[3] tbl_frf[4].envd.obd[4] tbl_frf[4].envd.obd[5] tbl_frf[4].envd.obd[6] tbl_frf[4].envd.obd[7] tbl_frf[5].envd.header tbl_frf[5].envd.cus_set[0][0] tbl_frf[5].envd.cus_set[0][1] tbl_frf[5].envd.cus_set[0][2] tbl_frf[5].envd.cus_set[0][3] tbl_frf[5].envd.cus_set[0][4] tbl_frf[5].envd.cus_set[0][5] tbl_frf[5].envd.cus_set[0][6] tbl_frf[5].envd.cus_set[0][7] tbl_frf[5].envd.cus_set[0][8] tbl_frf[5].envd.cus_set[0][9] tbl_frf[5].envd.cus_set[0][10] tbl_frf[5].envd.cus_set[0][11] tbl_frf[5].envd.cus_set[0][12] tbl_frf[5].envd.cus_set[0][13] tbl_frf[5].envd.cus_set[1][0] tbl_frf[5].envd.cus_set[1][1] tbl_frf[5].envd.cus_set[1][2] tbl_frf[5].envd.cus_set[1][3] tbl_frf[5].envd.cus_set[1][4] tbl_frf[5].envd.cus_set[1][5] tbl_frf[5].envd.cus_set[1][6] tbl_frf[5].envd.cus_set[1][7] tbl_frf[5].envd.cus_set[1][8] tbl_frf[5].envd.cus_set[1][9] tbl_frf[5].envd.cus_set[1][10] tbl_frf[5].envd.cus_set[1][11] tbl_frf[5].envd.cus_set[1][12] tbl_frf[5].envd.cus_set[1][13] tbl_frf[5].envd.cmn_cus[0] tbl_frf[5].envd.obd[0] tbl_frf[5].envd.obd[1] tbl_frf[5].envd.obd[2] tbl_frf[5].envd.obd[3] tbl_frf[5].envd.obd[4] tbl_frf[5].envd.obd[5] tbl_frf[5].envd.obd[6] tbl_frf[5].envd.obd[7] tbl_frf[6].envd.header tbl_frf[6].envd.cus_set[0][0] tbl_frf[6].envd.cus_set[0][1] tbl_frf[6].envd.cus_set[0][2] tbl_frf[6].envd.cus_set[0][3] tbl_frf[6].envd.cus_set[0][4] tbl_frf[6].envd.cus_set[0][5] tbl_frf[6].envd.cus_set[0][6] tbl_frf[6].envd.cus_set[0][7] tbl_frf[6].envd.cus_set[0][8] tbl_frf[6].envd.cus_set[0][9] tbl_frf[6].envd.cus_set[0][10] tbl_frf[6].envd.cus_set[0][11] tbl_frf[6].envd.cus_set[0][12] tbl_frf[6].envd.cus_set[0][13] tbl_frf[6].envd.cus_set[1][0] tbl_frf[6].envd.cus_set[1][1] tbl_frf[6].envd.cus_set[1][2] tbl_frf[6].envd.cus_set[1][3] tbl_frf[6].envd.cus_set[1][4] tbl_frf[6].envd.cus_set[1][5] tbl_frf[6].envd.cus_set[1][6] tbl_frf[6].envd.cus_set[1][7] tbl_frf[6].envd.cus_set[1][8] tbl_frf[6].envd.cus_set[1][9] tbl_frf[6].envd.cus_set[1][10] tbl_frf[6].envd.cus_set[1][11] tbl_frf[6].envd.cus_set[1][12] tbl_frf[6].envd.cus_set[1][13] tbl_frf[6].envd.cmn_cus[0] tbl_frf[6].envd.obd[0] tbl_frf[6].envd.obd[1] tbl_frf[6].envd.obd[2] tbl_frf[6].envd.obd[3] tbl_frf[6].envd.obd[4] tbl_frf[6].envd.obd[5] tbl_frf[6].envd.obd[6] tbl_frf[6].envd.obd[7] tbl_frf[7].envd.header tbl_frf[7].envd.cus_set[0][0] tbl_frf[7].envd.cus_set[0][1] tbl_frf[7].envd.cus_set[0][2] tbl_frf[7].envd.cus_set[0][3] tbl_frf[7].envd.cus_set[0][4] tbl_frf[7].envd.cus_set[0][5] tbl_frf[7].envd.cus_set[0][6] tbl_frf[7].envd.cus_set[0][7] tbl_frf[7].envd.cus_set[0][8] tbl_frf[7].envd.cus_set[0][9] tbl_frf[7].envd.cus_set[0][10] tbl_frf[7].envd.cus_set[0][11] tbl_frf[7].envd.cus_set[0][12] tbl_frf[7].envd.cus_set[0][13] tbl_frf[7].envd.cus_set[1][0] tbl_frf[7].envd.cus_set[1][1] tbl_frf[7].envd.cus_set[1][2] tbl_frf[7].envd.cus_set[1][3] tbl_frf[7].envd.cus_set[1][4] tbl_frf[7].envd.cus_set[1][5] tbl_frf[7].envd.cus_set[1][6] tbl_frf[7].envd.cus_set[1][7] tbl_frf[7].envd.cus_set[1][8] tbl_frf[7].envd.cus_set[1][9] tbl_frf[7].envd.cus_set[1][10] tbl_frf[7].envd.cus_set[1][11] tbl_frf[7].envd.cus_set[1][12] tbl_frf[7].envd.cus_set[1][13] tbl_frf[7].envd.cmn_cus[0] tbl_frf[7].envd.obd[0] tbl_frf[7].envd.obd[1] tbl_frf[7].envd.obd[2] tbl_frf[7].envd.obd[3] tbl_frf[7].envd.obd[4] tbl_frf[7].envd.obd[5] tbl_frf[7].envd.obd[6] tbl_frf[7].envd.obd[7] tbl_frf[8].envd.header tbl_frf[8].envd.cus_set[0][0] tbl_frf[8].envd.cus_set[0][1] tbl_frf[8].envd.cus_set[0][2] tbl_frf[8].envd.cus_set[0][3] tbl_frf[8].envd.cus_set[0][4] tbl_frf[8].envd.cus_set[0][5] tbl_frf[8].envd.cus_set[0][6] tbl_frf[8].envd.cus_set[0][7] tbl_frf[8].envd.cus_set[0][8] tbl_frf[8].envd.cus_set[0][9] tbl_frf[8].envd.cus_set[0][10] tbl_frf[8].envd.cus_set[0][11] tbl_frf[8].envd.cus_set[0][12] tbl_frf[8].envd.cus_set[0][13] tbl_frf[8].envd.cus_set[1][0] tbl_frf[8].envd.cus_set[1][1] tbl_frf[8].envd.cus_set[1][2] tbl_frf[8].envd.cus_set[1][3] tbl_frf[8].envd.cus_set[1][4] tbl_frf[8].envd.cus_set[1][5] tbl_frf[8].envd.cus_set[1][6] tbl_frf[8].envd.cus_set[1][7] tbl_frf[8].envd.cus_set[1][8] tbl_frf[8].envd.cus_set[1][9] tbl_frf[8].envd.cus_set[1][10] tbl_frf[8].envd.cus_set[1][11] tbl_frf[8].envd.cus_set[1][12] tbl_frf[8].envd.cus_set[1][13] tbl_frf[8].envd.cmn_cus[0] tbl_frf[8].envd.obd[0] tbl_frf[8].envd.obd[1] tbl_frf[8].envd.obd[2] tbl_frf[8].envd.obd[3] tbl_frf[8].envd.obd[4] tbl_frf[8].envd.obd[5] tbl_frf[8].envd.obd[6] tbl_frf[8].envd.obd[7] tbl_frf[9].envd.header tbl_frf[9].envd.cus_set[0][0] tbl_frf[9].envd.cus_set[0][1] tbl_frf[9].envd.cus_set[0][2] tbl_frf[9].envd.cus_set[0][3] tbl_frf[9].envd.cus_set[0][4] tbl_frf[9].envd.cus_set[0][5] tbl_frf[9].envd.cus_set[0][6] tbl_frf[9].envd.cus_set[0][7] tbl_frf[9].envd.cus_set[0][8] tbl_frf[9].envd.cus_set[0][9] tbl_frf[9].envd.cus_set[0][10] tbl_frf[9].envd.cus_set[0][11] tbl_frf[9].envd.cus_set[0][12] tbl_frf[9].envd.cus_set[0][13] tbl_frf[9].envd.cus_set[1][0] tbl_frf[9].envd.cus_set[1][1] tbl_frf[9].envd.cus_set[1][2] tbl_frf[9].envd.cus_set[1][3] tbl_frf[9].envd.cus_set[1][4] tbl_frf[9].envd.cus_set[1][5] tbl_frf[9].envd.cus_set[1][6] tbl_frf[9].envd.cus_set[1][7] tbl_frf[9].envd.cus_set[1][8] tbl_frf[9].envd.cus_set[1][9] tbl_frf[9].envd.cus_set[1][10] tbl_frf[9].envd.cus_set[1][11] tbl_frf[9].envd.cus_set[1][12] tbl_frf[9].envd.cus_set[1][13] tbl_frf[9].envd.cmn_cus[0] tbl_frf[9].envd.obd[0] tbl_frf[9].envd.obd[1] tbl_frf[9].envd.obd[2] tbl_frf[9].envd.obd[3] tbl_frf[9].envd.obd[4] tbl_frf[9].envd.obd[5] tbl_frf[9].envd.obd[6] tbl_frf[9].envd.obd[7] fmy_his[0][0] fmy_his[0][1] fmy_his[0][2] fmy_his[0][3] fmy_his[1][0] fmy_his[1][1] fmy_his[1][2] fmy_his[1][3] fmy_his[2][0] fmy_his[2][1] fmy_his[2][2] fmy_his[2][3] fmy_his[3][0] fmy_his[3][1] fmy_his[3][2] fmy_his[3][3] fmy_his[4][0] fmy_his[4][1] fmy_his[4][2] fmy_his[4][3] fmy_his[5][0] fmy_his[5][1] fmy_his[5][2] fmy_his[5][3] fmy_his[6][0] fmy_his[6][1] fmy_his[6][2] fmy_his[6][3] fmy_his[7][0] fmy_his[7][1] fmy_his[7][2] fmy_his[7][3] fmy_his[8][0] fmy_his[8][1] fmy_his[8][2] fmy_his[8][3] fmy_his[9][0] fmy_his[9][1] fmy_his[9][2] fmy_his[9][3] fmy_his_cod[0] fmy_his_cod[1] fmy_his_cod[2] fmy_his_cod[3] fmy_his_cod[4] fmy_his_cod[5] fmy_his_cod[6] fmy_his_cod[7] fmy_his_cod[8] fmy_his_cod[9] lv_dc lv_state_wup lv_wup_cyc dly_mil_ready state_mil state_wal_1 state_wal_2 obd_state_1 obd_state_2 lv_wal_1 lv_wal_2 lv_mil_fll_ready t_dtc_clr state_ena_obd state_cmpl_obd dist_act_wal_1 dist_act_wal_2 dist_act_mil t_act_mil t_act_mil_60 dist_dtc_clr dist_rel_dtc_clr ctr_wup_dtc_clr lv_abc_inh lv_inh_wup_cyc lv_err_pvs_pred lv_err_pvs_1 lv_err_pvs_2 lv_lih_pvs_move lv_act_pvs_lih lv_pvs_bls_bts_plaus lv_pvs_h_r lv_pvs_h_r_1 lv_pvs_h_r_2 v_pvs_min v_pvs_mmv_1 v_pvs_mmv_2 ctr_move lv_err_pvs lv_err_vcc_pvs_1 lv_err_vcc_pvs_2 lv_lih_bls_bts vcc_1 vcc_2 amp amp_mes v_amp tco_sp_ect ctr_bas_cyl_bal[0] ctr_bas_cyl_bal[1] ctr_bas_cyl_bal[2] ctr_eve_cyl_bal[0] ctr_eve_cyl_bal[1] ctr_eve_cyl_bal[2] fac_is_fil lv_act_is_fil_is n_sp_is_fil vs_n_grd vs_n_grd_fil lv_dt lv_vs_n_con dri gear vs vs_h_res vs_bas lv_vs_run vs_n n_mv_vs_sens vs_fil vs_ac t_vs_cor_diag fac_vs_adj vs_conf lv_can_vs_abs lv_can_ac_abs lv_can_dist_abs tq_conv tqi_n_max tqi_p_max tqi_vs_max eff_bas tq_loss tqfr_mmv tqfr_bas tqfr_add_toil tqfr_add_tco tqfr_add_env tq_max_sca tq_max_clu tq_min_clu tq_min_sca fac_tq_req_clu_cor tq_req_clu tq_dif_req fac_tq_tra fac_pv_av fac_n_dif lv_tq_tcs_req_inc_inter lv_tq_tcs_req_dec_inter lv_tq_tcs_req_dec_it lv_tq_tcs_req_inc_it lv_tcs_dec_ena lv_tcs_inc_ena tqi_esp_sub tq_esp_sub lv_tq_esp_req_min lv_tq_esp_req_max lv_tq_esp_act lv_tcs_inc tq_tcs_inter lv_tcs_ramp_end lv_tcs_ramp lv_cmd_tcs_ramp_end lv_tcs_ramp_lih lv_tcs_ramp_tq_lim lv_tcs_ramp_t_lim t_tcs_ramp t_tcs_inc lv_cmd_tcs_ramp_tq_lim lv_cmd_tcs_ramp_t_lim tq_inc_sum_tcs tq_tcs_req_inter tq_req_etcu n_sp_etcu_inter lv_req_n_ctl_etcu lv_etcu_dec_req lv_etcu_inc_req vs_sum_dist dist ctr_vs_dist lv_inh_inj_prev1 lv_inh_inj_prev2 lv_inh_inj_main1 lv_inh_inj_main2 lv_inh_inj_post1 lv_inh_inj_post2 v_tco mfw_egr_kgh mfw_egr_sp_kgh temp_egr_sp temp_egr temp_up_egrv /end OUT_MEASUREMENT
/end FUNCTION
/end MODULE
/end PROJECT
/* -------------------------------------------------------------------------
ETAS - Data Declaration System (DDS)
Quality FE<0> NCE<0> E<185> W<26510>
Quantity Maps <1254> Parameter<2906> Axes<899> Online<7032>
------------------------------------------------------------------------- */
