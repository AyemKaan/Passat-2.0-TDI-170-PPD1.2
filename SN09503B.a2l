ASAP2_VERSION 1 41
/begin PROJECT SN0 "SIMOS PPD"
/begin HEADER "_default_HeaderComment" PROJECT_NO PRJ_NUM /end HEADER
/begin MODULE _default_ModuleName "_default_ModuleLongIdentifier"
/begin MOD_COMMON "_default_ModCommonComment" DEPOSIT ABSOLUTE BYTE_ORDER MSB_FIRST ALIGNMENT_BYTE 1 ALIGNMENT_WORD 2 ALIGNMENT_LONG 4 ALIGNMENT_FLOAT32_IEEE 4 ALIGNMENT_FLOAT64_IEEE 8 /end MOD_COMMON
/begin AXIS_PTS ldp_fmy_dtc "" 0x8416dc online_dummy _REC_AXS_20_u2 5. _CNV_A_R_LINEAR_____0_CM 6 0. 5. FORMAT "%2.0" /end AXIS_PTS
/begin AXIS_PTS ldp_fmy_envd "" 0x8416ea online_dummy _REC_AXS_20_u1 7. _CNV_A_R_LINEAR_____0_CM 8 0. 7. READ_ONLY FORMAT "%2.0" /end AXIS_PTS
/begin CHARACTERISTIC fmy_id_imob.dtc[0] "diagnostic trouble codes for diagnosis instance IMOB" CURVE 0x85d08a _REC_CUR_20_u2_u2 65535. _CNV_A_R_LINEAR_____1_CM 0. 65535. DISPLAY_IDENTIFIER ID_ERR_DTC_IMOB FORMAT "%5.0"
 /begin AXIS_DESCR COM_AXIS online_dummy _CNV_A_R_LINEAR_____0_CM 6 0. 5. FORMAT "%2.0" AXIS_PTS_REF ldp_fmy_dtc /end AXIS_DESCR
/end CHARACTERISTIC
/begin CHARACTERISTIC fmy_id_imob.envd "environmental data contents of customer specific freeze frame for diagnosis instance IMOB" CURVE 0x85d096 _REC_CUR_20_u1_u1 255. _CNV_A_R_LINEAR_____1_CM 0. 255. DISPLAY_IDENTIFIER ID_ERR_ENVD_IMOB FORMAT "%3.0"
 /begin AXIS_DESCR COM_AXIS online_dummy _CNV_A_R_LINEAR_____0_CM 8 0. 7. READ_ONLY FORMAT "%2.0" AXIS_PTS_REF ldp_fmy_envd /end AXIS_DESCR
/end CHARACTERISTIC
/begin CHARACTERISTIC fmy_id_imob.c_err_clas "error class for diagnosis instance IMOB" VALUE 0x85d09e _REC_VAL_20_u1 255. _CNV_A_R_LINEAR_____1_CM 0. 255. DISPLAY_IDENTIFIER C_ERR_CLAS_IMOB FORMAT "%3.0" /end CHARACTERISTIC
/begin CHARACTERISTIC fmy_id_ecu_4.dtc[0] "diagnostic trouble codes for diagnosis instance ECU_4" CURVE 0x85d0a0 _REC_CUR_20_u2_u2 65535. _CNV_A_R_LINEAR_____1_CM 0. 65535. DISPLAY_IDENTIFIER ID_ERR_DTC_ECU_4 FORMAT "%5.0"
 /begin AXIS_DESCR COM_AXIS online_dummy _CNV_A_R_LINEAR_____0_CM 6 0. 5. FORMAT "%2.0" AXIS_PTS_REF ldp_fmy_dtc /end AXIS_DESCR
/end CHARACTERISTIC
/begin CHARACTERISTIC fmy_id_ecu_4.envd "environmental data contents of customer specific freeze frame for diagnosis instance ECU_4" CURVE 0x85d0ac _REC_CUR_20_u1_u1 255. _CNV_A_R_LINEAR_____1_CM 0. 255. DISPLAY_IDENTIFIER ID_ERR_ENVD_ECU_4 FORMAT "%3.0"
 /begin AXIS_DESCR COM_AXIS online_dummy _CNV_A_R_LINEAR_____0_CM 8 0. 7. READ_ONLY FORMAT "%2.0" AXIS_PTS_REF ldp_fmy_envd /end AXIS_DESCR
/end CHARACTERISTIC
/begin CHARACTERISTIC fmy_id_ecu_4.c_err_clas "error class for diagnosis instance ECU_4" VALUE 0x85d0b4 _REC_VAL_20_u1 255. _CNV_A_R_LINEAR_____1_CM 0. 255. DISPLAY_IDENTIFIER C_ERR_CLAS_ECU_4 FORMAT "%3.0" /end CHARACTERISTIC
/begin CHARACTERISTIC fmy_id_ecu_2.dtc[0] "diagnostic trouble codes for diagnosis instance ECU_2" CURVE 0x85d0b6 _REC_CUR_20_u2_u2 65535. _CNV_A_R_LINEAR_____1_CM 0. 65535. DISPLAY_IDENTIFIER ID_ERR_DTC_ECU_2 FORMAT "%5.0"
 /begin AXIS_DESCR COM_AXIS online_dummy _CNV_A_R_LINEAR_____0_CM 6 0. 5. FORMAT "%2.0" AXIS_PTS_REF ldp_fmy_dtc /end AXIS_DESCR
/end CHARACTERISTIC
/begin CHARACTERISTIC fmy_id_ecu_2.envd "environmental data contents of customer specific freeze frame for diagnosis instance ECU_2" CURVE 0x85d0c2 _REC_CUR_20_u1_u1 255. _CNV_A_R_LINEAR_____1_CM 0. 255. DISPLAY_IDENTIFIER ID_ERR_ENVD_ECU_2 FORMAT "%3.0"
 /begin AXIS_DESCR COM_AXIS online_dummy _CNV_A_R_LINEAR_____0_CM 8 0. 7. READ_ONLY FORMAT "%2.0" AXIS_PTS_REF ldp_fmy_envd /end AXIS_DESCR
/end CHARACTERISTIC
/begin CHARACTERISTIC fmy_id_ecu_2.c_err_clas "error class for diagnosis instance ECU_2" VALUE 0x85d0ca _REC_VAL_20_u1 255. _CNV_A_R_LINEAR_____1_CM 0. 255. DISPLAY_IDENTIFIER C_ERR_CLAS_ECU_2 FORMAT "%3.0" /end CHARACTERISTIC
/begin CHARACTERISTIC fmy_id_v_dcdc_rng.dtc[0] "diagnostic trouble codes for diagnosis instance V_DCDC_RNG" CURVE 0x85d0cc _REC_CUR_20_u2_u2 65535. _CNV_A_R_LINEAR_____1_CM 0. 65535. DISPLAY_IDENTIFIER ID_ERR_DTC_V_DCDC_RNG FORMAT "%5.0"
 /begin AXIS_DESCR COM_AXIS online_dummy _CNV_A_R_LINEAR_____0_CM 6 0. 5. FORMAT "%2.0" AXIS_PTS_REF ldp_fmy_dtc /end AXIS_DESCR
/end CHARACTERISTIC
/begin CHARACTERISTIC fmy_id_v_dcdc_rng.envd "environmental data contents of customer specific freeze frame for diagnosis instance V_DCDC_RNG" CURVE 0x85d0d8 _REC_CUR_20_u1_u1 255. _CNV_A_R_LINEAR_____1_CM 0. 255. DISPLAY_IDENTIFIER ID_ERR_ENVD_V_DCDC_RNG FORMAT "%3.0"
 /begin AXIS_DESCR COM_AXIS online_dummy _CNV_A_R_LINEAR_____0_CM 8 0. 7. READ_ONLY FORMAT "%2.0" AXIS_PTS_REF ldp_fmy_envd /end AXIS_DESCR
/end CHARACTERISTIC
/begin CHARACTERISTIC fmy_id_v_dcdc_rng.c_err_clas "error class for diagnosis instance V_DCDC_RNG" VALUE 0x85d0e0 _REC_VAL_20_u1 255. _CNV_A_R_LINEAR_____1_CM 0. 255. DISPLAY_IDENTIFIER C_ERR_CLAS_V_DCDC_RNG FORMAT "%3.0" /end CHARACTERISTIC
/begin CHARACTERISTIC fmy_id_pvs_l_1.dtc[0] "diagnostic trouble codes for diagnosis instance PVS_L_1" CURVE 0x85d0e2 _REC_CUR_20_u2_u2 65535. _CNV_A_R_LINEAR_____1_CM 0. 65535. DISPLAY_IDENTIFIER ID_ERR_DTC_PVS_L_1 FORMAT "%5.0"
 /begin AXIS_DESCR COM_AXIS online_dummy _CNV_A_R_LINEAR_____0_CM 6 0. 5. FORMAT "%2.0" AXIS_PTS_REF ldp_fmy_dtc /end AXIS_DESCR
/end CHARACTERISTIC
/begin CHARACTERISTIC fmy_id_pvs_l_1.envd "environmental data contents of customer specific freeze frame for diagnosis instance PVS_L_1" CURVE 0x85d0ee _REC_CUR_20_u1_u1 255. _CNV_A_R_LINEAR_____1_CM 0. 255. DISPLAY_IDENTIFIER ID_ERR_ENVD_PVS_L_1 FORMAT "%3.0"
 /begin AXIS_DESCR COM_AXIS online_dummy _CNV_A_R_LINEAR_____0_CM 8 0. 7. READ_ONLY FORMAT "%2.0" AXIS_PTS_REF ldp_fmy_envd /end AXIS_DESCR
/end CHARACTERISTIC
/begin CHARACTERISTIC fmy_id_pvs_l_1.c_err_clas "error class for diagnosis instance PVS_L_1" VALUE 0x85d0f6 _REC_VAL_20_u1 255. _CNV_A_R_LINEAR_____1_CM 0. 255. DISPLAY_IDENTIFIER C_ERR_CLAS_PVS_L_1 FORMAT "%3.0" /end CHARACTERISTIC
/begin CHARACTERISTIC fmy_id_pvs_l_2.dtc[0] "diagnostic trouble codes for diagnosis instance PVS_L_2" CURVE 0x85d0f8 _REC_CUR_20_u2_u2 65535. _CNV_A_R_LINEAR_____1_CM 0. 65535. DISPLAY_IDENTIFIER ID_ERR_DTC_PVS_L_2 FORMAT "%5.0"
 /begin AXIS_DESCR COM_AXIS online_dummy _CNV_A_R_LINEAR_____0_CM 6 0. 5. FORMAT "%2.0" AXIS_PTS_REF ldp_fmy_dtc /end AXIS_DESCR
/end CHARACTERISTIC
/begin CHARACTERISTIC fmy_id_pvs_l_2.envd "environmental data contents of customer specific freeze frame for diagnosis instance PVS_L_2" CURVE 0x85d104 _REC_CUR_20_u1_u1 255. _CNV_A_R_LINEAR_____1_CM 0. 255. DISPLAY_IDENTIFIER ID_ERR_ENVD_PVS_L_2 FORMAT "%3.0"
 /begin AXIS_DESCR COM_AXIS online_dummy _CNV_A_R_LINEAR_____0_CM 8 0. 7. READ_ONLY FORMAT "%2.0" AXIS_PTS_REF ldp_fmy_envd /end AXIS_DESCR
/end CHARACTERISTIC
/begin CHARACTERISTIC fmy_id_pvs_l_2.c_err_clas "error class for diagnosis instance PVS_L_2" VALUE 0x85d10c _REC_VAL_20_u1 255. _CNV_A_R_LINEAR_____1_CM 0. 255. DISPLAY_IDENTIFIER C_ERR_CLAS_PVS_L_2 FORMAT "%3.0" /end CHARACTERISTIC
/begin CHARACTERISTIC fmy_id_pvs_h_1.dtc[0] "diagnostic trouble codes for diagnosis instance PVS_H_1" CURVE 0x85d10e _REC_CUR_20_u2_u2 65535. _CNV_A_R_LINEAR_____1_CM 0. 65535. DISPLAY_IDENTIFIER ID_ERR_DTC_PVS_H_1 FORMAT "%5.0"
 /begin AXIS_DESCR COM_AXIS online_dummy _CNV_A_R_LINEAR_____0_CM 6 0. 5. FORMAT "%2.0" AXIS_PTS_REF ldp_fmy_dtc /end AXIS_DESCR
/end CHARACTERISTIC
/begin CHARACTERISTIC fmy_id_pvs_h_1.envd "environmental data contents of customer specific freeze frame for diagnosis instance PVS_H_1" CURVE 0x85d11a _REC_CUR_20_u1_u1 255. _CNV_A_R_LINEAR_____1_CM 0. 255. DISPLAY_IDENTIFIER ID_ERR_ENVD_PVS_H_1 FORMAT "%3.0"
 /begin AXIS_DESCR COM_AXIS online_dummy _CNV_A_R_LINEAR_____0_CM 8 0. 7. READ_ONLY FORMAT "%2.0" AXIS_PTS_REF ldp_fmy_envd /end AXIS_DESCR
/end CHARACTERISTIC
/begin CHARACTERISTIC fmy_id_pvs_h_1.c_err_clas "error class for diagnosis instance PVS_H_1" VALUE 0x85d122 _REC_VAL_20_u1 255. _CNV_A_R_LINEAR_____1_CM 0. 255. DISPLAY_IDENTIFIER C_ERR_CLAS_PVS_H_1 FORMAT "%3.0" /end CHARACTERISTIC
/begin CHARACTERISTIC fmy_id_pvs_h_2.dtc[0] "diagnostic trouble codes for diagnosis instance PVS_H_2" CURVE 0x85d124 _REC_CUR_20_u2_u2 65535. _CNV_A_R_LINEAR_____1_CM 0. 65535. DISPLAY_IDENTIFIER ID_ERR_DTC_PVS_H_2 FORMAT "%5.0"
 /begin AXIS_DESCR COM_AXIS online_dummy _CNV_A_R_LINEAR_____0_CM 6 0. 5. FORMAT "%2.0" AXIS_PTS_REF ldp_fmy_dtc /end AXIS_DESCR
/end CHARACTERISTIC
/begin CHARACTERISTIC fmy_id_pvs_h_2.envd "environmental data contents of customer specific freeze frame for diagnosis instance PVS_H_2" CURVE 0x85d130 _REC_CUR_20_u1_u1 255. _CNV_A_R_LINEAR_____1_CM 0. 255. DISPLAY_IDENTIFIER ID_ERR_ENVD_PVS_H_2 FORMAT "%3.0"
 /begin AXIS_DESCR COM_AXIS online_dummy _CNV_A_R_LINEAR_____0_CM 8 0. 7. READ_ONLY FORMAT "%2.0" AXIS_PTS_REF ldp_fmy_envd /end AXIS_DESCR
/end CHARACTERISTIC
/begin CHARACTERISTIC fmy_id_pvs_h_2.c_err_clas "error class for diagnosis instance PVS_H_2" VALUE 0x85d138 _REC_VAL_20_u1 255. _CNV_A_R_LINEAR_____1_CM 0. 255. DISPLAY_IDENTIFIER C_ERR_CLAS_PVS_H_2 FORMAT "%3.0" /end CHARACTERISTIC
/begin CHARACTERISTIC fmy_id_pvs_ratio.dtc[0] "diagnostic trouble codes for diagnosis instance PVS_RATIO" CURVE 0x85d13a _REC_CUR_20_u2_u2 65535. _CNV_A_R_LINEAR_____1_CM 0. 65535. DISPLAY_IDENTIFIER ID_ERR_DTC_PVS_RATIO FORMAT "%5.0"
 /begin AXIS_DESCR COM_AXIS online_dummy _CNV_A_R_LINEAR_____0_CM 6 0. 5. FORMAT "%2.0" AXIS_PTS_REF ldp_fmy_dtc /end AXIS_DESCR
/end CHARACTERISTIC
/begin CHARACTERISTIC fmy_id_pvs_ratio.envd "environmental data contents of customer specific freeze frame for diagnosis instance PVS_RATIO" CURVE 0x85d146 _REC_CUR_20_u1_u1 255. _CNV_A_R_LINEAR_____1_CM 0. 255. DISPLAY_IDENTIFIER ID_ERR_ENVD_PVS_RATIO FORMAT "%3.0"
 /begin AXIS_DESCR COM_AXIS online_dummy _CNV_A_R_LINEAR_____0_CM 8 0. 7. READ_ONLY FORMAT "%2.0" AXIS_PTS_REF ldp_fmy_envd /end AXIS_DESCR
/end CHARACTERISTIC
/begin CHARACTERISTIC fmy_id_pvs_ratio.c_err_clas "error class for diagnosis instance PVS_RATIO" VALUE 0x85d14e _REC_VAL_20_u1 255. _CNV_A_R_LINEAR_____1_CM 0. 255. DISPLAY_IDENTIFIER C_ERR_CLAS_PVS_RATIO FORMAT "%3.0" /end CHARACTERISTIC
/begin CHARACTERISTIC fmy_id_pvs_move.dtc[0] "diagnostic trouble codes for diagnosis instance PVS_MOVE" CURVE 0x85d150 _REC_CUR_20_u2_u2 65535. _CNV_A_R_LINEAR_____1_CM 0. 65535. DISPLAY_IDENTIFIER ID_ERR_DTC_PVS_MOVE FORMAT "%5.0"
 /begin AXIS_DESCR COM_AXIS online_dummy _CNV_A_R_LINEAR_____0_CM 6 0. 5. FORMAT "%2.0" AXIS_PTS_REF ldp_fmy_dtc /end AXIS_DESCR
/end CHARACTERISTIC
/begin CHARACTERISTIC fmy_id_pvs_move.envd "environmental data contents of customer specific freeze frame for diagnosis instance PVS_MOVE" CURVE 0x85d15c _REC_CUR_20_u1_u1 255. _CNV_A_R_LINEAR_____1_CM 0. 255. DISPLAY_IDENTIFIER ID_ERR_ENVD_PVS_MOVE FORMAT "%3.0"
 /begin AXIS_DESCR COM_AXIS online_dummy _CNV_A_R_LINEAR_____0_CM 8 0. 7. READ_ONLY FORMAT "%2.0" AXIS_PTS_REF ldp_fmy_envd /end AXIS_DESCR
/end CHARACTERISTIC
/begin CHARACTERISTIC fmy_id_pvs_move.c_err_clas "error class for diagnosis instance PVS_MOVE" VALUE 0x85d164 _REC_VAL_20_u1 255. _CNV_A_R_LINEAR_____1_CM 0. 255. DISPLAY_IDENTIFIER C_ERR_CLAS_PVS_MOVE FORMAT "%3.0" /end CHARACTERISTIC
/begin CHARACTERISTIC fmy_id_pvs_bls_bts.dtc[0] "diagnostic trouble codes for diagnosis instance PVS_BLS_BTS" CURVE 0x85d166 _REC_CUR_20_u2_u2 65535. _CNV_A_R_LINEAR_____1_CM 0. 65535. DISPLAY_IDENTIFIER ID_ERR_DTC_PVS_BLS_BTS FORMAT "%5.0"
 /begin AXIS_DESCR COM_AXIS online_dummy _CNV_A_R_LINEAR_____0_CM 6 0. 5. FORMAT "%2.0" AXIS_PTS_REF ldp_fmy_dtc /end AXIS_DESCR
/end CHARACTERISTIC
/begin CHARACTERISTIC fmy_id_pvs_bls_bts.envd "environmental data contents of customer specific freeze frame for diagnosis instance PVS_BLS_BTS" CURVE 0x85d172 _REC_CUR_20_u1_u1 255. _CNV_A_R_LINEAR_____1_CM 0. 255. DISPLAY_IDENTIFIER ID_ERR_ENVD_PVS_BLS_BTS FORMAT "%3.0"
 /begin AXIS_DESCR COM_AXIS online_dummy _CNV_A_R_LINEAR_____0_CM 8 0. 7. READ_ONLY FORMAT "%2.0" AXIS_PTS_REF ldp_fmy_envd /end AXIS_DESCR
/end CHARACTERISTIC
/begin CHARACTERISTIC fmy_id_pvs_bls_bts.c_err_clas "error class for diagnosis instance PVS_BLS_BTS" VALUE 0x85d17a _REC_VAL_20_u1 255. _CNV_A_R_LINEAR_____1_CM 0. 255. DISPLAY_IDENTIFIER C_ERR_CLAS_PVS_BLS_BTS FORMAT "%3.0" /end CHARACTERISTIC
/begin CHARACTERISTIC fmy_id_vcc_1.dtc[0] "diagnostic trouble codes for diagnosis instance VCC_1" CURVE 0x85d17c _REC_CUR_20_u2_u2 65535. _CNV_A_R_LINEAR_____1_CM 0. 65535. DISPLAY_IDENTIFIER ID_ERR_DTC_VCC_1 FORMAT "%5.0"
 /begin AXIS_DESCR COM_AXIS online_dummy _CNV_A_R_LINEAR_____0_CM 6 0. 5. FORMAT "%2.0" AXIS_PTS_REF ldp_fmy_dtc /end AXIS_DESCR
/end CHARACTERISTIC
/begin CHARACTERISTIC fmy_id_vcc_1.envd "environmental data contents of customer specific freeze frame for diagnosis instance VCC_1" CURVE 0x85d188 _REC_CUR_20_u1_u1 255. _CNV_A_R_LINEAR_____1_CM 0. 255. DISPLAY_IDENTIFIER ID_ERR_ENVD_VCC_1 FORMAT "%3.0"
 /begin AXIS_DESCR COM_AXIS online_dummy _CNV_A_R_LINEAR_____0_CM 8 0. 7. READ_ONLY FORMAT "%2.0" AXIS_PTS_REF ldp_fmy_envd /end AXIS_DESCR
/end CHARACTERISTIC
/begin CHARACTERISTIC fmy_id_vcc_1.c_err_clas "error class for diagnosis instance VCC_1" VALUE 0x85d190 _REC_VAL_20_u1 255. _CNV_A_R_LINEAR_____1_CM 0. 255. DISPLAY_IDENTIFIER C_ERR_CLAS_VCC_1 FORMAT "%3.0" /end CHARACTERISTIC
/begin CHARACTERISTIC fmy_id_vcc_2.dtc[0] "diagnostic trouble codes for diagnosis instance VCC_2" CURVE 0x85d192 _REC_CUR_20_u2_u2 65535. _CNV_A_R_LINEAR_____1_CM 0. 65535. DISPLAY_IDENTIFIER ID_ERR_DTC_VCC_2 FORMAT "%5.0"
 /begin AXIS_DESCR COM_AXIS online_dummy _CNV_A_R_LINEAR_____0_CM 6 0. 5. FORMAT "%2.0" AXIS_PTS_REF ldp_fmy_dtc /end AXIS_DESCR
/end CHARACTERISTIC
/begin CHARACTERISTIC fmy_id_vcc_2.envd "environmental data contents of customer specific freeze frame for diagnosis instance VCC_2" CURVE 0x85d19e _REC_CUR_20_u1_u1 255. _CNV_A_R_LINEAR_____1_CM 0. 255. DISPLAY_IDENTIFIER ID_ERR_ENVD_VCC_2 FORMAT "%3.0"
 /begin AXIS_DESCR COM_AXIS online_dummy _CNV_A_R_LINEAR_____0_CM 8 0. 7. READ_ONLY FORMAT "%2.0" AXIS_PTS_REF ldp_fmy_envd /end AXIS_DESCR
/end CHARACTERISTIC
/begin CHARACTERISTIC fmy_id_vcc_2.c_err_clas "error class for diagnosis instance VCC_2" VALUE 0x85d1a6 _REC_VAL_20_u1 255. _CNV_A_R_LINEAR_____1_CM 0. 255. DISPLAY_IDENTIFIER C_ERR_CLAS_VCC_2 FORMAT "%3.0" /end CHARACTERISTIC
/begin CHARACTERISTIC fmy_id_v_dip_pf_rng.dtc[0] "diagnostic trouble codes for diagnosis instance V_DIP_PF_RNG" CURVE 0x85d1a8 _REC_CUR_20_u2_u2 65535. _CNV_A_R_LINEAR_____1_CM 0. 65535. DISPLAY_IDENTIFIER ID_ERR_DTC_V_DIP_PF_RNG FORMAT "%5.0"
 /begin AXIS_DESCR COM_AXIS online_dummy _CNV_A_R_LINEAR_____0_CM 6 0. 5. FORMAT "%2.0" AXIS_PTS_REF ldp_fmy_dtc /end AXIS_DESCR
/end CHARACTERISTIC
/begin CHARACTERISTIC fmy_id_v_dip_pf_rng.envd "environmental data contents of customer specific freeze frame for diagnosis instance V_DIP_PF_RNG" CURVE 0x85d1b4 _REC_CUR_20_u1_u1 255. _CNV_A_R_LINEAR_____1_CM 0. 255. DISPLAY_IDENTIFIER ID_ERR_ENVD_V_DIP_PF_RNG FORMAT "%3.0"
 /begin AXIS_DESCR COM_AXIS online_dummy _CNV_A_R_LINEAR_____0_CM 8 0. 7. READ_ONLY FORMAT "%2.0" AXIS_PTS_REF ldp_fmy_envd /end AXIS_DESCR
/end CHARACTERISTIC
/begin CHARACTERISTIC fmy_id_v_dip_pf_rng.c_err_clas "error class for diagnosis instance V_DIP_PF_RNG" VALUE 0x85d1bc _REC_VAL_20_u1 255. _CNV_A_R_LINEAR_____1_CM 0. 255. DISPLAY_IDENTIFIER C_ERR_CLAS_V_DIP_PF_RNG FORMAT "%3.0" /end CHARACTERISTIC
/begin CHARACTERISTIC fmy_id_dip_pf_mes_grd.dtc[0] "diagnostic trouble codes for diagnosis instance DIP_PF_MES_GRD" CURVE 0x85d1be _REC_CUR_20_u2_u2 65535. _CNV_A_R_LINEAR_____1_CM 0. 65535. DISPLAY_IDENTIFIER ID_ERR_DTC_DIP_PF_MES_GRD FORMAT "%5.0"
 /begin AXIS_DESCR COM_AXIS online_dummy _CNV_A_R_LINEAR_____0_CM 6 0. 5. FORMAT "%2.0" AXIS_PTS_REF ldp_fmy_dtc /end AXIS_DESCR
/end CHARACTERISTIC
/begin CHARACTERISTIC fmy_id_dip_pf_mes_grd.envd "environmental data contents of customer specific freeze frame for diagnosis instance DIP_PF_MES_GRD" CURVE 0x85d1ca _REC_CUR_20_u1_u1 255. _CNV_A_R_LINEAR_____1_CM 0. 255. DISPLAY_IDENTIFIER ID_ERR_ENVD_DIP_PF_MES_GRD FORMAT "%3.0"
 /begin AXIS_DESCR COM_AXIS online_dummy _CNV_A_R_LINEAR_____0_CM 8 0. 7. READ_ONLY FORMAT "%2.0" AXIS_PTS_REF ldp_fmy_envd /end AXIS_DESCR
/end CHARACTERISTIC
/begin CHARACTERISTIC fmy_id_dip_pf_mes_grd.c_err_clas "error class for diagnosis instance DIP_PF_MES_GRD" VALUE 0x85d1d2 _REC_VAL_20_u1 255. _CNV_A_R_LINEAR_____1_CM 0. 255. DISPLAY_IDENTIFIER C_ERR_CLAS_DIP_PF_MES_GRD FORMAT "%3.0" /end CHARACTERISTIC
/begin CHARACTERISTIC fmy_id_dip_pf_mes_es.dtc[0] "diagnostic trouble codes for diagnosis instance DIP_PF_MES_ES" CURVE 0x85d1d4 _REC_CUR_20_u2_u2 65535. _CNV_A_R_LINEAR_____1_CM 0. 65535. DISPLAY_IDENTIFIER ID_ERR_DTC_DIP_PF_MES_ES FORMAT "%5.0"
 /begin AXIS_DESCR COM_AXIS online_dummy _CNV_A_R_LINEAR_____0_CM 6 0. 5. FORMAT "%2.0" AXIS_PTS_REF ldp_fmy_dtc /end AXIS_DESCR
/end CHARACTERISTIC
/begin CHARACTERISTIC fmy_id_dip_pf_mes_es.envd "environmental data contents of customer specific freeze frame for diagnosis instance DIP_PF_MES_ES" CURVE 0x85d1e0 _REC_CUR_20_u1_u1 255. _CNV_A_R_LINEAR_____1_CM 0. 255. DISPLAY_IDENTIFIER ID_ERR_ENVD_DIP_PF_MES_ES FORMAT "%3.0"
 /begin AXIS_DESCR COM_AXIS online_dummy _CNV_A_R_LINEAR_____0_CM 8 0. 7. READ_ONLY FORMAT "%2.0" AXIS_PTS_REF ldp_fmy_envd /end AXIS_DESCR
/end CHARACTERISTIC
/begin CHARACTERISTIC fmy_id_dip_pf_mes_es.c_err_clas "error class for diagnosis instance DIP_PF_MES_ES" VALUE 0x85d1e8 _REC_VAL_20_u1 255. _CNV_A_R_LINEAR_____1_CM 0. 255. DISPLAY_IDENTIFIER C_ERR_CLAS_DIP_PF_MES_ES FORMAT "%3.0" /end CHARACTERISTIC
/begin CHARACTERISTIC fmy_id_v_tco_1_rng.dtc[0] "diagnostic trouble codes for diagnosis instance V_TCO_1_RNG" CURVE 0x85d1ea _REC_CUR_20_u2_u2 65535. _CNV_A_R_LINEAR_____1_CM 0. 65535. DISPLAY_IDENTIFIER ID_ERR_DTC_V_TCO_1_RNG FORMAT "%5.0"
 /begin AXIS_DESCR COM_AXIS online_dummy _CNV_A_R_LINEAR_____0_CM 6 0. 5. FORMAT "%2.0" AXIS_PTS_REF ldp_fmy_dtc /end AXIS_DESCR
/end CHARACTERISTIC
/begin CHARACTERISTIC fmy_id_v_tco_1_rng.envd "environmental data contents of customer specific freeze frame for diagnosis instance V_TCO_1_RNG" CURVE 0x85d1f6 _REC_CUR_20_u1_u1 255. _CNV_A_R_LINEAR_____1_CM 0. 255. DISPLAY_IDENTIFIER ID_ERR_ENVD_V_TCO_1_RNG FORMAT "%3.0"
 /begin AXIS_DESCR COM_AXIS online_dummy _CNV_A_R_LINEAR_____0_CM 8 0. 7. READ_ONLY FORMAT "%2.0" AXIS_PTS_REF ldp_fmy_envd /end AXIS_DESCR
/end CHARACTERISTIC
/begin CHARACTERISTIC fmy_id_v_tco_1_rng.c_err_clas "error class for diagnosis instance V_TCO_1_RNG" VALUE 0x85d1fe _REC_VAL_20_u1 255. _CNV_A_R_LINEAR_____1_CM 0. 255. DISPLAY_IDENTIFIER C_ERR_CLAS_V_TCO_1_RNG FORMAT "%3.0" /end CHARACTERISTIC
/begin CHARACTERISTIC fmy_id_v_tco_2_rng.dtc[0] "diagnostic trouble codes for diagnosis instance V_TCO_2_RNG" CURVE 0x85d200 _REC_CUR_20_u2_u2 65535. _CNV_A_R_LINEAR_____1_CM 0. 65535. DISPLAY_IDENTIFIER ID_ERR_DTC_V_TCO_2_RNG FORMAT "%5.0"
 /begin AXIS_DESCR COM_AXIS online_dummy _CNV_A_R_LINEAR_____0_CM 6 0. 5. FORMAT "%2.0" AXIS_PTS_REF ldp_fmy_dtc /end AXIS_DESCR
/end CHARACTERISTIC
/begin CHARACTERISTIC fmy_id_v_tco_2_rng.envd "environmental data contents of customer specific freeze frame for diagnosis instance V_TCO_2_RNG" CURVE 0x85d20c _REC_CUR_20_u1_u1 255. _CNV_A_R_LINEAR_____1_CM 0. 255. DISPLAY_IDENTIFIER ID_ERR_ENVD_V_TCO_2_RNG FORMAT "%3.0"
 /begin AXIS_DESCR COM_AXIS online_dummy _CNV_A_R_LINEAR_____0_CM 8 0. 7. READ_ONLY FORMAT "%2.0" AXIS_PTS_REF ldp_fmy_envd /end AXIS_DESCR
/end CHARACTERISTIC
/begin CHARACTERISTIC fmy_id_v_tco_2_rng.c_err_clas "error class for diagnosis instance V_TCO_2_RNG" VALUE 0x85d214 _REC_VAL_20_u1 255. _CNV_A_R_LINEAR_____1_CM 0. 255. DISPLAY_IDENTIFIER C_ERR_CLAS_V_TCO_2_RNG FORMAT "%3.0" /end CHARACTERISTIC
/begin CHARACTERISTIC fmy_id_tco_1_mes_grd.dtc[0] "diagnostic trouble codes for diagnosis instance TCO_1_MES_GRD" CURVE 0x85d216 _REC_CUR_20_u2_u2 65535. _CNV_A_R_LINEAR_____1_CM 0. 65535. DISPLAY_IDENTIFIER ID_ERR_DTC_TCO_1_MES_GRD FORMAT "%5.0"
 /begin AXIS_DESCR COM_AXIS online_dummy _CNV_A_R_LINEAR_____0_CM 6 0. 5. FORMAT "%2.0" AXIS_PTS_REF ldp_fmy_dtc /end AXIS_DESCR
/end CHARACTERISTIC
/begin CHARACTERISTIC fmy_id_tco_1_mes_grd.envd "environmental data contents of customer specific freeze frame for diagnosis instance TCO_1_MES_GRD" CURVE 0x85d222 _REC_CUR_20_u1_u1 255. _CNV_A_R_LINEAR_____1_CM 0. 255. DISPLAY_IDENTIFIER ID_ERR_ENVD_TCO_1_MES_GRD FORMAT "%3.0"
 /begin AXIS_DESCR COM_AXIS online_dummy _CNV_A_R_LINEAR_____0_CM 8 0. 7. READ_ONLY FORMAT "%2.0" AXIS_PTS_REF ldp_fmy_envd /end AXIS_DESCR
/end CHARACTERISTIC
/begin CHARACTERISTIC fmy_id_tco_1_mes_grd.c_err_clas "error class for diagnosis instance TCO_1_MES_GRD" VALUE 0x85d22a _REC_VAL_20_u1 255. _CNV_A_R_LINEAR_____1_CM 0. 255. DISPLAY_IDENTIFIER C_ERR_CLAS_TCO_1_MES_GRD FORMAT "%3.0" /end CHARACTERISTIC
/begin CHARACTERISTIC fmy_id_tco_2_mes_grd.dtc[0] "diagnostic trouble codes for diagnosis instance TCO_2_MES_GRD" CURVE 0x85d22c _REC_CUR_20_u2_u2 65535. _CNV_A_R_LINEAR_____1_CM 0. 65535. DISPLAY_IDENTIFIER ID_ERR_DTC_TCO_2_MES_GRD FORMAT "%5.0"
 /begin AXIS_DESCR COM_AXIS online_dummy _CNV_A_R_LINEAR_____0_CM 6 0. 5. FORMAT "%2.0" AXIS_PTS_REF ldp_fmy_dtc /end AXIS_DESCR
/end CHARACTERISTIC
/begin CHARACTERISTIC fmy_id_tco_2_mes_grd.envd "environmental data contents of customer specific freeze frame for diagnosis instance TCO_2_MES_GRD" CURVE 0x85d238 _REC_CUR_20_u1_u1 255. _CNV_A_R_LINEAR_____1_CM 0. 255. DISPLAY_IDENTIFIER ID_ERR_ENVD_TCO_2_MES_GRD FORMAT "%3.0"
 /begin AXIS_DESCR COM_AXIS online_dummy _CNV_A_R_LINEAR_____0_CM 8 0. 7. READ_ONLY FORMAT "%2.0" AXIS_PTS_REF ldp_fmy_envd /end AXIS_DESCR
/end CHARACTERISTIC
/begin CHARACTERISTIC fmy_id_tco_2_mes_grd.c_err_clas "error class for diagnosis instance TCO_2_MES_GRD" VALUE 0x85d240 _REC_VAL_20_u1 255. _CNV_A_R_LINEAR_____1_CM 0. 255. DISPLAY_IDENTIFIER C_ERR_CLAS_TCO_2_MES_GRD FORMAT "%3.0" /end CHARACTERISTIC
/begin CHARACTERISTIC fmy_id_tco_mes_plaus.dtc[0] "diagnostic trouble codes for diagnosis instance TCO_MES_PLAUS" CURVE 0x85d242 _REC_CUR_20_u2_u2 65535. _CNV_A_R_LINEAR_____1_CM 0. 65535. DISPLAY_IDENTIFIER ID_ERR_DTC_TCO_MES_PLAUS FORMAT "%5.0"
 /begin AXIS_DESCR COM_AXIS online_dummy _CNV_A_R_LINEAR_____0_CM 6 0. 5. FORMAT "%2.0" AXIS_PTS_REF ldp_fmy_dtc /end AXIS_DESCR
/end CHARACTERISTIC
/begin CHARACTERISTIC fmy_id_tco_mes_plaus.envd "environmental data contents of customer specific freeze frame for diagnosis instance TCO_MES_PLAUS" CURVE 0x85d24e _REC_CUR_20_u1_u1 255. _CNV_A_R_LINEAR_____1_CM 0. 255. DISPLAY_IDENTIFIER ID_ERR_ENVD_TCO_MES_PLAUS FORMAT "%3.0"
 /begin AXIS_DESCR COM_AXIS online_dummy _CNV_A_R_LINEAR_____0_CM 8 0. 7. READ_ONLY FORMAT "%2.0" AXIS_PTS_REF ldp_fmy_envd /end AXIS_DESCR
/end CHARACTERISTIC
/begin CHARACTERISTIC fmy_id_tco_mes_plaus.c_err_clas "error class for diagnosis instance TCO_MES_PLAUS" VALUE 0x85d256 _REC_VAL_20_u1 255. _CNV_A_R_LINEAR_____1_CM 0. 255. DISPLAY_IDENTIFIER C_ERR_CLAS_TCO_MES_PLAUS FORMAT "%3.0" /end CHARACTERISTIC
/begin CHARACTERISTIC fmy_id_egr_ctl_min.dtc[0] "diagnostic trouble codes for diagnosis instance EGR_CTL_MIN" CURVE 0x85d258 _REC_CUR_20_u2_u2 65535. _CNV_A_R_LINEAR_____1_CM 0. 65535. DISPLAY_IDENTIFIER ID_ERR_DTC_EGR_CTL_MIN FORMAT "%5.0"
 /begin AXIS_DESCR COM_AXIS online_dummy _CNV_A_R_LINEAR_____0_CM 6 0. 5. FORMAT "%2.0" AXIS_PTS_REF ldp_fmy_dtc /end AXIS_DESCR
/end CHARACTERISTIC
/begin CHARACTERISTIC fmy_id_egr_ctl_min.envd "environmental data contents of customer specific freeze frame for diagnosis instance EGR_CTL_MIN" CURVE 0x85d264 _REC_CUR_20_u1_u1 255. _CNV_A_R_LINEAR_____1_CM 0. 255. DISPLAY_IDENTIFIER ID_ERR_ENVD_EGR_CTL_MIN FORMAT "%3.0"
 /begin AXIS_DESCR COM_AXIS online_dummy _CNV_A_R_LINEAR_____0_CM 8 0. 7. READ_ONLY FORMAT "%2.0" AXIS_PTS_REF ldp_fmy_envd /end AXIS_DESCR
/end CHARACTERISTIC
/begin CHARACTERISTIC fmy_id_egr_ctl_min.c_err_clas "error class for diagnosis instance EGR_CTL_MIN" VALUE 0x85d26c _REC_VAL_20_u1 255. _CNV_A_R_LINEAR_____1_CM 0. 255. DISPLAY_IDENTIFIER C_ERR_CLAS_EGR_CTL_MIN FORMAT "%3.0" /end CHARACTERISTIC
/begin CHARACTERISTIC fmy_id_egr_ctl_max.dtc[0] "diagnostic trouble codes for diagnosis instance EGR_CTL_MAX" CURVE 0x85d26e _REC_CUR_20_u2_u2 65535. _CNV_A_R_LINEAR_____1_CM 0. 65535. DISPLAY_IDENTIFIER ID_ERR_DTC_EGR_CTL_MAX FORMAT "%5.0"
 /begin AXIS_DESCR COM_AXIS online_dummy _CNV_A_R_LINEAR_____0_CM 6 0. 5. FORMAT "%2.0" AXIS_PTS_REF ldp_fmy_dtc /end AXIS_DESCR
/end CHARACTERISTIC
/begin CHARACTERISTIC fmy_id_egr_ctl_max.envd "environmental data contents of customer specific freeze frame for diagnosis instance EGR_CTL_MAX" CURVE 0x85d27a _REC_CUR_20_u1_u1 255. _CNV_A_R_LINEAR_____1_CM 0. 255. DISPLAY_IDENTIFIER ID_ERR_ENVD_EGR_CTL_MAX FORMAT "%3.0"
 /begin AXIS_DESCR COM_AXIS online_dummy _CNV_A_R_LINEAR_____0_CM 8 0. 7. READ_ONLY FORMAT "%2.0" AXIS_PTS_REF ldp_fmy_envd /end AXIS_DESCR
/end CHARACTERISTIC
/begin CHARACTERISTIC fmy_id_egr_ctl_max.c_err_clas "error class for diagnosis instance EGR_CTL_MAX" VALUE 0x85d282 _REC_VAL_20_u1 255. _CNV_A_R_LINEAR_____1_CM 0. 255. DISPLAY_IDENTIFIER C_ERR_CLAS_EGR_CTL_MAX FORMAT "%3.0" /end CHARACTERISTIC
/begin CHARACTERISTIC fmy_id_v_amp_rng.dtc[0] "diagnostic trouble codes for diagnosis instance V_AMP_RNG" CURVE 0x85d284 _REC_CUR_20_u2_u2 65535. _CNV_A_R_LINEAR_____1_CM 0. 65535. DISPLAY_IDENTIFIER ID_ERR_DTC_V_AMP_RNG FORMAT "%5.0"
 /begin AXIS_DESCR COM_AXIS online_dummy _CNV_A_R_LINEAR_____0_CM 6 0. 5. FORMAT "%2.0" AXIS_PTS_REF ldp_fmy_dtc /end AXIS_DESCR
/end CHARACTERISTIC
/begin CHARACTERISTIC fmy_id_v_amp_rng.envd "environmental data contents of customer specific freeze frame for diagnosis instance V_AMP_RNG" CURVE 0x85d290 _REC_CUR_20_u1_u1 255. _CNV_A_R_LINEAR_____1_CM 0. 255. DISPLAY_IDENTIFIER ID_ERR_ENVD_V_AMP_RNG FORMAT "%3.0"
 /begin AXIS_DESCR COM_AXIS online_dummy _CNV_A_R_LINEAR_____0_CM 8 0. 7. READ_ONLY FORMAT "%2.0" AXIS_PTS_REF ldp_fmy_envd /end AXIS_DESCR
/end CHARACTERISTIC
/begin CHARACTERISTIC fmy_id_v_amp_rng.c_err_clas "error class for diagnosis instance V_AMP_RNG" VALUE 0x85d298 _REC_VAL_20_u1 255. _CNV_A_R_LINEAR_____1_CM 0. 255. DISPLAY_IDENTIFIER C_ERR_CLAS_V_AMP_RNG FORMAT "%3.0" /end CHARACTERISTIC
/begin CHARACTERISTIC fmy_id_amp_mes_grd.dtc[0] "diagnostic trouble codes for diagnosis instance AMP_MES_GRD" CURVE 0x85d29a _REC_CUR_20_u2_u2 65535. _CNV_A_R_LINEAR_____1_CM 0. 65535. DISPLAY_IDENTIFIER ID_ERR_DTC_AMP_MES_GRD FORMAT "%5.0"
 /begin AXIS_DESCR COM_AXIS online_dummy _CNV_A_R_LINEAR_____0_CM 6 0. 5. FORMAT "%2.0" AXIS_PTS_REF ldp_fmy_dtc /end AXIS_DESCR
/end CHARACTERISTIC
/begin CHARACTERISTIC fmy_id_amp_mes_grd.envd "environmental data contents of customer specific freeze frame for diagnosis instance AMP_MES_GRD" CURVE 0x85d2a6 _REC_CUR_20_u1_u1 255. _CNV_A_R_LINEAR_____1_CM 0. 255. DISPLAY_IDENTIFIER ID_ERR_ENVD_AMP_MES_GRD FORMAT "%3.0"
 /begin AXIS_DESCR COM_AXIS online_dummy _CNV_A_R_LINEAR_____0_CM 8 0. 7. READ_ONLY FORMAT "%2.0" AXIS_PTS_REF ldp_fmy_envd /end AXIS_DESCR
/end CHARACTERISTIC
/begin CHARACTERISTIC fmy_id_amp_mes_grd.c_err_clas "error class for diagnosis instance AMP_MES_GRD" VALUE 0x85d2ae _REC_VAL_20_u1 255. _CNV_A_R_LINEAR_____1_CM 0. 255. DISPLAY_IDENTIFIER C_ERR_CLAS_AMP_MES_GRD FORMAT "%3.0" /end CHARACTERISTIC
/begin CHARACTERISTIC fmy_id_v_tfu_rng.dtc[0] "diagnostic trouble codes for diagnosis instance V_TFU_RNG" CURVE 0x85d2b0 _REC_CUR_20_u2_u2 65535. _CNV_A_R_LINEAR_____1_CM 0. 65535. DISPLAY_IDENTIFIER ID_ERR_DTC_V_TFU_RNG FORMAT "%5.0"
 /begin AXIS_DESCR COM_AXIS online_dummy _CNV_A_R_LINEAR_____0_CM 6 0. 5. FORMAT "%2.0" AXIS_PTS_REF ldp_fmy_dtc /end AXIS_DESCR
/end CHARACTERISTIC
/begin CHARACTERISTIC fmy_id_v_tfu_rng.envd "environmental data contents of customer specific freeze frame for diagnosis instance V_TFU_RNG" CURVE 0x85d2bc _REC_CUR_20_u1_u1 255. _CNV_A_R_LINEAR_____1_CM 0. 255. DISPLAY_IDENTIFIER ID_ERR_ENVD_V_TFU_RNG FORMAT "%3.0"
 /begin AXIS_DESCR COM_AXIS online_dummy _CNV_A_R_LINEAR_____0_CM 8 0. 7. READ_ONLY FORMAT "%2.0" AXIS_PTS_REF ldp_fmy_envd /end AXIS_DESCR
/end CHARACTERISTIC
/begin CHARACTERISTIC fmy_id_v_tfu_rng.c_err_clas "error class for diagnosis instance V_TFU_RNG" VALUE 0x85d2c4 _REC_VAL_20_u1 255. _CNV_A_R_LINEAR_____1_CM 0. 255. DISPLAY_IDENTIFIER C_ERR_CLAS_V_TFU_RNG FORMAT "%3.0" /end CHARACTERISTIC
/begin CHARACTERISTIC fmy_id_tfu_mes_grd.dtc[0] "diagnostic trouble codes for diagnosis instance TFU_MES_GRD" CURVE 0x85d2c6 _REC_CUR_20_u2_u2 65535. _CNV_A_R_LINEAR_____1_CM 0. 65535. DISPLAY_IDENTIFIER ID_ERR_DTC_TFU_MES_GRD FORMAT "%5.0"
 /begin AXIS_DESCR COM_AXIS online_dummy _CNV_A_R_LINEAR_____0_CM 6 0. 5. FORMAT "%2.0" AXIS_PTS_REF ldp_fmy_dtc /end AXIS_DESCR
/end CHARACTERISTIC
/begin CHARACTERISTIC fmy_id_tfu_mes_grd.envd "environmental data contents of customer specific freeze frame for diagnosis instance TFU_MES_GRD" CURVE 0x85d2d2 _REC_CUR_20_u1_u1 255. _CNV_A_R_LINEAR_____1_CM 0. 255. DISPLAY_IDENTIFIER ID_ERR_ENVD_TFU_MES_GRD FORMAT "%3.0"
 /begin AXIS_DESCR COM_AXIS online_dummy _CNV_A_R_LINEAR_____0_CM 8 0. 7. READ_ONLY FORMAT "%2.0" AXIS_PTS_REF ldp_fmy_envd /end AXIS_DESCR
/end CHARACTERISTIC
/begin CHARACTERISTIC fmy_id_tfu_mes_grd.c_err_clas "error class for diagnosis instance TFU_MES_GRD" VALUE 0x85d2da _REC_VAL_20_u1 255. _CNV_A_R_LINEAR_____1_CM 0. 255. DISPLAY_IDENTIFIER C_ERR_CLAS_TFU_MES_GRD FORMAT "%3.0" /end CHARACTERISTIC
/begin CHARACTERISTIC fmy_id_tfu_mes_plaus.dtc[0] "diagnostic trouble codes for diagnosis instance TFU_MES_PLAUS" CURVE 0x85d2dc _REC_CUR_20_u2_u2 65535. _CNV_A_R_LINEAR_____1_CM 0. 65535. DISPLAY_IDENTIFIER ID_ERR_DTC_TFU_MES_PLAUS FORMAT "%5.0"
 /begin AXIS_DESCR COM_AXIS online_dummy _CNV_A_R_LINEAR_____0_CM 6 0. 5. FORMAT "%2.0" AXIS_PTS_REF ldp_fmy_dtc /end AXIS_DESCR
/end CHARACTERISTIC
/begin CHARACTERISTIC fmy_id_tfu_mes_plaus.envd "environmental data contents of customer specific freeze frame for diagnosis instance TFU_MES_PLAUS" CURVE 0x85d2e8 _REC_CUR_20_u1_u1 255. _CNV_A_R_LINEAR_____1_CM 0. 255. DISPLAY_IDENTIFIER ID_ERR_ENVD_TFU_MES_PLAUS FORMAT "%3.0"
 /begin AXIS_DESCR COM_AXIS online_dummy _CNV_A_R_LINEAR_____0_CM 8 0. 7. READ_ONLY FORMAT "%2.0" AXIS_PTS_REF ldp_fmy_envd /end AXIS_DESCR
/end CHARACTERISTIC
/begin CHARACTERISTIC fmy_id_tfu_mes_plaus.c_err_clas "error class for diagnosis instance TFU_MES_PLAUS" VALUE 0x85d2f0 _REC_VAL_20_u1 255. _CNV_A_R_LINEAR_____1_CM 0. 255. DISPLAY_IDENTIFIER C_ERR_CLAS_TFU_MES_PLAUS FORMAT "%3.0" /end CHARACTERISTIC
/begin CHARACTERISTIC fmy_id_v_map_rng.dtc[0] "diagnostic trouble codes for diagnosis instance V_MAP_RNG" CURVE 0x85d2f2 _REC_CUR_20_u2_u2 65535. _CNV_A_R_LINEAR_____1_CM 0. 65535. DISPLAY_IDENTIFIER ID_ERR_DTC_V_MAP_RNG FORMAT "%5.0"
 /begin AXIS_DESCR COM_AXIS online_dummy _CNV_A_R_LINEAR_____0_CM 6 0. 5. FORMAT "%2.0" AXIS_PTS_REF ldp_fmy_dtc /end AXIS_DESCR
/end CHARACTERISTIC
/begin CHARACTERISTIC fmy_id_v_map_rng.envd "environmental data contents of customer specific freeze frame for diagnosis instance V_MAP_RNG" CURVE 0x85d2fe _REC_CUR_20_u1_u1 255. _CNV_A_R_LINEAR_____1_CM 0. 255. DISPLAY_IDENTIFIER ID_ERR_ENVD_V_MAP_RNG FORMAT "%3.0"
 /begin AXIS_DESCR COM_AXIS online_dummy _CNV_A_R_LINEAR_____0_CM 8 0. 7. READ_ONLY FORMAT "%2.0" AXIS_PTS_REF ldp_fmy_envd /end AXIS_DESCR
/end CHARACTERISTIC
/begin CHARACTERISTIC fmy_id_v_map_rng.c_err_clas "error class for diagnosis instance V_MAP_RNG" VALUE 0x85d306 _REC_VAL_20_u1 255. _CNV_A_R_LINEAR_____1_CM 0. 255. DISPLAY_IDENTIFIER C_ERR_CLAS_V_MAP_RNG FORMAT "%3.0" /end CHARACTERISTIC
/begin CHARACTERISTIC fmy_id_map_amp_ofs.dtc[0] "diagnostic trouble codes for diagnosis instance MAP_AMP_OFS" CURVE 0x85d308 _REC_CUR_20_u2_u2 65535. _CNV_A_R_LINEAR_____1_CM 0. 65535. DISPLAY_IDENTIFIER ID_ERR_DTC_MAP_AMP_OFS FORMAT "%5.0"
 /begin AXIS_DESCR COM_AXIS online_dummy _CNV_A_R_LINEAR_____0_CM 6 0. 5. FORMAT "%2.0" AXIS_PTS_REF ldp_fmy_dtc /end AXIS_DESCR
/end CHARACTERISTIC
/begin CHARACTERISTIC fmy_id_map_amp_ofs.envd "environmental data contents of customer specific freeze frame for diagnosis instance MAP_AMP_OFS" CURVE 0x85d314 _REC_CUR_20_u1_u1 255. _CNV_A_R_LINEAR_____1_CM 0. 255. DISPLAY_IDENTIFIER ID_ERR_ENVD_MAP_AMP_OFS FORMAT "%3.0"
 /begin AXIS_DESCR COM_AXIS online_dummy _CNV_A_R_LINEAR_____0_CM 8 0. 7. READ_ONLY FORMAT "%2.0" AXIS_PTS_REF ldp_fmy_envd /end AXIS_DESCR
/end CHARACTERISTIC
/begin CHARACTERISTIC fmy_id_map_amp_ofs.c_err_clas "error class for diagnosis instance MAP_AMP_OFS" VALUE 0x85d31c _REC_VAL_20_u1 255. _CNV_A_R_LINEAR_____1_CM 0. 255. DISPLAY_IDENTIFIER C_ERR_CLAS_MAP_AMP_OFS FORMAT "%3.0" /end CHARACTERISTIC
/begin CHARACTERISTIC fmy_id_map_is_ofs.dtc[0] "diagnostic trouble codes for diagnosis instance MAP_IS_OFS" CURVE 0x85d31e _REC_CUR_20_u2_u2 65535. _CNV_A_R_LINEAR_____1_CM 0. 65535. DISPLAY_IDENTIFIER ID_ERR_DTC_MAP_IS_OFS FORMAT "%5.0"
 /begin AXIS_DESCR COM_AXIS online_dummy _CNV_A_R_LINEAR_____0_CM 6 0. 5. FORMAT "%2.0" AXIS_PTS_REF ldp_fmy_dtc /end AXIS_DESCR
/end CHARACTERISTIC
/begin CHARACTERISTIC fmy_id_map_is_ofs.envd "environmental data contents of customer specific freeze frame for diagnosis instance MAP_IS_OFS" CURVE 0x85d32a _REC_CUR_20_u1_u1 255. _CNV_A_R_LINEAR_____1_CM 0. 255. DISPLAY_IDENTIFIER ID_ERR_ENVD_MAP_IS_OFS FORMAT "%3.0"
 /begin AXIS_DESCR COM_AXIS online_dummy _CNV_A_R_LINEAR_____0_CM 8 0. 7. READ_ONLY FORMAT "%2.0" AXIS_PTS_REF ldp_fmy_envd /end AXIS_DESCR
/end CHARACTERISTIC
/begin CHARACTERISTIC fmy_id_map_is_ofs.c_err_clas "error class for diagnosis instance MAP_IS_OFS" VALUE 0x85d332 _REC_VAL_20_u1 255. _CNV_A_R_LINEAR_____1_CM 0. 255. DISPLAY_IDENTIFIER C_ERR_CLAS_MAP_IS_OFS FORMAT "%3.0" /end CHARACTERISTIC
/begin CHARACTERISTIC fmy_id_map_mes_grd.dtc[0] "diagnostic trouble codes for diagnosis instance MAP_MES_GRD" CURVE 0x85d334 _REC_CUR_20_u2_u2 65535. _CNV_A_R_LINEAR_____1_CM 0. 65535. DISPLAY_IDENTIFIER ID_ERR_DTC_MAP_MES_GRD FORMAT "%5.0"
 /begin AXIS_DESCR COM_AXIS online_dummy _CNV_A_R_LINEAR_____0_CM 6 0. 5. FORMAT "%2.0" AXIS_PTS_REF ldp_fmy_dtc /end AXIS_DESCR
/end CHARACTERISTIC
/begin CHARACTERISTIC fmy_id_map_mes_grd.envd "environmental data contents of customer specific freeze frame for diagnosis instance MAP_MES_GRD" CURVE 0x85d340 _REC_CUR_20_u1_u1 255. _CNV_A_R_LINEAR_____1_CM 0. 255. DISPLAY_IDENTIFIER ID_ERR_ENVD_MAP_MES_GRD FORMAT "%3.0"
 /begin AXIS_DESCR COM_AXIS online_dummy _CNV_A_R_LINEAR_____0_CM 8 0. 7. READ_ONLY FORMAT "%2.0" AXIS_PTS_REF ldp_fmy_envd /end AXIS_DESCR
/end CHARACTERISTIC
/begin CHARACTERISTIC fmy_id_map_mes_grd.c_err_clas "error class for diagnosis instance MAP_MES_GRD" VALUE 0x85d348 _REC_VAL_20_u1 255. _CNV_A_R_LINEAR_____1_CM 0. 255. DISPLAY_IDENTIFIER C_ERR_CLAS_MAP_MES_GRD FORMAT "%3.0" /end CHARACTERISTIC
/begin CHARACTERISTIC fmy_id_maf_kgh_plaus.dtc[0] "diagnostic trouble codes for diagnosis instance MAF_KGH_PLAUS" CURVE 0x85d34a _REC_CUR_20_u2_u2 65535. _CNV_A_R_LINEAR_____1_CM 0. 65535. DISPLAY_IDENTIFIER ID_ERR_DTC_MAF_KGH_PLAUS FORMAT "%5.0"
 /begin AXIS_DESCR COM_AXIS online_dummy _CNV_A_R_LINEAR_____0_CM 6 0. 5. FORMAT "%2.0" AXIS_PTS_REF ldp_fmy_dtc /end AXIS_DESCR
/end CHARACTERISTIC
/begin CHARACTERISTIC fmy_id_maf_kgh_plaus.envd "environmental data contents of customer specific freeze frame for diagnosis instance MAF_KGH_PLAUS" CURVE 0x85d356 _REC_CUR_20_u1_u1 255. _CNV_A_R_LINEAR_____1_CM 0. 255. DISPLAY_IDENTIFIER ID_ERR_ENVD_MAF_KGH_PLAUS FORMAT "%3.0"
 /begin AXIS_DESCR COM_AXIS online_dummy _CNV_A_R_LINEAR_____0_CM 8 0. 7. READ_ONLY FORMAT "%2.0" AXIS_PTS_REF ldp_fmy_envd /end AXIS_DESCR
/end CHARACTERISTIC
/begin CHARACTERISTIC fmy_id_maf_kgh_plaus.c_err_clas "error class for diagnosis instance MAF_KGH_PLAUS" VALUE 0x85d35e _REC_VAL_20_u1 255. _CNV_A_R_LINEAR_____1_CM 0. 255. DISPLAY_IDENTIFIER C_ERR_CLAS_MAF_KGH_PLAUS FORMAT "%3.0" /end CHARACTERISTIC
/begin CHARACTERISTIC fmy_id_maf_0_rng.dtc[0] "diagnostic trouble codes for diagnosis instance MAF_0_RNG" CURVE 0x85d360 _REC_CUR_20_u2_u2 65535. _CNV_A_R_LINEAR_____1_CM 0. 65535. DISPLAY_IDENTIFIER ID_ERR_DTC_MAF_0_RNG FORMAT "%5.0"
 /begin AXIS_DESCR COM_AXIS online_dummy _CNV_A_R_LINEAR_____0_CM 6 0. 5. FORMAT "%2.0" AXIS_PTS_REF ldp_fmy_dtc /end AXIS_DESCR
/end CHARACTERISTIC
/begin CHARACTERISTIC fmy_id_maf_0_rng.envd "environmental data contents of customer specific freeze frame for diagnosis instance MAF_0_RNG" CURVE 0x85d36c _REC_CUR_20_u1_u1 255. _CNV_A_R_LINEAR_____1_CM 0. 255. DISPLAY_IDENTIFIER ID_ERR_ENVD_MAF_0_RNG FORMAT "%3.0"
 /begin AXIS_DESCR COM_AXIS online_dummy _CNV_A_R_LINEAR_____0_CM 8 0. 7. READ_ONLY FORMAT "%2.0" AXIS_PTS_REF ldp_fmy_envd /end AXIS_DESCR
/end CHARACTERISTIC
/begin CHARACTERISTIC fmy_id_maf_0_rng.c_err_clas "error class for diagnosis instance MAF_0_RNG" VALUE 0x85d374 _REC_VAL_20_u1 255. _CNV_A_R_LINEAR_____1_CM 0. 255. DISPLAY_IDENTIFIER C_ERR_CLAS_MAF_0_RNG FORMAT "%3.0" /end CHARACTERISTIC
/begin MEASUREMENT lv_err_conv_mon_1 "Error flag of diagnosis instance CONV_MON_1" UBYTE _CNV_S_2_RANGE______23_CM 1 0. 0. 1. DISPLAY_IDENTIFIER LV_ERR_CONV_MON_1 ECU_ADDRESS 0x7fb938 /end MEASUREMENT
/begin MEASUREMENT fmy_stat_conv_mon_1.ctr_abc "anti bounce counter for diagnosis instance CONV_MON_1" UBYTE _CNV_A_R_LINEAR_____1_CM 1 0. 0. 255. DISPLAY_IDENTIFIER CTR_ABC_CONV_MON_1 ECU_ADDRESS 0x7f9c23 FORMAT "%3.0" /end MEASUREMENT
/begin MEASUREMENT fmy_stat_conv_mon_1.ctr_end_diag "counter for end of diagnosis for diagnosis instance CONV_MON_1" UBYTE _CNV_A_R_LINEAR_____1_CM 1 0. 0. 255. DISPLAY_IDENTIFIER CTR_ABC_END_DIAG_CONV_MON_1 ECU_ADDRESS 0x7f9c22 FORMAT "%3.0" /end MEASUREMENT
/begin MEASUREMENT fmy_stat_conv_mon_1.err_info_stat.reserved "" UWORD _CNV_A_R_LINEAR_____0_CM 1 0. 0. 65535. DISPLAY_IDENTIFIER FMY_STAT_CONV_MON_1_ERR_INFO_STAT_RESERVED ECU_ADDRESS 0x7f9c20 BYTE_ORDER MSB_LAST BIT_MASK 0xF800 /end MEASUREMENT
/begin MEASUREMENT fmy_stat_conv_mon_1.err_info_stat.lv_cdn_diag_stc "Statistical flag for condition of diagnosis of the diagnosis instance CONV_MON_1" UWORD _CNV_S_2_RANGE______383_CM 1 0. 0. 1. DISPLAY_IDENTIFIER LV_CDN_DIAG_STC_CONV_MON_1 ECU_ADDRESS 0x7f9c20 BYTE_ORDER MSB_LAST BIT_MASK 0x400 /end MEASUREMENT
/begin MEASUREMENT fmy_stat_conv_mon_1.err_info_stat.lv_lock_diag "lock flag (CPU load optimisation) of the diagnosis instance CONV_MON_1" UWORD _CNV_S_2_RANGE______383_CM 1 0. 0. 1. DISPLAY_IDENTIFIER LV_LOCK_DIAG_CONV_MON_1 ECU_ADDRESS 0x7f9c20 BYTE_ORDER MSB_LAST BIT_MASK 0x200 /end MEASUREMENT
/begin MEASUREMENT fmy_stat_conv_mon_1.err_info_stat.lv_err_mem "storage in dynamic failure memory of the diagnosis instance CONV_MON_1" UWORD _CNV_S_2_RANGE______383_CM 1 0. 0. 1. DISPLAY_IDENTIFIER LV_ERR_MEM_CONV_MON_1 ECU_ADDRESS 0x7f9c20 BYTE_ORDER MSB_LAST BIT_MASK 0x80 /end MEASUREMENT
/begin MEASUREMENT fmy_stat_conv_mon_1.err_info_stat.lv_ready "readiness status of the diagnosis instance CONV_MON_1" UWORD _CNV_S_2_RANGE______383_CM 1 0. 0. 1. DISPLAY_IDENTIFIER LV_READY_CONV_MON_1 ECU_ADDRESS 0x7f9c20 BYTE_ORDER MSB_LAST BIT_MASK 0x40 /end MEASUREMENT
/begin MEASUREMENT fmy_stat_conv_mon_1.err_info_stat.lv_end_diag "end of diagnosis of the diagnosis instance CONV_MON_1" UWORD _CNV_S_2_RANGE______383_CM 1 0. 0. 1. DISPLAY_IDENTIFIER LV_END_DIAG_CONV_MON_1 ECU_ADDRESS 0x7f9c20 BYTE_ORDER MSB_LAST BIT_MASK 0x20 /end MEASUREMENT
/begin MEASUREMENT fmy_stat_conv_mon_1.err_info_stat.lv_cdn_diag "diagnosis condition of the diagnosis instance CONV_MON_1" UWORD _CNV_S_2_RANGE______383_CM 1 0. 0. 1. DISPLAY_IDENTIFIER LV_CDN_DIAG_CONV_MON_1 ECU_ADDRESS 0x7f9c20 BYTE_ORDER MSB_LAST BIT_MASK 0x10 /end MEASUREMENT
/begin MEASUREMENT fmy_stat_conv_mon_1.err_info_stat.err_sym "symptoms of the diagnosis instance CONV_MON_1" UWORD _CNV_S_6_CONV_ERRM__22_CM 1 0. 0. 15. DISPLAY_IDENTIFIER ERR_SYM_CONV_MON_1 ECU_ADDRESS 0x7f9c20 BYTE_ORDER MSB_LAST BIT_MASK 0xF /end MEASUREMENT
/begin MEASUREMENT lv_err_n_32_mon_1 "Error flag of diagnosis instance N_32_MON_1" UBYTE _CNV_S_2_RANGE______23_CM 1 0. 0. 1. DISPLAY_IDENTIFIER LV_ERR_N_32_MON_1 ECU_ADDRESS 0x7fb939 /end MEASUREMENT
/begin MEASUREMENT fmy_stat_n_32_mon_1.ctr_abc "anti bounce counter for diagnosis instance N_32_MON_1" UBYTE _CNV_A_R_LINEAR_____1_CM 1 0. 0. 255. DISPLAY_IDENTIFIER CTR_ABC_N_32_MON_1 ECU_ADDRESS 0x7f9c27 FORMAT "%3.0" /end MEASUREMENT
/begin MEASUREMENT fmy_stat_n_32_mon_1.ctr_end_diag "counter for end of diagnosis for diagnosis instance N_32_MON_1" UBYTE _CNV_A_R_LINEAR_____1_CM 1 0. 0. 255. DISPLAY_IDENTIFIER CTR_ABC_END_DIAG_N_32_MON_1 ECU_ADDRESS 0x7f9c26 FORMAT "%3.0" /end MEASUREMENT
/begin MEASUREMENT fmy_stat_n_32_mon_1.err_info_stat.reserved "" UWORD _CNV_A_R_LINEAR_____0_CM 1 0. 0. 65535. DISPLAY_IDENTIFIER FMY_STAT_N_32_MON_1_ERR_INFO_STAT_RESERVED ECU_ADDRESS 0x7f9c24 BYTE_ORDER MSB_LAST BIT_MASK 0xF800 /end MEASUREMENT
/begin MEASUREMENT fmy_stat_n_32_mon_1.err_info_stat.lv_cdn_diag_stc "Statistical flag for condition of diagnosis of the diagnosis instance N_32_MON_1" UWORD _CNV_S_2_RANGE______383_CM 1 0. 0. 1. DISPLAY_IDENTIFIER LV_CDN_DIAG_STC_N_32_MON_1 ECU_ADDRESS 0x7f9c24 BYTE_ORDER MSB_LAST BIT_MASK 0x400 /end MEASUREMENT
/begin MEASUREMENT fmy_stat_n_32_mon_1.err_info_stat.lv_lock_diag "lock flag (CPU load optimisation) of the diagnosis instance N_32_MON_1" UWORD _CNV_S_2_RANGE______383_CM 1 0. 0. 1. DISPLAY_IDENTIFIER LV_LOCK_DIAG_N_32_MON_1 ECU_ADDRESS 0x7f9c24 BYTE_ORDER MSB_LAST BIT_MASK 0x200 /end MEASUREMENT
/begin MEASUREMENT fmy_stat_n_32_mon_1.err_info_stat.lv_err_mem "storage in dynamic failure memory of the diagnosis instance N_32_MON_1" UWORD _CNV_S_2_RANGE______383_CM 1 0. 0. 1. DISPLAY_IDENTIFIER LV_ERR_MEM_N_32_MON_1 ECU_ADDRESS 0x7f9c24 BYTE_ORDER MSB_LAST BIT_MASK 0x80 /end MEASUREMENT
/begin MEASUREMENT fmy_stat_n_32_mon_1.err_info_stat.lv_ready "readiness status of the diagnosis instance N_32_MON_1" UWORD _CNV_S_2_RANGE______383_CM 1 0. 0. 1. DISPLAY_IDENTIFIER LV_READY_N_32_MON_1 ECU_ADDRESS 0x7f9c24 BYTE_ORDER MSB_LAST BIT_MASK 0x40 /end MEASUREMENT
/begin MEASUREMENT fmy_stat_n_32_mon_1.err_info_stat.lv_end_diag "end of diagnosis of the diagnosis instance N_32_MON_1" UWORD _CNV_S_2_RANGE______383_CM 1 0. 0. 1. DISPLAY_IDENTIFIER LV_END_DIAG_N_32_MON_1 ECU_ADDRESS 0x7f9c24 BYTE_ORDER MSB_LAST BIT_MASK 0x20 /end MEASUREMENT
/begin MEASUREMENT fmy_stat_n_32_mon_1.err_info_stat.lv_cdn_diag "diagnosis condition of the diagnosis instance N_32_MON_1" UWORD _CNV_S_2_RANGE______383_CM 1 0. 0. 1. DISPLAY_IDENTIFIER LV_CDN_DIAG_N_32_MON_1 ECU_ADDRESS 0x7f9c24 BYTE_ORDER MSB_LAST BIT_MASK 0x10 /end MEASUREMENT
/begin MEASUREMENT fmy_stat_n_32_mon_1.err_info_stat.err_sym "symptoms of the diagnosis instance N_32_MON_1" UWORD _CNV_S_6_CONV_ERRM__22_CM 1 0. 0. 15. DISPLAY_IDENTIFIER ERR_SYM_N_32_MON_1 ECU_ADDRESS 0x7f9c24 BYTE_ORDER MSB_LAST BIT_MASK 0xF /end MEASUREMENT
/begin MEASUREMENT lv_err_pvs_mon_1 "Error flag of diagnosis instance PVS_MON_1" UBYTE _CNV_S_2_RANGE______23_CM 1 0. 0. 1. DISPLAY_IDENTIFIER LV_ERR_PVS_MON_1 ECU_ADDRESS 0x7fb93a /end MEASUREMENT
/begin MEASUREMENT fmy_stat_pvs_mon_1.ctr_abc "anti bounce counter for diagnosis instance PVS_MON_1" UBYTE _CNV_A_R_LINEAR_____1_CM 1 0. 0. 255. DISPLAY_IDENTIFIER CTR_ABC_PVS_MON_1 ECU_ADDRESS 0x7f9c2b FORMAT "%3.0" /end MEASUREMENT
/begin MEASUREMENT fmy_stat_pvs_mon_1.ctr_end_diag "counter for end of diagnosis for diagnosis instance PVS_MON_1" UBYTE _CNV_A_R_LINEAR_____1_CM 1 0. 0. 255. DISPLAY_IDENTIFIER CTR_ABC_END_DIAG_PVS_MON_1 ECU_ADDRESS 0x7f9c2a FORMAT "%3.0" /end MEASUREMENT
/begin MEASUREMENT fmy_stat_pvs_mon_1.err_info_stat.reserved "" UWORD _CNV_A_R_LINEAR_____0_CM 1 0. 0. 65535. DISPLAY_IDENTIFIER FMY_STAT_PVS_MON_1_ERR_INFO_STAT_RESERVED ECU_ADDRESS 0x7f9c28 BYTE_ORDER MSB_LAST BIT_MASK 0xF800 /end MEASUREMENT
/begin MEASUREMENT fmy_stat_pvs_mon_1.err_info_stat.lv_cdn_diag_stc "Statistical flag for condition of diagnosis of the diagnosis instance PVS_MON_1" UWORD _CNV_S_2_RANGE______383_CM 1 0. 0. 1. DISPLAY_IDENTIFIER LV_CDN_DIAG_STC_PVS_MON_1 ECU_ADDRESS 0x7f9c28 BYTE_ORDER MSB_LAST BIT_MASK 0x400 /end MEASUREMENT
/begin MEASUREMENT fmy_stat_pvs_mon_1.err_info_stat.lv_lock_diag "lock flag (CPU load optimisation) of the diagnosis instance PVS_MON_1" UWORD _CNV_S_2_RANGE______383_CM 1 0. 0. 1. DISPLAY_IDENTIFIER LV_LOCK_DIAG_PVS_MON_1 ECU_ADDRESS 0x7f9c28 BYTE_ORDER MSB_LAST BIT_MASK 0x200 /end MEASUREMENT
/begin MEASUREMENT fmy_stat_pvs_mon_1.err_info_stat.lv_err_mem "storage in dynamic failure memory of the diagnosis instance PVS_MON_1" UWORD _CNV_S_2_RANGE______383_CM 1 0. 0. 1. DISPLAY_IDENTIFIER LV_ERR_MEM_PVS_MON_1 ECU_ADDRESS 0x7f9c28 BYTE_ORDER MSB_LAST BIT_MASK 0x80 /end MEASUREMENT
/begin MEASUREMENT fmy_stat_pvs_mon_1.err_info_stat.lv_ready "readiness status of the diagnosis instance PVS_MON_1" UWORD _CNV_S_2_RANGE______383_CM 1 0. 0. 1. DISPLAY_IDENTIFIER LV_READY_PVS_MON_1 ECU_ADDRESS 0x7f9c28 BYTE_ORDER MSB_LAST BIT_MASK 0x40 /end MEASUREMENT
/begin MEASUREMENT fmy_stat_pvs_mon_1.err_info_stat.lv_end_diag "end of diagnosis of the diagnosis instance PVS_MON_1" UWORD _CNV_S_2_RANGE______383_CM 1 0. 0. 1. DISPLAY_IDENTIFIER LV_END_DIAG_PVS_MON_1 ECU_ADDRESS 0x7f9c28 BYTE_ORDER MSB_LAST BIT_MASK 0x20 /end MEASUREMENT
/begin MEASUREMENT fmy_stat_pvs_mon_1.err_info_stat.lv_cdn_diag "diagnosis condition of the diagnosis instance PVS_MON_1" UWORD _CNV_S_2_RANGE______383_CM 1 0. 0. 1. DISPLAY_IDENTIFIER LV_CDN_DIAG_PVS_MON_1 ECU_ADDRESS 0x7f9c28 BYTE_ORDER MSB_LAST BIT_MASK 0x10 /end MEASUREMENT
/begin MEASUREMENT fmy_stat_pvs_mon_1.err_info_stat.err_sym "symptoms of the diagnosis instance PVS_MON_1" UWORD _CNV_S_6_CONV_ERRM__22_CM 1 0. 0. 15. DISPLAY_IDENTIFIER ERR_SYM_PVS_MON_1 ECU_ADDRESS 0x7f9c28 BYTE_ORDER MSB_LAST BIT_MASK 0xF /end MEASUREMENT
/begin MEASUREMENT lv_err_fcut_mon_1 "Error flag of diagnosis instance FCUT_MON_1" UBYTE _CNV_S_2_RANGE______23_CM 1 0. 0. 1. DISPLAY_IDENTIFIER LV_ERR_FCUT_MON_1 ECU_ADDRESS 0x7fb93b /end MEASUREMENT
/begin MEASUREMENT fmy_stat_fcut_mon_1.ctr_abc "anti bounce counter for diagnosis instance FCUT_MON_1" UBYTE _CNV_A_R_LINEAR_____1_CM 1 0. 0. 255. DISPLAY_IDENTIFIER CTR_ABC_FCUT_MON_1 ECU_ADDRESS 0x7f9c2f FORMAT "%3.0" /end MEASUREMENT
/begin MEASUREMENT fmy_stat_fcut_mon_1.ctr_end_diag "counter for end of diagnosis for diagnosis instance FCUT_MON_1" UBYTE _CNV_A_R_LINEAR_____1_CM 1 0. 0. 255. DISPLAY_IDENTIFIER CTR_ABC_END_DIAG_FCUT_MON_1 ECU_ADDRESS 0x7f9c2e FORMAT "%3.0" /end MEASUREMENT
/begin MEASUREMENT fmy_stat_fcut_mon_1.err_info_stat.reserved "" UWORD _CNV_A_R_LINEAR_____0_CM 1 0. 0. 65535. DISPLAY_IDENTIFIER FMY_STAT_FCUT_MON_1_ERR_INFO_STAT_RESERVED ECU_ADDRESS 0x7f9c2c BYTE_ORDER MSB_LAST BIT_MASK 0xF800 /end MEASUREMENT
/begin MEASUREMENT fmy_stat_fcut_mon_1.err_info_stat.lv_cdn_diag_stc "Statistical flag for condition of diagnosis of the diagnosis instance FCUT_MON_1" UWORD _CNV_S_2_RANGE______383_CM 1 0. 0. 1. DISPLAY_IDENTIFIER LV_CDN_DIAG_STC_FCUT_MON_1 ECU_ADDRESS 0x7f9c2c BYTE_ORDER MSB_LAST BIT_MASK 0x400 /end MEASUREMENT
/begin MEASUREMENT fmy_stat_fcut_mon_1.err_info_stat.lv_lock_diag "lock flag (CPU load optimisation) of the diagnosis instance FCUT_MON_1" UWORD _CNV_S_2_RANGE______383_CM 1 0. 0. 1. DISPLAY_IDENTIFIER LV_LOCK_DIAG_FCUT_MON_1 ECU_ADDRESS 0x7f9c2c BYTE_ORDER MSB_LAST BIT_MASK 0x200 /end MEASUREMENT
/begin MEASUREMENT fmy_stat_fcut_mon_1.err_info_stat.lv_err_mem "storage in dynamic failure memory of the diagnosis instance FCUT_MON_1" UWORD _CNV_S_2_RANGE______383_CM 1 0. 0. 1. DISPLAY_IDENTIFIER LV_ERR_MEM_FCUT_MON_1 ECU_ADDRESS 0x7f9c2c BYTE_ORDER MSB_LAST BIT_MASK 0x80 /end MEASUREMENT
/begin MEASUREMENT fmy_stat_fcut_mon_1.err_info_stat.lv_ready "readiness status of the diagnosis instance FCUT_MON_1" UWORD _CNV_S_2_RANGE______383_CM 1 0. 0. 1. DISPLAY_IDENTIFIER LV_READY_FCUT_MON_1 ECU_ADDRESS 0x7f9c2c BYTE_ORDER MSB_LAST BIT_MASK 0x40 /end MEASUREMENT
/begin MEASUREMENT fmy_stat_fcut_mon_1.err_info_stat.lv_end_diag "end of diagnosis of the diagnosis instance FCUT_MON_1" UWORD _CNV_S_2_RANGE______383_CM 1 0. 0. 1. DISPLAY_IDENTIFIER LV_END_DIAG_FCUT_MON_1 ECU_ADDRESS 0x7f9c2c BYTE_ORDER MSB_LAST BIT_MASK 0x20 /end MEASUREMENT
/begin MEASUREMENT fmy_stat_fcut_mon_1.err_info_stat.lv_cdn_diag "diagnosis condition of the diagnosis instance FCUT_MON_1" UWORD _CNV_S_2_RANGE______383_CM 1 0. 0. 1. DISPLAY_IDENTIFIER LV_CDN_DIAG_FCUT_MON_1 ECU_ADDRESS 0x7f9c2c BYTE_ORDER MSB_LAST BIT_MASK 0x10 /end MEASUREMENT
/begin MEASUREMENT fmy_stat_fcut_mon_1.err_info_stat.err_sym "symptoms of the diagnosis instance FCUT_MON_1" UWORD _CNV_S_6_CONV_ERRM__22_CM 1 0. 0. 15. DISPLAY_IDENTIFIER ERR_SYM_FCUT_MON_1 ECU_ADDRESS 0x7f9c2c BYTE_ORDER MSB_LAST BIT_MASK 0xF /end MEASUREMENT
/begin MEASUREMENT lv_err_tqi_n_max_mon_1 "Error flag of diagnosis instance TQI_N_MAX_MON_1" UBYTE _CNV_S_2_RANGE______23_CM 1 0. 0. 1. DISPLAY_IDENTIFIER LV_ERR_TQI_N_MAX_MON_1 ECU_ADDRESS 0x7fb93c /end MEASUREMENT
/begin MEASUREMENT fmy_stat_tqi_n_max_mon_1.ctr_abc "anti bounce counter for diagnosis instance TQI_N_MAX_MON_1" UBYTE _CNV_A_R_LINEAR_____1_CM 1 0. 0. 255. DISPLAY_IDENTIFIER CTR_ABC_TQI_N_MAX_MON_1 ECU_ADDRESS 0x7f9c33 FORMAT "%3.0" /end MEASUREMENT
/begin MEASUREMENT fmy_stat_tqi_n_max_mon_1.ctr_end_diag "counter for end of diagnosis for diagnosis instance TQI_N_MAX_MON_1" UBYTE _CNV_A_R_LINEAR_____1_CM 1 0. 0. 255. DISPLAY_IDENTIFIER CTR_ABC_END_DIAG_TQI_N_MAX_MON_1 ECU_ADDRESS 0x7f9c32 FORMAT "%3.0" /end MEASUREMENT
/begin MEASUREMENT fmy_stat_tqi_n_max_mon_1.err_info_stat.reserved "" UWORD _CNV_A_R_LINEAR_____0_CM 1 0. 0. 65535. DISPLAY_IDENTIFIER FMY_STAT_TQI_N_MAX_MON_1_ERR_INFO_STAT_RESERVED ECU_ADDRESS 0x7f9c30 BYTE_ORDER MSB_LAST BIT_MASK 0xF800 /end MEASUREMENT
/begin MEASUREMENT fmy_stat_tqi_n_max_mon_1.err_info_stat.lv_cdn_diag_stc "Statistical flag for condition of diagnosis of the diagnosis instance TQI_N_MAX_MON_1" UWORD _CNV_S_2_RANGE______383_CM 1 0. 0. 1. DISPLAY_IDENTIFIER LV_CDN_DIAG_STC_TQI_N_MAX_MON_1 ECU_ADDRESS 0x7f9c30 BYTE_ORDER MSB_LAST BIT_MASK 0x400 /end MEASUREMENT
/begin MEASUREMENT fmy_stat_tqi_n_max_mon_1.err_info_stat.lv_lock_diag "lock flag (CPU load optimisation) of the diagnosis instance TQI_N_MAX_MON_1" UWORD _CNV_S_2_RANGE______383_CM 1 0. 0. 1. DISPLAY_IDENTIFIER LV_LOCK_DIAG_TQI_N_MAX_MON_1 ECU_ADDRESS 0x7f9c30 BYTE_ORDER MSB_LAST BIT_MASK 0x200 /end MEASUREMENT
/begin MEASUREMENT fmy_stat_tqi_n_max_mon_1.err_info_stat.lv_err_mem "storage in dynamic failure memory of the diagnosis instance TQI_N_MAX_MON_1" UWORD _CNV_S_2_RANGE______383_CM 1 0. 0. 1. DISPLAY_IDENTIFIER LV_ERR_MEM_TQI_N_MAX_MON_1 ECU_ADDRESS 0x7f9c30 BYTE_ORDER MSB_LAST BIT_MASK 0x80 /end MEASUREMENT
/begin MEASUREMENT fmy_stat_tqi_n_max_mon_1.err_info_stat.lv_ready "readiness status of the diagnosis instance TQI_N_MAX_MON_1" UWORD _CNV_S_2_RANGE______383_CM 1 0. 0. 1. DISPLAY_IDENTIFIER LV_READY_TQI_N_MAX_MON_1 ECU_ADDRESS 0x7f9c30 BYTE_ORDER MSB_LAST BIT_MASK 0x40 /end MEASUREMENT
/begin MEASUREMENT fmy_stat_tqi_n_max_mon_1.err_info_stat.lv_end_diag "end of diagnosis of the diagnosis instance TQI_N_MAX_MON_1" UWORD _CNV_S_2_RANGE______383_CM 1 0. 0. 1. DISPLAY_IDENTIFIER LV_END_DIAG_TQI_N_MAX_MON_1 ECU_ADDRESS 0x7f9c30 BYTE_ORDER MSB_LAST BIT_MASK 0x20 /end MEASUREMENT
/begin MEASUREMENT fmy_stat_tqi_n_max_mon_1.err_info_stat.lv_cdn_diag "diagnosis condition of the diagnosis instance TQI_N_MAX_MON_1" UWORD _CNV_S_2_RANGE______383_CM 1 0. 0. 1. DISPLAY_IDENTIFIER LV_CDN_DIAG_TQI_N_MAX_MON_1 ECU_ADDRESS 0x7f9c30 BYTE_ORDER MSB_LAST BIT_MASK 0x10 /end MEASUREMENT
/begin MEASUREMENT fmy_stat_tqi_n_max_mon_1.err_info_stat.err_sym "symptoms of the diagnosis instance TQI_N_MAX_MON_1" UWORD _CNV_S_6_CONV_ERRM__22_CM 1 0. 0. 15. DISPLAY_IDENTIFIER ERR_SYM_TQI_N_MAX_MON_1 ECU_ADDRESS 0x7f9c30 BYTE_ORDER MSB_LAST BIT_MASK 0xF /end MEASUREMENT
/begin MEASUREMENT lv_err_serv_mon_1 "Error flag of diagnosis instance SERV_MON_1" UBYTE _CNV_S_2_RANGE______23_CM 1 0. 0. 1. DISPLAY_IDENTIFIER LV_ERR_SERV_MON_1 ECU_ADDRESS 0x7fb93d /end MEASUREMENT
/begin MEASUREMENT fmy_stat_serv_mon_1.ctr_abc "anti bounce counter for diagnosis instance SERV_MON_1" UBYTE _CNV_A_R_LINEAR_____1_CM 1 0. 0. 255. DISPLAY_IDENTIFIER CTR_ABC_SERV_MON_1 ECU_ADDRESS 0x7f9c37 FORMAT "%3.0" /end MEASUREMENT
/begin MEASUREMENT fmy_stat_serv_mon_1.ctr_end_diag "counter for end of diagnosis for diagnosis instance SERV_MON_1" UBYTE _CNV_A_R_LINEAR_____1_CM 1 0. 0. 255. DISPLAY_IDENTIFIER CTR_ABC_END_DIAG_SERV_MON_1 ECU_ADDRESS 0x7f9c36 FORMAT "%3.0" /end MEASUREMENT
/begin MEASUREMENT fmy_stat_serv_mon_1.err_info_stat.reserved "" UWORD _CNV_A_R_LINEAR_____0_CM 1 0. 0. 65535. DISPLAY_IDENTIFIER FMY_STAT_SERV_MON_1_ERR_INFO_STAT_RESERVED ECU_ADDRESS 0x7f9c34 BYTE_ORDER MSB_LAST BIT_MASK 0xF800 /end MEASUREMENT
/begin MEASUREMENT fmy_stat_serv_mon_1.err_info_stat.lv_cdn_diag_stc "Statistical flag for condition of diagnosis of the diagnosis instance SERV_MON_1" UWORD _CNV_S_2_RANGE______383_CM 1 0. 0. 1. DISPLAY_IDENTIFIER LV_CDN_DIAG_STC_SERV_MON_1 ECU_ADDRESS 0x7f9c34 BYTE_ORDER MSB_LAST BIT_MASK 0x400 /end MEASUREMENT
/begin MEASUREMENT fmy_stat_serv_mon_1.err_info_stat.lv_lock_diag "lock flag (CPU load optimisation) of the diagnosis instance SERV_MON_1" UWORD _CNV_S_2_RANGE______383_CM 1 0. 0. 1. DISPLAY_IDENTIFIER LV_LOCK_DIAG_SERV_MON_1 ECU_ADDRESS 0x7f9c34 BYTE_ORDER MSB_LAST BIT_MASK 0x200 /end MEASUREMENT
/begin MEASUREMENT fmy_stat_serv_mon_1.err_info_stat.lv_err_mem "storage in dynamic failure memory of the diagnosis instance SERV_MON_1" UWORD _CNV_S_2_RANGE______383_CM 1 0. 0. 1. DISPLAY_IDENTIFIER LV_ERR_MEM_SERV_MON_1 ECU_ADDRESS 0x7f9c34 BYTE_ORDER MSB_LAST BIT_MASK 0x80 /end MEASUREMENT
/begin MEASUREMENT fmy_stat_serv_mon_1.err_info_stat.lv_ready "readiness status of the diagnosis instance SERV_MON_1" UWORD _CNV_S_2_RANGE______383_CM 1 0. 0. 1. DISPLAY_IDENTIFIER LV_READY_SERV_MON_1 ECU_ADDRESS 0x7f9c34 BYTE_ORDER MSB_LAST BIT_MASK 0x40 /end MEASUREMENT
/begin MEASUREMENT fmy_stat_serv_mon_1.err_info_stat.lv_end_diag "end of diagnosis of the diagnosis instance SERV_MON_1" UWORD _CNV_S_2_RANGE______383_CM 1 0. 0. 1. DISPLAY_IDENTIFIER LV_END_DIAG_SERV_MON_1 ECU_ADDRESS 0x7f9c34 BYTE_ORDER MSB_LAST BIT_MASK 0x20 /end MEASUREMENT
/begin MEASUREMENT fmy_stat_serv_mon_1.err_info_stat.lv_cdn_diag "diagnosis condition of the diagnosis instance SERV_MON_1" UWORD _CNV_S_2_RANGE______383_CM 1 0. 0. 1. DISPLAY_IDENTIFIER LV_CDN_DIAG_SERV_MON_1 ECU_ADDRESS 0x7f9c34 BYTE_ORDER MSB_LAST BIT_MASK 0x10 /end MEASUREMENT
/begin MEASUREMENT fmy_stat_serv_mon_1.err_info_stat.err_sym "symptoms of the diagnosis instance SERV_MON_1" UWORD _CNV_S_6_CONV_ERRM__22_CM 1 0. 0. 15. DISPLAY_IDENTIFIER ERR_SYM_SERV_MON_1 ECU_ADDRESS 0x7f9c34 BYTE_ORDER MSB_LAST BIT_MASK 0xF /end MEASUREMENT
/begin MEASUREMENT lv_err_post_inh_mon "Error flag of diagnosis instance POST_INH_MON" UBYTE _CNV_S_2_RANGE______23_CM 1 0. 0. 1. DISPLAY_IDENTIFIER LV_ERR_POST_INH_MON ECU_ADDRESS 0x7fb93e /end MEASUREMENT
/begin MEASUREMENT fmy_stat_post_inh_mon.ctr_abc "anti bounce counter for diagnosis instance POST_INH_MON" UBYTE _CNV_A_R_LINEAR_____1_CM 1 0. 0. 255. DISPLAY_IDENTIFIER CTR_ABC_POST_INH_MON ECU_ADDRESS 0x7f9c3b FORMAT "%3.0" /end MEASUREMENT
/begin MEASUREMENT fmy_stat_post_inh_mon.ctr_end_diag "counter for end of diagnosis for diagnosis instance POST_INH_MON" UBYTE _CNV_A_R_LINEAR_____1_CM 1 0. 0. 255. DISPLAY_IDENTIFIER CTR_ABC_END_DIAG_POST_INH_MON ECU_ADDRESS 0x7f9c3a FORMAT "%3.0" /end MEASUREMENT
/begin MEASUREMENT fmy_stat_post_inh_mon.err_info_stat.reserved "" UWORD _CNV_A_R_LINEAR_____0_CM 1 0. 0. 65535. DISPLAY_IDENTIFIER FMY_STAT_POST_INH_MON_ERR_INFO_STAT_RESERVED ECU_ADDRESS 0x7f9c38 BYTE_ORDER MSB_LAST BIT_MASK 0xF800 /end MEASUREMENT
/begin MEASUREMENT fmy_stat_post_inh_mon.err_info_stat.lv_cdn_diag_stc "Statistical flag for condition of diagnosis of the diagnosis instance POST_INH_MON" UWORD _CNV_S_2_RANGE______383_CM 1 0. 0. 1. DISPLAY_IDENTIFIER LV_CDN_DIAG_STC_POST_INH_MON ECU_ADDRESS 0x7f9c38 BYTE_ORDER MSB_LAST BIT_MASK 0x400 /end MEASUREMENT
/begin MEASUREMENT fmy_stat_post_inh_mon.err_info_stat.lv_lock_diag "lock flag (CPU load optimisation) of the diagnosis instance POST_INH_MON" UWORD _CNV_S_2_RANGE______383_CM 1 0. 0. 1. DISPLAY_IDENTIFIER LV_LOCK_DIAG_POST_INH_MON ECU_ADDRESS 0x7f9c38 BYTE_ORDER MSB_LAST BIT_MASK 0x200 /end MEASUREMENT
/begin MEASUREMENT fmy_stat_post_inh_mon.err_info_stat.lv_err_mem "storage in dynamic failure memory of the diagnosis instance POST_INH_MON" UWORD _CNV_S_2_RANGE______383_CM 1 0. 0. 1. DISPLAY_IDENTIFIER LV_ERR_MEM_POST_INH_MON ECU_ADDRESS 0x7f9c38 BYTE_ORDER MSB_LAST BIT_MASK 0x80 /end MEASUREMENT
/begin MEASUREMENT fmy_stat_post_inh_mon.err_info_stat.lv_ready "readiness status of the diagnosis instance POST_INH_MON" UWORD _CNV_S_2_RANGE______383_CM 1 0. 0. 1. DISPLAY_IDENTIFIER LV_READY_POST_INH_MON ECU_ADDRESS 0x7f9c38 BYTE_ORDER MSB_LAST BIT_MASK 0x40 /end MEASUREMENT
/begin MEASUREMENT fmy_stat_post_inh_mon.err_info_stat.lv_end_diag "end of diagnosis of the diagnosis instance POST_INH_MON" UWORD _CNV_S_2_RANGE______383_CM 1 0. 0. 1. DISPLAY_IDENTIFIER LV_END_DIAG_POST_INH_MON ECU_ADDRESS 0x7f9c38 BYTE_ORDER MSB_LAST BIT_MASK 0x20 /end MEASUREMENT
/begin MEASUREMENT fmy_stat_post_inh_mon.err_info_stat.lv_cdn_diag "diagnosis condition of the diagnosis instance POST_INH_MON" UWORD _CNV_S_2_RANGE______383_CM 1 0. 0. 1. DISPLAY_IDENTIFIER LV_CDN_DIAG_POST_INH_MON ECU_ADDRESS 0x7f9c38 BYTE_ORDER MSB_LAST BIT_MASK 0x10 /end MEASUREMENT
/begin MEASUREMENT fmy_stat_post_inh_mon.err_info_stat.err_sym "symptoms of the diagnosis instance POST_INH_MON" UWORD _CNV_S_6_CONV_ERRM__22_CM 1 0. 0. 15. DISPLAY_IDENTIFIER ERR_SYM_POST_INH_MON ECU_ADDRESS 0x7f9c38 BYTE_ORDER MSB_LAST BIT_MASK 0xF /end MEASUREMENT
/begin MEASUREMENT lv_err_cru_inh_mon "Error flag of diagnosis instance CRU_INH_MON" UBYTE _CNV_S_2_RANGE______23_CM 1 0. 0. 1. DISPLAY_IDENTIFIER LV_ERR_CRU_INH_MON ECU_ADDRESS 0x7fb93f /end MEASUREMENT
/begin MEASUREMENT fmy_stat_cru_inh_mon.ctr_abc "anti bounce counter for diagnosis instance CRU_INH_MON" UBYTE _CNV_A_R_LINEAR_____1_CM 1 0. 0. 255. DISPLAY_IDENTIFIER CTR_ABC_CRU_INH_MON ECU_ADDRESS 0x7f9c3f FORMAT "%3.0" /end MEASUREMENT
/begin MEASUREMENT fmy_stat_cru_inh_mon.ctr_end_diag "counter for end of diagnosis for diagnosis instance CRU_INH_MON" UBYTE _CNV_A_R_LINEAR_____1_CM 1 0. 0. 255. DISPLAY_IDENTIFIER CTR_ABC_END_DIAG_CRU_INH_MON ECU_ADDRESS 0x7f9c3e FORMAT "%3.0" /end MEASUREMENT
/begin MEASUREMENT fmy_stat_cru_inh_mon.err_info_stat.reserved "" UWORD _CNV_A_R_LINEAR_____0_CM 1 0. 0. 65535. DISPLAY_IDENTIFIER FMY_STAT_CRU_INH_MON_ERR_INFO_STAT_RESERVED ECU_ADDRESS 0x7f9c3c BYTE_ORDER MSB_LAST BIT_MASK 0xF800 /end MEASUREMENT
/begin MEASUREMENT fmy_stat_cru_inh_mon.err_info_stat.lv_cdn_diag_stc "Statistical flag for condition of diagnosis of the diagnosis instance CRU_INH_MON" UWORD _CNV_S_2_RANGE______383_CM 1 0. 0. 1. DISPLAY_IDENTIFIER LV_CDN_DIAG_STC_CRU_INH_MON ECU_ADDRESS 0x7f9c3c BYTE_ORDER MSB_LAST BIT_MASK 0x400 /end MEASUREMENT
/begin MEASUREMENT fmy_stat_cru_inh_mon.err_info_stat.lv_lock_diag "lock flag (CPU load optimisation) of the diagnosis instance CRU_INH_MON" UWORD _CNV_S_2_RANGE______383_CM 1 0. 0. 1. DISPLAY_IDENTIFIER LV_LOCK_DIAG_CRU_INH_MON ECU_ADDRESS 0x7f9c3c BYTE_ORDER MSB_LAST BIT_MASK 0x200 /end MEASUREMENT
/begin MEASUREMENT fmy_stat_cru_inh_mon.err_info_stat.lv_err_mem "storage in dynamic failure memory of the diagnosis instance CRU_INH_MON" UWORD _CNV_S_2_RANGE______383_CM 1 0. 0. 1. DISPLAY_IDENTIFIER LV_ERR_MEM_CRU_INH_MON ECU_ADDRESS 0x7f9c3c BYTE_ORDER MSB_LAST BIT_MASK 0x80 /end MEASUREMENT
/begin MEASUREMENT fmy_stat_cru_inh_mon.err_info_stat.lv_ready "readiness status of the diagnosis instance CRU_INH_MON" UWORD _CNV_S_2_RANGE______383_CM 1 0. 0. 1. DISPLAY_IDENTIFIER LV_READY_CRU_INH_MON ECU_ADDRESS 0x7f9c3c BYTE_ORDER MSB_LAST BIT_MASK 0x40 /end MEASUREMENT
/begin MEASUREMENT fmy_stat_cru_inh_mon.err_info_stat.lv_end_diag "end of diagnosis of the diagnosis instance CRU_INH_MON" UWORD _CNV_S_2_RANGE______383_CM 1 0. 0. 1. DISPLAY_IDENTIFIER LV_END_DIAG_CRU_INH_MON ECU_ADDRESS 0x7f9c3c BYTE_ORDER MSB_LAST BIT_MASK 0x20 /end MEASUREMENT
/begin MEASUREMENT fmy_stat_cru_inh_mon.err_info_stat.lv_cdn_diag "diagnosis condition of the diagnosis instance CRU_INH_MON" UWORD _CNV_S_2_RANGE______383_CM 1 0. 0. 1. DISPLAY_IDENTIFIER LV_CDN_DIAG_CRU_INH_MON ECU_ADDRESS 0x7f9c3c BYTE_ORDER MSB_LAST BIT_MASK 0x10 /end MEASUREMENT
/begin MEASUREMENT fmy_stat_cru_inh_mon.err_info_stat.err_sym "symptoms of the diagnosis instance CRU_INH_MON" UWORD _CNV_S_6_CONV_ERRM__22_CM 1 0. 0. 15. DISPLAY_IDENTIFIER ERR_SYM_CRU_INH_MON ECU_ADDRESS 0x7f9c3c BYTE_ORDER MSB_LAST BIT_MASK 0xF /end MEASUREMENT
/begin MEASUREMENT lv_err_can_inh_mon "Error flag of diagnosis instance CAN_INH_MON" UBYTE _CNV_S_2_RANGE______23_CM 1 0. 0. 1. DISPLAY_IDENTIFIER LV_ERR_CAN_INH_MON ECU_ADDRESS 0x7fb940 /end MEASUREMENT
/begin MEASUREMENT fmy_stat_can_inh_mon.ctr_abc "anti bounce counter for diagnosis instance CAN_INH_MON" UBYTE _CNV_A_R_LINEAR_____1_CM 1 0. 0. 255. DISPLAY_IDENTIFIER CTR_ABC_CAN_INH_MON ECU_ADDRESS 0x7f9c43 FORMAT "%3.0" /end MEASUREMENT
/begin MEASUREMENT fmy_stat_can_inh_mon.ctr_end_diag "counter for end of diagnosis for diagnosis instance CAN_INH_MON" UBYTE _CNV_A_R_LINEAR_____1_CM 1 0. 0. 255. DISPLAY_IDENTIFIER CTR_ABC_END_DIAG_CAN_INH_MON ECU_ADDRESS 0x7f9c42 FORMAT "%3.0" /end MEASUREMENT
/begin MEASUREMENT fmy_stat_can_inh_mon.err_info_stat.reserved "" UWORD _CNV_A_R_LINEAR_____0_CM 1 0. 0. 65535. DISPLAY_IDENTIFIER FMY_STAT_CAN_INH_MON_ERR_INFO_STAT_RESERVED ECU_ADDRESS 0x7f9c40 BYTE_ORDER MSB_LAST BIT_MASK 0xF800 /end MEASUREMENT
/begin MEASUREMENT fmy_stat_can_inh_mon.err_info_stat.lv_cdn_diag_stc "Statistical flag for condition of diagnosis of the diagnosis instance CAN_INH_MON" UWORD _CNV_S_2_RANGE______383_CM 1 0. 0. 1. DISPLAY_IDENTIFIER LV_CDN_DIAG_STC_CAN_INH_MON ECU_ADDRESS 0x7f9c40 BYTE_ORDER MSB_LAST BIT_MASK 0x400 /end MEASUREMENT
/begin MEASUREMENT fmy_stat_can_inh_mon.err_info_stat.lv_lock_diag "lock flag (CPU load optimisation) of the diagnosis instance CAN_INH_MON" UWORD _CNV_S_2_RANGE______383_CM 1 0. 0. 1. DISPLAY_IDENTIFIER LV_LOCK_DIAG_CAN_INH_MON ECU_ADDRESS 0x7f9c40 BYTE_ORDER MSB_LAST BIT_MASK 0x200 /end MEASUREMENT
/begin MEASUREMENT fmy_stat_can_inh_mon.err_info_stat.lv_err_mem "storage in dynamic failure memory of the diagnosis instance CAN_INH_MON" UWORD _CNV_S_2_RANGE______383_CM 1 0. 0. 1. DISPLAY_IDENTIFIER LV_ERR_MEM_CAN_INH_MON ECU_ADDRESS 0x7f9c40 BYTE_ORDER MSB_LAST BIT_MASK 0x80 /end MEASUREMENT
/begin MEASUREMENT fmy_stat_can_inh_mon.err_info_stat.lv_ready "readiness status of the diagnosis instance CAN_INH_MON" UWORD _CNV_S_2_RANGE______383_CM 1 0. 0. 1. DISPLAY_IDENTIFIER LV_READY_CAN_INH_MON ECU_ADDRESS 0x7f9c40 BYTE_ORDER MSB_LAST BIT_MASK 0x40 /end MEASUREMENT
/begin MEASUREMENT fmy_stat_can_inh_mon.err_info_stat.lv_end_diag "end of diagnosis of the diagnosis instance CAN_INH_MON" UWORD _CNV_S_2_RANGE______383_CM 1 0. 0. 1. DISPLAY_IDENTIFIER LV_END_DIAG_CAN_INH_MON ECU_ADDRESS 0x7f9c40 BYTE_ORDER MSB_LAST BIT_MASK 0x20 /end MEASUREMENT
/begin MEASUREMENT fmy_stat_can_inh_mon.err_info_stat.lv_cdn_diag "diagnosis condition of the diagnosis instance CAN_INH_MON" UWORD _CNV_S_2_RANGE______383_CM 1 0. 0. 1. DISPLAY_IDENTIFIER LV_CDN_DIAG_CAN_INH_MON ECU_ADDRESS 0x7f9c40 BYTE_ORDER MSB_LAST BIT_MASK 0x10 /end MEASUREMENT
/begin MEASUREMENT fmy_stat_can_inh_mon.err_info_stat.err_sym "symptoms of the diagnosis instance CAN_INH_MON" UWORD _CNV_S_6_CONV_ERRM__22_CM 1 0. 0. 15. DISPLAY_IDENTIFIER ERR_SYM_CAN_INH_MON ECU_ADDRESS 0x7f9c40 BYTE_ORDER MSB_LAST BIT_MASK 0xF /end MEASUREMENT
/begin MEASUREMENT lv_err_mon_3 "Error flag of diagnosis instance MON_3" UBYTE _CNV_S_2_RANGE______23_CM 1 0. 0. 1. DISPLAY_IDENTIFIER LV_ERR_MON_3 ECU_ADDRESS 0x7fb941 /end MEASUREMENT
/begin MEASUREMENT fmy_stat_mon_3.ctr_abc "anti bounce counter for diagnosis instance MON_3" UBYTE _CNV_A_R_LINEAR_____1_CM 1 0. 0. 255. DISPLAY_IDENTIFIER CTR_ABC_MON_3 ECU_ADDRESS 0x7f9c47 FORMAT "%3.0" /end MEASUREMENT
/begin MEASUREMENT fmy_stat_mon_3.ctr_end_diag "counter for end of diagnosis for diagnosis instance MON_3" UBYTE _CNV_A_R_LINEAR_____1_CM 1 0. 0. 255. DISPLAY_IDENTIFIER CTR_ABC_END_DIAG_MON_3 ECU_ADDRESS 0x7f9c46 FORMAT "%3.0" /end MEASUREMENT
/begin MEASUREMENT fmy_stat_mon_3.err_info_stat.reserved "" UWORD _CNV_A_R_LINEAR_____0_CM 1 0. 0. 65535. DISPLAY_IDENTIFIER FMY_STAT_MON_3_ERR_INFO_STAT_RESERVED ECU_ADDRESS 0x7f9c44 BYTE_ORDER MSB_LAST BIT_MASK 0xF800 /end MEASUREMENT
/begin MEASUREMENT fmy_stat_mon_3.err_info_stat.lv_cdn_diag_stc "Statistical flag for condition of diagnosis of the diagnosis instance MON_3" UWORD _CNV_S_2_RANGE______383_CM 1 0. 0. 1. DISPLAY_IDENTIFIER LV_CDN_DIAG_STC_MON_3 ECU_ADDRESS 0x7f9c44 BYTE_ORDER MSB_LAST BIT_MASK 0x400 /end MEASUREMENT
/begin MEASUREMENT fmy_stat_mon_3.err_info_stat.lv_lock_diag "lock flag (CPU load optimisation) of the diagnosis instance MON_3" UWORD _CNV_S_2_RANGE______383_CM 1 0. 0. 1. DISPLAY_IDENTIFIER LV_LOCK_DIAG_MON_3 ECU_ADDRESS 0x7f9c44 BYTE_ORDER MSB_LAST BIT_MASK 0x200 /end MEASUREMENT
/begin MEASUREMENT fmy_stat_mon_3.err_info_stat.lv_err_mem "storage in dynamic failure memory of the diagnosis instance MON_3" UWORD _CNV_S_2_RANGE______383_CM 1 0. 0. 1. DISPLAY_IDENTIFIER LV_ERR_MEM_MON_3 ECU_ADDRESS 0x7f9c44 BYTE_ORDER MSB_LAST BIT_MASK 0x80 /end MEASUREMENT
/begin MEASUREMENT fmy_stat_mon_3.err_info_stat.lv_ready "readiness status of the diagnosis instance MON_3" UWORD _CNV_S_2_RANGE______383_CM 1 0. 0. 1. DISPLAY_IDENTIFIER LV_READY_MON_3 ECU_ADDRESS 0x7f9c44 BYTE_ORDER MSB_LAST BIT_MASK 0x40 /end MEASUREMENT
/begin MEASUREMENT fmy_stat_mon_3.err_info_stat.lv_end_diag "end of diagnosis of the diagnosis instance MON_3" UWORD _CNV_S_2_RANGE______383_CM 1 0. 0. 1. DISPLAY_IDENTIFIER LV_END_DIAG_MON_3 ECU_ADDRESS 0x7f9c44 BYTE_ORDER MSB_LAST BIT_MASK 0x20 /end MEASUREMENT
/begin MEASUREMENT fmy_stat_mon_3.err_info_stat.lv_cdn_diag "diagnosis condition of the diagnosis instance MON_3" UWORD _CNV_S_2_RANGE______383_CM 1 0. 0. 1. DISPLAY_IDENTIFIER LV_CDN_DIAG_MON_3 ECU_ADDRESS 0x7f9c44 BYTE_ORDER MSB_LAST BIT_MASK 0x10 /end MEASUREMENT
/begin MEASUREMENT fmy_stat_mon_3.err_info_stat.err_sym "symptoms of the diagnosis instance MON_3" UWORD _CNV_S_6_CONV_ERRM__22_CM 1 0. 0. 15. DISPLAY_IDENTIFIER ERR_SYM_MON_3 ECU_ADDRESS 0x7f9c44 BYTE_ORDER MSB_LAST BIT_MASK 0xF /end MEASUREMENT
/begin MEASUREMENT fmy_stat_per_cam_in_1.ctr_abc "anti bounce counter for diagnosis instance PER_CAM_IN_1" UBYTE _CNV_A_R_LINEAR_____1_CM 1 0. 0. 255. DISPLAY_IDENTIFIER CTR_ABC_PER_CAM_IN_1 ECU_ADDRESS 0x7f9c4b FORMAT "%3.0" /end MEASUREMENT
/begin MEASUREMENT fmy_stat_per_cam_in_1.ctr_end_diag "counter for end of diagnosis for diagnosis instance PER_CAM_IN_1" UBYTE _CNV_A_R_LINEAR_____1_CM 1 0. 0. 255. DISPLAY_IDENTIFIER CTR_ABC_END_DIAG_PER_CAM_IN_1 ECU_ADDRESS 0x7f9c4a FORMAT "%3.0" /end MEASUREMENT
/begin MEASUREMENT fmy_stat_per_cam_in_1.err_info_stat.reserved "" UWORD _CNV_A_R_LINEAR_____0_CM 1 0. 0. 65535. DISPLAY_IDENTIFIER FMY_STAT_PER_CAM_IN_1_ERR_INFO_STAT_RESERVED ECU_ADDRESS 0x7f9c48 BYTE_ORDER MSB_LAST BIT_MASK 0xF800 /end MEASUREMENT
/begin MEASUREMENT fmy_stat_per_cam_in_1.err_info_stat.lv_cdn_diag_stc "Statistical flag for condition of diagnosis of the diagnosis instance PER_CAM_IN_1" UWORD _CNV_S_2_RANGE______383_CM 1 0. 0. 1. DISPLAY_IDENTIFIER LV_CDN_DIAG_STC_PER_CAM_IN_1 ECU_ADDRESS 0x7f9c48 BYTE_ORDER MSB_LAST BIT_MASK 0x400 /end MEASUREMENT
/begin MEASUREMENT fmy_stat_per_cam_in_1.err_info_stat.lv_lock_diag "lock flag (CPU load optimisation) of the diagnosis instance PER_CAM_IN_1" UWORD _CNV_S_2_RANGE______383_CM 1 0. 0. 1. DISPLAY_IDENTIFIER LV_LOCK_DIAG_PER_CAM_IN_1 ECU_ADDRESS 0x7f9c48 BYTE_ORDER MSB_LAST BIT_MASK 0x200 /end MEASUREMENT
/begin MEASUREMENT fmy_stat_per_cam_in_1.err_info_stat.lv_err_mem "storage in dynamic failure memory of the diagnosis instance PER_CAM_IN_1" UWORD _CNV_S_2_RANGE______383_CM 1 0. 0. 1. DISPLAY_IDENTIFIER LV_ERR_MEM_PER_CAM_IN_1 ECU_ADDRESS 0x7f9c48 BYTE_ORDER MSB_LAST BIT_MASK 0x80 /end MEASUREMENT
/begin MEASUREMENT fmy_stat_per_cam_in_1.err_info_stat.lv_ready "readiness status of the diagnosis instance PER_CAM_IN_1" UWORD _CNV_S_2_RANGE______383_CM 1 0. 0. 1. DISPLAY_IDENTIFIER LV_READY_PER_CAM_IN_1 ECU_ADDRESS 0x7f9c48 BYTE_ORDER MSB_LAST BIT_MASK 0x40 /end MEASUREMENT
/begin MEASUREMENT fmy_stat_per_cam_in_1.err_info_stat.lv_end_diag "end of diagnosis of the diagnosis instance PER_CAM_IN_1" UWORD _CNV_S_2_RANGE______383_CM 1 0. 0. 1. DISPLAY_IDENTIFIER LV_END_DIAG_PER_CAM_IN_1 ECU_ADDRESS 0x7f9c48 BYTE_ORDER MSB_LAST BIT_MASK 0x20 /end MEASUREMENT
/begin MEASUREMENT fmy_stat_per_cam_in_1.err_info_stat.lv_cdn_diag "diagnosis condition of the diagnosis instance PER_CAM_IN_1" UWORD _CNV_S_2_RANGE______383_CM 1 0. 0. 1. DISPLAY_IDENTIFIER LV_CDN_DIAG_PER_CAM_IN_1 ECU_ADDRESS 0x7f9c48 BYTE_ORDER MSB_LAST BIT_MASK 0x10 /end MEASUREMENT
/begin MEASUREMENT fmy_stat_per_cam_in_1.err_info_stat.err_sym "symptoms of the diagnosis instance PER_CAM_IN_1" UWORD _CNV_S_6_CONV_ERRM__22_CM 1 0. 0. 15. DISPLAY_IDENTIFIER ERR_SYM_PER_CAM_IN_1 ECU_ADDRESS 0x7f9c48 BYTE_ORDER MSB_LAST BIT_MASK 0xF /end MEASUREMENT
/begin MEASUREMENT fmy_stat_syn_cam_in_1.ctr_abc "anti bounce counter for diagnosis instance SYN_CAM_IN_1" UBYTE _CNV_A_R_LINEAR_____1_CM 1 0. 0. 255. DISPLAY_IDENTIFIER CTR_ABC_SYN_CAM_IN_1 ECU_ADDRESS 0x7f9c4f FORMAT "%3.0" /end MEASUREMENT
/begin MEASUREMENT fmy_stat_syn_cam_in_1.ctr_end_diag "counter for end of diagnosis for diagnosis instance SYN_CAM_IN_1" UBYTE _CNV_A_R_LINEAR_____1_CM 1 0. 0. 255. DISPLAY_IDENTIFIER CTR_ABC_END_DIAG_SYN_CAM_IN_1 ECU_ADDRESS 0x7f9c4e FORMAT "%3.0" /end MEASUREMENT
/begin MEASUREMENT fmy_stat_syn_cam_in_1.err_info_stat.reserved "" UWORD _CNV_A_R_LINEAR_____0_CM 1 0. 0. 65535. DISPLAY_IDENTIFIER FMY_STAT_SYN_CAM_IN_1_ERR_INFO_STAT_RESERVED ECU_ADDRESS 0x7f9c4c BYTE_ORDER MSB_LAST BIT_MASK 0xF800 /end MEASUREMENT
/begin MEASUREMENT fmy_stat_syn_cam_in_1.err_info_stat.lv_cdn_diag_stc "Statistical flag for condition of diagnosis of the diagnosis instance SYN_CAM_IN_1" UWORD _CNV_S_2_RANGE______383_CM 1 0. 0. 1. DISPLAY_IDENTIFIER LV_CDN_DIAG_STC_SYN_CAM_IN_1 ECU_ADDRESS 0x7f9c4c BYTE_ORDER MSB_LAST BIT_MASK 0x400 /end MEASUREMENT
/begin MEASUREMENT fmy_stat_syn_cam_in_1.err_info_stat.lv_lock_diag "lock flag (CPU load optimisation) of the diagnosis instance SYN_CAM_IN_1" UWORD _CNV_S_2_RANGE______383_CM 1 0. 0. 1. DISPLAY_IDENTIFIER LV_LOCK_DIAG_SYN_CAM_IN_1 ECU_ADDRESS 0x7f9c4c BYTE_ORDER MSB_LAST BIT_MASK 0x200 /end MEASUREMENT
/begin MEASUREMENT fmy_stat_syn_cam_in_1.err_info_stat.lv_err_mem "storage in dynamic failure memory of the diagnosis instance SYN_CAM_IN_1" UWORD _CNV_S_2_RANGE______383_CM 1 0. 0. 1. DISPLAY_IDENTIFIER LV_ERR_MEM_SYN_CAM_IN_1 ECU_ADDRESS 0x7f9c4c BYTE_ORDER MSB_LAST BIT_MASK 0x80 /end MEASUREMENT
/begin MEASUREMENT fmy_stat_syn_cam_in_1.err_info_stat.lv_ready "readiness status of the diagnosis instance SYN_CAM_IN_1" UWORD _CNV_S_2_RANGE______383_CM 1 0. 0. 1. DISPLAY_IDENTIFIER LV_READY_SYN_CAM_IN_1 ECU_ADDRESS 0x7f9c4c BYTE_ORDER MSB_LAST BIT_MASK 0x40 /end MEASUREMENT
/begin MEASUREMENT fmy_stat_syn_cam_in_1.err_info_stat.lv_end_diag "end of diagnosis of the diagnosis instance SYN_CAM_IN_1" UWORD _CNV_S_2_RANGE______383_CM 1 0. 0. 1. DISPLAY_IDENTIFIER LV_END_DIAG_SYN_CAM_IN_1 ECU_ADDRESS 0x7f9c4c BYTE_ORDER MSB_LAST BIT_MASK 0x20 /end MEASUREMENT
/begin MEASUREMENT fmy_stat_syn_cam_in_1.err_info_stat.lv_cdn_diag "diagnosis condition of the diagnosis instance SYN_CAM_IN_1" UWORD _CNV_S_2_RANGE______383_CM 1 0. 0. 1. DISPLAY_IDENTIFIER LV_CDN_DIAG_SYN_CAM_IN_1 ECU_ADDRESS 0x7f9c4c BYTE_ORDER MSB_LAST BIT_MASK 0x10 /end MEASUREMENT
/begin MEASUREMENT fmy_stat_syn_cam_in_1.err_info_stat.err_sym "symptoms of the diagnosis instance SYN_CAM_IN_1" UWORD _CNV_S_6_CONV_ERRM__22_CM 1 0. 0. 15. DISPLAY_IDENTIFIER ERR_SYM_SYN_CAM_IN_1 ECU_ADDRESS 0x7f9c4c BYTE_ORDER MSB_LAST BIT_MASK 0xF /end MEASUREMENT
/begin MEASUREMENT fmy_stat_ref_crk_cam_in_1.ctr_abc "anti bounce counter for diagnosis instance REF_CRK_CAM_IN_1" UBYTE _CNV_A_R_LINEAR_____1_CM 1 0. 0. 255. DISPLAY_IDENTIFIER CTR_ABC_REF_CRK_CAM_IN_1 ECU_ADDRESS 0x7f9c53 FORMAT "%3.0" /end MEASUREMENT
/begin MEASUREMENT fmy_stat_ref_crk_cam_in_1.ctr_end_diag "counter for end of diagnosis for diagnosis instance REF_CRK_CAM_IN_1" UBYTE _CNV_A_R_LINEAR_____1_CM 1 0. 0. 255. DISPLAY_IDENTIFIER CTR_ABC_END_DIAG_REF_CRK_CAM_IN_1 ECU_ADDRESS 0x7f9c52 FORMAT "%3.0" /end MEASUREMENT
/begin MEASUREMENT fmy_stat_ref_crk_cam_in_1.err_info_stat.reserved "" UWORD _CNV_A_R_LINEAR_____0_CM 1 0. 0. 65535. DISPLAY_IDENTIFIER FMY_STAT_REF_CRK_CAM_IN_1_ERR_INFO_STAT_RESERVED ECU_ADDRESS 0x7f9c50 BYTE_ORDER MSB_LAST BIT_MASK 0xF800 /end MEASUREMENT
/begin MEASUREMENT fmy_stat_ref_crk_cam_in_1.err_info_stat.lv_cdn_diag_stc "Statistical flag for condition of diagnosis of the diagnosis instance REF_CRK_CAM_IN_1" UWORD _CNV_S_2_RANGE______383_CM 1 0. 0. 1. DISPLAY_IDENTIFIER LV_CDN_DIAG_STC_REF_CRK_CAM_IN_1 ECU_ADDRESS 0x7f9c50 BYTE_ORDER MSB_LAST BIT_MASK 0x400 /end MEASUREMENT
/begin MEASUREMENT fmy_stat_ref_crk_cam_in_1.err_info_stat.lv_lock_diag "lock flag (CPU load optimisation) of the diagnosis instance REF_CRK_CAM_IN_1" UWORD _CNV_S_2_RANGE______383_CM 1 0. 0. 1. DISPLAY_IDENTIFIER LV_LOCK_DIAG_REF_CRK_CAM_IN_1 ECU_ADDRESS 0x7f9c50 BYTE_ORDER MSB_LAST BIT_MASK 0x200 /end MEASUREMENT
/begin MEASUREMENT fmy_stat_ref_crk_cam_in_1.err_info_stat.lv_err_mem "storage in dynamic failure memory of the diagnosis instance REF_CRK_CAM_IN_1" UWORD _CNV_S_2_RANGE______383_CM 1 0. 0. 1. DISPLAY_IDENTIFIER LV_ERR_MEM_REF_CRK_CAM_IN_1 ECU_ADDRESS 0x7f9c50 BYTE_ORDER MSB_LAST BIT_MASK 0x80 /end MEASUREMENT
/begin MEASUREMENT fmy_stat_ref_crk_cam_in_1.err_info_stat.lv_ready "readiness status of the diagnosis instance REF_CRK_CAM_IN_1" UWORD _CNV_S_2_RANGE______383_CM 1 0. 0. 1. DISPLAY_IDENTIFIER LV_READY_REF_CRK_CAM_IN_1 ECU_ADDRESS 0x7f9c50 BYTE_ORDER MSB_LAST BIT_MASK 0x40 /end MEASUREMENT
/begin MEASUREMENT fmy_stat_ref_crk_cam_in_1.err_info_stat.lv_end_diag "end of diagnosis of the diagnosis instance REF_CRK_CAM_IN_1" UWORD _CNV_S_2_RANGE______383_CM 1 0. 0. 1. DISPLAY_IDENTIFIER LV_END_DIAG_REF_CRK_CAM_IN_1 ECU_ADDRESS 0x7f9c50 BYTE_ORDER MSB_LAST BIT_MASK 0x20 /end MEASUREMENT
/begin MEASUREMENT fmy_stat_ref_crk_cam_in_1.err_info_stat.lv_cdn_diag "diagnosis condition of the diagnosis instance REF_CRK_CAM_IN_1" UWORD _CNV_S_2_RANGE______383_CM 1 0. 0. 1. DISPLAY_IDENTIFIER LV_CDN_DIAG_REF_CRK_CAM_IN_1 ECU_ADDRESS 0x7f9c50 BYTE_ORDER MSB_LAST BIT_MASK 0x10 /end MEASUREMENT
/begin MEASUREMENT fmy_stat_ref_crk_cam_in_1.err_info_stat.err_sym "symptoms of the diagnosis instance REF_CRK_CAM_IN_1" UWORD _CNV_S_6_CONV_ERRM__22_CM 1 0. 0. 15. DISPLAY_IDENTIFIER ERR_SYM_REF_CRK_CAM_IN_1 ECU_ADDRESS 0x7f9c50 BYTE_ORDER MSB_LAST BIT_MASK 0xF /end MEASUREMENT
/begin MEASUREMENT fmy_stat_crk_tooth.ctr_abc "anti bounce counter for diagnosis instance CRK_TOOTH" UBYTE _CNV_A_R_LINEAR_____1_CM 1 0. 0. 255. DISPLAY_IDENTIFIER CTR_ABC_CRK_TOOTH ECU_ADDRESS 0x7f9c57 FORMAT "%3.0" /end MEASUREMENT
/begin MEASUREMENT fmy_stat_crk_tooth.ctr_end_diag "counter for end of diagnosis for diagnosis instance CRK_TOOTH" UBYTE _CNV_A_R_LINEAR_____1_CM 1 0. 0. 255. DISPLAY_IDENTIFIER CTR_ABC_END_DIAG_CRK_TOOTH ECU_ADDRESS 0x7f9c56 FORMAT "%3.0" /end MEASUREMENT
/begin MEASUREMENT fmy_stat_crk_tooth.err_info_stat.reserved "" UWORD _CNV_A_R_LINEAR_____0_CM 1 0. 0. 65535. DISPLAY_IDENTIFIER FMY_STAT_CRK_TOOTH_ERR_INFO_STAT_RESERVED ECU_ADDRESS 0x7f9c54 BYTE_ORDER MSB_LAST BIT_MASK 0xF800 /end MEASUREMENT
/begin MEASUREMENT fmy_stat_crk_tooth.err_info_stat.lv_cdn_diag_stc "Statistical flag for condition of diagnosis of the diagnosis instance CRK_TOOTH" UWORD _CNV_S_2_RANGE______383_CM 1 0. 0. 1. DISPLAY_IDENTIFIER LV_CDN_DIAG_STC_CRK_TOOTH ECU_ADDRESS 0x7f9c54 BYTE_ORDER MSB_LAST BIT_MASK 0x400 /end MEASUREMENT
/begin MEASUREMENT fmy_stat_crk_tooth.err_info_stat.lv_lock_diag "lock flag (CPU load optimisation) of the diagnosis instance CRK_TOOTH" UWORD _CNV_S_2_RANGE______383_CM 1 0. 0. 1. DISPLAY_IDENTIFIER LV_LOCK_DIAG_CRK_TOOTH ECU_ADDRESS 0x7f9c54 BYTE_ORDER MSB_LAST BIT_MASK 0x200 /end MEASUREMENT
/begin MEASUREMENT fmy_stat_crk_tooth.err_info_stat.lv_err_mem "storage in dynamic failure memory of the diagnosis instance CRK_TOOTH" UWORD _CNV_S_2_RANGE______383_CM 1 0. 0. 1. DISPLAY_IDENTIFIER LV_ERR_MEM_CRK_TOOTH ECU_ADDRESS 0x7f9c54 BYTE_ORDER MSB_LAST BIT_MASK 0x80 /end MEASUREMENT
/begin MEASUREMENT fmy_stat_crk_tooth.err_info_stat.lv_ready "readiness status of the diagnosis instance CRK_TOOTH" UWORD _CNV_S_2_RANGE______383_CM 1 0. 0. 1. DISPLAY_IDENTIFIER LV_READY_CRK_TOOTH ECU_ADDRESS 0x7f9c54 BYTE_ORDER MSB_LAST BIT_MASK 0x40 /end MEASUREMENT
/begin MEASUREMENT fmy_stat_crk_tooth.err_info_stat.lv_end_diag "end of diagnosis of the diagnosis instance CRK_TOOTH" UWORD _CNV_S_2_RANGE______383_CM 1 0. 0. 1. DISPLAY_IDENTIFIER LV_END_DIAG_CRK_TOOTH ECU_ADDRESS 0x7f9c54 BYTE_ORDER MSB_LAST BIT_MASK 0x20 /end MEASUREMENT
/begin MEASUREMENT fmy_stat_crk_tooth.err_info_stat.lv_cdn_diag "diagnosis condition of the diagnosis instance CRK_TOOTH" UWORD _CNV_S_2_RANGE______383_CM 1 0. 0. 1. DISPLAY_IDENTIFIER LV_CDN_DIAG_CRK_TOOTH ECU_ADDRESS 0x7f9c54 BYTE_ORDER MSB_LAST BIT_MASK 0x10 /end MEASUREMENT
/begin MEASUREMENT fmy_stat_crk_tooth.err_info_stat.err_sym "symptoms of the diagnosis instance CRK_TOOTH" UWORD _CNV_S_6_CONV_ERRM__22_CM 1 0. 0. 15. DISPLAY_IDENTIFIER ERR_SYM_CRK_TOOTH ECU_ADDRESS 0x7f9c54 BYTE_ORDER MSB_LAST BIT_MASK 0xF /end MEASUREMENT
/begin MEASUREMENT fmy_stat_crk_tooth_per.ctr_abc "anti bounce counter for diagnosis instance CRK_TOOTH_PER" UBYTE _CNV_A_R_LINEAR_____1_CM 1 0. 0. 255. DISPLAY_IDENTIFIER CTR_ABC_CRK_TOOTH_PER ECU_ADDRESS 0x7f9c5b FORMAT "%3.0" /end MEASUREMENT
/begin MEASUREMENT fmy_stat_crk_tooth_per.ctr_end_diag "counter for end of diagnosis for diagnosis instance CRK_TOOTH_PER" UBYTE _CNV_A_R_LINEAR_____1_CM 1 0. 0. 255. DISPLAY_IDENTIFIER CTR_ABC_END_DIAG_CRK_TOOTH_PER ECU_ADDRESS 0x7f9c5a FORMAT "%3.0" /end MEASUREMENT
/begin MEASUREMENT fmy_stat_crk_tooth_per.err_info_stat.reserved "" UWORD _CNV_A_R_LINEAR_____0_CM 1 0. 0. 65535. DISPLAY_IDENTIFIER FMY_STAT_CRK_TOOTH_PER_ERR_INFO_STAT_RESERVED ECU_ADDRESS 0x7f9c58 BYTE_ORDER MSB_LAST BIT_MASK 0xF800 /end MEASUREMENT
/begin MEASUREMENT fmy_stat_crk_tooth_per.err_info_stat.lv_cdn_diag_stc "Statistical flag for condition of diagnosis of the diagnosis instance CRK_TOOTH_PER" UWORD _CNV_S_2_RANGE______383_CM 1 0. 0. 1. DISPLAY_IDENTIFIER LV_CDN_DIAG_STC_CRK_TOOTH_PER ECU_ADDRESS 0x7f9c58 BYTE_ORDER MSB_LAST BIT_MASK 0x400 /end MEASUREMENT
/begin MEASUREMENT fmy_stat_crk_tooth_per.err_info_stat.lv_lock_diag "lock flag (CPU load optimisation) of the diagnosis instance CRK_TOOTH_PER" UWORD _CNV_S_2_RANGE______383_CM 1 0. 0. 1. DISPLAY_IDENTIFIER LV_LOCK_DIAG_CRK_TOOTH_PER ECU_ADDRESS 0x7f9c58 BYTE_ORDER MSB_LAST BIT_MASK 0x200 /end MEASUREMENT
/begin MEASUREMENT fmy_stat_crk_tooth_per.err_info_stat.lv_err_mem "storage in dynamic failure memory of the diagnosis instance CRK_TOOTH_PER" UWORD _CNV_S_2_RANGE______383_CM 1 0. 0. 1. DISPLAY_IDENTIFIER LV_ERR_MEM_CRK_TOOTH_PER ECU_ADDRESS 0x7f9c58 BYTE_ORDER MSB_LAST BIT_MASK 0x80 /end MEASUREMENT
/begin MEASUREMENT fmy_stat_crk_tooth_per.err_info_stat.lv_ready "readiness status of the diagnosis instance CRK_TOOTH_PER" UWORD _CNV_S_2_RANGE______383_CM 1 0. 0. 1. DISPLAY_IDENTIFIER LV_READY_CRK_TOOTH_PER ECU_ADDRESS 0x7f9c58 BYTE_ORDER MSB_LAST BIT_MASK 0x40 /end MEASUREMENT
/begin MEASUREMENT fmy_stat_crk_tooth_per.err_info_stat.lv_end_diag "end of diagnosis of the diagnosis instance CRK_TOOTH_PER" UWORD _CNV_S_2_RANGE______383_CM 1 0. 0. 1. DISPLAY_IDENTIFIER LV_END_DIAG_CRK_TOOTH_PER ECU_ADDRESS 0x7f9c58 BYTE_ORDER MSB_LAST BIT_MASK 0x20 /end MEASUREMENT
/begin MEASUREMENT fmy_stat_crk_tooth_per.err_info_stat.lv_cdn_diag "diagnosis condition of the diagnosis instance CRK_TOOTH_PER" UWORD _CNV_S_2_RANGE______383_CM 1 0. 0. 1. DISPLAY_IDENTIFIER LV_CDN_DIAG_CRK_TOOTH_PER ECU_ADDRESS 0x7f9c58 BYTE_ORDER MSB_LAST BIT_MASK 0x10 /end MEASUREMENT
/begin MEASUREMENT fmy_stat_crk_tooth_per.err_info_stat.err_sym "symptoms of the diagnosis instance CRK_TOOTH_PER" UWORD _CNV_S_6_CONV_ERRM__22_CM 1 0. 0. 15. DISPLAY_IDENTIFIER ERR_SYM_CRK_TOOTH_PER ECU_ADDRESS 0x7f9c58 BYTE_ORDER MSB_LAST BIT_MASK 0xF /end MEASUREMENT
/begin MEASUREMENT fmy_stat_crk_syn.ctr_abc "anti bounce counter for diagnosis instance CRK_SYN" UBYTE _CNV_A_R_LINEAR_____1_CM 1 0. 0. 255. DISPLAY_IDENTIFIER CTR_ABC_CRK_SYN ECU_ADDRESS 0x7f9c5f FORMAT "%3.0" /end MEASUREMENT
/begin MEASUREMENT fmy_stat_crk_syn.ctr_end_diag "counter for end of diagnosis for diagnosis instance CRK_SYN" UBYTE _CNV_A_R_LINEAR_____1_CM 1 0. 0. 255. DISPLAY_IDENTIFIER CTR_ABC_END_DIAG_CRK_SYN ECU_ADDRESS 0x7f9c5e FORMAT "%3.0" /end MEASUREMENT
/begin MEASUREMENT fmy_stat_crk_syn.err_info_stat.reserved "" UWORD _CNV_A_R_LINEAR_____0_CM 1 0. 0. 65535. DISPLAY_IDENTIFIER FMY_STAT_CRK_SYN_ERR_INFO_STAT_RESERVED ECU_ADDRESS 0x7f9c5c BYTE_ORDER MSB_LAST BIT_MASK 0xF800 /end MEASUREMENT
/begin MEASUREMENT fmy_stat_crk_syn.err_info_stat.lv_cdn_diag_stc "Statistical flag for condition of diagnosis of the diagnosis instance CRK_SYN" UWORD _CNV_S_2_RANGE______383_CM 1 0. 0. 1. DISPLAY_IDENTIFIER LV_CDN_DIAG_STC_CRK_SYN ECU_ADDRESS 0x7f9c5c BYTE_ORDER MSB_LAST BIT_MASK 0x400 /end MEASUREMENT
/begin MEASUREMENT fmy_stat_crk_syn.err_info_stat.lv_lock_diag "lock flag (CPU load optimisation) of the diagnosis instance CRK_SYN" UWORD _CNV_S_2_RANGE______383_CM 1 0. 0. 1. DISPLAY_IDENTIFIER LV_LOCK_DIAG_CRK_SYN ECU_ADDRESS 0x7f9c5c BYTE_ORDER MSB_LAST BIT_MASK 0x200 /end MEASUREMENT
/begin MEASUREMENT fmy_stat_crk_syn.err_info_stat.lv_err_mem "storage in dynamic failure memory of the diagnosis instance CRK_SYN" UWORD _CNV_S_2_RANGE______383_CM 1 0. 0. 1. DISPLAY_IDENTIFIER LV_ERR_MEM_CRK_SYN ECU_ADDRESS 0x7f9c5c BYTE_ORDER MSB_LAST BIT_MASK 0x80 /end MEASUREMENT
/begin MEASUREMENT fmy_stat_crk_syn.err_info_stat.lv_ready "readiness status of the diagnosis instance CRK_SYN" UWORD _CNV_S_2_RANGE______383_CM 1 0. 0. 1. DISPLAY_IDENTIFIER LV_READY_CRK_SYN ECU_ADDRESS 0x7f9c5c BYTE_ORDER MSB_LAST BIT_MASK 0x40 /end MEASUREMENT
/begin MEASUREMENT fmy_stat_crk_syn.err_info_stat.lv_end_diag "end of diagnosis of the diagnosis instance CRK_SYN" UWORD _CNV_S_2_RANGE______383_CM 1 0. 0. 1. DISPLAY_IDENTIFIER LV_END_DIAG_CRK_SYN ECU_ADDRESS 0x7f9c5c BYTE_ORDER MSB_LAST BIT_MASK 0x20 /end MEASUREMENT
/begin MEASUREMENT fmy_stat_crk_syn.err_info_stat.lv_cdn_diag "diagnosis condition of the diagnosis instance CRK_SYN" UWORD _CNV_S_2_RANGE______383_CM 1 0. 0. 1. DISPLAY_IDENTIFIER LV_CDN_DIAG_CRK_SYN ECU_ADDRESS 0x7f9c5c BYTE_ORDER MSB_LAST BIT_MASK 0x10 /end MEASUREMENT
/begin MEASUREMENT fmy_stat_crk_syn.err_info_stat.err_sym "symptoms of the diagnosis instance CRK_SYN" UWORD _CNV_S_6_CONV_ERRM__22_CM 1 0. 0. 15. DISPLAY_IDENTIFIER ERR_SYM_CRK_SYN ECU_ADDRESS 0x7f9c5c BYTE_ORDER MSB_LAST BIT_MASK 0xF /end MEASUREMENT
/begin MEASUREMENT fmy_stat_crk_plaus.ctr_abc "anti bounce counter for diagnosis instance CRK_PLAUS" UBYTE _CNV_A_R_LINEAR_____1_CM 1 0. 0. 255. DISPLAY_IDENTIFIER CTR_ABC_CRK_PLAUS ECU_ADDRESS 0x7f9c63 FORMAT "%3.0" /end MEASUREMENT
/begin MEASUREMENT fmy_stat_crk_plaus.ctr_end_diag "counter for end of diagnosis for diagnosis instance CRK_PLAUS" UBYTE _CNV_A_R_LINEAR_____1_CM 1 0. 0. 255. DISPLAY_IDENTIFIER CTR_ABC_END_DIAG_CRK_PLAUS ECU_ADDRESS 0x7f9c62 FORMAT "%3.0" /end MEASUREMENT
/begin MEASUREMENT fmy_stat_crk_plaus.err_info_stat.reserved "" UWORD _CNV_A_R_LINEAR_____0_CM 1 0. 0. 65535. DISPLAY_IDENTIFIER FMY_STAT_CRK_PLAUS_ERR_INFO_STAT_RESERVED ECU_ADDRESS 0x7f9c60 BYTE_ORDER MSB_LAST BIT_MASK 0xF800 /end MEASUREMENT
/begin MEASUREMENT fmy_stat_crk_plaus.err_info_stat.lv_cdn_diag_stc "Statistical flag for condition of diagnosis of the diagnosis instance CRK_PLAUS" UWORD _CNV_S_2_RANGE______383_CM 1 0. 0. 1. DISPLAY_IDENTIFIER LV_CDN_DIAG_STC_CRK_PLAUS ECU_ADDRESS 0x7f9c60 BYTE_ORDER MSB_LAST BIT_MASK 0x400 /end MEASUREMENT
/begin MEASUREMENT fmy_stat_crk_plaus.err_info_stat.lv_lock_diag "lock flag (CPU load optimisation) of the diagnosis instance CRK_PLAUS" UWORD _CNV_S_2_RANGE______383_CM 1 0. 0. 1. DISPLAY_IDENTIFIER LV_LOCK_DIAG_CRK_PLAUS ECU_ADDRESS 0x7f9c60 BYTE_ORDER MSB_LAST BIT_MASK 0x200 /end MEASUREMENT
/begin MEASUREMENT fmy_stat_crk_plaus.err_info_stat.lv_err_mem "storage in dynamic failure memory of the diagnosis instance CRK_PLAUS" UWORD _CNV_S_2_RANGE______383_CM 1 0. 0. 1. DISPLAY_IDENTIFIER LV_ERR_MEM_CRK_PLAUS ECU_ADDRESS 0x7f9c60 BYTE_ORDER MSB_LAST BIT_MASK 0x80 /end MEASUREMENT
/begin MEASUREMENT fmy_stat_crk_plaus.err_info_stat.lv_ready "readiness status of the diagnosis instance CRK_PLAUS" UWORD _CNV_S_2_RANGE______383_CM 1 0. 0. 1. DISPLAY_IDENTIFIER LV_READY_CRK_PLAUS ECU_ADDRESS 0x7f9c60 BYTE_ORDER MSB_LAST BIT_MASK 0x40 /end MEASUREMENT
/begin MEASUREMENT fmy_stat_crk_plaus.err_info_stat.lv_end_diag "end of diagnosis of the diagnosis instance CRK_PLAUS" UWORD _CNV_S_2_RANGE______383_CM 1 0. 0. 1. DISPLAY_IDENTIFIER LV_END_DIAG_CRK_PLAUS ECU_ADDRESS 0x7f9c60 BYTE_ORDER MSB_LAST BIT_MASK 0x20 /end MEASUREMENT
/begin MEASUREMENT fmy_stat_crk_plaus.err_info_stat.lv_cdn_diag "diagnosis condition of the diagnosis instance CRK_PLAUS" UWORD _CNV_S_2_RANGE______383_CM 1 0. 0. 1. DISPLAY_IDENTIFIER LV_CDN_DIAG_CRK_PLAUS ECU_ADDRESS 0x7f9c60 BYTE_ORDER MSB_LAST BIT_MASK 0x10 /end MEASUREMENT
/begin MEASUREMENT fmy_stat_crk_plaus.err_info_stat.err_sym "symptoms of the diagnosis instance CRK_PLAUS" UWORD _CNV_S_6_CONV_ERRM__22_CM 1 0. 0. 15. DISPLAY_IDENTIFIER ERR_SYM_CRK_PLAUS ECU_ADDRESS 0x7f9c60 BYTE_ORDER MSB_LAST BIT_MASK 0xF /end MEASUREMENT
/begin MEASUREMENT fmy_stat_plaus_cam_in_1.ctr_abc "anti bounce counter for diagnosis instance PLAUS_CAM_IN_1" UBYTE _CNV_A_R_LINEAR_____1_CM 1 0. 0. 255. DISPLAY_IDENTIFIER CTR_ABC_PLAUS_CAM_IN_1 ECU_ADDRESS 0x7f9c67 FORMAT "%3.0" /end MEASUREMENT
/begin MEASUREMENT fmy_stat_plaus_cam_in_1.ctr_end_diag "counter for end of diagnosis for diagnosis instance PLAUS_CAM_IN_1" UBYTE _CNV_A_R_LINEAR_____1_CM 1 0. 0. 255. DISPLAY_IDENTIFIER CTR_ABC_END_DIAG_PLAUS_CAM_IN_1 ECU_ADDRESS 0x7f9c66 FORMAT "%3.0" /end MEASUREMENT
/begin MEASUREMENT fmy_stat_plaus_cam_in_1.err_info_stat.reserved "" UWORD _CNV_A_R_LINEAR_____0_CM 1 0. 0. 65535. DISPLAY_IDENTIFIER FMY_STAT_PLAUS_CAM_IN_1_ERR_INFO_STAT_RESERVED ECU_ADDRESS 0x7f9c64 BYTE_ORDER MSB_LAST BIT_MASK 0xF800 /end MEASUREMENT
/begin MEASUREMENT fmy_stat_plaus_cam_in_1.err_info_stat.lv_cdn_diag_stc "Statistical flag for condition of diagnosis of the diagnosis instance PLAUS_CAM_IN_1" UWORD _CNV_S_2_RANGE______383_CM 1 0. 0. 1. DISPLAY_IDENTIFIER LV_CDN_DIAG_STC_PLAUS_CAM_IN_1 ECU_ADDRESS 0x7f9c64 BYTE_ORDER MSB_LAST BIT_MASK 0x400 /end MEASUREMENT
/begin MEASUREMENT fmy_stat_plaus_cam_in_1.err_info_stat.lv_lock_diag "lock flag (CPU load optimisation) of the diagnosis instance PLAUS_CAM_IN_1" UWORD _CNV_S_2_RANGE______383_CM 1 0. 0. 1. DISPLAY_IDENTIFIER LV_LOCK_DIAG_PLAUS_CAM_IN_1 ECU_ADDRESS 0x7f9c64 BYTE_ORDER MSB_LAST BIT_MASK 0x200 /end MEASUREMENT
/begin MEASUREMENT fmy_stat_plaus_cam_in_1.err_info_stat.lv_err_mem "storage in dynamic failure memory of the diagnosis instance PLAUS_CAM_IN_1" UWORD _CNV_S_2_RANGE______383_CM 1 0. 0. 1. DISPLAY_IDENTIFIER LV_ERR_MEM_PLAUS_CAM_IN_1 ECU_ADDRESS 0x7f9c64 BYTE_ORDER MSB_LAST BIT_MASK 0x80 /end MEASUREMENT
/begin MEASUREMENT fmy_stat_plaus_cam_in_1.err_info_stat.lv_ready "readiness status of the diagnosis instance PLAUS_CAM_IN_1" UWORD _CNV_S_2_RANGE______383_CM 1 0. 0. 1. DISPLAY_IDENTIFIER LV_READY_PLAUS_CAM_IN_1 ECU_ADDRESS 0x7f9c64 BYTE_ORDER MSB_LAST BIT_MASK 0x40 /end MEASUREMENT
/begin MEASUREMENT fmy_stat_plaus_cam_in_1.err_info_stat.lv_end_diag "end of diagnosis of the diagnosis instance PLAUS_CAM_IN_1" UWORD _CNV_S_2_RANGE______383_CM 1 0. 0. 1. DISPLAY_IDENTIFIER LV_END_DIAG_PLAUS_CAM_IN_1 ECU_ADDRESS 0x7f9c64 BYTE_ORDER MSB_LAST BIT_MASK 0x20 /end MEASUREMENT
/begin MEASUREMENT fmy_stat_plaus_cam_in_1.err_info_stat.lv_cdn_diag "diagnosis condition of the diagnosis instance PLAUS_CAM_IN_1" UWORD _CNV_S_2_RANGE______383_CM 1 0. 0. 1. DISPLAY_IDENTIFIER LV_CDN_DIAG_PLAUS_CAM_IN_1 ECU_ADDRESS 0x7f9c64 BYTE_ORDER MSB_LAST BIT_MASK 0x10 /end MEASUREMENT
/begin MEASUREMENT fmy_stat_plaus_cam_in_1.err_info_stat.err_sym "symptoms of the diagnosis instance PLAUS_CAM_IN_1" UWORD _CNV_S_6_CONV_ERRM__22_CM 1 0. 0. 15. DISPLAY_IDENTIFIER ERR_SYM_PLAUS_CAM_IN_1 ECU_ADDRESS 0x7f9c64 BYTE_ORDER MSB_LAST BIT_MASK 0xF /end MEASUREMENT
/begin MEASUREMENT fmy_stat_syn_crk_cam_in_1.ctr_abc "anti bounce counter for diagnosis instance SYN_CRK_CAM_IN_1" UBYTE _CNV_A_R_LINEAR_____1_CM 1 0. 0. 255. DISPLAY_IDENTIFIER CTR_ABC_SYN_CRK_CAM_IN_1 ECU_ADDRESS 0x7f9c6b FORMAT "%3.0" /end MEASUREMENT
/begin MEASUREMENT fmy_stat_syn_crk_cam_in_1.ctr_end_diag "counter for end of diagnosis for diagnosis instance SYN_CRK_CAM_IN_1" UBYTE _CNV_A_R_LINEAR_____1_CM 1 0. 0. 255. DISPLAY_IDENTIFIER CTR_ABC_END_DIAG_SYN_CRK_CAM_IN_1 ECU_ADDRESS 0x7f9c6a FORMAT "%3.0" /end MEASUREMENT
/begin MEASUREMENT fmy_stat_syn_crk_cam_in_1.err_info_stat.reserved "" UWORD _CNV_A_R_LINEAR_____0_CM 1 0. 0. 65535. DISPLAY_IDENTIFIER FMY_STAT_SYN_CRK_CAM_IN_1_ERR_INFO_STAT_RESERVED ECU_ADDRESS 0x7f9c68 BYTE_ORDER MSB_LAST BIT_MASK 0xF800 /end MEASUREMENT
/begin MEASUREMENT fmy_stat_syn_crk_cam_in_1.err_info_stat.lv_cdn_diag_stc "Statistical flag for condition of diagnosis of the diagnosis instance SYN_CRK_CAM_IN_1" UWORD _CNV_S_2_RANGE______383_CM 1 0. 0. 1. DISPLAY_IDENTIFIER LV_CDN_DIAG_STC_SYN_CRK_CAM_IN_1 ECU_ADDRESS 0x7f9c68 BYTE_ORDER MSB_LAST BIT_MASK 0x400 /end MEASUREMENT
/begin MEASUREMENT fmy_stat_syn_crk_cam_in_1.err_info_stat.lv_lock_diag "lock flag (CPU load optimisation) of the diagnosis instance SYN_CRK_CAM_IN_1" UWORD _CNV_S_2_RANGE______383_CM 1 0. 0. 1. DISPLAY_IDENTIFIER LV_LOCK_DIAG_SYN_CRK_CAM_IN_1 ECU_ADDRESS 0x7f9c68 BYTE_ORDER MSB_LAST BIT_MASK 0x200 /end MEASUREMENT
/begin MEASUREMENT fmy_stat_syn_crk_cam_in_1.err_info_stat.lv_err_mem "storage in dynamic failure memory of the diagnosis instance SYN_CRK_CAM_IN_1" UWORD _CNV_S_2_RANGE______383_CM 1 0. 0. 1. DISPLAY_IDENTIFIER LV_ERR_MEM_SYN_CRK_CAM_IN_1 ECU_ADDRESS 0x7f9c68 BYTE_ORDER MSB_LAST BIT_MASK 0x80 /end MEASUREMENT
/begin MEASUREMENT fmy_stat_syn_crk_cam_in_1.err_info_stat.lv_ready "readiness status of the diagnosis instance SYN_CRK_CAM_IN_1" UWORD _CNV_S_2_RANGE______383_CM 1 0. 0. 1. DISPLAY_IDENTIFIER LV_READY_SYN_CRK_CAM_IN_1 ECU_ADDRESS 0x7f9c68 BYTE_ORDER MSB_LAST BIT_MASK 0x40 /end MEASUREMENT
/begin MEASUREMENT fmy_stat_syn_crk_cam_in_1.err_info_stat.lv_end_diag "end of diagnosis of the diagnosis instance SYN_CRK_CAM_IN_1" UWORD _CNV_S_2_RANGE______383_CM 1 0. 0. 1. DISPLAY_IDENTIFIER LV_END_DIAG_SYN_CRK_CAM_IN_1 ECU_ADDRESS 0x7f9c68 BYTE_ORDER MSB_LAST BIT_MASK 0x20 /end MEASUREMENT
/begin MEASUREMENT fmy_stat_syn_crk_cam_in_1.err_info_stat.lv_cdn_diag "diagnosis condition of the diagnosis instance SYN_CRK_CAM_IN_1" UWORD _CNV_S_2_RANGE______383_CM 1 0. 0. 1. DISPLAY_IDENTIFIER LV_CDN_DIAG_SYN_CRK_CAM_IN_1 ECU_ADDRESS 0x7f9c68 BYTE_ORDER MSB_LAST BIT_MASK 0x10 /end MEASUREMENT
/begin MEASUREMENT fmy_stat_syn_crk_cam_in_1.err_info_stat.err_sym "symptoms of the diagnosis instance SYN_CRK_CAM_IN_1" UWORD _CNV_S_6_CONV_ERRM__22_CM 1 0. 0. 15. DISPLAY_IDENTIFIER ERR_SYM_SYN_CRK_CAM_IN_1 ECU_ADDRESS 0x7f9c68 BYTE_ORDER MSB_LAST BIT_MASK 0xF /end MEASUREMENT
/begin MEASUREMENT fmy_stat_lsh_up_1.ctr_abc "anti bounce counter for diagnosis instance LSH_UP_1" UBYTE _CNV_A_R_LINEAR_____1_CM 1 0. 0. 255. DISPLAY_IDENTIFIER CTR_ABC_LSH_UP_1 ECU_ADDRESS 0x7f9c6f FORMAT "%3.0" /end MEASUREMENT
/begin MEASUREMENT fmy_stat_lsh_up_1.ctr_end_diag "counter for end of diagnosis for diagnosis instance LSH_UP_1" UBYTE _CNV_A_R_LINEAR_____1_CM 1 0. 0. 255. DISPLAY_IDENTIFIER CTR_ABC_END_DIAG_LSH_UP_1 ECU_ADDRESS 0x7f9c6e FORMAT "%3.0" /end MEASUREMENT
/begin MEASUREMENT fmy_stat_lsh_up_1.err_info_stat.reserved "" UWORD _CNV_A_R_LINEAR_____0_CM 1 0. 0. 65535. DISPLAY_IDENTIFIER FMY_STAT_LSH_UP_1_ERR_INFO_STAT_RESERVED ECU_ADDRESS 0x7f9c6c BYTE_ORDER MSB_LAST BIT_MASK 0xF800 /end MEASUREMENT
/begin MEASUREMENT fmy_stat_lsh_up_1.err_info_stat.lv_cdn_diag_stc "Statistical flag for condition of diagnosis of the diagnosis instance LSH_UP_1" UWORD _CNV_S_2_RANGE______383_CM 1 0. 0. 1. DISPLAY_IDENTIFIER LV_CDN_DIAG_STC_LSH_UP_1 ECU_ADDRESS 0x7f9c6c BYTE_ORDER MSB_LAST BIT_MASK 0x400 /end MEASUREMENT
/begin MEASUREMENT fmy_stat_lsh_up_1.err_info_stat.lv_lock_diag "lock flag (CPU load optimisation) of the diagnosis instance LSH_UP_1" UWORD _CNV_S_2_RANGE______383_CM 1 0. 0. 1. DISPLAY_IDENTIFIER LV_LOCK_DIAG_LSH_UP_1 ECU_ADDRESS 0x7f9c6c BYTE_ORDER MSB_LAST BIT_MASK 0x200 /end MEASUREMENT
/begin MEASUREMENT fmy_stat_lsh_up_1.err_info_stat.lv_err_mem "storage in dynamic failure memory of the diagnosis instance LSH_UP_1" UWORD _CNV_S_2_RANGE______383_CM 1 0. 0. 1. DISPLAY_IDENTIFIER LV_ERR_MEM_LSH_UP_1 ECU_ADDRESS 0x7f9c6c BYTE_ORDER MSB_LAST BIT_MASK 0x80 /end MEASUREMENT
/begin MEASUREMENT fmy_stat_lsh_up_1.err_info_stat.lv_ready "readiness status of the diagnosis instance LSH_UP_1" UWORD _CNV_S_2_RANGE______383_CM 1 0. 0. 1. DISPLAY_IDENTIFIER LV_READY_LSH_UP_1 ECU_ADDRESS 0x7f9c6c BYTE_ORDER MSB_LAST BIT_MASK 0x40 /end MEASUREMENT
/begin MEASUREMENT fmy_stat_lsh_up_1.err_info_stat.lv_end_diag "end of diagnosis of the diagnosis instance LSH_UP_1" UWORD _CNV_S_2_RANGE______383_CM 1 0. 0. 1. DISPLAY_IDENTIFIER LV_END_DIAG_LSH_UP_1 ECU_ADDRESS 0x7f9c6c BYTE_ORDER MSB_LAST BIT_MASK 0x20 /end MEASUREMENT
/begin MEASUREMENT fmy_stat_lsh_up_1.err_info_stat.lv_cdn_diag "diagnosis condition of the diagnosis instance LSH_UP_1" UWORD _CNV_S_2_RANGE______383_CM 1 0. 0. 1. DISPLAY_IDENTIFIER LV_CDN_DIAG_LSH_UP_1 ECU_ADDRESS 0x7f9c6c BYTE_ORDER MSB_LAST BIT_MASK 0x10 /end MEASUREMENT
/begin MEASUREMENT fmy_stat_lsh_up_1.err_info_stat.err_sym "symptoms of the diagnosis instance LSH_UP_1" UWORD _CNV_S_6_CONV_ERRM__22_CM 1 0. 0. 15. DISPLAY_IDENTIFIER ERR_SYM_LSH_UP_1 ECU_ADDRESS 0x7f9c6c BYTE_ORDER MSB_LAST BIT_MASK 0xF /end MEASUREMENT
/begin MEASUREMENT fmy_stat_lsh_down_1.ctr_abc "anti bounce counter for diagnosis instance LSH_DOWN_1" UBYTE _CNV_A_R_LINEAR_____1_CM 1 0. 0. 255. DISPLAY_IDENTIFIER CTR_ABC_LSH_DOWN_1 ECU_ADDRESS 0x7f9c73 FORMAT "%3.0" /end MEASUREMENT
/begin MEASUREMENT fmy_stat_lsh_down_1.ctr_end_diag "counter for end of diagnosis for diagnosis instance LSH_DOWN_1" UBYTE _CNV_A_R_LINEAR_____1_CM 1 0. 0. 255. DISPLAY_IDENTIFIER CTR_ABC_END_DIAG_LSH_DOWN_1 ECU_ADDRESS 0x7f9c72 FORMAT "%3.0" /end MEASUREMENT
/begin MEASUREMENT fmy_stat_lsh_down_1.err_info_stat.reserved "" UWORD _CNV_A_R_LINEAR_____0_CM 1 0. 0. 65535. DISPLAY_IDENTIFIER FMY_STAT_LSH_DOWN_1_ERR_INFO_STAT_RESERVED ECU_ADDRESS 0x7f9c70 BYTE_ORDER MSB_LAST BIT_MASK 0xF800 /end MEASUREMENT
/begin MEASUREMENT fmy_stat_lsh_down_1.err_info_stat.lv_cdn_diag_stc "Statistical flag for condition of diagnosis of the diagnosis instance LSH_DOWN_1" UWORD _CNV_S_2_RANGE______383_CM 1 0. 0. 1. DISPLAY_IDENTIFIER LV_CDN_DIAG_STC_LSH_DOWN_1 ECU_ADDRESS 0x7f9c70 BYTE_ORDER MSB_LAST BIT_MASK 0x400 /end MEASUREMENT
/begin MEASUREMENT fmy_stat_lsh_down_1.err_info_stat.lv_lock_diag "lock flag (CPU load optimisation) of the diagnosis instance LSH_DOWN_1" UWORD _CNV_S_2_RANGE______383_CM 1 0. 0. 1. DISPLAY_IDENTIFIER LV_LOCK_DIAG_LSH_DOWN_1 ECU_ADDRESS 0x7f9c70 BYTE_ORDER MSB_LAST BIT_MASK 0x200 /end MEASUREMENT
/begin MEASUREMENT fmy_stat_lsh_down_1.err_info_stat.lv_err_mem "storage in dynamic failure memory of the diagnosis instance LSH_DOWN_1" UWORD _CNV_S_2_RANGE______383_CM 1 0. 0. 1. DISPLAY_IDENTIFIER LV_ERR_MEM_LSH_DOWN_1 ECU_ADDRESS 0x7f9c70 BYTE_ORDER MSB_LAST BIT_MASK 0x80 /end MEASUREMENT
/begin MEASUREMENT fmy_stat_lsh_down_1.err_info_stat.lv_ready "readiness status of the diagnosis instance LSH_DOWN_1" UWORD _CNV_S_2_RANGE______383_CM 1 0. 0. 1. DISPLAY_IDENTIFIER LV_READY_LSH_DOWN_1 ECU_ADDRESS 0x7f9c70 BYTE_ORDER MSB_LAST BIT_MASK 0x40 /end MEASUREMENT
/begin MEASUREMENT fmy_stat_lsh_down_1.err_info_stat.lv_end_diag "end of diagnosis of the diagnosis instance LSH_DOWN_1" UWORD _CNV_S_2_RANGE______383_CM 1 0. 0. 1. DISPLAY_IDENTIFIER LV_END_DIAG_LSH_DOWN_1 ECU_ADDRESS 0x7f9c70 BYTE_ORDER MSB_LAST BIT_MASK 0x20 /end MEASUREMENT
/begin MEASUREMENT fmy_stat_lsh_down_1.err_info_stat.lv_cdn_diag "diagnosis condition of the diagnosis instance LSH_DOWN_1" UWORD _CNV_S_2_RANGE______383_CM 1 0. 0. 1. DISPLAY_IDENTIFIER LV_CDN_DIAG_LSH_DOWN_1 ECU_ADDRESS 0x7f9c70 BYTE_ORDER MSB_LAST BIT_MASK 0x10 /end MEASUREMENT
/begin MEASUREMENT fmy_stat_lsh_down_1.err_info_stat.err_sym "symptoms of the diagnosis instance LSH_DOWN_1" UWORD _CNV_S_6_CONV_ERRM__22_CM 1 0. 0. 15. DISPLAY_IDENTIFIER ERR_SYM_LSH_DOWN_1 ECU_ADDRESS 0x7f9c70 BYTE_ORDER MSB_LAST BIT_MASK 0xF /end MEASUREMENT
/begin MEASUREMENT fmy_stat_scg_ls_down_1.ctr_abc "anti bounce counter for diagnosis instance SCG_LS_DOWN_1" UBYTE _CNV_A_R_LINEAR_____1_CM 1 0. 0. 255. DISPLAY_IDENTIFIER CTR_ABC_SCG_LS_DOWN_1 ECU_ADDRESS 0x7f9c77 FORMAT "%3.0" /end MEASUREMENT
/begin MEASUREMENT fmy_stat_scg_ls_down_1.ctr_end_diag "counter for end of diagnosis for diagnosis instance SCG_LS_DOWN_1" UBYTE _CNV_A_R_LINEAR_____1_CM 1 0. 0. 255. DISPLAY_IDENTIFIER CTR_ABC_END_DIAG_SCG_LS_DOWN_1 ECU_ADDRESS 0x7f9c76 FORMAT "%3.0" /end MEASUREMENT
/begin MEASUREMENT fmy_stat_scg_ls_down_1.err_info_stat.reserved "" UWORD _CNV_A_R_LINEAR_____0_CM 1 0. 0. 65535. DISPLAY_IDENTIFIER FMY_STAT_SCG_LS_DOWN_1_ERR_INFO_STAT_RESERVED ECU_ADDRESS 0x7f9c74 BYTE_ORDER MSB_LAST BIT_MASK 0xF800 /end MEASUREMENT
/begin MEASUREMENT fmy_stat_scg_ls_down_1.err_info_stat.lv_cdn_diag_stc "Statistical flag for condition of diagnosis of the diagnosis instance SCG_LS_DOWN_1" UWORD _CNV_S_2_RANGE______383_CM 1 0. 0. 1. DISPLAY_IDENTIFIER LV_CDN_DIAG_STC_SCG_LS_DOWN_1 ECU_ADDRESS 0x7f9c74 BYTE_ORDER MSB_LAST BIT_MASK 0x400 /end MEASUREMENT
/begin MEASUREMENT fmy_stat_scg_ls_down_1.err_info_stat.lv_lock_diag "lock flag (CPU load optimisation) of the diagnosis instance SCG_LS_DOWN_1" UWORD _CNV_S_2_RANGE______383_CM 1 0. 0. 1. DISPLAY_IDENTIFIER LV_LOCK_DIAG_SCG_LS_DOWN_1 ECU_ADDRESS 0x7f9c74 BYTE_ORDER MSB_LAST BIT_MASK 0x200 /end MEASUREMENT
/begin MEASUREMENT fmy_stat_scg_ls_down_1.err_info_stat.lv_err_mem "storage in dynamic failure memory of the diagnosis instance SCG_LS_DOWN_1" UWORD _CNV_S_2_RANGE______383_CM 1 0. 0. 1. DISPLAY_IDENTIFIER LV_ERR_MEM_SCG_LS_DOWN_1 ECU_ADDRESS 0x7f9c74 BYTE_ORDER MSB_LAST BIT_MASK 0x80 /end MEASUREMENT
/begin MEASUREMENT fmy_stat_scg_ls_down_1.err_info_stat.lv_ready "readiness status of the diagnosis instance SCG_LS_DOWN_1" UWORD _CNV_S_2_RANGE______383_CM 1 0. 0. 1. DISPLAY_IDENTIFIER LV_READY_SCG_LS_DOWN_1 ECU_ADDRESS 0x7f9c74 BYTE_ORDER MSB_LAST BIT_MASK 0x40 /end MEASUREMENT
/begin MEASUREMENT fmy_stat_scg_ls_down_1.err_info_stat.lv_end_diag "end of diagnosis of the diagnosis instance SCG_LS_DOWN_1" UWORD _CNV_S_2_RANGE______383_CM 1 0. 0. 1. DISPLAY_IDENTIFIER LV_END_DIAG_SCG_LS_DOWN_1 ECU_ADDRESS 0x7f9c74 BYTE_ORDER MSB_LAST BIT_MASK 0x20 /end MEASUREMENT
/begin MEASUREMENT fmy_stat_scg_ls_down_1.err_info_stat.lv_cdn_diag "diagnosis condition of the diagnosis instance SCG_LS_DOWN_1" UWORD _CNV_S_2_RANGE______383_CM 1 0. 0. 1. DISPLAY_IDENTIFIER LV_CDN_DIAG_SCG_LS_DOWN_1 ECU_ADDRESS 0x7f9c74 BYTE_ORDER MSB_LAST BIT_MASK 0x10 /end MEASUREMENT
/begin MEASUREMENT fmy_stat_scg_ls_down_1.err_info_stat.err_sym "symptoms of the diagnosis instance SCG_LS_DOWN_1" UWORD _CNV_S_6_CONV_ERRM__22_CM 1 0. 0. 15. DISPLAY_IDENTIFIER ERR_SYM_SCG_LS_DOWN_1 ECU_ADDRESS 0x7f9c74 BYTE_ORDER MSB_LAST BIT_MASK 0xF /end MEASUREMENT
/begin MEASUREMENT fmy_stat_scp_ls_down_1.ctr_abc "anti bounce counter for diagnosis instance SCP_LS_DOWN_1" UBYTE _CNV_A_R_LINEAR_____1_CM 1 0. 0. 255. DISPLAY_IDENTIFIER CTR_ABC_SCP_LS_DOWN_1 ECU_ADDRESS 0x7f9c7b FORMAT "%3.0" /end MEASUREMENT
/begin MEASUREMENT fmy_stat_scp_ls_down_1.ctr_end_diag "counter for end of diagnosis for diagnosis instance SCP_LS_DOWN_1" UBYTE _CNV_A_R_LINEAR_____1_CM 1 0. 0. 255. DISPLAY_IDENTIFIER CTR_ABC_END_DIAG_SCP_LS_DOWN_1 ECU_ADDRESS 0x7f9c7a FORMAT "%3.0" /end MEASUREMENT
/begin MEASUREMENT fmy_stat_scp_ls_down_1.err_info_stat.reserved "" UWORD _CNV_A_R_LINEAR_____0_CM 1 0. 0. 65535. DISPLAY_IDENTIFIER FMY_STAT_SCP_LS_DOWN_1_ERR_INFO_STAT_RESERVED ECU_ADDRESS 0x7f9c78 BYTE_ORDER MSB_LAST BIT_MASK 0xF800 /end MEASUREMENT
/begin MEASUREMENT fmy_stat_scp_ls_down_1.err_info_stat.lv_cdn_diag_stc "Statistical flag for condition of diagnosis of the diagnosis instance SCP_LS_DOWN_1" UWORD _CNV_S_2_RANGE______383_CM 1 0. 0. 1. DISPLAY_IDENTIFIER LV_CDN_DIAG_STC_SCP_LS_DOWN_1 ECU_ADDRESS 0x7f9c78 BYTE_ORDER MSB_LAST BIT_MASK 0x400 /end MEASUREMENT
/begin MEASUREMENT fmy_stat_scp_ls_down_1.err_info_stat.lv_lock_diag "lock flag (CPU load optimisation) of the diagnosis instance SCP_LS_DOWN_1" UWORD _CNV_S_2_RANGE______383_CM 1 0. 0. 1. DISPLAY_IDENTIFIER LV_LOCK_DIAG_SCP_LS_DOWN_1 ECU_ADDRESS 0x7f9c78 BYTE_ORDER MSB_LAST BIT_MASK 0x200 /end MEASUREMENT
/begin MEASUREMENT fmy_stat_scp_ls_down_1.err_info_stat.lv_err_mem "storage in dynamic failure memory of the diagnosis instance SCP_LS_DOWN_1" UWORD _CNV_S_2_RANGE______383_CM 1 0. 0. 1. DISPLAY_IDENTIFIER LV_ERR_MEM_SCP_LS_DOWN_1 ECU_ADDRESS 0x7f9c78 BYTE_ORDER MSB_LAST BIT_MASK 0x80 /end MEASUREMENT
/begin MEASUREMENT fmy_stat_scp_ls_down_1.err_info_stat.lv_ready "readiness status of the diagnosis instance SCP_LS_DOWN_1" UWORD _CNV_S_2_RANGE______383_CM 1 0. 0. 1. DISPLAY_IDENTIFIER LV_READY_SCP_LS_DOWN_1 ECU_ADDRESS 0x7f9c78 BYTE_ORDER MSB_LAST BIT_MASK 0x40 /end MEASUREMENT
/begin MEASUREMENT fmy_stat_scp_ls_down_1.err_info_stat.lv_end_diag "end of diagnosis of the diagnosis instance SCP_LS_DOWN_1" UWORD _CNV_S_2_RANGE______383_CM 1 0. 0. 1. DISPLAY_IDENTIFIER LV_END_DIAG_SCP_LS_DOWN_1 ECU_ADDRESS 0x7f9c78 BYTE_ORDER MSB_LAST BIT_MASK 0x20 /end MEASUREMENT
/begin MEASUREMENT fmy_stat_scp_ls_down_1.err_info_stat.lv_cdn_diag "diagnosis condition of the diagnosis instance SCP_LS_DOWN_1" UWORD _CNV_S_2_RANGE______383_CM 1 0. 0. 1. DISPLAY_IDENTIFIER LV_CDN_DIAG_SCP_LS_DOWN_1 ECU_ADDRESS 0x7f9c78 BYTE_ORDER MSB_LAST BIT_MASK 0x10 /end MEASUREMENT
/begin MEASUREMENT fmy_stat_scp_ls_down_1.err_info_stat.err_sym "symptoms of the diagnosis instance SCP_LS_DOWN_1" UWORD _CNV_S_6_CONV_ERRM__22_CM 1 0. 0. 15. DISPLAY_IDENTIFIER ERR_SYM_SCP_LS_DOWN_1 ECU_ADDRESS 0x7f9c78 BYTE_ORDER MSB_LAST BIT_MASK 0xF /end MEASUREMENT
/begin MEASUREMENT fmy_stat_oc_ls_down_1.ctr_abc "anti bounce counter for diagnosis instance OC_LS_DOWN_1" UBYTE _CNV_A_R_LINEAR_____1_CM 1 0. 0. 255. DISPLAY_IDENTIFIER CTR_ABC_OC_LS_DOWN_1 ECU_ADDRESS 0x7f9c7f FORMAT "%3.0" /end MEASUREMENT
/begin MEASUREMENT fmy_stat_oc_ls_down_1.ctr_end_diag "counter for end of diagnosis for diagnosis instance OC_LS_DOWN_1" UBYTE _CNV_A_R_LINEAR_____1_CM 1 0. 0. 255. DISPLAY_IDENTIFIER CTR_ABC_END_DIAG_OC_LS_DOWN_1 ECU_ADDRESS 0x7f9c7e FORMAT "%3.0" /end MEASUREMENT
/begin MEASUREMENT fmy_stat_oc_ls_down_1.err_info_stat.reserved "" UWORD _CNV_A_R_LINEAR_____0_CM 1 0. 0. 65535. DISPLAY_IDENTIFIER FMY_STAT_OC_LS_DOWN_1_ERR_INFO_STAT_RESERVED ECU_ADDRESS 0x7f9c7c BYTE_ORDER MSB_LAST BIT_MASK 0xF800 /end MEASUREMENT
/begin MEASUREMENT fmy_stat_oc_ls_down_1.err_info_stat.lv_cdn_diag_stc "Statistical flag for condition of diagnosis of the diagnosis instance OC_LS_DOWN_1" UWORD _CNV_S_2_RANGE______383_CM 1 0. 0. 1. DISPLAY_IDENTIFIER LV_CDN_DIAG_STC_OC_LS_DOWN_1 ECU_ADDRESS 0x7f9c7c BYTE_ORDER MSB_LAST BIT_MASK 0x400 /end MEASUREMENT
/begin MEASUREMENT fmy_stat_oc_ls_down_1.err_info_stat.lv_lock_diag "lock flag (CPU load optimisation) of the diagnosis instance OC_LS_DOWN_1" UWORD _CNV_S_2_RANGE______383_CM 1 0. 0. 1. DISPLAY_IDENTIFIER LV_LOCK_DIAG_OC_LS_DOWN_1 ECU_ADDRESS 0x7f9c7c BYTE_ORDER MSB_LAST BIT_MASK 0x200 /end MEASUREMENT
/begin MEASUREMENT fmy_stat_oc_ls_down_1.err_info_stat.lv_err_mem "storage in dynamic failure memory of the diagnosis instance OC_LS_DOWN_1" UWORD _CNV_S_2_RANGE______383_CM 1 0. 0. 1. DISPLAY_IDENTIFIER LV_ERR_MEM_OC_LS_DOWN_1 ECU_ADDRESS 0x7f9c7c BYTE_ORDER MSB_LAST BIT_MASK 0x80 /end MEASUREMENT
/begin MEASUREMENT fmy_stat_oc_ls_down_1.err_info_stat.lv_ready "readiness status of the diagnosis instance OC_LS_DOWN_1" UWORD _CNV_S_2_RANGE______383_CM 1 0. 0. 1. DISPLAY_IDENTIFIER LV_READY_OC_LS_DOWN_1 ECU_ADDRESS 0x7f9c7c BYTE_ORDER MSB_LAST BIT_MASK 0x40 /end MEASUREMENT
/begin MEASUREMENT fmy_stat_oc_ls_down_1.err_info_stat.lv_end_diag "end of diagnosis of the diagnosis instance OC_LS_DOWN_1" UWORD _CNV_S_2_RANGE______383_CM 1 0. 0. 1. DISPLAY_IDENTIFIER LV_END_DIAG_OC_LS_DOWN_1 ECU_ADDRESS 0x7f9c7c BYTE_ORDER MSB_LAST BIT_MASK 0x20 /end MEASUREMENT
/begin MEASUREMENT fmy_stat_oc_ls_down_1.err_info_stat.lv_cdn_diag "diagnosis condition of the diagnosis instance OC_LS_DOWN_1" UWORD _CNV_S_2_RANGE______383_CM 1 0. 0. 1. DISPLAY_IDENTIFIER LV_CDN_DIAG_OC_LS_DOWN_1 ECU_ADDRESS 0x7f9c7c BYTE_ORDER MSB_LAST BIT_MASK 0x10 /end MEASUREMENT
/begin MEASUREMENT fmy_stat_oc_ls_down_1.err_info_stat.err_sym "symptoms of the diagnosis instance OC_LS_DOWN_1" UWORD _CNV_S_6_CONV_ERRM__22_CM 1 0. 0. 15. DISPLAY_IDENTIFIER ERR_SYM_OC_LS_DOWN_1 ECU_ADDRESS 0x7f9c7c BYTE_ORDER MSB_LAST BIT_MASK 0xF /end MEASUREMENT
/begin MEASUREMENT fmy_stat_obd_lsh_down_1.ctr_abc "anti bounce counter for diagnosis instance OBD_LSH_DOWN_1" UBYTE _CNV_A_R_LINEAR_____1_CM 1 0. 0. 255. DISPLAY_IDENTIFIER CTR_ABC_OBD_LSH_DOWN_1 ECU_ADDRESS 0x7f9c83 FORMAT "%3.0" /end MEASUREMENT
/begin MEASUREMENT fmy_stat_obd_lsh_down_1.ctr_end_diag "counter for end of diagnosis for diagnosis instance OBD_LSH_DOWN_1" UBYTE _CNV_A_R_LINEAR_____1_CM 1 0. 0. 255. DISPLAY_IDENTIFIER CTR_ABC_END_DIAG_OBD_LSH_DOWN_1 ECU_ADDRESS 0x7f9c82 FORMAT "%3.0" /end MEASUREMENT
/begin MEASUREMENT fmy_stat_obd_lsh_down_1.err_info_stat.reserved "" UWORD _CNV_A_R_LINEAR_____0_CM 1 0. 0. 65535. DISPLAY_IDENTIFIER FMY_STAT_OBD_LSH_DOWN_1_ERR_INFO_STAT_RESERVED ECU_ADDRESS 0x7f9c80 BYTE_ORDER MSB_LAST BIT_MASK 0xF800 /end MEASUREMENT
/begin MEASUREMENT fmy_stat_obd_lsh_down_1.err_info_stat.lv_cdn_diag_stc "Statistical flag for condition of diagnosis of the diagnosis instance OBD_LSH_DOWN_1" UWORD _CNV_S_2_RANGE______383_CM 1 0. 0. 1. DISPLAY_IDENTIFIER LV_CDN_DIAG_STC_OBD_LSH_DOWN_1 ECU_ADDRESS 0x7f9c80 BYTE_ORDER MSB_LAST BIT_MASK 0x400 /end MEASUREMENT
/begin MEASUREMENT fmy_stat_obd_lsh_down_1.err_info_stat.lv_lock_diag "lock flag (CPU load optimisation) of the diagnosis instance OBD_LSH_DOWN_1" UWORD _CNV_S_2_RANGE______383_CM 1 0. 0. 1. DISPLAY_IDENTIFIER LV_LOCK_DIAG_OBD_LSH_DOWN_1 ECU_ADDRESS 0x7f9c80 BYTE_ORDER MSB_LAST BIT_MASK 0x200 /end MEASUREMENT
/begin MEASUREMENT fmy_stat_obd_lsh_down_1.err_info_stat.lv_err_mem "storage in dynamic failure memory of the diagnosis instance OBD_LSH_DOWN_1" UWORD _CNV_S_2_RANGE______383_CM 1 0. 0. 1. DISPLAY_IDENTIFIER LV_ERR_MEM_OBD_LSH_DOWN_1 ECU_ADDRESS 0x7f9c80 BYTE_ORDER MSB_LAST BIT_MASK 0x80 /end MEASUREMENT
/begin MEASUREMENT fmy_stat_obd_lsh_down_1.err_info_stat.lv_ready "readiness status of the diagnosis instance OBD_LSH_DOWN_1" UWORD _CNV_S_2_RANGE______383_CM 1 0. 0. 1. DISPLAY_IDENTIFIER LV_READY_OBD_LSH_DOWN_1 ECU_ADDRESS 0x7f9c80 BYTE_ORDER MSB_LAST BIT_MASK 0x40 /end MEASUREMENT
/begin MEASUREMENT fmy_stat_obd_lsh_down_1.err_info_stat.lv_end_diag "end of diagnosis of the diagnosis instance OBD_LSH_DOWN_1" UWORD _CNV_S_2_RANGE______383_CM 1 0. 0. 1. DISPLAY_IDENTIFIER LV_END_DIAG_OBD_LSH_DOWN_1 ECU_ADDRESS 0x7f9c80 BYTE_ORDER MSB_LAST BIT_MASK 0x20 /end MEASUREMENT
/begin MEASUREMENT fmy_stat_obd_lsh_down_1.err_info_stat.lv_cdn_diag "diagnosis condition of the diagnosis instance OBD_LSH_DOWN_1" UWORD _CNV_S_2_RANGE______383_CM 1 0. 0. 1. DISPLAY_IDENTIFIER LV_CDN_DIAG_OBD_LSH_DOWN_1 ECU_ADDRESS 0x7f9c80 BYTE_ORDER MSB_LAST BIT_MASK 0x10 /end MEASUREMENT
/begin MEASUREMENT fmy_stat_obd_lsh_down_1.err_info_stat.err_sym "symptoms of the diagnosis instance OBD_LSH_DOWN_1" UWORD _CNV_S_6_CONV_ERRM__22_CM 1 0. 0. 15. DISPLAY_IDENTIFIER ERR_SYM_OBD_LSH_DOWN_1 ECU_ADDRESS 0x7f9c80 BYTE_ORDER MSB_LAST BIT_MASK 0xF /end MEASUREMENT
/begin MEASUREMENT fmy_stat_lam_adj_1.ctr_abc "anti bounce counter for diagnosis instance LAM_ADJ_1" UBYTE _CNV_A_R_LINEAR_____1_CM 1 0. 0. 255. DISPLAY_IDENTIFIER CTR_ABC_LAM_ADJ_1 ECU_ADDRESS 0x7f9c87 FORMAT "%3.0" /end MEASUREMENT
/begin MEASUREMENT fmy_stat_lam_adj_1.ctr_end_diag "counter for end of diagnosis for diagnosis instance LAM_ADJ_1" UBYTE _CNV_A_R_LINEAR_____1_CM 1 0. 0. 255. DISPLAY_IDENTIFIER CTR_ABC_END_DIAG_LAM_ADJ_1 ECU_ADDRESS 0x7f9c86 FORMAT "%3.0" /end MEASUREMENT
/begin MEASUREMENT fmy_stat_lam_adj_1.err_info_stat.reserved "" UWORD _CNV_A_R_LINEAR_____0_CM 1 0. 0. 65535. DISPLAY_IDENTIFIER FMY_STAT_LAM_ADJ_1_ERR_INFO_STAT_RESERVED ECU_ADDRESS 0x7f9c84 BYTE_ORDER MSB_LAST BIT_MASK 0xF800 /end MEASUREMENT
/begin MEASUREMENT fmy_stat_lam_adj_1.err_info_stat.lv_cdn_diag_stc "Statistical flag for condition of diagnosis of the diagnosis instance LAM_ADJ_1" UWORD _CNV_S_2_RANGE______383_CM 1 0. 0. 1. DISPLAY_IDENTIFIER LV_CDN_DIAG_STC_LAM_ADJ_1 ECU_ADDRESS 0x7f9c84 BYTE_ORDER MSB_LAST BIT_MASK 0x400 /end MEASUREMENT
/begin MEASUREMENT fmy_stat_lam_adj_1.err_info_stat.lv_lock_diag "lock flag (CPU load optimisation) of the diagnosis instance LAM_ADJ_1" UWORD _CNV_S_2_RANGE______383_CM 1 0. 0. 1. DISPLAY_IDENTIFIER LV_LOCK_DIAG_LAM_ADJ_1 ECU_ADDRESS 0x7f9c84 BYTE_ORDER MSB_LAST BIT_MASK 0x200 /end MEASUREMENT
/begin MEASUREMENT fmy_stat_lam_adj_1.err_info_stat.lv_err_mem "storage in dynamic failure memory of the diagnosis instance LAM_ADJ_1" UWORD _CNV_S_2_RANGE______383_CM 1 0. 0. 1. DISPLAY_IDENTIFIER LV_ERR_MEM_LAM_ADJ_1 ECU_ADDRESS 0x7f9c84 BYTE_ORDER MSB_LAST BIT_MASK 0x80 /end MEASUREMENT
/begin MEASUREMENT fmy_stat_lam_adj_1.err_info_stat.lv_ready "readiness status of the diagnosis instance LAM_ADJ_1" UWORD _CNV_S_2_RANGE______383_CM 1 0. 0. 1. DISPLAY_IDENTIFIER LV_READY_LAM_ADJ_1 ECU_ADDRESS 0x7f9c84 BYTE_ORDER MSB_LAST BIT_MASK 0x40 /end MEASUREMENT
/begin MEASUREMENT fmy_stat_lam_adj_1.err_info_stat.lv_end_diag "end of diagnosis of the diagnosis instance LAM_ADJ_1" UWORD _CNV_S_2_RANGE______383_CM 1 0. 0. 1. DISPLAY_IDENTIFIER LV_END_DIAG_LAM_ADJ_1 ECU_ADDRESS 0x7f9c84 BYTE_ORDER MSB_LAST BIT_MASK 0x20 /end MEASUREMENT
/begin MEASUREMENT fmy_stat_lam_adj_1.err_info_stat.lv_cdn_diag "diagnosis condition of the diagnosis instance LAM_ADJ_1" UWORD _CNV_S_2_RANGE______383_CM 1 0. 0. 1. DISPLAY_IDENTIFIER LV_CDN_DIAG_LAM_ADJ_1 ECU_ADDRESS 0x7f9c84 BYTE_ORDER MSB_LAST BIT_MASK 0x10 /end MEASUREMENT
/begin MEASUREMENT fmy_stat_lam_adj_1.err_info_stat.err_sym "symptoms of the diagnosis instance LAM_ADJ_1" UWORD _CNV_S_6_CONV_ERRM__22_CM 1 0. 0. 15. DISPLAY_IDENTIFIER ERR_SYM_LAM_ADJ_1 ECU_ADDRESS 0x7f9c84 BYTE_ORDER MSB_LAST BIT_MASK 0xF /end MEASUREMENT
/begin MEASUREMENT fmy_stat_chk_ls_down_1.ctr_abc "anti bounce counter for diagnosis instance CHK_LS_DOWN_1" UBYTE _CNV_A_R_LINEAR_____1_CM 1 0. 0. 255. DISPLAY_IDENTIFIER CTR_ABC_CHK_LS_DOWN_1 ECU_ADDRESS 0x7f9c8b FORMAT "%3.0" /end MEASUREMENT
/begin MEASUREMENT fmy_stat_chk_ls_down_1.ctr_end_diag "counter for end of diagnosis for diagnosis instance CHK_LS_DOWN_1" UBYTE _CNV_A_R_LINEAR_____1_CM 1 0. 0. 255. DISPLAY_IDENTIFIER CTR_ABC_END_DIAG_CHK_LS_DOWN_1 ECU_ADDRESS 0x7f9c8a FORMAT "%3.0" /end MEASUREMENT
/begin MEASUREMENT fmy_stat_chk_ls_down_1.err_info_stat.reserved "" UWORD _CNV_A_R_LINEAR_____0_CM 1 0. 0. 65535. DISPLAY_IDENTIFIER FMY_STAT_CHK_LS_DOWN_1_ERR_INFO_STAT_RESERVED ECU_ADDRESS 0x7f9c88 BYTE_ORDER MSB_LAST BIT_MASK 0xF800 /end MEASUREMENT
/begin MEASUREMENT fmy_stat_chk_ls_down_1.err_info_stat.lv_cdn_diag_stc "Statistical flag for condition of diagnosis of the diagnosis instance CHK_LS_DOWN_1" UWORD _CNV_S_2_RANGE______383_CM 1 0. 0. 1. DISPLAY_IDENTIFIER LV_CDN_DIAG_STC_CHK_LS_DOWN_1 ECU_ADDRESS 0x7f9c88 BYTE_ORDER MSB_LAST BIT_MASK 0x400 /end MEASUREMENT
/begin MEASUREMENT fmy_stat_chk_ls_down_1.err_info_stat.lv_lock_diag "lock flag (CPU load optimisation) of the diagnosis instance CHK_LS_DOWN_1" UWORD _CNV_S_2_RANGE______383_CM 1 0. 0. 1. DISPLAY_IDENTIFIER LV_LOCK_DIAG_CHK_LS_DOWN_1 ECU_ADDRESS 0x7f9c88 BYTE_ORDER MSB_LAST BIT_MASK 0x200 /end MEASUREMENT
/begin MEASUREMENT fmy_stat_chk_ls_down_1.err_info_stat.lv_err_mem "storage in dynamic failure memory of the diagnosis instance CHK_LS_DOWN_1" UWORD _CNV_S_2_RANGE______383_CM 1 0. 0. 1. DISPLAY_IDENTIFIER LV_ERR_MEM_CHK_LS_DOWN_1 ECU_ADDRESS 0x7f9c88 BYTE_ORDER MSB_LAST BIT_MASK 0x80 /end MEASUREMENT
/begin MEASUREMENT fmy_stat_chk_ls_down_1.err_info_stat.lv_ready "readiness status of the diagnosis instance CHK_LS_DOWN_1" UWORD _CNV_S_2_RANGE______383_CM 1 0. 0. 1. DISPLAY_IDENTIFIER LV_READY_CHK_LS_DOWN_1 ECU_ADDRESS 0x7f9c88 BYTE_ORDER MSB_LAST BIT_MASK 0x40 /end MEASUREMENT
/begin MEASUREMENT fmy_stat_chk_ls_down_1.err_info_stat.lv_end_diag "end of diagnosis of the diagnosis instance CHK_LS_DOWN_1" UWORD _CNV_S_2_RANGE______383_CM 1 0. 0. 1. DISPLAY_IDENTIFIER LV_END_DIAG_CHK_LS_DOWN_1 ECU_ADDRESS 0x7f9c88 BYTE_ORDER MSB_LAST BIT_MASK 0x20 /end MEASUREMENT
/begin MEASUREMENT fmy_stat_chk_ls_down_1.err_info_stat.lv_cdn_diag "diagnosis condition of the diagnosis instance CHK_LS_DOWN_1" UWORD _CNV_S_2_RANGE______383_CM 1 0. 0. 1. DISPLAY_IDENTIFIER LV_CDN_DIAG_CHK_LS_DOWN_1 ECU_ADDRESS 0x7f9c88 BYTE_ORDER MSB_LAST BIT_MASK 0x10 /end MEASUREMENT
/begin MEASUREMENT fmy_stat_chk_ls_down_1.err_info_stat.err_sym "symptoms of the diagnosis instance CHK_LS_DOWN_1" UWORD _CNV_S_6_CONV_ERRM__22_CM 1 0. 0. 15. DISPLAY_IDENTIFIER ERR_SYM_CHK_LS_DOWN_1 ECU_ADDRESS 0x7f9c88 BYTE_ORDER MSB_LAST BIT_MASK 0xF /end MEASUREMENT
/begin MEASUREMENT fmy_stat_puc_ls_down_1.ctr_abc "anti bounce counter for diagnosis instance PUC_LS_DOWN_1" UBYTE _CNV_A_R_LINEAR_____1_CM 1 0. 0. 255. DISPLAY_IDENTIFIER CTR_ABC_PUC_LS_DOWN_1 ECU_ADDRESS 0x7f9c8f FORMAT "%3.0" /end MEASUREMENT
/begin MEASUREMENT fmy_stat_puc_ls_down_1.ctr_end_diag "counter for end of diagnosis for diagnosis instance PUC_LS_DOWN_1" UBYTE _CNV_A_R_LINEAR_____1_CM 1 0. 0. 255. DISPLAY_IDENTIFIER CTR_ABC_END_DIAG_PUC_LS_DOWN_1 ECU_ADDRESS 0x7f9c8e FORMAT "%3.0" /end MEASUREMENT
/begin MEASUREMENT fmy_stat_puc_ls_down_1.err_info_stat.reserved "" UWORD _CNV_A_R_LINEAR_____0_CM 1 0. 0. 65535. DISPLAY_IDENTIFIER FMY_STAT_PUC_LS_DOWN_1_ERR_INFO_STAT_RESERVED ECU_ADDRESS 0x7f9c8c BYTE_ORDER MSB_LAST BIT_MASK 0xF800 /end MEASUREMENT
/begin MEASUREMENT fmy_stat_puc_ls_down_1.err_info_stat.lv_cdn_diag_stc "Statistical flag for condition of diagnosis of the diagnosis instance PUC_LS_DOWN_1" UWORD _CNV_S_2_RANGE______383_CM 1 0. 0. 1. DISPLAY_IDENTIFIER LV_CDN_DIAG_STC_PUC_LS_DOWN_1 ECU_ADDRESS 0x7f9c8c BYTE_ORDER MSB_LAST BIT_MASK 0x400 /end MEASUREMENT
/begin MEASUREMENT fmy_stat_puc_ls_down_1.err_info_stat.lv_lock_diag "lock flag (CPU load optimisation) of the diagnosis instance PUC_LS_DOWN_1" UWORD _CNV_S_2_RANGE______383_CM 1 0. 0. 1. DISPLAY_IDENTIFIER LV_LOCK_DIAG_PUC_LS_DOWN_1 ECU_ADDRESS 0x7f9c8c BYTE_ORDER MSB_LAST BIT_MASK 0x200 /end MEASUREMENT
/begin MEASUREMENT fmy_stat_puc_ls_down_1.err_info_stat.lv_err_mem "storage in dynamic failure memory of the diagnosis instance PUC_LS_DOWN_1" UWORD _CNV_S_2_RANGE______383_CM 1 0. 0. 1. DISPLAY_IDENTIFIER LV_ERR_MEM_PUC_LS_DOWN_1 ECU_ADDRESS 0x7f9c8c BYTE_ORDER MSB_LAST BIT_MASK 0x80 /end MEASUREMENT
/begin MEASUREMENT fmy_stat_puc_ls_down_1.err_info_stat.lv_ready "readiness status of the diagnosis instance PUC_LS_DOWN_1" UWORD _CNV_S_2_RANGE______383_CM 1 0. 0. 1. DISPLAY_IDENTIFIER LV_READY_PUC_LS_DOWN_1 ECU_ADDRESS 0x7f9c8c BYTE_ORDER MSB_LAST BIT_MASK 0x40 /end MEASUREMENT
/begin MEASUREMENT fmy_stat_puc_ls_down_1.err_info_stat.lv_end_diag "end of diagnosis of the diagnosis instance PUC_LS_DOWN_1" UWORD _CNV_S_2_RANGE______383_CM 1 0. 0. 1. DISPLAY_IDENTIFIER LV_END_DIAG_PUC_LS_DOWN_1 ECU_ADDRESS 0x7f9c8c BYTE_ORDER MSB_LAST BIT_MASK 0x20 /end MEASUREMENT
/begin MEASUREMENT fmy_stat_puc_ls_down_1.err_info_stat.lv_cdn_diag "diagnosis condition of the diagnosis instance PUC_LS_DOWN_1" UWORD _CNV_S_2_RANGE______383_CM 1 0. 0. 1. DISPLAY_IDENTIFIER LV_CDN_DIAG_PUC_LS_DOWN_1 ECU_ADDRESS 0x7f9c8c BYTE_ORDER MSB_LAST BIT_MASK 0x10 /end MEASUREMENT
/begin MEASUREMENT fmy_stat_puc_ls_down_1.err_info_stat.err_sym "symptoms of the diagnosis instance PUC_LS_DOWN_1" UWORD _CNV_S_6_CONV_ERRM__22_CM 1 0. 0. 15. DISPLAY_IDENTIFIER ERR_SYM_PUC_LS_DOWN_1 ECU_ADDRESS 0x7f9c8c BYTE_ORDER MSB_LAST BIT_MASK 0xF /end MEASUREMENT
/begin MEASUREMENT fmy_stat_fl_ls_down_1.ctr_abc "anti bounce counter for diagnosis instance FL_LS_DOWN_1" UBYTE _CNV_A_R_LINEAR_____1_CM 1 0. 0. 255. DISPLAY_IDENTIFIER CTR_ABC_FL_LS_DOWN_1 ECU_ADDRESS 0x7f9c93 FORMAT "%3.0" /end MEASUREMENT
/begin MEASUREMENT fmy_stat_fl_ls_down_1.ctr_end_diag "counter for end of diagnosis for diagnosis instance FL_LS_DOWN_1" UBYTE _CNV_A_R_LINEAR_____1_CM 1 0. 0. 255. DISPLAY_IDENTIFIER CTR_ABC_END_DIAG_FL_LS_DOWN_1 ECU_ADDRESS 0x7f9c92 FORMAT "%3.0" /end MEASUREMENT
/begin MEASUREMENT fmy_stat_fl_ls_down_1.err_info_stat.reserved "" UWORD _CNV_A_R_LINEAR_____0_CM 1 0. 0. 65535. DISPLAY_IDENTIFIER FMY_STAT_FL_LS_DOWN_1_ERR_INFO_STAT_RESERVED ECU_ADDRESS 0x7f9c90 BYTE_ORDER MSB_LAST BIT_MASK 0xF800 /end MEASUREMENT
/begin MEASUREMENT fmy_stat_fl_ls_down_1.err_info_stat.lv_cdn_diag_stc "Statistical flag for condition of diagnosis of the diagnosis instance FL_LS_DOWN_1" UWORD _CNV_S_2_RANGE______383_CM 1 0. 0. 1. DISPLAY_IDENTIFIER LV_CDN_DIAG_STC_FL_LS_DOWN_1 ECU_ADDRESS 0x7f9c90 BYTE_ORDER MSB_LAST BIT_MASK 0x400 /end MEASUREMENT
/begin MEASUREMENT fmy_stat_fl_ls_down_1.err_info_stat.lv_lock_diag "lock flag (CPU load optimisation) of the diagnosis instance FL_LS_DOWN_1" UWORD _CNV_S_2_RANGE______383_CM 1 0. 0. 1. DISPLAY_IDENTIFIER LV_LOCK_DIAG_FL_LS_DOWN_1 ECU_ADDRESS 0x7f9c90 BYTE_ORDER MSB_LAST BIT_MASK 0x200 /end MEASUREMENT
/begin MEASUREMENT fmy_stat_fl_ls_down_1.err_info_stat.lv_err_mem "storage in dynamic failure memory of the diagnosis instance FL_LS_DOWN_1" UWORD _CNV_S_2_RANGE______383_CM 1 0. 0. 1. DISPLAY_IDENTIFIER LV_ERR_MEM_FL_LS_DOWN_1 ECU_ADDRESS 0x7f9c90 BYTE_ORDER MSB_LAST BIT_MASK 0x80 /end MEASUREMENT
/begin MEASUREMENT fmy_stat_fl_ls_down_1.err_info_stat.lv_ready "readiness status of the diagnosis instance FL_LS_DOWN_1" UWORD _CNV_S_2_RANGE______383_CM 1 0. 0. 1. DISPLAY_IDENTIFIER LV_READY_FL_LS_DOWN_1 ECU_ADDRESS 0x7f9c90 BYTE_ORDER MSB_LAST BIT_MASK 0x40 /end MEASUREMENT
/begin MEASUREMENT fmy_stat_fl_ls_down_1.err_info_stat.lv_end_diag "end of diagnosis of the diagnosis instance FL_LS_DOWN_1" UWORD _CNV_S_2_RANGE______383_CM 1 0. 0. 1. DISPLAY_IDENTIFIER LV_END_DIAG_FL_LS_DOWN_1 ECU_ADDRESS 0x7f9c90 BYTE_ORDER MSB_LAST BIT_MASK 0x20 /end MEASUREMENT
/begin MEASUREMENT fmy_stat_fl_ls_down_1.err_info_stat.lv_cdn_diag "diagnosis condition of the diagnosis instance FL_LS_DOWN_1" UWORD _CNV_S_2_RANGE______383_CM 1 0. 0. 1. DISPLAY_IDENTIFIER LV_CDN_DIAG_FL_LS_DOWN_1 ECU_ADDRESS 0x7f9c90 BYTE_ORDER MSB_LAST BIT_MASK 0x10 /end MEASUREMENT
/begin MEASUREMENT fmy_stat_fl_ls_down_1.err_info_stat.err_sym "symptoms of the diagnosis instance FL_LS_DOWN_1" UWORD _CNV_S_6_CONV_ERRM__22_CM 1 0. 0. 15. DISPLAY_IDENTIFIER ERR_SYM_FL_LS_DOWN_1 ECU_ADDRESS 0x7f9c90 BYTE_ORDER MSB_LAST BIT_MASK 0xF /end MEASUREMENT
/begin MEASUREMENT fmy_stat_el_lsl_up_1.ctr_abc "anti bounce counter for diagnosis instance EL_LSL_UP_1" UBYTE _CNV_A_R_LINEAR_____1_CM 1 0. 0. 255. DISPLAY_IDENTIFIER CTR_ABC_EL_LSL_UP_1 ECU_ADDRESS 0x7f9c97 FORMAT "%3.0" /end MEASUREMENT
/begin MEASUREMENT fmy_stat_el_lsl_up_1.ctr_end_diag "counter for end of diagnosis for diagnosis instance EL_LSL_UP_1" UBYTE _CNV_A_R_LINEAR_____1_CM 1 0. 0. 255. DISPLAY_IDENTIFIER CTR_ABC_END_DIAG_EL_LSL_UP_1 ECU_ADDRESS 0x7f9c96 FORMAT "%3.0" /end MEASUREMENT
/begin MEASUREMENT fmy_stat_el_lsl_up_1.err_info_stat.reserved "" UWORD _CNV_A_R_LINEAR_____0_CM 1 0. 0. 65535. DISPLAY_IDENTIFIER FMY_STAT_EL_LSL_UP_1_ERR_INFO_STAT_RESERVED ECU_ADDRESS 0x7f9c94 BYTE_ORDER MSB_LAST BIT_MASK 0xF800 /end MEASUREMENT
/begin MEASUREMENT fmy_stat_el_lsl_up_1.err_info_stat.lv_cdn_diag_stc "Statistical flag for condition of diagnosis of the diagnosis instance EL_LSL_UP_1" UWORD _CNV_S_2_RANGE______383_CM 1 0. 0. 1. DISPLAY_IDENTIFIER LV_CDN_DIAG_STC_EL_LSL_UP_1 ECU_ADDRESS 0x7f9c94 BYTE_ORDER MSB_LAST BIT_MASK 0x400 /end MEASUREMENT
/begin MEASUREMENT fmy_stat_el_lsl_up_1.err_info_stat.lv_lock_diag "lock flag (CPU load optimisation) of the diagnosis instance EL_LSL_UP_1" UWORD _CNV_S_2_RANGE______383_CM 1 0. 0. 1. DISPLAY_IDENTIFIER LV_LOCK_DIAG_EL_LSL_UP_1 ECU_ADDRESS 0x7f9c94 BYTE_ORDER MSB_LAST BIT_MASK 0x200 /end MEASUREMENT
/begin MEASUREMENT fmy_stat_el_lsl_up_1.err_info_stat.lv_err_mem "storage in dynamic failure memory of the diagnosis instance EL_LSL_UP_1" UWORD _CNV_S_2_RANGE______383_CM 1 0. 0. 1. DISPLAY_IDENTIFIER LV_ERR_MEM_EL_LSL_UP_1 ECU_ADDRESS 0x7f9c94 BYTE_ORDER MSB_LAST BIT_MASK 0x80 /end MEASUREMENT
/begin MEASUREMENT fmy_stat_el_lsl_up_1.err_info_stat.lv_ready "readiness status of the diagnosis instance EL_LSL_UP_1" UWORD _CNV_S_2_RANGE______383_CM 1 0. 0. 1. DISPLAY_IDENTIFIER LV_READY_EL_LSL_UP_1 ECU_ADDRESS 0x7f9c94 BYTE_ORDER MSB_LAST BIT_MASK 0x40 /end MEASUREMENT
/begin MEASUREMENT fmy_stat_el_lsl_up_1.err_info_stat.lv_end_diag "end of diagnosis of the diagnosis instance EL_LSL_UP_1" UWORD _CNV_S_2_RANGE______383_CM 1 0. 0. 1. DISPLAY_IDENTIFIER LV_END_DIAG_EL_LSL_UP_1 ECU_ADDRESS 0x7f9c94 BYTE_ORDER MSB_LAST BIT_MASK 0x20 /end MEASUREMENT
/begin MEASUREMENT fmy_stat_el_lsl_up_1.err_info_stat.lv_cdn_diag "diagnosis condition of the diagnosis instance EL_LSL_UP_1" UWORD _CNV_S_2_RANGE______383_CM 1 0. 0. 1. DISPLAY_IDENTIFIER LV_CDN_DIAG_EL_LSL_UP_1 ECU_ADDRESS 0x7f9c94 BYTE_ORDER MSB_LAST BIT_MASK 0x10 /end MEASUREMENT
/begin MEASUREMENT fmy_stat_el_lsl_up_1.err_info_stat.err_sym "symptoms of the diagnosis instance EL_LSL_UP_1" UWORD _CNV_S_6_CONV_ERRM__22_CM 1 0. 0. 15. DISPLAY_IDENTIFIER ERR_SYM_EL_LSL_UP_1 ECU_ADDRESS 0x7f9c94 BYTE_ORDER MSB_LAST BIT_MASK 0xF /end MEASUREMENT
/begin MEASUREMENT fmy_stat_oc_lsl_up_1.ctr_abc "anti bounce counter for diagnosis instance OC_LSL_UP_1" UBYTE _CNV_A_R_LINEAR_____1_CM 1 0. 0. 255. DISPLAY_IDENTIFIER CTR_ABC_OC_LSL_UP_1 ECU_ADDRESS 0x7f9c9b FORMAT "%3.0" /end MEASUREMENT
/begin MEASUREMENT fmy_stat_oc_lsl_up_1.ctr_end_diag "counter for end of diagnosis for diagnosis instance OC_LSL_UP_1" UBYTE _CNV_A_R_LINEAR_____1_CM 1 0. 0. 255. DISPLAY_IDENTIFIER CTR_ABC_END_DIAG_OC_LSL_UP_1 ECU_ADDRESS 0x7f9c9a FORMAT "%3.0" /end MEASUREMENT
/begin MEASUREMENT fmy_stat_oc_lsl_up_1.err_info_stat.reserved "" UWORD _CNV_A_R_LINEAR_____0_CM 1 0. 0. 65535. DISPLAY_IDENTIFIER FMY_STAT_OC_LSL_UP_1_ERR_INFO_STAT_RESERVED ECU_ADDRESS 0x7f9c98 BYTE_ORDER MSB_LAST BIT_MASK 0xF800 /end MEASUREMENT
/begin MEASUREMENT fmy_stat_oc_lsl_up_1.err_info_stat.lv_cdn_diag_stc "Statistical flag for condition of diagnosis of the diagnosis instance OC_LSL_UP_1" UWORD _CNV_S_2_RANGE______383_CM 1 0. 0. 1. DISPLAY_IDENTIFIER LV_CDN_DIAG_STC_OC_LSL_UP_1 ECU_ADDRESS 0x7f9c98 BYTE_ORDER MSB_LAST BIT_MASK 0x400 /end MEASUREMENT
/begin MEASUREMENT fmy_stat_oc_lsl_up_1.err_info_stat.lv_lock_diag "lock flag (CPU load optimisation) of the diagnosis instance OC_LSL_UP_1" UWORD _CNV_S_2_RANGE______383_CM 1 0. 0. 1. DISPLAY_IDENTIFIER LV_LOCK_DIAG_OC_LSL_UP_1 ECU_ADDRESS 0x7f9c98 BYTE_ORDER MSB_LAST BIT_MASK 0x200 /end MEASUREMENT
/begin MEASUREMENT fmy_stat_oc_lsl_up_1.err_info_stat.lv_err_mem "storage in dynamic failure memory of the diagnosis instance OC_LSL_UP_1" UWORD _CNV_S_2_RANGE______383_CM 1 0. 0. 1. DISPLAY_IDENTIFIER LV_ERR_MEM_OC_LSL_UP_1 ECU_ADDRESS 0x7f9c98 BYTE_ORDER MSB_LAST BIT_MASK 0x80 /end MEASUREMENT
/begin MEASUREMENT fmy_stat_oc_lsl_up_1.err_info_stat.lv_ready "readiness status of the diagnosis instance OC_LSL_UP_1" UWORD _CNV_S_2_RANGE______383_CM 1 0. 0. 1. DISPLAY_IDENTIFIER LV_READY_OC_LSL_UP_1 ECU_ADDRESS 0x7f9c98 BYTE_ORDER MSB_LAST BIT_MASK 0x40 /end MEASUREMENT
/begin MEASUREMENT fmy_stat_oc_lsl_up_1.err_info_stat.lv_end_diag "end of diagnosis of the diagnosis instance OC_LSL_UP_1" UWORD _CNV_S_2_RANGE______383_CM 1 0. 0. 1. DISPLAY_IDENTIFIER LV_END_DIAG_OC_LSL_UP_1 ECU_ADDRESS 0x7f9c98 BYTE_ORDER MSB_LAST BIT_MASK 0x20 /end MEASUREMENT
/begin MEASUREMENT fmy_stat_oc_lsl_up_1.err_info_stat.lv_cdn_diag "diagnosis condition of the diagnosis instance OC_LSL_UP_1" UWORD _CNV_S_2_RANGE______383_CM 1 0. 0. 1. DISPLAY_IDENTIFIER LV_CDN_DIAG_OC_LSL_UP_1 ECU_ADDRESS 0x7f9c98 BYTE_ORDER MSB_LAST BIT_MASK 0x10 /end MEASUREMENT
/begin MEASUREMENT fmy_stat_oc_lsl_up_1.err_info_stat.err_sym "symptoms of the diagnosis instance OC_LSL_UP_1" UWORD _CNV_S_6_CONV_ERRM__22_CM 1 0. 0. 15. DISPLAY_IDENTIFIER ERR_SYM_OC_LSL_UP_1 ECU_ADDRESS 0x7f9c98 BYTE_ORDER MSB_LAST BIT_MASK 0xF /end MEASUREMENT
/begin MEASUREMENT fmy_stat_lsl_up_if_1.ctr_abc "anti bounce counter for diagnosis instance LSL_UP_IF_1" UBYTE _CNV_A_R_LINEAR_____1_CM 1 0. 0. 255. DISPLAY_IDENTIFIER CTR_ABC_LSL_UP_IF_1 ECU_ADDRESS 0x7f9c9f FORMAT "%3.0" /end MEASUREMENT
/begin MEASUREMENT fmy_stat_lsl_up_if_1.ctr_end_diag "counter for end of diagnosis for diagnosis instance LSL_UP_IF_1" UBYTE _CNV_A_R_LINEAR_____1_CM 1 0. 0. 255. DISPLAY_IDENTIFIER CTR_ABC_END_DIAG_LSL_UP_IF_1 ECU_ADDRESS 0x7f9c9e FORMAT "%3.0" /end MEASUREMENT
/begin MEASUREMENT fmy_stat_lsl_up_if_1.err_info_stat.reserved "" UWORD _CNV_A_R_LINEAR_____0_CM 1 0. 0. 65535. DISPLAY_IDENTIFIER FMY_STAT_LSL_UP_IF_1_ERR_INFO_STAT_RESERVED ECU_ADDRESS 0x7f9c9c BYTE_ORDER MSB_LAST BIT_MASK 0xF800 /end MEASUREMENT
/begin MEASUREMENT fmy_stat_lsl_up_if_1.err_info_stat.lv_cdn_diag_stc "Statistical flag for condition of diagnosis of the diagnosis instance LSL_UP_IF_1" UWORD _CNV_S_2_RANGE______383_CM 1 0. 0. 1. DISPLAY_IDENTIFIER LV_CDN_DIAG_STC_LSL_UP_IF_1 ECU_ADDRESS 0x7f9c9c BYTE_ORDER MSB_LAST BIT_MASK 0x400 /end MEASUREMENT
/begin MEASUREMENT fmy_stat_lsl_up_if_1.err_info_stat.lv_lock_diag "lock flag (CPU load optimisation) of the diagnosis instance LSL_UP_IF_1" UWORD _CNV_S_2_RANGE______383_CM 1 0. 0. 1. DISPLAY_IDENTIFIER LV_LOCK_DIAG_LSL_UP_IF_1 ECU_ADDRESS 0x7f9c9c BYTE_ORDER MSB_LAST BIT_MASK 0x200 /end MEASUREMENT
/begin MEASUREMENT fmy_stat_lsl_up_if_1.err_info_stat.lv_err_mem "storage in dynamic failure memory of the diagnosis instance LSL_UP_IF_1" UWORD _CNV_S_2_RANGE______383_CM 1 0. 0. 1. DISPLAY_IDENTIFIER LV_ERR_MEM_LSL_UP_IF_1 ECU_ADDRESS 0x7f9c9c BYTE_ORDER MSB_LAST BIT_MASK 0x80 /end MEASUREMENT
/begin MEASUREMENT fmy_stat_lsl_up_if_1.err_info_stat.lv_ready "readiness status of the diagnosis instance LSL_UP_IF_1" UWORD _CNV_S_2_RANGE______383_CM 1 0. 0. 1. DISPLAY_IDENTIFIER LV_READY_LSL_UP_IF_1 ECU_ADDRESS 0x7f9c9c BYTE_ORDER MSB_LAST BIT_MASK 0x40 /end MEASUREMENT
/begin MEASUREMENT fmy_stat_lsl_up_if_1.err_info_stat.lv_end_diag "end of diagnosis of the diagnosis instance LSL_UP_IF_1" UWORD _CNV_S_2_RANGE______383_CM 1 0. 0. 1. DISPLAY_IDENTIFIER LV_END_DIAG_LSL_UP_IF_1 ECU_ADDRESS 0x7f9c9c BYTE_ORDER MSB_LAST BIT_MASK 0x20 /end MEASUREMENT
/begin MEASUREMENT fmy_stat_lsl_up_if_1.err_info_stat.lv_cdn_diag "diagnosis condition of the diagnosis instance LSL_UP_IF_1" UWORD _CNV_S_2_RANGE______383_CM 1 0. 0. 1. DISPLAY_IDENTIFIER LV_CDN_DIAG_LSL_UP_IF_1 ECU_ADDRESS 0x7f9c9c BYTE_ORDER MSB_LAST BIT_MASK 0x10 /end MEASUREMENT
/begin MEASUREMENT fmy_stat_lsl_up_if_1.err_info_stat.err_sym "symptoms of the diagnosis instance LSL_UP_IF_1" UWORD _CNV_S_6_CONV_ERRM__22_CM 1 0. 0. 15. DISPLAY_IDENTIFIER ERR_SYM_LSL_UP_IF_1 ECU_ADDRESS 0x7f9c9c BYTE_ORDER MSB_LAST BIT_MASK 0xF /end MEASUREMENT
/begin MEASUREMENT fmy_stat_air_lsl_up_1.ctr_abc "anti bounce counter for diagnosis instance AIR_LSL_UP_1" UBYTE _CNV_A_R_LINEAR_____1_CM 1 0. 0. 255. DISPLAY_IDENTIFIER CTR_ABC_AIR_LSL_UP_1 ECU_ADDRESS 0x7f9ca3 FORMAT "%3.0" /end MEASUREMENT
/begin MEASUREMENT fmy_stat_air_lsl_up_1.ctr_end_diag "counter for end of diagnosis for diagnosis instance AIR_LSL_UP_1" UBYTE _CNV_A_R_LINEAR_____1_CM 1 0. 0. 255. DISPLAY_IDENTIFIER CTR_ABC_END_DIAG_AIR_LSL_UP_1 ECU_ADDRESS 0x7f9ca2 FORMAT "%3.0" /end MEASUREMENT
/begin MEASUREMENT fmy_stat_air_lsl_up_1.err_info_stat.reserved "" UWORD _CNV_A_R_LINEAR_____0_CM 1 0. 0. 65535. DISPLAY_IDENTIFIER FMY_STAT_AIR_LSL_UP_1_ERR_INFO_STAT_RESERVED ECU_ADDRESS 0x7f9ca0 BYTE_ORDER MSB_LAST BIT_MASK 0xF800 /end MEASUREMENT
/begin MEASUREMENT fmy_stat_air_lsl_up_1.err_info_stat.lv_cdn_diag_stc "Statistical flag for condition of diagnosis of the diagnosis instance AIR_LSL_UP_1" UWORD _CNV_S_2_RANGE______383_CM 1 0. 0. 1. DISPLAY_IDENTIFIER LV_CDN_DIAG_STC_AIR_LSL_UP_1 ECU_ADDRESS 0x7f9ca0 BYTE_ORDER MSB_LAST BIT_MASK 0x400 /end MEASUREMENT
/begin MEASUREMENT fmy_stat_air_lsl_up_1.err_info_stat.lv_lock_diag "lock flag (CPU load optimisation) of the diagnosis instance AIR_LSL_UP_1" UWORD _CNV_S_2_RANGE______383_CM 1 0. 0. 1. DISPLAY_IDENTIFIER LV_LOCK_DIAG_AIR_LSL_UP_1 ECU_ADDRESS 0x7f9ca0 BYTE_ORDER MSB_LAST BIT_MASK 0x200 /end MEASUREMENT
/begin MEASUREMENT fmy_stat_air_lsl_up_1.err_info_stat.lv_err_mem "storage in dynamic failure memory of the diagnosis instance AIR_LSL_UP_1" UWORD _CNV_S_2_RANGE______383_CM 1 0. 0. 1. DISPLAY_IDENTIFIER LV_ERR_MEM_AIR_LSL_UP_1 ECU_ADDRESS 0x7f9ca0 BYTE_ORDER MSB_LAST BIT_MASK 0x80 /end MEASUREMENT
/begin MEASUREMENT fmy_stat_air_lsl_up_1.err_info_stat.lv_ready "readiness status of the diagnosis instance AIR_LSL_UP_1" UWORD _CNV_S_2_RANGE______383_CM 1 0. 0. 1. DISPLAY_IDENTIFIER LV_READY_AIR_LSL_UP_1 ECU_ADDRESS 0x7f9ca0 BYTE_ORDER MSB_LAST BIT_MASK 0x40 /end MEASUREMENT
/begin MEASUREMENT fmy_stat_air_lsl_up_1.err_info_stat.lv_end_diag "end of diagnosis of the diagnosis instance AIR_LSL_UP_1" UWORD _CNV_S_2_RANGE______383_CM 1 0. 0. 1. DISPLAY_IDENTIFIER LV_END_DIAG_AIR_LSL_UP_1 ECU_ADDRESS 0x7f9ca0 BYTE_ORDER MSB_LAST BIT_MASK 0x20 /end MEASUREMENT
/begin MEASUREMENT fmy_stat_air_lsl_up_1.err_info_stat.lv_cdn_diag "diagnosis condition of the diagnosis instance AIR_LSL_UP_1" UWORD _CNV_S_2_RANGE______383_CM 1 0. 0. 1. DISPLAY_IDENTIFIER LV_CDN_DIAG_AIR_LSL_UP_1 ECU_ADDRESS 0x7f9ca0 BYTE_ORDER MSB_LAST BIT_MASK 0x10 /end MEASUREMENT
/begin MEASUREMENT fmy_stat_air_lsl_up_1.err_info_stat.err_sym "symptoms of the diagnosis instance AIR_LSL_UP_1" UWORD _CNV_S_6_CONV_ERRM__22_CM 1 0. 0. 15. DISPLAY_IDENTIFIER ERR_SYM_AIR_LSL_UP_1 ECU_ADDRESS 0x7f9ca0 BYTE_ORDER MSB_LAST BIT_MASK 0xF /end MEASUREMENT
/begin MEASUREMENT fmy_stat_ttip_obd_ls_up_1.ctr_abc "anti bounce counter for diagnosis instance TTIP_OBD_LS_UP_1" UBYTE _CNV_A_R_LINEAR_____1_CM 1 0. 0. 255. DISPLAY_IDENTIFIER CTR_ABC_TTIP_OBD_LS_UP_1 ECU_ADDRESS 0x7f9ca7 FORMAT "%3.0" /end MEASUREMENT
/begin MEASUREMENT fmy_stat_ttip_obd_ls_up_1.ctr_end_diag "counter for end of diagnosis for diagnosis instance TTIP_OBD_LS_UP_1" UBYTE _CNV_A_R_LINEAR_____1_CM 1 0. 0. 255. DISPLAY_IDENTIFIER CTR_ABC_END_DIAG_TTIP_OBD_LS_UP_1 ECU_ADDRESS 0x7f9ca6 FORMAT "%3.0" /end MEASUREMENT
/begin MEASUREMENT fmy_stat_ttip_obd_ls_up_1.err_info_stat.reserved "" UWORD _CNV_A_R_LINEAR_____0_CM 1 0. 0. 65535. DISPLAY_IDENTIFIER FMY_STAT_TTIP_OBD_LS_UP_1_ERR_INFO_STAT_RESERVED ECU_ADDRESS 0x7f9ca4 BYTE_ORDER MSB_LAST BIT_MASK 0xF800 /end MEASUREMENT
/begin MEASUREMENT fmy_stat_ttip_obd_ls_up_1.err_info_stat.lv_cdn_diag_stc "Statistical flag for condition of diagnosis of the diagnosis instance TTIP_OBD_LS_UP_1" UWORD _CNV_S_2_RANGE______383_CM 1 0. 0. 1. DISPLAY_IDENTIFIER LV_CDN_DIAG_STC_TTIP_OBD_LS_UP_1 ECU_ADDRESS 0x7f9ca4 BYTE_ORDER MSB_LAST BIT_MASK 0x400 /end MEASUREMENT
/begin MEASUREMENT fmy_stat_ttip_obd_ls_up_1.err_info_stat.lv_lock_diag "lock flag (CPU load optimisation) of the diagnosis instance TTIP_OBD_LS_UP_1" UWORD _CNV_S_2_RANGE______383_CM 1 0. 0. 1. DISPLAY_IDENTIFIER LV_LOCK_DIAG_TTIP_OBD_LS_UP_1 ECU_ADDRESS 0x7f9ca4 BYTE_ORDER MSB_LAST BIT_MASK 0x200 /end MEASUREMENT
/begin MEASUREMENT fmy_stat_ttip_obd_ls_up_1.err_info_stat.lv_err_mem "storage in dynamic failure memory of the diagnosis instance TTIP_OBD_LS_UP_1" UWORD _CNV_S_2_RANGE______383_CM 1 0. 0. 1. DISPLAY_IDENTIFIER LV_ERR_MEM_TTIP_OBD_LS_UP_1 ECU_ADDRESS 0x7f9ca4 BYTE_ORDER MSB_LAST BIT_MASK 0x80 /end MEASUREMENT
/begin MEASUREMENT fmy_stat_ttip_obd_ls_up_1.err_info_stat.lv_ready "readiness status of the diagnosis instance TTIP_OBD_LS_UP_1" UWORD _CNV_S_2_RANGE______383_CM 1 0. 0. 1. DISPLAY_IDENTIFIER LV_READY_TTIP_OBD_LS_UP_1 ECU_ADDRESS 0x7f9ca4 BYTE_ORDER MSB_LAST BIT_MASK 0x40 /end MEASUREMENT
/begin MEASUREMENT fmy_stat_ttip_obd_ls_up_1.err_info_stat.lv_end_diag "end of diagnosis of the diagnosis instance TTIP_OBD_LS_UP_1" UWORD _CNV_S_2_RANGE______383_CM 1 0. 0. 1. DISPLAY_IDENTIFIER LV_END_DIAG_TTIP_OBD_LS_UP_1 ECU_ADDRESS 0x7f9ca4 BYTE_ORDER MSB_LAST BIT_MASK 0x20 /end MEASUREMENT
/begin MEASUREMENT fmy_stat_ttip_obd_ls_up_1.err_info_stat.lv_cdn_diag "diagnosis condition of the diagnosis instance TTIP_OBD_LS_UP_1" UWORD _CNV_S_2_RANGE______383_CM 1 0. 0. 1. DISPLAY_IDENTIFIER LV_CDN_DIAG_TTIP_OBD_LS_UP_1 ECU_ADDRESS 0x7f9ca4 BYTE_ORDER MSB_LAST BIT_MASK 0x10 /end MEASUREMENT
/begin MEASUREMENT fmy_stat_ttip_obd_ls_up_1.err_info_stat.err_sym "symptoms of the diagnosis instance TTIP_OBD_LS_UP_1" UWORD _CNV_S_6_CONV_ERRM__22_CM 1 0. 0. 15. DISPLAY_IDENTIFIER ERR_SYM_TTIP_OBD_LS_UP_1 ECU_ADDRESS 0x7f9ca4 BYTE_ORDER MSB_LAST BIT_MASK 0xF /end MEASUREMENT
/begin MEASUREMENT fmy_stat_dyn_vld_ls_up_1.ctr_abc "anti bounce counter for diagnosis instance DYN_VLD_LS_UP_1" UBYTE _CNV_A_R_LINEAR_____1_CM 1 0. 0. 255. DISPLAY_IDENTIFIER CTR_ABC_DYN_VLD_LS_UP_1 ECU_ADDRESS 0x7f9cab FORMAT "%3.0" /end MEASUREMENT
/begin MEASUREMENT fmy_stat_dyn_vld_ls_up_1.ctr_end_diag "counter for end of diagnosis for diagnosis instance DYN_VLD_LS_UP_1" UBYTE _CNV_A_R_LINEAR_____1_CM 1 0. 0. 255. DISPLAY_IDENTIFIER CTR_ABC_END_DIAG_DYN_VLD_LS_UP_1 ECU_ADDRESS 0x7f9caa FORMAT "%3.0" /end MEASUREMENT
/begin MEASUREMENT fmy_stat_dyn_vld_ls_up_1.err_info_stat.reserved "" UWORD _CNV_A_R_LINEAR_____0_CM 1 0. 0. 65535. DISPLAY_IDENTIFIER FMY_STAT_DYN_VLD_LS_UP_1_ERR_INFO_STAT_RESERVED ECU_ADDRESS 0x7f9ca8 BYTE_ORDER MSB_LAST BIT_MASK 0xF800 /end MEASUREMENT
/begin MEASUREMENT fmy_stat_dyn_vld_ls_up_1.err_info_stat.lv_cdn_diag_stc "Statistical flag for condition of diagnosis of the diagnosis instance DYN_VLD_LS_UP_1" UWORD _CNV_S_2_RANGE______383_CM 1 0. 0. 1. DISPLAY_IDENTIFIER LV_CDN_DIAG_STC_DYN_VLD_LS_UP_1 ECU_ADDRESS 0x7f9ca8 BYTE_ORDER MSB_LAST BIT_MASK 0x400 /end MEASUREMENT
/begin MEASUREMENT fmy_stat_dyn_vld_ls_up_1.err_info_stat.lv_lock_diag "lock flag (CPU load optimisation) of the diagnosis instance DYN_VLD_LS_UP_1" UWORD _CNV_S_2_RANGE______383_CM 1 0. 0. 1. DISPLAY_IDENTIFIER LV_LOCK_DIAG_DYN_VLD_LS_UP_1 ECU_ADDRESS 0x7f9ca8 BYTE_ORDER MSB_LAST BIT_MASK 0x200 /end MEASUREMENT
/begin MEASUREMENT fmy_stat_dyn_vld_ls_up_1.err_info_stat.lv_err_mem "storage in dynamic failure memory of the diagnosis instance DYN_VLD_LS_UP_1" UWORD _CNV_S_2_RANGE______383_CM 1 0. 0. 1. DISPLAY_IDENTIFIER LV_ERR_MEM_DYN_VLD_LS_UP_1 ECU_ADDRESS 0x7f9ca8 BYTE_ORDER MSB_LAST BIT_MASK 0x80 /end MEASUREMENT
/begin MEASUREMENT fmy_stat_dyn_vld_ls_up_1.err_info_stat.lv_ready "readiness status of the diagnosis instance DYN_VLD_LS_UP_1" UWORD _CNV_S_2_RANGE______383_CM 1 0. 0. 1. DISPLAY_IDENTIFIER LV_READY_DYN_VLD_LS_UP_1 ECU_ADDRESS 0x7f9ca8 BYTE_ORDER MSB_LAST BIT_MASK 0x40 /end MEASUREMENT
/begin MEASUREMENT fmy_stat_dyn_vld_ls_up_1.err_info_stat.lv_end_diag "end of diagnosis of the diagnosis instance DYN_VLD_LS_UP_1" UWORD _CNV_S_2_RANGE______383_CM 1 0. 0. 1. DISPLAY_IDENTIFIER LV_END_DIAG_DYN_VLD_LS_UP_1 ECU_ADDRESS 0x7f9ca8 BYTE_ORDER MSB_LAST BIT_MASK 0x20 /end MEASUREMENT
/begin MEASUREMENT fmy_stat_dyn_vld_ls_up_1.err_info_stat.lv_cdn_diag "diagnosis condition of the diagnosis instance DYN_VLD_LS_UP_1" UWORD _CNV_S_2_RANGE______383_CM 1 0. 0. 1. DISPLAY_IDENTIFIER LV_CDN_DIAG_DYN_VLD_LS_UP_1 ECU_ADDRESS 0x7f9ca8 BYTE_ORDER MSB_LAST BIT_MASK 0x10 /end MEASUREMENT
/begin MEASUREMENT fmy_stat_dyn_vld_ls_up_1.err_info_stat.err_sym "symptoms of the diagnosis instance DYN_VLD_LS_UP_1" UWORD _CNV_S_6_CONV_ERRM__22_CM 1 0. 0. 15. DISPLAY_IDENTIFIER ERR_SYM_DYN_VLD_LS_UP_1 ECU_ADDRESS 0x7f9ca8 BYTE_ORDER MSB_LAST BIT_MASK 0xF /end MEASUREMENT
/begin MEASUREMENT fmy_stat_puc_vld_ls_up_1.ctr_abc "anti bounce counter for diagnosis instance PUC_VLD_LS_UP_1" UBYTE _CNV_A_R_LINEAR_____1_CM 1 0. 0. 255. DISPLAY_IDENTIFIER CTR_ABC_PUC_VLD_LS_UP_1 ECU_ADDRESS 0x7f9caf FORMAT "%3.0" /end MEASUREMENT
/begin MEASUREMENT fmy_stat_puc_vld_ls_up_1.ctr_end_diag "counter for end of diagnosis for diagnosis instance PUC_VLD_LS_UP_1" UBYTE _CNV_A_R_LINEAR_____1_CM 1 0. 0. 255. DISPLAY_IDENTIFIER CTR_ABC_END_DIAG_PUC_VLD_LS_UP_1 ECU_ADDRESS 0x7f9cae FORMAT "%3.0" /end MEASUREMENT
/begin MEASUREMENT fmy_stat_puc_vld_ls_up_1.err_info_stat.reserved "" UWORD _CNV_A_R_LINEAR_____0_CM 1 0. 0. 65535. DISPLAY_IDENTIFIER FMY_STAT_PUC_VLD_LS_UP_1_ERR_INFO_STAT_RESERVED ECU_ADDRESS 0x7f9cac BYTE_ORDER MSB_LAST BIT_MASK 0xF800 /end MEASUREMENT
/begin MEASUREMENT fmy_stat_puc_vld_ls_up_1.err_info_stat.lv_cdn_diag_stc "Statistical flag for condition of diagnosis of the diagnosis instance PUC_VLD_LS_UP_1" UWORD _CNV_S_2_RANGE______383_CM 1 0. 0. 1. DISPLAY_IDENTIFIER LV_CDN_DIAG_STC_PUC_VLD_LS_UP_1 ECU_ADDRESS 0x7f9cac BYTE_ORDER MSB_LAST BIT_MASK 0x400 /end MEASUREMENT
/begin MEASUREMENT fmy_stat_puc_vld_ls_up_1.err_info_stat.lv_lock_diag "lock flag (CPU load optimisation) of the diagnosis instance PUC_VLD_LS_UP_1" UWORD _CNV_S_2_RANGE______383_CM 1 0. 0. 1. DISPLAY_IDENTIFIER LV_LOCK_DIAG_PUC_VLD_LS_UP_1 ECU_ADDRESS 0x7f9cac BYTE_ORDER MSB_LAST BIT_MASK 0x200 /end MEASUREMENT
/begin MEASUREMENT fmy_stat_puc_vld_ls_up_1.err_info_stat.lv_err_mem "storage in dynamic failure memory of the diagnosis instance PUC_VLD_LS_UP_1" UWORD _CNV_S_2_RANGE______383_CM 1 0. 0. 1. DISPLAY_IDENTIFIER LV_ERR_MEM_PUC_VLD_LS_UP_1 ECU_ADDRESS 0x7f9cac BYTE_ORDER MSB_LAST BIT_MASK 0x80 /end MEASUREMENT
/begin MEASUREMENT fmy_stat_puc_vld_ls_up_1.err_info_stat.lv_ready "readiness status of the diagnosis instance PUC_VLD_LS_UP_1" UWORD _CNV_S_2_RANGE______383_CM 1 0. 0. 1. DISPLAY_IDENTIFIER LV_READY_PUC_VLD_LS_UP_1 ECU_ADDRESS 0x7f9cac BYTE_ORDER MSB_LAST BIT_MASK 0x40 /end MEASUREMENT
/begin MEASUREMENT fmy_stat_puc_vld_ls_up_1.err_info_stat.lv_end_diag "end of diagnosis of the diagnosis instance PUC_VLD_LS_UP_1" UWORD _CNV_S_2_RANGE______383_CM 1 0. 0. 1. DISPLAY_IDENTIFIER LV_END_DIAG_PUC_VLD_LS_UP_1 ECU_ADDRESS 0x7f9cac BYTE_ORDER MSB_LAST BIT_MASK 0x20 /end MEASUREMENT
/begin MEASUREMENT fmy_stat_puc_vld_ls_up_1.err_info_stat.lv_cdn_diag "diagnosis condition of the diagnosis instance PUC_VLD_LS_UP_1" UWORD _CNV_S_2_RANGE______383_CM 1 0. 0. 1. DISPLAY_IDENTIFIER LV_CDN_DIAG_PUC_VLD_LS_UP_1 ECU_ADDRESS 0x7f9cac BYTE_ORDER MSB_LAST BIT_MASK 0x10 /end MEASUREMENT
/begin MEASUREMENT fmy_stat_puc_vld_ls_up_1.err_info_stat.err_sym "symptoms of the diagnosis instance PUC_VLD_LS_UP_1" UWORD _CNV_S_6_CONV_ERRM__22_CM 1 0. 0. 15. DISPLAY_IDENTIFIER ERR_SYM_PUC_VLD_LS_UP_1 ECU_ADDRESS 0x7f9cac BYTE_ORDER MSB_LAST BIT_MASK 0xF /end MEASUREMENT
/begin MEASUREMENT fmy_stat_obd_vld_lsh_up_1.ctr_abc "anti bounce counter for diagnosis instance OBD_VLD_LSH_UP_1" UBYTE _CNV_A_R_LINEAR_____1_CM 1 0. 0. 255. DISPLAY_IDENTIFIER CTR_ABC_OBD_VLD_LSH_UP_1 ECU_ADDRESS 0x7f9cb3 FORMAT "%3.0" /end MEASUREMENT
/begin MEASUREMENT fmy_stat_obd_vld_lsh_up_1.ctr_end_diag "counter for end of diagnosis for diagnosis instance OBD_VLD_LSH_UP_1" UBYTE _CNV_A_R_LINEAR_____1_CM 1 0. 0. 255. DISPLAY_IDENTIFIER CTR_ABC_END_DIAG_OBD_VLD_LSH_UP_1 ECU_ADDRESS 0x7f9cb2 FORMAT "%3.0" /end MEASUREMENT
/begin MEASUREMENT fmy_stat_obd_vld_lsh_up_1.err_info_stat.reserved "" UWORD _CNV_A_R_LINEAR_____0_CM 1 0. 0. 65535. DISPLAY_IDENTIFIER FMY_STAT_OBD_VLD_LSH_UP_1_ERR_INFO_STAT_RESERVED ECU_ADDRESS 0x7f9cb0 BYTE_ORDER MSB_LAST BIT_MASK 0xF800 /end MEASUREMENT
/begin MEASUREMENT fmy_stat_obd_vld_lsh_up_1.err_info_stat.lv_cdn_diag_stc "Statistical flag for condition of diagnosis of the diagnosis instance OBD_VLD_LSH_UP_1" UWORD _CNV_S_2_RANGE______383_CM 1 0. 0. 1. DISPLAY_IDENTIFIER LV_CDN_DIAG_STC_OBD_VLD_LSH_UP_1 ECU_ADDRESS 0x7f9cb0 BYTE_ORDER MSB_LAST BIT_MASK 0x400 /end MEASUREMENT
/begin MEASUREMENT fmy_stat_obd_vld_lsh_up_1.err_info_stat.lv_lock_diag "lock flag (CPU load optimisation) of the diagnosis instance OBD_VLD_LSH_UP_1" UWORD _CNV_S_2_RANGE______383_CM 1 0. 0. 1. DISPLAY_IDENTIFIER LV_LOCK_DIAG_OBD_VLD_LSH_UP_1 ECU_ADDRESS 0x7f9cb0 BYTE_ORDER MSB_LAST BIT_MASK 0x200 /end MEASUREMENT
/begin MEASUREMENT fmy_stat_obd_vld_lsh_up_1.err_info_stat.lv_err_mem "storage in dynamic failure memory of the diagnosis instance OBD_VLD_LSH_UP_1" UWORD _CNV_S_2_RANGE______383_CM 1 0. 0. 1. DISPLAY_IDENTIFIER LV_ERR_MEM_OBD_VLD_LSH_UP_1 ECU_ADDRESS 0x7f9cb0 BYTE_ORDER MSB_LAST BIT_MASK 0x80 /end MEASUREMENT
/begin MEASUREMENT fmy_stat_obd_vld_lsh_up_1.err_info_stat.lv_ready "readiness status of the diagnosis instance OBD_VLD_LSH_UP_1" UWORD _CNV_S_2_RANGE______383_CM 1 0. 0. 1. DISPLAY_IDENTIFIER LV_READY_OBD_VLD_LSH_UP_1 ECU_ADDRESS 0x7f9cb0 BYTE_ORDER MSB_LAST BIT_MASK 0x40 /end MEASUREMENT
/begin MEASUREMENT fmy_stat_obd_vld_lsh_up_1.err_info_stat.lv_end_diag "end of diagnosis of the diagnosis instance OBD_VLD_LSH_UP_1" UWORD _CNV_S_2_RANGE______383_CM 1 0. 0. 1. DISPLAY_IDENTIFIER LV_END_DIAG_OBD_VLD_LSH_UP_1 ECU_ADDRESS 0x7f9cb0 BYTE_ORDER MSB_LAST BIT_MASK 0x20 /end MEASUREMENT
/begin MEASUREMENT fmy_stat_obd_vld_lsh_up_1.err_info_stat.lv_cdn_diag "diagnosis condition of the diagnosis instance OBD_VLD_LSH_UP_1" UWORD _CNV_S_2_RANGE______383_CM 1 0. 0. 1. DISPLAY_IDENTIFIER LV_CDN_DIAG_OBD_VLD_LSH_UP_1 ECU_ADDRESS 0x7f9cb0 BYTE_ORDER MSB_LAST BIT_MASK 0x10 /end MEASUREMENT
/begin MEASUREMENT fmy_stat_obd_vld_lsh_up_1.err_info_stat.err_sym "symptoms of the diagnosis instance OBD_VLD_LSH_UP_1" UWORD _CNV_S_6_CONV_ERRM__22_CM 1 0. 0. 15. DISPLAY_IDENTIFIER ERR_SYM_OBD_VLD_LSH_UP_1 ECU_ADDRESS 0x7f9cb0 BYTE_ORDER MSB_LAST BIT_MASK 0xF /end MEASUREMENT
/begin MEASUREMENT fmy_stat_shift_afl_lsl_up_1.ctr_abc "anti bounce counter for diagnosis instance SHIFT_AFL_LSL_UP_1" UBYTE _CNV_A_R_LINEAR_____1_CM 1 0. 0. 255. DISPLAY_IDENTIFIER CTR_ABC_SHIFT_AFL_LSL_UP_1 ECU_ADDRESS 0x7f9cb7 FORMAT "%3.0" /end MEASUREMENT
/begin MEASUREMENT fmy_stat_shift_afl_lsl_up_1.ctr_end_diag "counter for end of diagnosis for diagnosis instance SHIFT_AFL_LSL_UP_1" UBYTE _CNV_A_R_LINEAR_____1_CM 1 0. 0. 255. DISPLAY_IDENTIFIER CTR_ABC_END_DIAG_SHIFT_AFL_LSL_UP_1 ECU_ADDRESS 0x7f9cb6 FORMAT "%3.0" /end MEASUREMENT
/begin MEASUREMENT fmy_stat_shift_afl_lsl_up_1.err_info_stat.reserved "" UWORD _CNV_A_R_LINEAR_____0_CM 1 0. 0. 65535. DISPLAY_IDENTIFIER FMY_STAT_SHIFT_AFL_LSL_UP_1_ERR_INFO_STAT_RESERVED ECU_ADDRESS 0x7f9cb4 BYTE_ORDER MSB_LAST BIT_MASK 0xF800 /end MEASUREMENT
/begin MEASUREMENT fmy_stat_shift_afl_lsl_up_1.err_info_stat.lv_cdn_diag_stc "Statistical flag for condition of diagnosis of the diagnosis instance SHIFT_AFL_LSL_UP_1" UWORD _CNV_S_2_RANGE______383_CM 1 0. 0. 1. DISPLAY_IDENTIFIER LV_CDN_DIAG_STC_SHIFT_AFL_LSL_UP_1 ECU_ADDRESS 0x7f9cb4 BYTE_ORDER MSB_LAST BIT_MASK 0x400 /end MEASUREMENT
/begin MEASUREMENT fmy_stat_shift_afl_lsl_up_1.err_info_stat.lv_lock_diag "lock flag (CPU load optimisation) of the diagnosis instance SHIFT_AFL_LSL_UP_1" UWORD _CNV_S_2_RANGE______383_CM 1 0. 0. 1. DISPLAY_IDENTIFIER LV_LOCK_DIAG_SHIFT_AFL_LSL_UP_1 ECU_ADDRESS 0x7f9cb4 BYTE_ORDER MSB_LAST BIT_MASK 0x200 /end MEASUREMENT
/begin MEASUREMENT fmy_stat_shift_afl_lsl_up_1.err_info_stat.lv_err_mem "storage in dynamic failure memory of the diagnosis instance SHIFT_AFL_LSL_UP_1" UWORD _CNV_S_2_RANGE______383_CM 1 0. 0. 1. DISPLAY_IDENTIFIER LV_ERR_MEM_SHIFT_AFL_LSL_UP_1 ECU_ADDRESS 0x7f9cb4 BYTE_ORDER MSB_LAST BIT_MASK 0x80 /end MEASUREMENT
/begin MEASUREMENT fmy_stat_shift_afl_lsl_up_1.err_info_stat.lv_ready "readiness status of the diagnosis instance SHIFT_AFL_LSL_UP_1" UWORD _CNV_S_2_RANGE______383_CM 1 0. 0. 1. DISPLAY_IDENTIFIER LV_READY_SHIFT_AFL_LSL_UP_1 ECU_ADDRESS 0x7f9cb4 BYTE_ORDER MSB_LAST BIT_MASK 0x40 /end MEASUREMENT
/begin MEASUREMENT fmy_stat_shift_afl_lsl_up_1.err_info_stat.lv_end_diag "end of diagnosis of the diagnosis instance SHIFT_AFL_LSL_UP_1" UWORD _CNV_S_2_RANGE______383_CM 1 0. 0. 1. DISPLAY_IDENTIFIER LV_END_DIAG_SHIFT_AFL_LSL_UP_1 ECU_ADDRESS 0x7f9cb4 BYTE_ORDER MSB_LAST BIT_MASK 0x20 /end MEASUREMENT
/begin MEASUREMENT fmy_stat_shift_afl_lsl_up_1.err_info_stat.lv_cdn_diag "diagnosis condition of the diagnosis instance SHIFT_AFL_LSL_UP_1" UWORD _CNV_S_2_RANGE______383_CM 1 0. 0. 1. DISPLAY_IDENTIFIER LV_CDN_DIAG_SHIFT_AFL_LSL_UP_1 ECU_ADDRESS 0x7f9cb4 BYTE_ORDER MSB_LAST BIT_MASK 0x10 /end MEASUREMENT
/begin MEASUREMENT fmy_stat_shift_afl_lsl_up_1.err_info_stat.err_sym "symptoms of the diagnosis instance SHIFT_AFL_LSL_UP_1" UWORD _CNV_S_6_CONV_ERRM__22_CM 1 0. 0. 15. DISPLAY_IDENTIFIER ERR_SYM_SHIFT_AFL_LSL_UP_1 ECU_ADDRESS 0x7f9cb4 BYTE_ORDER MSB_LAST BIT_MASK 0xF /end MEASUREMENT
/begin MEASUREMENT fmy_stat_shift_afr_lsl_up_1.ctr_abc "anti bounce counter for diagnosis instance SHIFT_AFR_LSL_UP_1" UBYTE _CNV_A_R_LINEAR_____1_CM 1 0. 0. 255. DISPLAY_IDENTIFIER CTR_ABC_SHIFT_AFR_LSL_UP_1 ECU_ADDRESS 0x7f9cbb FORMAT "%3.0" /end MEASUREMENT
/begin MEASUREMENT fmy_stat_shift_afr_lsl_up_1.ctr_end_diag "counter for end of diagnosis for diagnosis instance SHIFT_AFR_LSL_UP_1" UBYTE _CNV_A_R_LINEAR_____1_CM 1 0. 0. 255. DISPLAY_IDENTIFIER CTR_ABC_END_DIAG_SHIFT_AFR_LSL_UP_1 ECU_ADDRESS 0x7f9cba FORMAT "%3.0" /end MEASUREMENT
/begin MEASUREMENT fmy_stat_shift_afr_lsl_up_1.err_info_stat.reserved "" UWORD _CNV_A_R_LINEAR_____0_CM 1 0. 0. 65535. DISPLAY_IDENTIFIER FMY_STAT_SHIFT_AFR_LSL_UP_1_ERR_INFO_STAT_RESERVED ECU_ADDRESS 0x7f9cb8 BYTE_ORDER MSB_LAST BIT_MASK 0xF800 /end MEASUREMENT
/begin MEASUREMENT fmy_stat_shift_afr_lsl_up_1.err_info_stat.lv_cdn_diag_stc "Statistical flag for condition of diagnosis of the diagnosis instance SHIFT_AFR_LSL_UP_1" UWORD _CNV_S_2_RANGE______383_CM 1 0. 0. 1. DISPLAY_IDENTIFIER LV_CDN_DIAG_STC_SHIFT_AFR_LSL_UP_1 ECU_ADDRESS 0x7f9cb8 BYTE_ORDER MSB_LAST BIT_MASK 0x400 /end MEASUREMENT
/begin MEASUREMENT fmy_stat_shift_afr_lsl_up_1.err_info_stat.lv_lock_diag "lock flag (CPU load optimisation) of the diagnosis instance SHIFT_AFR_LSL_UP_1" UWORD _CNV_S_2_RANGE______383_CM 1 0. 0. 1. DISPLAY_IDENTIFIER LV_LOCK_DIAG_SHIFT_AFR_LSL_UP_1 ECU_ADDRESS 0x7f9cb8 BYTE_ORDER MSB_LAST BIT_MASK 0x200 /end MEASUREMENT
/begin MEASUREMENT fmy_stat_shift_afr_lsl_up_1.err_info_stat.lv_err_mem "storage in dynamic failure memory of the diagnosis instance SHIFT_AFR_LSL_UP_1" UWORD _CNV_S_2_RANGE______383_CM 1 0. 0. 1. DISPLAY_IDENTIFIER LV_ERR_MEM_SHIFT_AFR_LSL_UP_1 ECU_ADDRESS 0x7f9cb8 BYTE_ORDER MSB_LAST BIT_MASK 0x80 /end MEASUREMENT
/begin MEASUREMENT fmy_stat_shift_afr_lsl_up_1.err_info_stat.lv_ready "readiness status of the diagnosis instance SHIFT_AFR_LSL_UP_1" UWORD _CNV_S_2_RANGE______383_CM 1 0. 0. 1. DISPLAY_IDENTIFIER LV_READY_SHIFT_AFR_LSL_UP_1 ECU_ADDRESS 0x7f9cb8 BYTE_ORDER MSB_LAST BIT_MASK 0x40 /end MEASUREMENT
/begin MEASUREMENT fmy_stat_shift_afr_lsl_up_1.err_info_stat.lv_end_diag "end of diagnosis of the diagnosis instance SHIFT_AFR_LSL_UP_1" UWORD _CNV_S_2_RANGE______383_CM 1 0. 0. 1. DISPLAY_IDENTIFIER LV_END_DIAG_SHIFT_AFR_LSL_UP_1 ECU_ADDRESS 0x7f9cb8 BYTE_ORDER MSB_LAST BIT_MASK 0x20 /end MEASUREMENT
/begin MEASUREMENT fmy_stat_shift_afr_lsl_up_1.err_info_stat.lv_cdn_diag "diagnosis condition of the diagnosis instance SHIFT_AFR_LSL_UP_1" UWORD _CNV_S_2_RANGE______383_CM 1 0. 0. 1. DISPLAY_IDENTIFIER LV_CDN_DIAG_SHIFT_AFR_LSL_UP_1 ECU_ADDRESS 0x7f9cb8 BYTE_ORDER MSB_LAST BIT_MASK 0x10 /end MEASUREMENT
/begin MEASUREMENT fmy_stat_shift_afr_lsl_up_1.err_info_stat.err_sym "symptoms of the diagnosis instance SHIFT_AFR_LSL_UP_1" UWORD _CNV_S_6_CONV_ERRM__22_CM 1 0. 0. 15. DISPLAY_IDENTIFIER ERR_SYM_SHIFT_AFR_LSL_UP_1 ECU_ADDRESS 0x7f9cb8 BYTE_ORDER MSB_LAST BIT_MASK 0xF /end MEASUREMENT
/begin MEASUREMENT fmy_stat_lsh_lsl_up_1.ctr_abc "anti bounce counter for diagnosis instance LSH_LSL_UP_1" UBYTE _CNV_A_R_LINEAR_____1_CM 1 0. 0. 255. DISPLAY_IDENTIFIER CTR_ABC_LSH_LSL_UP_1 ECU_ADDRESS 0x7f9cbf FORMAT "%3.0" /end MEASUREMENT
/begin MEASUREMENT fmy_stat_lsh_lsl_up_1.ctr_end_diag "counter for end of diagnosis for diagnosis instance LSH_LSL_UP_1" UBYTE _CNV_A_R_LINEAR_____1_CM 1 0. 0. 255. DISPLAY_IDENTIFIER CTR_ABC_END_DIAG_LSH_LSL_UP_1 ECU_ADDRESS 0x7f9cbe FORMAT "%3.0" /end MEASUREMENT
/begin MEASUREMENT fmy_stat_lsh_lsl_up_1.err_info_stat.reserved "" UWORD _CNV_A_R_LINEAR_____0_CM 1 0. 0. 65535. DISPLAY_IDENTIFIER FMY_STAT_LSH_LSL_UP_1_ERR_INFO_STAT_RESERVED ECU_ADDRESS 0x7f9cbc BYTE_ORDER MSB_LAST BIT_MASK 0xF800 /end MEASUREMENT
/begin MEASUREMENT fmy_stat_lsh_lsl_up_1.err_info_stat.lv_cdn_diag_stc "Statistical flag for condition of diagnosis of the diagnosis instance LSH_LSL_UP_1" UWORD _CNV_S_2_RANGE______383_CM 1 0. 0. 1. DISPLAY_IDENTIFIER LV_CDN_DIAG_STC_LSH_LSL_UP_1 ECU_ADDRESS 0x7f9cbc BYTE_ORDER MSB_LAST BIT_MASK 0x400 /end MEASUREMENT
/begin MEASUREMENT fmy_stat_lsh_lsl_up_1.err_info_stat.lv_lock_diag "lock flag (CPU load optimisation) of the diagnosis instance LSH_LSL_UP_1" UWORD _CNV_S_2_RANGE______383_CM 1 0. 0. 1. DISPLAY_IDENTIFIER LV_LOCK_DIAG_LSH_LSL_UP_1 ECU_ADDRESS 0x7f9cbc BYTE_ORDER MSB_LAST BIT_MASK 0x200 /end MEASUREMENT
/begin MEASUREMENT fmy_stat_lsh_lsl_up_1.err_info_stat.lv_err_mem "storage in dynamic failure memory of the diagnosis instance LSH_LSL_UP_1" UWORD _CNV_S_2_RANGE______383_CM 1 0. 0. 1. DISPLAY_IDENTIFIER LV_ERR_MEM_LSH_LSL_UP_1 ECU_ADDRESS 0x7f9cbc BYTE_ORDER MSB_LAST BIT_MASK 0x80 /end MEASUREMENT
/begin MEASUREMENT fmy_stat_lsh_lsl_up_1.err_info_stat.lv_ready "readiness status of the diagnosis instance LSH_LSL_UP_1" UWORD _CNV_S_2_RANGE______383_CM 1 0. 0. 1. DISPLAY_IDENTIFIER LV_READY_LSH_LSL_UP_1 ECU_ADDRESS 0x7f9cbc BYTE_ORDER MSB_LAST BIT_MASK 0x40 /end MEASUREMENT
/begin MEASUREMENT fmy_stat_lsh_lsl_up_1.err_info_stat.lv_end_diag "end of diagnosis of the diagnosis instance LSH_LSL_UP_1" UWORD _CNV_S_2_RANGE______383_CM 1 0. 0. 1. DISPLAY_IDENTIFIER LV_END_DIAG_LSH_LSL_UP_1 ECU_ADDRESS 0x7f9cbc BYTE_ORDER MSB_LAST BIT_MASK 0x20 /end MEASUREMENT
/begin MEASUREMENT fmy_stat_lsh_lsl_up_1.err_info_stat.lv_cdn_diag "diagnosis condition of the diagnosis instance LSH_LSL_UP_1" UWORD _CNV_S_2_RANGE______383_CM 1 0. 0. 1. DISPLAY_IDENTIFIER LV_CDN_DIAG_LSH_LSL_UP_1 ECU_ADDRESS 0x7f9cbc BYTE_ORDER MSB_LAST BIT_MASK 0x10 /end MEASUREMENT
/begin MEASUREMENT fmy_stat_lsh_lsl_up_1.err_info_stat.err_sym "symptoms of the diagnosis instance LSH_LSL_UP_1" UWORD _CNV_S_6_CONV_ERRM__22_CM 1 0. 0. 15. DISPLAY_IDENTIFIER ERR_SYM_LSH_LSL_UP_1 ECU_ADDRESS 0x7f9cbc BYTE_ORDER MSB_LAST BIT_MASK 0xF /end MEASUREMENT
/begin MEASUREMENT fmy_stat_swt_ls_down_1.ctr_abc "anti bounce counter for diagnosis instance SWT_LS_DOWN_1" UBYTE _CNV_A_R_LINEAR_____1_CM 1 0. 0. 255. DISPLAY_IDENTIFIER CTR_ABC_SWT_LS_DOWN_1 ECU_ADDRESS 0x7f9cc3 FORMAT "%3.0" /end MEASUREMENT
/begin MEASUREMENT fmy_stat_swt_ls_down_1.ctr_end_diag "counter for end of diagnosis for diagnosis instance SWT_LS_DOWN_1" UBYTE _CNV_A_R_LINEAR_____1_CM 1 0. 0. 255. DISPLAY_IDENTIFIER CTR_ABC_END_DIAG_SWT_LS_DOWN_1 ECU_ADDRESS 0x7f9cc2 FORMAT "%3.0" /end MEASUREMENT
/begin MEASUREMENT fmy_stat_swt_ls_down_1.err_info_stat.reserved "" UWORD _CNV_A_R_LINEAR_____0_CM 1 0. 0. 65535. DISPLAY_IDENTIFIER FMY_STAT_SWT_LS_DOWN_1_ERR_INFO_STAT_RESERVED ECU_ADDRESS 0x7f9cc0 BYTE_ORDER MSB_LAST BIT_MASK 0xF800 /end MEASUREMENT
/begin MEASUREMENT fmy_stat_swt_ls_down_1.err_info_stat.lv_cdn_diag_stc "Statistical flag for condition of diagnosis of the diagnosis instance SWT_LS_DOWN_1" UWORD _CNV_S_2_RANGE______383_CM 1 0. 0. 1. DISPLAY_IDENTIFIER LV_CDN_DIAG_STC_SWT_LS_DOWN_1 ECU_ADDRESS 0x7f9cc0 BYTE_ORDER MSB_LAST BIT_MASK 0x400 /end MEASUREMENT
/begin MEASUREMENT fmy_stat_swt_ls_down_1.err_info_stat.lv_lock_diag "lock flag (CPU load optimisation) of the diagnosis instance SWT_LS_DOWN_1" UWORD _CNV_S_2_RANGE______383_CM 1 0. 0. 1. DISPLAY_IDENTIFIER LV_LOCK_DIAG_SWT_LS_DOWN_1 ECU_ADDRESS 0x7f9cc0 BYTE_ORDER MSB_LAST BIT_MASK 0x200 /end MEASUREMENT
/begin MEASUREMENT fmy_stat_swt_ls_down_1.err_info_stat.lv_err_mem "storage in dynamic failure memory of the diagnosis instance SWT_LS_DOWN_1" UWORD _CNV_S_2_RANGE______383_CM 1 0. 0. 1. DISPLAY_IDENTIFIER LV_ERR_MEM_SWT_LS_DOWN_1 ECU_ADDRESS 0x7f9cc0 BYTE_ORDER MSB_LAST BIT_MASK 0x80 /end MEASUREMENT
/begin MEASUREMENT fmy_stat_swt_ls_down_1.err_info_stat.lv_ready "readiness status of the diagnosis instance SWT_LS_DOWN_1" UWORD _CNV_S_2_RANGE______383_CM 1 0. 0. 1. DISPLAY_IDENTIFIER LV_READY_SWT_LS_DOWN_1 ECU_ADDRESS 0x7f9cc0 BYTE_ORDER MSB_LAST BIT_MASK 0x40 /end MEASUREMENT
/begin MEASUREMENT fmy_stat_swt_ls_down_1.err_info_stat.lv_end_diag "end of diagnosis of the diagnosis instance SWT_LS_DOWN_1" UWORD _CNV_S_2_RANGE______383_CM 1 0. 0. 1. DISPLAY_IDENTIFIER LV_END_DIAG_SWT_LS_DOWN_1 ECU_ADDRESS 0x7f9cc0 BYTE_ORDER MSB_LAST BIT_MASK 0x20 /end MEASUREMENT
/begin MEASUREMENT fmy_stat_swt_ls_down_1.err_info_stat.lv_cdn_diag "diagnosis condition of the diagnosis instance SWT_LS_DOWN_1" UWORD _CNV_S_2_RANGE______383_CM 1 0. 0. 1. DISPLAY_IDENTIFIER LV_CDN_DIAG_SWT_LS_DOWN_1 ECU_ADDRESS 0x7f9cc0 BYTE_ORDER MSB_LAST BIT_MASK 0x10 /end MEASUREMENT
/begin MEASUREMENT fmy_stat_swt_ls_down_1.err_info_stat.err_sym "symptoms of the diagnosis instance SWT_LS_DOWN_1" UWORD _CNV_S_6_CONV_ERRM__22_CM 1 0. 0. 15. DISPLAY_IDENTIFIER ERR_SYM_SWT_LS_DOWN_1 ECU_ADDRESS 0x7f9cc0 BYTE_ORDER MSB_LAST BIT_MASK 0xF /end MEASUREMENT
/begin MEASUREMENT fmy_stat_pue_ls_down_1.ctr_abc "anti bounce counter for diagnosis instance PUE_LS_DOWN_1" UBYTE _CNV_A_R_LINEAR_____1_CM 1 0. 0. 255. DISPLAY_IDENTIFIER CTR_ABC_PUE_LS_DOWN_1 ECU_ADDRESS 0x7f9cc7 FORMAT "%3.0" /end MEASUREMENT
/begin MEASUREMENT fmy_stat_pue_ls_down_1.ctr_end_diag "counter for end of diagnosis for diagnosis instance PUE_LS_DOWN_1" UBYTE _CNV_A_R_LINEAR_____1_CM 1 0. 0. 255. DISPLAY_IDENTIFIER CTR_ABC_END_DIAG_PUE_LS_DOWN_1 ECU_ADDRESS 0x7f9cc6 FORMAT "%3.0" /end MEASUREMENT
/begin MEASUREMENT fmy_stat_pue_ls_down_1.err_info_stat.reserved "" UWORD _CNV_A_R_LINEAR_____0_CM 1 0. 0. 65535. DISPLAY_IDENTIFIER FMY_STAT_PUE_LS_DOWN_1_ERR_INFO_STAT_RESERVED ECU_ADDRESS 0x7f9cc4 BYTE_ORDER MSB_LAST BIT_MASK 0xF800 /end MEASUREMENT
/begin MEASUREMENT fmy_stat_pue_ls_down_1.err_info_stat.lv_cdn_diag_stc "Statistical flag for condition of diagnosis of the diagnosis instance PUE_LS_DOWN_1" UWORD _CNV_S_2_RANGE______383_CM 1 0. 0. 1. DISPLAY_IDENTIFIER LV_CDN_DIAG_STC_PUE_LS_DOWN_1 ECU_ADDRESS 0x7f9cc4 BYTE_ORDER MSB_LAST BIT_MASK 0x400 /end MEASUREMENT
/begin MEASUREMENT fmy_stat_pue_ls_down_1.err_info_stat.lv_lock_diag "lock flag (CPU load optimisation) of the diagnosis instance PUE_LS_DOWN_1" UWORD _CNV_S_2_RANGE______383_CM 1 0. 0. 1. DISPLAY_IDENTIFIER LV_LOCK_DIAG_PUE_LS_DOWN_1 ECU_ADDRESS 0x7f9cc4 BYTE_ORDER MSB_LAST BIT_MASK 0x200 /end MEASUREMENT
/begin MEASUREMENT fmy_stat_pue_ls_down_1.err_info_stat.lv_err_mem "storage in dynamic failure memory of the diagnosis instance PUE_LS_DOWN_1" UWORD _CNV_S_2_RANGE______383_CM 1 0. 0. 1. DISPLAY_IDENTIFIER LV_ERR_MEM_PUE_LS_DOWN_1 ECU_ADDRESS 0x7f9cc4 BYTE_ORDER MSB_LAST BIT_MASK 0x80 /end MEASUREMENT
/begin MEASUREMENT fmy_stat_pue_ls_down_1.err_info_stat.lv_ready "readiness status of the diagnosis instance PUE_LS_DOWN_1" UWORD _CNV_S_2_RANGE______383_CM 1 0. 0. 1. DISPLAY_IDENTIFIER LV_READY_PUE_LS_DOWN_1 ECU_ADDRESS 0x7f9cc4 BYTE_ORDER MSB_LAST BIT_MASK 0x40 /end MEASUREMENT
/begin MEASUREMENT fmy_stat_pue_ls_down_1.err_info_stat.lv_end_diag "end of diagnosis of the diagnosis instance PUE_LS_DOWN_1" UWORD _CNV_S_2_RANGE______383_CM 1 0. 0. 1. DISPLAY_IDENTIFIER LV_END_DIAG_PUE_LS_DOWN_1 ECU_ADDRESS 0x7f9cc4 BYTE_ORDER MSB_LAST BIT_MASK 0x20 /end MEASUREMENT
/begin MEASUREMENT fmy_stat_pue_ls_down_1.err_info_stat.lv_cdn_diag "diagnosis condition of the diagnosis instance PUE_LS_DOWN_1" UWORD _CNV_S_2_RANGE______383_CM 1 0. 0. 1. DISPLAY_IDENTIFIER LV_CDN_DIAG_PUE_LS_DOWN_1 ECU_ADDRESS 0x7f9cc4 BYTE_ORDER MSB_LAST BIT_MASK 0x10 /end MEASUREMENT
/begin MEASUREMENT fmy_stat_pue_ls_down_1.err_info_stat.err_sym "symptoms of the diagnosis instance PUE_LS_DOWN_1" UWORD _CNV_S_6_CONV_ERRM__22_CM 1 0. 0. 15. DISPLAY_IDENTIFIER ERR_SYM_PUE_LS_DOWN_1 ECU_ADDRESS 0x7f9cc4 BYTE_ORDER MSB_LAST BIT_MASK 0xF /end MEASUREMENT
/begin MEASUREMENT fmy_stat_chg_ls_up.ctr_abc "anti bounce counter for diagnosis instance CHG_LS_UP" UBYTE _CNV_A_R_LINEAR_____1_CM 1 0. 0. 255. DISPLAY_IDENTIFIER CTR_ABC_CHG_LS_UP ECU_ADDRESS 0x7f9ccb FORMAT "%3.0" /end MEASUREMENT
/begin MEASUREMENT fmy_stat_chg_ls_up.ctr_end_diag "counter for end of diagnosis for diagnosis instance CHG_LS_UP" UBYTE _CNV_A_R_LINEAR_____1_CM 1 0. 0. 255. DISPLAY_IDENTIFIER CTR_ABC_END_DIAG_CHG_LS_UP ECU_ADDRESS 0x7f9cca FORMAT "%3.0" /end MEASUREMENT
/begin MEASUREMENT fmy_stat_chg_ls_up.err_info_stat.reserved "" UWORD _CNV_A_R_LINEAR_____0_CM 1 0. 0. 65535. DISPLAY_IDENTIFIER FMY_STAT_CHG_LS_UP_ERR_INFO_STAT_RESERVED ECU_ADDRESS 0x7f9cc8 BYTE_ORDER MSB_LAST BIT_MASK 0xF800 /end MEASUREMENT
/begin MEASUREMENT fmy_stat_chg_ls_up.err_info_stat.lv_cdn_diag_stc "Statistical flag for condition of diagnosis of the diagnosis instance CHG_LS_UP" UWORD _CNV_S_2_RANGE______383_CM 1 0. 0. 1. DISPLAY_IDENTIFIER LV_CDN_DIAG_STC_CHG_LS_UP ECU_ADDRESS 0x7f9cc8 BYTE_ORDER MSB_LAST BIT_MASK 0x400 /end MEASUREMENT
/begin MEASUREMENT fmy_stat_chg_ls_up.err_info_stat.lv_lock_diag "lock flag (CPU load optimisation) of the diagnosis instance CHG_LS_UP" UWORD _CNV_S_2_RANGE______383_CM 1 0. 0. 1. DISPLAY_IDENTIFIER LV_LOCK_DIAG_CHG_LS_UP ECU_ADDRESS 0x7f9cc8 BYTE_ORDER MSB_LAST BIT_MASK 0x200 /end MEASUREMENT
/begin MEASUREMENT fmy_stat_chg_ls_up.err_info_stat.lv_err_mem "storage in dynamic failure memory of the diagnosis instance CHG_LS_UP" UWORD _CNV_S_2_RANGE______383_CM 1 0. 0. 1. DISPLAY_IDENTIFIER LV_ERR_MEM_CHG_LS_UP ECU_ADDRESS 0x7f9cc8 BYTE_ORDER MSB_LAST BIT_MASK 0x80 /end MEASUREMENT
/begin MEASUREMENT fmy_stat_chg_ls_up.err_info_stat.lv_ready "readiness status of the diagnosis instance CHG_LS_UP" UWORD _CNV_S_2_RANGE______383_CM 1 0. 0. 1. DISPLAY_IDENTIFIER LV_READY_CHG_LS_UP ECU_ADDRESS 0x7f9cc8 BYTE_ORDER MSB_LAST BIT_MASK 0x40 /end MEASUREMENT
/begin MEASUREMENT fmy_stat_chg_ls_up.err_info_stat.lv_end_diag "end of diagnosis of the diagnosis instance CHG_LS_UP" UWORD _CNV_S_2_RANGE______383_CM 1 0. 0. 1. DISPLAY_IDENTIFIER LV_END_DIAG_CHG_LS_UP ECU_ADDRESS 0x7f9cc8 BYTE_ORDER MSB_LAST BIT_MASK 0x20 /end MEASUREMENT
/begin MEASUREMENT fmy_stat_chg_ls_up.err_info_stat.lv_cdn_diag "diagnosis condition of the diagnosis instance CHG_LS_UP" UWORD _CNV_S_2_RANGE______383_CM 1 0. 0. 1. DISPLAY_IDENTIFIER LV_CDN_DIAG_CHG_LS_UP ECU_ADDRESS 0x7f9cc8 BYTE_ORDER MSB_LAST BIT_MASK 0x10 /end MEASUREMENT
/begin MEASUREMENT fmy_stat_chg_ls_up.err_info_stat.err_sym "symptoms of the diagnosis instance CHG_LS_UP" UWORD _CNV_S_6_CONV_ERRM__22_CM 1 0. 0. 15. DISPLAY_IDENTIFIER ERR_SYM_CHG_LS_UP ECU_ADDRESS 0x7f9cc8 BYTE_ORDER MSB_LAST BIT_MASK 0xF /end MEASUREMENT
/begin MEASUREMENT fmy_stat_chg_ls_down.ctr_abc "anti bounce counter for diagnosis instance CHG_LS_DOWN" UBYTE _CNV_A_R_LINEAR_____1_CM 1 0. 0. 255. DISPLAY_IDENTIFIER CTR_ABC_CHG_LS_DOWN ECU_ADDRESS 0x7f9ccf FORMAT "%3.0" /end MEASUREMENT
/begin MEASUREMENT fmy_stat_chg_ls_down.ctr_end_diag "counter for end of diagnosis for diagnosis instance CHG_LS_DOWN" UBYTE _CNV_A_R_LINEAR_____1_CM 1 0. 0. 255. DISPLAY_IDENTIFIER CTR_ABC_END_DIAG_CHG_LS_DOWN ECU_ADDRESS 0x7f9cce FORMAT "%3.0" /end MEASUREMENT
/begin MEASUREMENT fmy_stat_chg_ls_down.err_info_stat.reserved "" UWORD _CNV_A_R_LINEAR_____0_CM 1 0. 0. 65535. DISPLAY_IDENTIFIER FMY_STAT_CHG_LS_DOWN_ERR_INFO_STAT_RESERVED ECU_ADDRESS 0x7f9ccc BYTE_ORDER MSB_LAST BIT_MASK 0xF800 /end MEASUREMENT
/begin MEASUREMENT fmy_stat_chg_ls_down.err_info_stat.lv_cdn_diag_stc "Statistical flag for condition of diagnosis of the diagnosis instance CHG_LS_DOWN" UWORD _CNV_S_2_RANGE______383_CM 1 0. 0. 1. DISPLAY_IDENTIFIER LV_CDN_DIAG_STC_CHG_LS_DOWN ECU_ADDRESS 0x7f9ccc BYTE_ORDER MSB_LAST BIT_MASK 0x400 /end MEASUREMENT
/begin MEASUREMENT fmy_stat_chg_ls_down.err_info_stat.lv_lock_diag "lock flag (CPU load optimisation) of the diagnosis instance CHG_LS_DOWN" UWORD _CNV_S_2_RANGE______383_CM 1 0. 0. 1. DISPLAY_IDENTIFIER LV_LOCK_DIAG_CHG_LS_DOWN ECU_ADDRESS 0x7f9ccc BYTE_ORDER MSB_LAST BIT_MASK 0x200 /end MEASUREMENT
/begin MEASUREMENT fmy_stat_chg_ls_down.err_info_stat.lv_err_mem "storage in dynamic failure memory of the diagnosis instance CHG_LS_DOWN" UWORD _CNV_S_2_RANGE______383_CM 1 0. 0. 1. DISPLAY_IDENTIFIER LV_ERR_MEM_CHG_LS_DOWN ECU_ADDRESS 0x7f9ccc BYTE_ORDER MSB_LAST BIT_MASK 0x80 /end MEASUREMENT
/begin MEASUREMENT fmy_stat_chg_ls_down.err_info_stat.lv_ready "readiness status of the diagnosis instance CHG_LS_DOWN" UWORD _CNV_S_2_RANGE______383_CM 1 0. 0. 1. DISPLAY_IDENTIFIER LV_READY_CHG_LS_DOWN ECU_ADDRESS 0x7f9ccc BYTE_ORDER MSB_LAST BIT_MASK 0x40 /end MEASUREMENT
/begin MEASUREMENT fmy_stat_chg_ls_down.err_info_stat.lv_end_diag "end of diagnosis of the diagnosis instance CHG_LS_DOWN" UWORD _CNV_S_2_RANGE______383_CM 1 0. 0. 1. DISPLAY_IDENTIFIER LV_END_DIAG_CHG_LS_DOWN ECU_ADDRESS 0x7f9ccc BYTE_ORDER MSB_LAST BIT_MASK 0x20 /end MEASUREMENT
/begin MEASUREMENT fmy_stat_chg_ls_down.err_info_stat.lv_cdn_diag "diagnosis condition of the diagnosis instance CHG_LS_DOWN" UWORD _CNV_S_2_RANGE______383_CM 1 0. 0. 1. DISPLAY_IDENTIFIER LV_CDN_DIAG_CHG_LS_DOWN ECU_ADDRESS 0x7f9ccc BYTE_ORDER MSB_LAST BIT_MASK 0x10 /end MEASUREMENT
/begin MEASUREMENT fmy_stat_chg_ls_down.err_info_stat.err_sym "symptoms of the diagnosis instance CHG_LS_DOWN" UWORD _CNV_S_6_CONV_ERRM__22_CM 1 0. 0. 15. DISPLAY_IDENTIFIER ERR_SYM_CHG_LS_DOWN ECU_ADDRESS 0x7f9ccc BYTE_ORDER MSB_LAST BIT_MASK 0xF /end MEASUREMENT
/begin COMPU_METHOD _CNV_A_R_LINEAR_____0_CM "" RAT_FUNC "%6.3" "[-]" COEFFS 0 1. 0. 0 0 1 /end COMPU_METHOD
/begin COMPU_METHOD _CNV_A_R_LINEAR_____1_CM "" RAT_FUNC "%6.3" "-" COEFFS 0 1. 0. 0 0 1 /end COMPU_METHOD
/begin COMPU_METHOD _CNV_S_6_CONV_ERRM__22_CM "" TAB_VERB "%6.3" "[-]" COMPU_TAB_REF _CNV_S_6_CONV_ERRM__22 /end COMPU_METHOD
/begin COMPU_VTAB _CNV_S_6_CONV_ERRM__22 "" TAB_VERB 6 0 "NO_SYM" 1 "SYM_0" 2 "SYM_1" 4 "SYM_2" 8 "SYM_3" 15 "BENCH_MODE" /end COMPU_VTAB
/begin COMPU_METHOD _CNV_S_2_RANGE______23_CM "" TAB_VERB "%6.3" "[-]" COMPU_TAB_REF _CNV_S_2_RANGE______23 /end COMPU_METHOD
/begin COMPU_VTAB _CNV_S_2_RANGE______23 "" TAB_VERB 2 0 "passive" 1 "active" /end COMPU_VTAB
/begin COMPU_METHOD _CNV_S_2_RANGE______383_CM "" TAB_VERB "%6.3" "-" COMPU_TAB_REF _CNV_S_2_RANGE______383 /end COMPU_METHOD
/begin COMPU_VTAB _CNV_S_2_RANGE______383 "" TAB_VERB 2 0 "passive" 1 "active" /end COMPU_VTAB
/begin RECORD_LAYOUT _REC_VAL_20_u1 FNC_VALUES 1 UBYTE COLUMN_DIR DIRECT /end RECORD_LAYOUT
/begin RECORD_LAYOUT _REC_AXS_20_u2 NO_AXIS_PTS_X 1 UWORD AXIS_PTS_X 2 UWORD INDEX_INCR DIRECT /end RECORD_LAYOUT
/begin RECORD_LAYOUT _REC_AXS_20_u1 NO_AXIS_PTS_X 1 UBYTE AXIS_PTS_X 2 UBYTE INDEX_INCR DIRECT /end RECORD_LAYOUT
/begin RECORD_LAYOUT _REC_CUR_20_u2_u2 FNC_VALUES 1 UWORD COLUMN_DIR DIRECT /end RECORD_LAYOUT
/begin RECORD_LAYOUT _REC_CUR_20_u1_u1 FNC_VALUES 1 UBYTE COLUMN_DIR DIRECT /end RECORD_LAYOUT
/begin FUNCTION ERRM_AERRMON "Error Management data for diagnosis AERRMON"
 /begin OUT_MEASUREMENT lv_err_conv_mon_1 fmy_stat_conv_mon_1.ctr_abc fmy_stat_conv_mon_1.ctr_end_diag fmy_stat_conv_mon_1.err_info_stat.reserved fmy_stat_conv_mon_1.err_info_stat.lv_cdn_diag_stc fmy_stat_conv_mon_1.err_info_stat.lv_lock_diag fmy_stat_conv_mon_1.err_info_stat.lv_err_mem fmy_stat_conv_mon_1.err_info_stat.lv_ready fmy_stat_conv_mon_1.err_info_stat.lv_end_diag fmy_stat_conv_mon_1.err_info_stat.lv_cdn_diag fmy_stat_conv_mon_1.err_info_stat.err_sym lv_err_n_32_mon_1 fmy_stat_n_32_mon_1.ctr_abc fmy_stat_n_32_mon_1.ctr_end_diag fmy_stat_n_32_mon_1.err_info_stat.reserved fmy_stat_n_32_mon_1.err_info_stat.lv_cdn_diag_stc fmy_stat_n_32_mon_1.err_info_stat.lv_lock_diag fmy_stat_n_32_mon_1.err_info_stat.lv_err_mem fmy_stat_n_32_mon_1.err_info_stat.lv_ready fmy_stat_n_32_mon_1.err_info_stat.lv_end_diag fmy_stat_n_32_mon_1.err_info_stat.lv_cdn_diag fmy_stat_n_32_mon_1.err_info_stat.err_sym lv_err_pvs_mon_1 fmy_stat_pvs_mon_1.ctr_abc fmy_stat_pvs_mon_1.ctr_end_diag fmy_stat_pvs_mon_1.err_info_stat.reserved fmy_stat_pvs_mon_1.err_info_stat.lv_cdn_diag_stc fmy_stat_pvs_mon_1.err_info_stat.lv_lock_diag fmy_stat_pvs_mon_1.err_info_stat.lv_err_mem fmy_stat_pvs_mon_1.err_info_stat.lv_ready fmy_stat_pvs_mon_1.err_info_stat.lv_end_diag fmy_stat_pvs_mon_1.err_info_stat.lv_cdn_diag fmy_stat_pvs_mon_1.err_info_stat.err_sym lv_err_fcut_mon_1 fmy_stat_fcut_mon_1.ctr_abc fmy_stat_fcut_mon_1.ctr_end_diag fmy_stat_fcut_mon_1.err_info_stat.reserved fmy_stat_fcut_mon_1.err_info_stat.lv_cdn_diag_stc fmy_stat_fcut_mon_1.err_info_stat.lv_lock_diag fmy_stat_fcut_mon_1.err_info_stat.lv_err_mem fmy_stat_fcut_mon_1.err_info_stat.lv_ready fmy_stat_fcut_mon_1.err_info_stat.lv_end_diag fmy_stat_fcut_mon_1.err_info_stat.lv_cdn_diag fmy_stat_fcut_mon_1.err_info_stat.err_sym lv_err_tqi_n_max_mon_1 fmy_stat_tqi_n_max_mon_1.ctr_abc fmy_stat_tqi_n_max_mon_1.ctr_end_diag fmy_stat_tqi_n_max_mon_1.err_info_stat.reserved fmy_stat_tqi_n_max_mon_1.err_info_stat.lv_cdn_diag_stc fmy_stat_tqi_n_max_mon_1.err_info_stat.lv_lock_diag fmy_stat_tqi_n_max_mon_1.err_info_stat.lv_err_mem fmy_stat_tqi_n_max_mon_1.err_info_stat.lv_ready fmy_stat_tqi_n_max_mon_1.err_info_stat.lv_end_diag fmy_stat_tqi_n_max_mon_1.err_info_stat.lv_cdn_diag fmy_stat_tqi_n_max_mon_1.err_info_stat.err_sym lv_err_serv_mon_1 fmy_stat_serv_mon_1.ctr_abc fmy_stat_serv_mon_1.ctr_end_diag fmy_stat_serv_mon_1.err_info_stat.reserved fmy_stat_serv_mon_1.err_info_stat.lv_cdn_diag_stc fmy_stat_serv_mon_1.err_info_stat.lv_lock_diag fmy_stat_serv_mon_1.err_info_stat.lv_err_mem fmy_stat_serv_mon_1.err_info_stat.lv_ready fmy_stat_serv_mon_1.err_info_stat.lv_end_diag fmy_stat_serv_mon_1.err_info_stat.lv_cdn_diag fmy_stat_serv_mon_1.err_info_stat.err_sym lv_err_post_inh_mon fmy_stat_post_inh_mon.ctr_abc fmy_stat_post_inh_mon.ctr_end_diag fmy_stat_post_inh_mon.err_info_stat.reserved fmy_stat_post_inh_mon.err_info_stat.lv_cdn_diag_stc fmy_stat_post_inh_mon.err_info_stat.lv_lock_diag fmy_stat_post_inh_mon.err_info_stat.lv_err_mem fmy_stat_post_inh_mon.err_info_stat.lv_ready fmy_stat_post_inh_mon.err_info_stat.lv_end_diag fmy_stat_post_inh_mon.err_info_stat.lv_cdn_diag fmy_stat_post_inh_mon.err_info_stat.err_sym lv_err_cru_inh_mon fmy_stat_cru_inh_mon.ctr_abc fmy_stat_cru_inh_mon.ctr_end_diag fmy_stat_cru_inh_mon.err_info_stat.reserved fmy_stat_cru_inh_mon.err_info_stat.lv_cdn_diag_stc fmy_stat_cru_inh_mon.err_info_stat.lv_lock_diag fmy_stat_cru_inh_mon.err_info_stat.lv_err_mem fmy_stat_cru_inh_mon.err_info_stat.lv_ready fmy_stat_cru_inh_mon.err_info_stat.lv_end_diag fmy_stat_cru_inh_mon.err_info_stat.lv_cdn_diag fmy_stat_cru_inh_mon.err_info_stat.err_sym lv_err_can_inh_mon fmy_stat_can_inh_mon.ctr_abc fmy_stat_can_inh_mon.ctr_end_diag fmy_stat_can_inh_mon.err_info_stat.reserved fmy_stat_can_inh_mon.err_info_stat.lv_cdn_diag_stc fmy_stat_can_inh_mon.err_info_stat.lv_lock_diag fmy_stat_can_inh_mon.err_info_stat.lv_err_mem fmy_stat_can_inh_mon.err_info_stat.lv_ready fmy_stat_can_inh_mon.err_info_stat.lv_end_diag fmy_stat_can_inh_mon.err_info_stat.lv_cdn_diag fmy_stat_can_inh_mon.err_info_stat.err_sym /end OUT_MEASUREMENT
/end FUNCTION
/begin FUNCTION ERRM_TMO3ERRM "Error Management data for diagnosis TMO3ERRM"
 /begin OUT_MEASUREMENT lv_err_mon_3 fmy_stat_mon_3.ctr_abc fmy_stat_mon_3.ctr_end_diag fmy_stat_mon_3.err_info_stat.reserved fmy_stat_mon_3.err_info_stat.lv_cdn_diag_stc fmy_stat_mon_3.err_info_stat.lv_lock_diag fmy_stat_mon_3.err_info_stat.lv_err_mem fmy_stat_mon_3.err_info_stat.lv_ready fmy_stat_mon_3.err_info_stat.lv_end_diag fmy_stat_mon_3.err_info_stat.lv_cdn_diag fmy_stat_mon_3.err_info_stat.err_sym /end OUT_MEASUREMENT
/end FUNCTION
/begin FUNCTION ERRM_ENSD_DIAG "Error Management data for diagnosis ENSD_DIAG"
 /begin OUT_MEASUREMENT fmy_stat_per_cam_in_1.ctr_abc fmy_stat_per_cam_in_1.ctr_end_diag fmy_stat_per_cam_in_1.err_info_stat.reserved fmy_stat_per_cam_in_1.err_info_stat.lv_cdn_diag_stc fmy_stat_per_cam_in_1.err_info_stat.lv_lock_diag fmy_stat_per_cam_in_1.err_info_stat.lv_err_mem fmy_stat_per_cam_in_1.err_info_stat.lv_ready fmy_stat_per_cam_in_1.err_info_stat.lv_end_diag fmy_stat_per_cam_in_1.err_info_stat.lv_cdn_diag fmy_stat_per_cam_in_1.err_info_stat.err_sym fmy_stat_syn_cam_in_1.ctr_abc fmy_stat_syn_cam_in_1.ctr_end_diag fmy_stat_syn_cam_in_1.err_info_stat.reserved fmy_stat_syn_cam_in_1.err_info_stat.lv_cdn_diag_stc fmy_stat_syn_cam_in_1.err_info_stat.lv_lock_diag fmy_stat_syn_cam_in_1.err_info_stat.lv_err_mem fmy_stat_syn_cam_in_1.err_info_stat.lv_ready fmy_stat_syn_cam_in_1.err_info_stat.lv_end_diag fmy_stat_syn_cam_in_1.err_info_stat.lv_cdn_diag fmy_stat_syn_cam_in_1.err_info_stat.err_sym fmy_stat_ref_crk_cam_in_1.ctr_abc fmy_stat_ref_crk_cam_in_1.ctr_end_diag fmy_stat_ref_crk_cam_in_1.err_info_stat.reserved fmy_stat_ref_crk_cam_in_1.err_info_stat.lv_cdn_diag_stc fmy_stat_ref_crk_cam_in_1.err_info_stat.lv_lock_diag fmy_stat_ref_crk_cam_in_1.err_info_stat.lv_err_mem fmy_stat_ref_crk_cam_in_1.err_info_stat.lv_ready fmy_stat_ref_crk_cam_in_1.err_info_stat.lv_end_diag fmy_stat_ref_crk_cam_in_1.err_info_stat.lv_cdn_diag fmy_stat_ref_crk_cam_in_1.err_info_stat.err_sym fmy_stat_crk_tooth.ctr_abc fmy_stat_crk_tooth.ctr_end_diag fmy_stat_crk_tooth.err_info_stat.reserved fmy_stat_crk_tooth.err_info_stat.lv_cdn_diag_stc fmy_stat_crk_tooth.err_info_stat.lv_lock_diag fmy_stat_crk_tooth.err_info_stat.lv_err_mem fmy_stat_crk_tooth.err_info_stat.lv_ready fmy_stat_crk_tooth.err_info_stat.lv_end_diag fmy_stat_crk_tooth.err_info_stat.lv_cdn_diag fmy_stat_crk_tooth.err_info_stat.err_sym fmy_stat_crk_tooth_per.ctr_abc fmy_stat_crk_tooth_per.ctr_end_diag fmy_stat_crk_tooth_per.err_info_stat.reserved fmy_stat_crk_tooth_per.err_info_stat.lv_cdn_diag_stc fmy_stat_crk_tooth_per.err_info_stat.lv_lock_diag fmy_stat_crk_tooth_per.err_info_stat.lv_err_mem fmy_stat_crk_tooth_per.err_info_stat.lv_ready fmy_stat_crk_tooth_per.err_info_stat.lv_end_diag fmy_stat_crk_tooth_per.err_info_stat.lv_cdn_diag fmy_stat_crk_tooth_per.err_info_stat.err_sym fmy_stat_crk_syn.ctr_abc fmy_stat_crk_syn.ctr_end_diag fmy_stat_crk_syn.err_info_stat.reserved fmy_stat_crk_syn.err_info_stat.lv_cdn_diag_stc fmy_stat_crk_syn.err_info_stat.lv_lock_diag fmy_stat_crk_syn.err_info_stat.lv_err_mem fmy_stat_crk_syn.err_info_stat.lv_ready fmy_stat_crk_syn.err_info_stat.lv_end_diag fmy_stat_crk_syn.err_info_stat.lv_cdn_diag fmy_stat_crk_syn.err_info_stat.err_sym fmy_stat_crk_plaus.ctr_abc fmy_stat_crk_plaus.ctr_end_diag fmy_stat_crk_plaus.err_info_stat.reserved fmy_stat_crk_plaus.err_info_stat.lv_cdn_diag_stc fmy_stat_crk_plaus.err_info_stat.lv_lock_diag fmy_stat_crk_plaus.err_info_stat.lv_err_mem fmy_stat_crk_plaus.err_info_stat.lv_ready fmy_stat_crk_plaus.err_info_stat.lv_end_diag fmy_stat_crk_plaus.err_info_stat.lv_cdn_diag fmy_stat_crk_plaus.err_info_stat.err_sym fmy_stat_plaus_cam_in_1.ctr_abc fmy_stat_plaus_cam_in_1.ctr_end_diag fmy_stat_plaus_cam_in_1.err_info_stat.reserved fmy_stat_plaus_cam_in_1.err_info_stat.lv_cdn_diag_stc fmy_stat_plaus_cam_in_1.err_info_stat.lv_lock_diag fmy_stat_plaus_cam_in_1.err_info_stat.lv_err_mem fmy_stat_plaus_cam_in_1.err_info_stat.lv_ready fmy_stat_plaus_cam_in_1.err_info_stat.lv_end_diag fmy_stat_plaus_cam_in_1.err_info_stat.lv_cdn_diag fmy_stat_plaus_cam_in_1.err_info_stat.err_sym fmy_stat_syn_crk_cam_in_1.ctr_abc fmy_stat_syn_crk_cam_in_1.ctr_end_diag fmy_stat_syn_crk_cam_in_1.err_info_stat.reserved fmy_stat_syn_crk_cam_in_1.err_info_stat.lv_cdn_diag_stc fmy_stat_syn_crk_cam_in_1.err_info_stat.lv_lock_diag fmy_stat_syn_crk_cam_in_1.err_info_stat.lv_err_mem fmy_stat_syn_crk_cam_in_1.err_info_stat.lv_ready fmy_stat_syn_crk_cam_in_1.err_info_stat.lv_end_diag fmy_stat_syn_crk_cam_in_1.err_info_stat.lv_cdn_diag fmy_stat_syn_crk_cam_in_1.err_info_stat.err_sym /end OUT_MEASUREMENT
/end FUNCTION
/begin FUNCTION ERRM_EGCP_DIAG "Error Management data for diagnosis EGCP_DIAG"
 /begin OUT_MEASUREMENT fmy_stat_lsh_up_1.ctr_abc fmy_stat_lsh_up_1.ctr_end_diag fmy_stat_lsh_up_1.err_info_stat.reserved fmy_stat_lsh_up_1.err_info_stat.lv_cdn_diag_stc fmy_stat_lsh_up_1.err_info_stat.lv_lock_diag fmy_stat_lsh_up_1.err_info_stat.lv_err_mem fmy_stat_lsh_up_1.err_info_stat.lv_ready fmy_stat_lsh_up_1.err_info_stat.lv_end_diag fmy_stat_lsh_up_1.err_info_stat.lv_cdn_diag fmy_stat_lsh_up_1.err_info_stat.err_sym fmy_stat_lsh_down_1.ctr_abc fmy_stat_lsh_down_1.ctr_end_diag fmy_stat_lsh_down_1.err_info_stat.reserved fmy_stat_lsh_down_1.err_info_stat.lv_cdn_diag_stc fmy_stat_lsh_down_1.err_info_stat.lv_lock_diag fmy_stat_lsh_down_1.err_info_stat.lv_err_mem fmy_stat_lsh_down_1.err_info_stat.lv_ready fmy_stat_lsh_down_1.err_info_stat.lv_end_diag fmy_stat_lsh_down_1.err_info_stat.lv_cdn_diag fmy_stat_lsh_down_1.err_info_stat.err_sym fmy_stat_scg_ls_down_1.ctr_abc fmy_stat_scg_ls_down_1.ctr_end_diag fmy_stat_scg_ls_down_1.err_info_stat.reserved fmy_stat_scg_ls_down_1.err_info_stat.lv_cdn_diag_stc fmy_stat_scg_ls_down_1.err_info_stat.lv_lock_diag fmy_stat_scg_ls_down_1.err_info_stat.lv_err_mem fmy_stat_scg_ls_down_1.err_info_stat.lv_ready fmy_stat_scg_ls_down_1.err_info_stat.lv_end_diag fmy_stat_scg_ls_down_1.err_info_stat.lv_cdn_diag fmy_stat_scg_ls_down_1.err_info_stat.err_sym fmy_stat_scp_ls_down_1.ctr_abc fmy_stat_scp_ls_down_1.ctr_end_diag fmy_stat_scp_ls_down_1.err_info_stat.reserved fmy_stat_scp_ls_down_1.err_info_stat.lv_cdn_diag_stc fmy_stat_scp_ls_down_1.err_info_stat.lv_lock_diag fmy_stat_scp_ls_down_1.err_info_stat.lv_err_mem fmy_stat_scp_ls_down_1.err_info_stat.lv_ready fmy_stat_scp_ls_down_1.err_info_stat.lv_end_diag fmy_stat_scp_ls_down_1.err_info_stat.lv_cdn_diag fmy_stat_scp_ls_down_1.err_info_stat.err_sym fmy_stat_oc_ls_down_1.ctr_abc fmy_stat_oc_ls_down_1.ctr_end_diag fmy_stat_oc_ls_down_1.err_info_stat.reserved fmy_stat_oc_ls_down_1.err_info_stat.lv_cdn_diag_stc fmy_stat_oc_ls_down_1.err_info_stat.lv_lock_diag fmy_stat_oc_ls_down_1.err_info_stat.lv_err_mem fmy_stat_oc_ls_down_1.err_info_stat.lv_ready fmy_stat_oc_ls_down_1.err_info_stat.lv_end_diag fmy_stat_oc_ls_down_1.err_info_stat.lv_cdn_diag fmy_stat_oc_ls_down_1.err_info_stat.err_sym fmy_stat_obd_lsh_down_1.ctr_abc fmy_stat_obd_lsh_down_1.ctr_end_diag fmy_stat_obd_lsh_down_1.err_info_stat.reserved fmy_stat_obd_lsh_down_1.err_info_stat.lv_cdn_diag_stc fmy_stat_obd_lsh_down_1.err_info_stat.lv_lock_diag fmy_stat_obd_lsh_down_1.err_info_stat.lv_err_mem fmy_stat_obd_lsh_down_1.err_info_stat.lv_ready fmy_stat_obd_lsh_down_1.err_info_stat.lv_end_diag fmy_stat_obd_lsh_down_1.err_info_stat.lv_cdn_diag fmy_stat_obd_lsh_down_1.err_info_stat.err_sym fmy_stat_lam_adj_1.ctr_abc fmy_stat_lam_adj_1.ctr_end_diag fmy_stat_lam_adj_1.err_info_stat.reserved fmy_stat_lam_adj_1.err_info_stat.lv_cdn_diag_stc fmy_stat_lam_adj_1.err_info_stat.lv_lock_diag fmy_stat_lam_adj_1.err_info_stat.lv_err_mem fmy_stat_lam_adj_1.err_info_stat.lv_ready fmy_stat_lam_adj_1.err_info_stat.lv_end_diag fmy_stat_lam_adj_1.err_info_stat.lv_cdn_diag fmy_stat_lam_adj_1.err_info_stat.err_sym fmy_stat_chk_ls_down_1.ctr_abc fmy_stat_chk_ls_down_1.ctr_end_diag fmy_stat_chk_ls_down_1.err_info_stat.reserved fmy_stat_chk_ls_down_1.err_info_stat.lv_cdn_diag_stc fmy_stat_chk_ls_down_1.err_info_stat.lv_lock_diag fmy_stat_chk_ls_down_1.err_info_stat.lv_err_mem fmy_stat_chk_ls_down_1.err_info_stat.lv_ready fmy_stat_chk_ls_down_1.err_info_stat.lv_end_diag fmy_stat_chk_ls_down_1.err_info_stat.lv_cdn_diag fmy_stat_chk_ls_down_1.err_info_stat.err_sym fmy_stat_puc_ls_down_1.ctr_abc fmy_stat_puc_ls_down_1.ctr_end_diag fmy_stat_puc_ls_down_1.err_info_stat.reserved fmy_stat_puc_ls_down_1.err_info_stat.lv_cdn_diag_stc fmy_stat_puc_ls_down_1.err_info_stat.lv_lock_diag fmy_stat_puc_ls_down_1.err_info_stat.lv_err_mem fmy_stat_puc_ls_down_1.err_info_stat.lv_ready fmy_stat_puc_ls_down_1.err_info_stat.lv_end_diag fmy_stat_puc_ls_down_1.err_info_stat.lv_cdn_diag fmy_stat_puc_ls_down_1.err_info_stat.err_sym fmy_stat_fl_ls_down_1.ctr_abc fmy_stat_fl_ls_down_1.ctr_end_diag fmy_stat_fl_ls_down_1.err_info_stat.reserved fmy_stat_fl_ls_down_1.err_info_stat.lv_cdn_diag_stc fmy_stat_fl_ls_down_1.err_info_stat.lv_lock_diag fmy_stat_fl_ls_down_1.err_info_stat.lv_err_mem fmy_stat_fl_ls_down_1.err_info_stat.lv_ready fmy_stat_fl_ls_down_1.err_info_stat.lv_end_diag fmy_stat_fl_ls_down_1.err_info_stat.lv_cdn_diag fmy_stat_fl_ls_down_1.err_info_stat.err_sym fmy_stat_el_lsl_up_1.ctr_abc fmy_stat_el_lsl_up_1.ctr_end_diag fmy_stat_el_lsl_up_1.err_info_stat.reserved fmy_stat_el_lsl_up_1.err_info_stat.lv_cdn_diag_stc fmy_stat_el_lsl_up_1.err_info_stat.lv_lock_diag fmy_stat_el_lsl_up_1.err_info_stat.lv_err_mem fmy_stat_el_lsl_up_1.err_info_stat.lv_ready fmy_stat_el_lsl_up_1.err_info_stat.lv_end_diag fmy_stat_el_lsl_up_1.err_info_stat.lv_cdn_diag fmy_stat_el_lsl_up_1.err_info_stat.err_sym fmy_stat_oc_lsl_up_1.ctr_abc fmy_stat_oc_lsl_up_1.ctr_end_diag fmy_stat_oc_lsl_up_1.err_info_stat.reserved fmy_stat_oc_lsl_up_1.err_info_stat.lv_cdn_diag_stc fmy_stat_oc_lsl_up_1.err_info_stat.lv_lock_diag fmy_stat_oc_lsl_up_1.err_info_stat.lv_err_mem fmy_stat_oc_lsl_up_1.err_info_stat.lv_ready fmy_stat_oc_lsl_up_1.err_info_stat.lv_end_diag fmy_stat_oc_lsl_up_1.err_info_stat.lv_cdn_diag fmy_stat_oc_lsl_up_1.err_info_stat.err_sym fmy_stat_lsl_up_if_1.ctr_abc fmy_stat_lsl_up_if_1.ctr_end_diag fmy_stat_lsl_up_if_1.err_info_stat.reserved fmy_stat_lsl_up_if_1.err_info_stat.lv_cdn_diag_stc fmy_stat_lsl_up_if_1.err_info_stat.lv_lock_diag fmy_stat_lsl_up_if_1.err_info_stat.lv_err_mem fmy_stat_lsl_up_if_1.err_info_stat.lv_ready fmy_stat_lsl_up_if_1.err_info_stat.lv_end_diag fmy_stat_lsl_up_if_1.err_info_stat.lv_cdn_diag fmy_stat_lsl_up_if_1.err_info_stat.err_sym fmy_stat_air_lsl_up_1.ctr_abc fmy_stat_air_lsl_up_1.ctr_end_diag fmy_stat_air_lsl_up_1.err_info_stat.reserved fmy_stat_air_lsl_up_1.err_info_stat.lv_cdn_diag_stc fmy_stat_air_lsl_up_1.err_info_stat.lv_lock_diag fmy_stat_air_lsl_up_1.err_info_stat.lv_err_mem fmy_stat_air_lsl_up_1.err_info_stat.lv_ready fmy_stat_air_lsl_up_1.err_info_stat.lv_end_diag fmy_stat_air_lsl_up_1.err_info_stat.lv_cdn_diag fmy_stat_air_lsl_up_1.err_info_stat.err_sym fmy_stat_ttip_obd_ls_up_1.ctr_abc fmy_stat_ttip_obd_ls_up_1.ctr_end_diag fmy_stat_ttip_obd_ls_up_1.err_info_stat.reserved fmy_stat_ttip_obd_ls_up_1.err_info_stat.lv_cdn_diag_stc fmy_stat_ttip_obd_ls_up_1.err_info_stat.lv_lock_diag fmy_stat_ttip_obd_ls_up_1.err_info_stat.lv_err_mem fmy_stat_ttip_obd_ls_up_1.err_info_stat.lv_ready fmy_stat_ttip_obd_ls_up_1.err_info_stat.lv_end_diag fmy_stat_ttip_obd_ls_up_1.err_info_stat.lv_cdn_diag fmy_stat_ttip_obd_ls_up_1.err_info_stat.err_sym fmy_stat_dyn_vld_ls_up_1.ctr_abc fmy_stat_dyn_vld_ls_up_1.ctr_end_diag fmy_stat_dyn_vld_ls_up_1.err_info_stat.reserved fmy_stat_dyn_vld_ls_up_1.err_info_stat.lv_cdn_diag_stc fmy_stat_dyn_vld_ls_up_1.err_info_stat.lv_lock_diag fmy_stat_dyn_vld_ls_up_1.err_info_stat.lv_err_mem fmy_stat_dyn_vld_ls_up_1.err_info_stat.lv_ready fmy_stat_dyn_vld_ls_up_1.err_info_stat.lv_end_diag fmy_stat_dyn_vld_ls_up_1.err_info_stat.lv_cdn_diag fmy_stat_dyn_vld_ls_up_1.err_info_stat.err_sym fmy_stat_puc_vld_ls_up_1.ctr_abc fmy_stat_puc_vld_ls_up_1.ctr_end_diag fmy_stat_puc_vld_ls_up_1.err_info_stat.reserved fmy_stat_puc_vld_ls_up_1.err_info_stat.lv_cdn_diag_stc fmy_stat_puc_vld_ls_up_1.err_info_stat.lv_lock_diag fmy_stat_puc_vld_ls_up_1.err_info_stat.lv_err_mem fmy_stat_puc_vld_ls_up_1.err_info_stat.lv_ready fmy_stat_puc_vld_ls_up_1.err_info_stat.lv_end_diag fmy_stat_puc_vld_ls_up_1.err_info_stat.lv_cdn_diag fmy_stat_puc_vld_ls_up_1.err_info_stat.err_sym fmy_stat_obd_vld_lsh_up_1.ctr_abc fmy_stat_obd_vld_lsh_up_1.ctr_end_diag fmy_stat_obd_vld_lsh_up_1.err_info_stat.reserved fmy_stat_obd_vld_lsh_up_1.err_info_stat.lv_cdn_diag_stc fmy_stat_obd_vld_lsh_up_1.err_info_stat.lv_lock_diag fmy_stat_obd_vld_lsh_up_1.err_info_stat.lv_err_mem fmy_stat_obd_vld_lsh_up_1.err_info_stat.lv_ready fmy_stat_obd_vld_lsh_up_1.err_info_stat.lv_end_diag fmy_stat_obd_vld_lsh_up_1.err_info_stat.lv_cdn_diag fmy_stat_obd_vld_lsh_up_1.err_info_stat.err_sym fmy_stat_shift_afl_lsl_up_1.ctr_abc fmy_stat_shift_afl_lsl_up_1.ctr_end_diag fmy_stat_shift_afl_lsl_up_1.err_info_stat.reserved fmy_stat_shift_afl_lsl_up_1.err_info_stat.lv_cdn_diag_stc fmy_stat_shift_afl_lsl_up_1.err_info_stat.lv_lock_diag fmy_stat_shift_afl_lsl_up_1.err_info_stat.lv_err_mem fmy_stat_shift_afl_lsl_up_1.err_info_stat.lv_ready fmy_stat_shift_afl_lsl_up_1.err_info_stat.lv_end_diag fmy_stat_shift_afl_lsl_up_1.err_info_stat.lv_cdn_diag fmy_stat_shift_afl_lsl_up_1.err_info_stat.err_sym fmy_stat_shift_afr_lsl_up_1.ctr_abc fmy_stat_shift_afr_lsl_up_1.ctr_end_diag fmy_stat_shift_afr_lsl_up_1.err_info_stat.reserved fmy_stat_shift_afr_lsl_up_1.err_info_stat.lv_cdn_diag_stc fmy_stat_shift_afr_lsl_up_1.err_info_stat.lv_lock_diag fmy_stat_shift_afr_lsl_up_1.err_info_stat.lv_err_mem fmy_stat_shift_afr_lsl_up_1.err_info_stat.lv_ready fmy_stat_shift_afr_lsl_up_1.err_info_stat.lv_end_diag fmy_stat_shift_afr_lsl_up_1.err_info_stat.lv_cdn_diag fmy_stat_shift_afr_lsl_up_1.err_info_stat.err_sym fmy_stat_lsh_lsl_up_1.ctr_abc fmy_stat_lsh_lsl_up_1.ctr_end_diag fmy_stat_lsh_lsl_up_1.err_info_stat.reserved fmy_stat_lsh_lsl_up_1.err_info_stat.lv_cdn_diag_stc fmy_stat_lsh_lsl_up_1.err_info_stat.lv_lock_diag fmy_stat_lsh_lsl_up_1.err_info_stat.lv_err_mem fmy_stat_lsh_lsl_up_1.err_info_stat.lv_ready fmy_stat_lsh_lsl_up_1.err_info_stat.lv_end_diag fmy_stat_lsh_lsl_up_1.err_info_stat.lv_cdn_diag fmy_stat_lsh_lsl_up_1.err_info_stat.err_sym fmy_stat_swt_ls_down_1.ctr_abc fmy_stat_swt_ls_down_1.ctr_end_diag fmy_stat_swt_ls_down_1.err_info_stat.reserved fmy_stat_swt_ls_down_1.err_info_stat.lv_cdn_diag_stc fmy_stat_swt_ls_down_1.err_info_stat.lv_lock_diag fmy_stat_swt_ls_down_1.err_info_stat.lv_err_mem fmy_stat_swt_ls_down_1.err_info_stat.lv_ready fmy_stat_swt_ls_down_1.err_info_stat.lv_end_diag fmy_stat_swt_ls_down_1.err_info_stat.lv_cdn_diag fmy_stat_swt_ls_down_1.err_info_stat.err_sym fmy_stat_pue_ls_down_1.ctr_abc fmy_stat_pue_ls_down_1.ctr_end_diag fmy_stat_pue_ls_down_1.err_info_stat.reserved fmy_stat_pue_ls_down_1.err_info_stat.lv_cdn_diag_stc fmy_stat_pue_ls_down_1.err_info_stat.lv_lock_diag fmy_stat_pue_ls_down_1.err_info_stat.lv_err_mem fmy_stat_pue_ls_down_1.err_info_stat.lv_ready fmy_stat_pue_ls_down_1.err_info_stat.lv_end_diag fmy_stat_pue_ls_down_1.err_info_stat.lv_cdn_diag fmy_stat_pue_ls_down_1.err_info_stat.err_sym fmy_stat_chg_ls_up.ctr_abc fmy_stat_chg_ls_up.ctr_end_diag fmy_stat_chg_ls_up.err_info_stat.reserved fmy_stat_chg_ls_up.err_info_stat.lv_cdn_diag_stc fmy_stat_chg_ls_up.err_info_stat.lv_lock_diag fmy_stat_chg_ls_up.err_info_stat.lv_err_mem fmy_stat_chg_ls_up.err_info_stat.lv_ready fmy_stat_chg_ls_up.err_info_stat.lv_end_diag fmy_stat_chg_ls_up.err_info_stat.lv_cdn_diag fmy_stat_chg_ls_up.err_info_stat.err_sym fmy_stat_chg_ls_down.ctr_abc fmy_stat_chg_ls_down.ctr_end_diag fmy_stat_chg_ls_down.err_info_stat.reserved fmy_stat_chg_ls_down.err_info_stat.lv_cdn_diag_stc fmy_stat_chg_ls_down.err_info_stat.lv_lock_diag fmy_stat_chg_ls_down.err_info_stat.lv_err_mem fmy_stat_chg_ls_down.err_info_stat.lv_ready fmy_stat_chg_ls_down.err_info_stat.lv_end_diag fmy_stat_chg_ls_down.err_info_stat.lv_cdn_diag fmy_stat_chg_ls_down.err_info_stat.err_sym /end OUT_MEASUREMENT
/end FUNCTION
/begin FUNCTION C_B_ERRM ""
 /begin SUB_FUNCTION ERRM_CAL_AIMOB ERRM_CAL_ADCDCDGO ERRM_CAL_APVSDIAG ERRM_CAL_AVCCDIAG ERRM_CAL_ADIPDIAG ERRM_CAL_ATCODIAG ERRM_CAL_AEGRCTLD ERRM_CAL_AAMPDIAG ERRM_CAL_ATFUDIAG ERRM_CAL_AMAPDIAG ERRM_CAL_AMAFPLAD ERRM_CAL_AMAFANAD ERRM_CAL_ATPCDIAG ERRM_CAL_ATACDIAG ERRM_CAL_AOBDFSD ERRM_CAL_ACYBDIAG ERRM_CAL_AEGRVCAD ERRM_CAL_ATHRCAD ERRM_CAL_ABPACAD ERRM_CAL_ABYPCAD ERRM_CAL_AMAPCTLD ERRM_CAL_ERRM_DIAG ERRM_CAL_AOBDEGR ERRM_CAL_AVSDIAG ERRM_CAL_ACSDIAG ERRM_CAL_ABRAKE_D ERRM_CAL_ACANDGO ERRM_CAL_AVARDIAG ERRM_CAL_AAC_DIAG ERRM_CAL_ATBADIAG ERRM_CAL_AALTDIAG ERRM_CAL_AVEGRVDG ERRM_CAL_ACAPDIAG ERRM_CAL_ATCOPLAD ERRM_CAL_AEFPDIAG ERRM_CAL_ASPIDIAG ERRM_CAL_AEGRBYPD ERRM_CAL_AEGRVDHB ERRM_CAL_AINJDIAG ERRM_CAL_ATEGTURD ERRM_CAL_ADGOSPI ERRM_CAL_ARLYDIAG ERRM_CAL_AVBDIAG ERRM_CAL_AERRMON ERRM_CAL_TMO3ERRM ERRM_CAL_ENSD_DIAG ERRM_CAL_EGCP_DIAG /end SUB_FUNCTION
/end FUNCTION
/begin FUNCTION ERRM_CAL_AIMOB "Error Management Calibrations for diagnosis AIMOB"
 /begin DEF_CHARACTERISTIC fmy_id_imob.dtc[0] fmy_id_imob.envd fmy_id_imob.c_err_clas fmy_id_ecu_4.dtc[0] fmy_id_ecu_4.envd fmy_id_ecu_4.c_err_clas fmy_id_ecu_2.dtc[0] fmy_id_ecu_2.envd fmy_id_ecu_2.c_err_clas /end DEF_CHARACTERISTIC
/end FUNCTION
/begin FUNCTION ERRM_CAL_ADCDCDGO "Error Management Calibrations for diagnosis ADCDCDGO"
 /begin DEF_CHARACTERISTIC fmy_id_v_dcdc_rng.dtc[0] fmy_id_v_dcdc_rng.envd fmy_id_v_dcdc_rng.c_err_clas /end DEF_CHARACTERISTIC
/end FUNCTION
/begin FUNCTION ERRM_CAL_APVSDIAG "Error Management Calibrations for diagnosis APVSDIAG"
 /begin DEF_CHARACTERISTIC fmy_id_pvs_l_1.dtc[0] fmy_id_pvs_l_1.envd fmy_id_pvs_l_1.c_err_clas fmy_id_pvs_l_2.dtc[0] fmy_id_pvs_l_2.envd fmy_id_pvs_l_2.c_err_clas fmy_id_pvs_h_1.dtc[0] fmy_id_pvs_h_1.envd fmy_id_pvs_h_1.c_err_clas fmy_id_pvs_h_2.dtc[0] fmy_id_pvs_h_2.envd fmy_id_pvs_h_2.c_err_clas fmy_id_pvs_ratio.dtc[0] fmy_id_pvs_ratio.envd fmy_id_pvs_ratio.c_err_clas fmy_id_pvs_move.dtc[0] fmy_id_pvs_move.envd fmy_id_pvs_move.c_err_clas fmy_id_pvs_bls_bts.dtc[0] fmy_id_pvs_bls_bts.envd fmy_id_pvs_bls_bts.c_err_clas /end DEF_CHARACTERISTIC
/end FUNCTION
/begin FUNCTION ERRM_CAL_AVCCDIAG "Error Management Calibrations for diagnosis AVCCDIAG"
 /begin DEF_CHARACTERISTIC fmy_id_vcc_1.dtc[0] fmy_id_vcc_1.envd fmy_id_vcc_1.c_err_clas fmy_id_vcc_2.dtc[0] fmy_id_vcc_2.envd fmy_id_vcc_2.c_err_clas /end DEF_CHARACTERISTIC
/end FUNCTION
/begin FUNCTION ERRM_CAL_ADIPDIAG "Error Management Calibrations for diagnosis ADIPDIAG"
 /begin DEF_CHARACTERISTIC fmy_id_v_dip_pf_rng.dtc[0] fmy_id_v_dip_pf_rng.envd fmy_id_v_dip_pf_rng.c_err_clas fmy_id_dip_pf_mes_grd.dtc[0] fmy_id_dip_pf_mes_grd.envd fmy_id_dip_pf_mes_grd.c_err_clas fmy_id_dip_pf_mes_es.dtc[0] fmy_id_dip_pf_mes_es.envd fmy_id_dip_pf_mes_es.c_err_clas /end DEF_CHARACTERISTIC
/end FUNCTION
/begin FUNCTION ERRM_CAL_ATCODIAG "Error Management Calibrations for diagnosis ATCODIAG"
 /begin DEF_CHARACTERISTIC fmy_id_v_tco_1_rng.dtc[0] fmy_id_v_tco_1_rng.envd fmy_id_v_tco_1_rng.c_err_clas fmy_id_v_tco_2_rng.dtc[0] fmy_id_v_tco_2_rng.envd fmy_id_v_tco_2_rng.c_err_clas fmy_id_tco_1_mes_grd.dtc[0] fmy_id_tco_1_mes_grd.envd fmy_id_tco_1_mes_grd.c_err_clas fmy_id_tco_2_mes_grd.dtc[0] fmy_id_tco_2_mes_grd.envd fmy_id_tco_2_mes_grd.c_err_clas fmy_id_tco_mes_plaus.dtc[0] fmy_id_tco_mes_plaus.envd fmy_id_tco_mes_plaus.c_err_clas /end DEF_CHARACTERISTIC
/end FUNCTION
/begin FUNCTION ERRM_CAL_AEGRCTLD "Error Management Calibrations for diagnosis AEGRCTLD"
 /begin DEF_CHARACTERISTIC fmy_id_egr_ctl_min.dtc[0] fmy_id_egr_ctl_min.envd fmy_id_egr_ctl_min.c_err_clas fmy_id_egr_ctl_max.dtc[0] fmy_id_egr_ctl_max.envd fmy_id_egr_ctl_max.c_err_clas /end DEF_CHARACTERISTIC
/end FUNCTION
/begin FUNCTION ERRM_CAL_AAMPDIAG "Error Management Calibrations for diagnosis AAMPDIAG"
 /begin DEF_CHARACTERISTIC fmy_id_v_amp_rng.dtc[0] fmy_id_v_amp_rng.envd fmy_id_v_amp_rng.c_err_clas fmy_id_amp_mes_grd.dtc[0] fmy_id_amp_mes_grd.envd fmy_id_amp_mes_grd.c_err_clas /end DEF_CHARACTERISTIC
/end FUNCTION
/begin FUNCTION ERRM_CAL_ATFUDIAG "Error Management Calibrations for diagnosis ATFUDIAG"
 /begin DEF_CHARACTERISTIC fmy_id_v_tfu_rng.dtc[0] fmy_id_v_tfu_rng.envd fmy_id_v_tfu_rng.c_err_clas fmy_id_tfu_mes_grd.dtc[0] fmy_id_tfu_mes_grd.envd fmy_id_tfu_mes_grd.c_err_clas fmy_id_tfu_mes_plaus.dtc[0] fmy_id_tfu_mes_plaus.envd fmy_id_tfu_mes_plaus.c_err_clas /end DEF_CHARACTERISTIC
/end FUNCTION
/begin FUNCTION ERRM_CAL_AMAPDIAG "Error Management Calibrations for diagnosis AMAPDIAG"
 /begin DEF_CHARACTERISTIC fmy_id_v_map_rng.dtc[0] fmy_id_v_map_rng.envd fmy_id_v_map_rng.c_err_clas fmy_id_map_amp_ofs.dtc[0] fmy_id_map_amp_ofs.envd fmy_id_map_amp_ofs.c_err_clas fmy_id_map_is_ofs.dtc[0] fmy_id_map_is_ofs.envd fmy_id_map_is_ofs.c_err_clas fmy_id_map_mes_grd.dtc[0] fmy_id_map_mes_grd.envd fmy_id_map_mes_grd.c_err_clas /end DEF_CHARACTERISTIC
/end FUNCTION
/begin FUNCTION ERRM_CAL_AMAFPLAD "Error Management Calibrations for diagnosis AMAFPLAD"
 /begin DEF_CHARACTERISTIC fmy_id_maf_kgh_plaus.dtc[0] fmy_id_maf_kgh_plaus.envd fmy_id_maf_kgh_plaus.c_err_clas /end DEF_CHARACTERISTIC
/end FUNCTION
/begin FUNCTION ERRM_CAL_AMAFANAD "Error Management Calibrations for diagnosis AMAFANAD"
 /begin DEF_CHARACTERISTIC fmy_id_maf_0_rng.dtc[0] fmy_id_maf_0_rng.envd fmy_id_maf_0_rng.c_err_clas /end DEF_CHARACTERISTIC
/end FUNCTION
/end MODULE
/end PROJECT
