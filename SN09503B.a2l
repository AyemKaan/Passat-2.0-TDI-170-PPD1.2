ASAP2_VERSION 1 41
/begin PROJECT SN0 "SIMOS PPD"
/begin HEADER "_default_HeaderComment" PROJECT_NO PRJ_NUM /end HEADER
/begin MODULE _default_ModuleName "_default_ModuleLongIdentifier"
/begin MOD_COMMON "_default_ModCommonComment" DEPOSIT ABSOLUTE BYTE_ORDER MSB_FIRST ALIGNMENT_BYTE 1 ALIGNMENT_WORD 2 ALIGNMENT_LONG 4 ALIGNMENT_FLOAT32_IEEE 4 ALIGNMENT_FLOAT64_IEEE 8 /end MOD_COMMON
/begin MEASUREMENT tqi_tql_tfu_prot "torque for fuel overheating protection" SWORD _CNV_A_R_LINEAR_____52_CM 1 0. -1024. 1023.96875 DISPLAY_IDENTIFIER TQI_TQL_TFU_PROT ECU_ADDRESS 0x7f9d0c BYTE_ORDER MSB_LAST FORMAT "%6.2" /end MEASUREMENT
/begin CHARACTERISTIC c_tfu_thd_tqi_tql_tfu_prot "fuel temperature threshold for fuel overheating protection" VALUE 0x85ccfc _REC_VAL_20_u1 255. _CNV_A_R_LINEAR_____18_CM -50. 205. DISPLAY_IDENTIFIER C_TFU_THD_TQI_TQL_TFU_PROT FORMAT "%3.0" /end CHARACTERISTIC
/begin AXIS_PTS ldp_vs_ip_fac_tqi_tql_tfu_prot "vehicle speed correction of fuel overheating protection" 0x842ac7 vs _REC_AXS_20_u1 255. _CNV_A_R_LINEAR_____34_CM 12 0. 255. FORMAT "%3.0" /end AXIS_PTS
/begin AXIS_PTS ldp_n_ip_tqi_tql_tfu_prot "fuel overheating protection" 0x841f82 n _REC_AXS_20_u2 6375. _CNV_A_R_LINEAR_____5_CM 16 0. 6375. FORMAT "%4.0" /end AXIS_PTS
/begin AXIS_PTS ldp_tfu_ip_tqi_tql_tfu_prot "fuel overheating protection" 0x842480 tfu _REC_AXS_20_u1 255. _CNV_A_R_LINEAR_____18_CM 16 -50. 205. FORMAT "%3.0" /end AXIS_PTS
/begin CHARACTERISTIC ip_fac_tqi_tql_tfu_prot "MFBPRT: vehicle speed correction of fuel overheating protection" CURVE 0x8530b6 _REC_CUR_20_u1_u1 3.984375 _CNV_A_R_LINEAR_____95_CM 0. 3.984375 DISPLAY_IDENTIFIER IP_FAC_TQI_TQL_TFU_PROT FORMAT "%3.2"
 /begin AXIS_DESCR COM_AXIS vs _CNV_A_R_LINEAR_____34_CM 12 0. 255. FORMAT "%3.0" AXIS_PTS_REF ldp_vs_ip_fac_tqi_tql_tfu_prot /end AXIS_DESCR
/end CHARACTERISTIC
/begin CHARACTERISTIC ip_tqi_tql_tfu_prot "MFBPRT: fuel overheating protection" MAP 0x85c44c _REC_MAP_20_u2_u2_u1 2047.96875 _CNV_A_R_LINEAR_____86_CM -1024. 1023.96875 DISPLAY_IDENTIFIER IP_TQI_TQL_TFU_PROT FORMAT "%6.2"
 /begin AXIS_DESCR COM_AXIS n _CNV_A_R_LINEAR_____5_CM 16 0. 6375. FORMAT "%4.0" AXIS_PTS_REF ldp_n_ip_tqi_tql_tfu_prot /end AXIS_DESCR
 /begin AXIS_DESCR COM_AXIS tfu _CNV_A_R_LINEAR_____18_CM 16 -50. 205. FORMAT "%3.0" AXIS_PTS_REF ldp_tfu_ip_tqi_tql_tfu_prot /end AXIS_DESCR
/end CHARACTERISTIC
/begin AXIS_PTS ldpm_amp_2_inj "fuel mass AMP-correction factor of PREV1, PREV2, MAIN2 & POST1 at ST" 0x842b06 amp _REC_AXS_20_u2 5434. _CNV_A_R_LINEAR_____45_CM 4 0. 5434. FORMAT "%6.2" /end AXIS_PTS
/begin AXIS_PTS ldpm_n_3_inj "start fuel mass of injection PREV1, PREV2, MAIN2 & POST1" 0x842ec6 n _REC_AXS_20_u2 6375. _CNV_A_R_LINEAR_____5_CM 7 0. 6375. FORMAT "%4.0" /end AXIS_PTS
/begin AXIS_PTS ldpm_tco_2_inj "start fuel mass of injection PREV1, PREV2, MAIN2 & POST1" 0x84378f tco _REC_AXS_20_u1 255. _CNV_A_R_LINEAR_____18_CM 12 -50. 205. FORMAT "%3.0" /end AXIS_PTS
/begin AXIS_PTS ldpm_n_4_inj "amp correction of fuel mass of injection PREV1, PREV2, MAIN2 & POST1 at ST" 0x842ed6 n _REC_AXS_20_u2 6375. _CNV_A_R_LINEAR_____5_CM 4 0. 6375. FORMAT "%4.0" /end AXIS_PTS
/begin AXIS_PTS ldpm_tco_3_inj "amp correction of fuel mass of injection PREV1, PREV2, MAIN2 & POST1 at ST" 0x84379c tco _REC_AXS_20_u1 255. _CNV_A_R_LINEAR_____18_CM 6 -50. 205. FORMAT "%3.0" /end AXIS_PTS
/begin MEASUREMENT lv_mf_slm_act "logical variable for 'smoke limitation active'" UBYTE _CNV_S_2_RANGE______11_CM 1 0. 0. 1. DISPLAY_IDENTIFIER LV_MF_SLM_ACT ECU_ADDRESS 0x7fba29 /end MEASUREMENT
/begin MEASUREMENT mf_slm "fuel mass for smoke limitation" UWORD _CNV_A_R_LINEAR_____38_CM 1 0. 0. 262.14 DISPLAY_IDENTIFIER MF_SLM ECU_ADDRESS 0x7f9d08 BYTE_ORDER MSB_LAST /end MEASUREMENT
/begin MEASUREMENT maf_fil_slm "filtered MAF for smoke limitation" UWORD _CNV_A_R_LINEAR_____60_CM 1 0. 0. 1389. DISPLAY_IDENTIFIER MAF_FIL_SLM ECU_ADDRESS 0x7fa9d4 BYTE_ORDER MSB_LAST FORMAT "%6.2" /end MEASUREMENT
/begin MEASUREMENT mf_slm_cor_fup "smoke limitation correction from FUP" SWORD _CNV_A_R_LINEAR_____38_CM 1 0. -131.072 131.068 DISPLAY_IDENTIFIER MF_SLM_COR_FUP ECU_ADDRESS 0x7fa9d6 BYTE_ORDER MSB_LAST /end MEASUREMENT
/begin MEASUREMENT mf_slm_cor_tco "smoke limitation correction from TCO" SWORD _CNV_A_R_LINEAR_____38_CM 1 0. -131.072 131.068 DISPLAY_IDENTIFIER MF_SLM_COR_TCO ECU_ADDRESS 0x7fa9d8 BYTE_ORDER MSB_LAST /end MEASUREMENT
/begin MEASUREMENT mf_slm_cor_temp_slm "smoke limiation correction from TIA or TBA" SWORD _CNV_A_R_LINEAR_____38_CM 1 0. -131.072 131.068 DISPLAY_IDENTIFIER MF_SLM_COR_TEMP_SLM ECU_ADDRESS 0x7fa9da BYTE_ORDER MSB_LAST /end MEASUREMENT
/begin MEASUREMENT temp_slm "temperature for smoke limitation" UBYTE _CNV_A_R_LINEAR_____18_CM 1 0. -50. 205. DISPLAY_IDENTIFIER TEMP_SLM ECU_ADDRESS 0x7fba2a FORMAT "%3.0" /end MEASUREMENT
/begin CHARACTERISTIC lc_mf_slm_is_act "activation for smoke limitation during IS" VALUE 0x85015a _REC_VAL_20_u1 1. _CNV_A_R_LINEAR_____0_CM 0. 1. DISPLAY_IDENTIFIER LC_MF_SLM_IS_ACT FORMAT "%1.0" /end CHARACTERISTIC
/begin CHARACTERISTIC c_crlc_maf_slm "correlation constant for MAF for smoke limitation" VALUE 0x84fbf8 _REC_VAL_20_u2 0.9999874 _CNV_A_R_LINEAR_____87_CM 0. 0.9999874 DISPLAY_IDENTIFIER C_CRLC_MAF_SLM FORMAT "%6.5" /end CHARACTERISTIC
/begin CHARACTERISTIC lc_swi_temp_slm "switch for smoke limitation temperature selection" VALUE 0x850166 _REC_VAL_20_u1 1. _CNV_A_R_LINEAR_____0_CM 0. 1. DISPLAY_IDENTIFIER LC_SWI_TEMP_SLM FORMAT "%1.0" /end CHARACTERISTIC
/begin CHARACTERISTIC ip_fac_mf_slm__tco "MFSLM: smoke limitation TCO-correction factor" CURVE 0x84824e _REC_CUR_20_u2_u1 3.99998471 _CNV_A_R_LINEAR_____59_CM 0. 3.99998471 DISPLAY_IDENTIFIER IP_FAC_MF_SLM__TCO FORMAT "%6.5"
 /begin AXIS_DESCR COM_AXIS tco _CNV_A_R_LINEAR_____18_CM 8 -50. 205. FORMAT "%3.0" AXIS_PTS_REF ldp_tco_ip_fac_mf_slm /end AXIS_DESCR
/end CHARACTERISTIC
/begin AXIS_PTS ldp_tco_ip_fac_mf_slm "" 0x8422da tco _REC_AXS_20_u1 255. _CNV_A_R_LINEAR_____18_CM 8 -50. 205. FORMAT "%3.0" /end AXIS_PTS
/begin CHARACTERISTIC ip_fac_mf_slm__amp "MFSLM: smoke limitation AMP-correction factor" CURVE 0x84823e _REC_CUR_20_u2_u2 3.99998471 _CNV_A_R_LINEAR_____59_CM 0. 3.99998471 DISPLAY_IDENTIFIER IP_FAC_MF_SLM__AMP FORMAT "%6.5"
 /begin AXIS_DESCR COM_AXIS amp _CNV_A_R_LINEAR_____45_CM 8 0. 5434. FORMAT "%6.2" AXIS_PTS_REF ldp_amp_ip_fac_mf_slm /end AXIS_DESCR
/end CHARACTERISTIC
/begin AXIS_PTS ldp_amp_ip_fac_mf_slm "" 0x84123e amp _REC_AXS_20_u2 5434. _CNV_A_R_LINEAR_____45_CM 8 0. 5434. FORMAT "%6.2" /end AXIS_PTS
/begin CHARACTERISTIC ip_fac_mf_slm__temp_slm "MFSLM: smoke limitation TIA- or TBA-correction factor" CURVE 0x84825e _REC_CUR_20_u2_u1 3.99998471 _CNV_A_R_LINEAR_____59_CM 0. 3.99998471 DISPLAY_IDENTIFIER IP_FAC_MF_SLM__TEMP_SLM FORMAT "%6.5"
 /begin AXIS_DESCR COM_AXIS temp_slm _CNV_A_R_LINEAR_____18_CM 8 -50. 205. FORMAT "%3.0" AXIS_PTS_REF ldp_temp_slm_ip_fac_mf_slm /end AXIS_DESCR
/end CHARACTERISTIC
/begin AXIS_PTS ldp_temp_slm_ip_fac_mf_slm "" 0x84244d temp_slm _REC_AXS_20_u1 255. _CNV_A_R_LINEAR_____18_CM 8 -50. 205. FORMAT "%3.0" /end AXIS_PTS
/begin CHARACTERISTIC ip_mf_slm_bas__n__maf_fil "MFSLM: basic smoke limitation from filtered MAF" MAP 0x84ce74 _REC_MAP_20_u2_u2_u2 262.14 _CNV_A_R_LINEAR_____38_CM 0. 262.14 DISPLAY_IDENTIFIER IP_MF_SLM_BAS__N__MAF_FIL
 /begin AXIS_DESCR COM_AXIS n _CNV_A_R_LINEAR_____5_CM 12 0. 6375. FORMAT "%4.0" AXIS_PTS_REF ldpm_n_ip_mf_slm_bas /end AXIS_DESCR
 /begin AXIS_DESCR COM_AXIS maf_fil_slm _CNV_A_R_LINEAR_____60_CM 16 0. 1389. FORMAT "%6.2" AXIS_PTS_REF ldpm_maf_fil_ip_mf_slm_bas /end AXIS_DESCR
/end CHARACTERISTIC
/begin AXIS_PTS ldpm_n_ip_mf_slm_bas "" 0x8433fa n _REC_AXS_20_u2 6375. _CNV_A_R_LINEAR_____5_CM 12 0. 6375. FORMAT "%4.0" /end AXIS_PTS
/begin AXIS_PTS ldpm_maf_fil_ip_mf_slm_bas "" 0x842bce maf_fil_slm _REC_AXS_20_u2 1389. _CNV_A_R_LINEAR_____60_CM 16 0. 1389. FORMAT "%6.2" /end AXIS_PTS
/begin CHARACTERISTIC ip_mf_slm_cor_amp__n__amp "MFSLM: smoke limitation correction from AMP" MAP 0x84d174 _REC_MAP_20_u2_u2_u2 262.14 _CNV_A_R_LINEAR_____131_CM -131.072 131.068 DISPLAY_IDENTIFIER IP_MF_SLM_COR_AMP__N__AMP
 /begin AXIS_DESCR COM_AXIS n _CNV_A_R_LINEAR_____5_CM 6 0. 6375. FORMAT "%4.0" AXIS_PTS_REF ldpm_n_ip_mf_slm /end AXIS_DESCR
 /begin AXIS_DESCR COM_AXIS amp _CNV_A_R_LINEAR_____45_CM 6 0. 5434. FORMAT "%6.2" AXIS_PTS_REF ldp_amp_ip_mf_slm_cor_amp /end AXIS_DESCR
/end CHARACTERISTIC
/begin AXIS_PTS ldpm_n_ip_mf_slm "" 0x8433ec n _REC_AXS_20_u2 6375. _CNV_A_R_LINEAR_____5_CM 6 0. 6375. FORMAT "%4.0" /end AXIS_PTS
/begin AXIS_PTS ldp_amp_ip_mf_slm_cor_amp "" 0x84131a amp _REC_AXS_20_u2 5434. _CNV_A_R_LINEAR_____45_CM 6 0. 5434. FORMAT "%6.2" /end AXIS_PTS
/begin CHARACTERISTIC ip_mf_slm_tfu_lim__n__tfu "MFSLM: smoke limitation from TFU" MAP 0x84d2ac _REC_MAP_20_u2_u2_u1 262.14 _CNV_A_R_LINEAR_____38_CM 0. 262.14 DISPLAY_IDENTIFIER IP_MF_SLM_TFU_LIM__N__TFU
 /begin AXIS_DESCR COM_AXIS n _CNV_A_R_LINEAR_____5_CM 6 0. 6375. FORMAT "%4.0" AXIS_PTS_REF ldpm_n_ip_mf_slm /end AXIS_DESCR
 /begin AXIS_DESCR COM_AXIS tfu _CNV_A_R_LINEAR_____18_CM 4 -50. 205. FORMAT "%3.0" AXIS_PTS_REF ldp_tfu_ip_mf_slm_tfu_lim /end AXIS_DESCR
/end CHARACTERISTIC
/begin AXIS_PTS ldp_tfu_ip_mf_slm_tfu_lim "" 0x842474 tfu _REC_AXS_20_u1 255. _CNV_A_R_LINEAR_____18_CM 4 -50. 205. FORMAT "%3.0" /end AXIS_PTS
/begin CHARACTERISTIC ip_mf_slm_cor_tco__n__maf "MFSLM: smoke limitation correction from TCO" MAP 0x84d21c _REC_MAP_20_u2_u2_u2 262.14 _CNV_A_R_LINEAR_____131_CM -131.072 131.068 DISPLAY_IDENTIFIER IP_MF_SLM_COR_TCO__N__MAF
 /begin AXIS_DESCR COM_AXIS n _CNV_A_R_LINEAR_____5_CM 6 0. 6375. FORMAT "%4.0" AXIS_PTS_REF ldpm_n_ip_mf_slm /end AXIS_DESCR
 /begin AXIS_DESCR COM_AXIS maf _CNV_A_R_LINEAR_____60_CM 6 0. 1389. FORMAT "%6.2" AXIS_PTS_REF ldp_maf_ip_mf_slm_cor_tco /end AXIS_DESCR
/end CHARACTERISTIC
/begin AXIS_PTS ldp_maf_ip_mf_slm_cor_tco "" 0x84174a maf _REC_AXS_20_u2 1389. _CNV_A_R_LINEAR_____60_CM 6 0. 1389. FORMAT "%6.2" /end AXIS_PTS
/begin CHARACTERISTIC ip_mf_slm_cor_fup__n__fup_tra_d "MFSLM: smoke limitation correction from FUP" MAP 0x84d1bc _REC_MAP_20_u2_u2_u2 262.14 _CNV_A_R_LINEAR_____131_CM -131.072 131.068 DISPLAY_IDENTIFIER IP_MF_SLM_COR_FUP__N__FUP_TRA_D
 /begin AXIS_DESCR COM_AXIS n _CNV_A_R_LINEAR_____5_CM 6 0. 6375. FORMAT "%4.0" AXIS_PTS_REF ldpm_n_ip_mf_slm /end AXIS_DESCR
 /begin AXIS_DESCR COM_AXIS fup_tra_dif _CNV_A_R_LINEAR_____117_CM 8 -100. 99.99694820000001 FORMAT "%5.3" AXIS_PTS_REF ldp_fup_tra_d_ip_mf_slm_cor_fup /end AXIS_DESCR
/end CHARACTERISTIC
/begin AXIS_PTS ldp_fup_tra_d_ip_mf_slm_cor_fup "" 0x841716 fup_tra_dif _REC_AXS_20_u2 199.9969482 _CNV_A_R_LINEAR_____117_CM 8 -100. 99.99694820000001 FORMAT "%5.3" /end AXIS_PTS
/begin CHARACTERISTIC ip_mf_slm_cor_temp_slm__n__maf "MFSLM: smoke limitation correction from TIA or TBA" MAP 0x84d264 _REC_MAP_20_u2_u2_u2 262.14 _CNV_A_R_LINEAR_____131_CM -131.072 131.068 DISPLAY_IDENTIFIER IP_MF_SLM_COR_TEMP_SLM__N__MAF
 /begin AXIS_DESCR COM_AXIS n _CNV_A_R_LINEAR_____5_CM 6 0. 6375. FORMAT "%4.0" AXIS_PTS_REF ldpm_n_ip_mf_slm /end AXIS_DESCR
 /begin AXIS_DESCR COM_AXIS maf _CNV_A_R_LINEAR_____60_CM 6 0. 1389. FORMAT "%6.2" AXIS_PTS_REF ldp_maf_ip_mf_slm_cor_temp_slm /end AXIS_DESCR
/end CHARACTERISTIC
/begin AXIS_PTS ldp_maf_ip_mf_slm_cor_temp_slm "" 0x841758 maf _REC_AXS_20_u2 1389. _CNV_A_R_LINEAR_____60_CM 6 0. 1389. FORMAT "%6.2" /end AXIS_PTS
/begin CHARACTERISTIC ip_mf_slm_bas_rgn__n__maf_fil "MFSLM: basic smoke limitation from filtered MAF in regeneration" MAP 0x84cff4 _REC_MAP_20_u2_u2_u2 262.14 _CNV_A_R_LINEAR_____38_CM 0. 262.14 DISPLAY_IDENTIFIER IP_MF_SLM_BAS_RGN__N__MAF_FIL
 /begin AXIS_DESCR COM_AXIS n _CNV_A_R_LINEAR_____5_CM 12 0. 6375. FORMAT "%4.0" AXIS_PTS_REF ldpm_n_ip_mf_slm_bas /end AXIS_DESCR
 /begin AXIS_DESCR COM_AXIS maf_fil_slm _CNV_A_R_LINEAR_____60_CM 16 0. 1389. FORMAT "%6.2" AXIS_PTS_REF ldpm_maf_fil_ip_mf_slm_bas /end AXIS_DESCR
/end CHARACTERISTIC
/begin MEASUREMENT lf_rcha_prev1_act "Activation flag word for recharge pulses PREV1 (cylinder individual)" UWORD _CNV_A_R_LINEAR_____0_CM 1 0. 0. 65535. DISPLAY_IDENTIFIER LF_RCHA_PREV1_ACT ECU_ADDRESS 0x7fa170 BYTE_ORDER MSB_LAST FORMAT "%5.0" /end MEASUREMENT
/begin MEASUREMENT lf_rcha_main1_act "Activation flag word for recharge pulses MAIN1 (cylinder individual)" UWORD _CNV_A_R_LINEAR_____0_CM 1 0. 0. 65535. DISPLAY_IDENTIFIER LF_RCHA_MAIN1_ACT ECU_ADDRESS 0x7fa172 BYTE_ORDER MSB_LAST FORMAT "%5.0" /end MEASUREMENT
/begin MEASUREMENT lf_rcha_post1_act "Activation flag word for recharge pulses POST1 (cylinder individual)" UWORD _CNV_A_R_LINEAR_____0_CM 1 0. 0. 65535. DISPLAY_IDENTIFIER LF_RCHA_POST1_ACT ECU_ADDRESS 0x7fa174 BYTE_ORDER MSB_LAST FORMAT "%5.0" /end MEASUREMENT
/begin MEASUREMENT t_rcha_pulse_[0] "Recharge pulse rate" UWORD _CNV_A_R_LINEAR_____211_CM 1 0. 0. 32.767 DISPLAY_IDENTIFIER T_RCHA_PULSE__0_ ECU_ADDRESS 0x7fa168 BYTE_ORDER MSB_LAST FORMAT "%5.3" /end MEASUREMENT
/begin MEASUREMENT t_rcha_pulse_[1] "Recharge pulse rate" UWORD _CNV_A_R_LINEAR_____211_CM 1 0. 0. 32.767 DISPLAY_IDENTIFIER T_RCHA_PULSE__1_ ECU_ADDRESS 0x7fa16a BYTE_ORDER MSB_LAST FORMAT "%5.3" /end MEASUREMENT
/begin MEASUREMENT t_rcha_pulse_[2] "Recharge pulse rate" UWORD _CNV_A_R_LINEAR_____211_CM 1 0. 0. 32.767 DISPLAY_IDENTIFIER T_RCHA_PULSE__2_ ECU_ADDRESS 0x7fa16c BYTE_ORDER MSB_LAST FORMAT "%5.3" /end MEASUREMENT
/begin MEASUREMENT t_rcha_pulse_[3] "Recharge pulse rate" UWORD _CNV_A_R_LINEAR_____211_CM 1 0. 0. 32.767 DISPLAY_IDENTIFIER T_RCHA_PULSE__3_ ECU_ADDRESS 0x7fa16e BYTE_ORDER MSB_LAST FORMAT "%5.3" /end MEASUREMENT
/begin CHARACTERISTIC c_tco_rcha_lim "Coolant temperature limit for recharge activation" VALUE 0x85ccbf _REC_VAL_20_u1 255. _CNV_A_R_LINEAR_____18_CM -50. 205. DISPLAY_IDENTIFIER C_TCO_RCHA_LIM FORMAT "%5.3" /end CHARACTERISTIC
/begin CHARACTERISTIC c_ti_rcha_lim "Injection time limit for recharge activation" VALUE 0x85cd1c _REC_VAL_20_u2 32.767 _CNV_A_R_LINEAR_____211_CM 0. 32.767 DISPLAY_IDENTIFIER C_TI_RCHA_LIM FORMAT "%5.3" /end CHARACTERISTIC
/begin CHARACTERISTIC c_t_rcha_pulse_dur_[0] "Recharge pulse time (cylinder individual)" VALUE 0x85cc72 _REC_VAL_20_u2 32.767 _CNV_A_R_LINEAR_____211_CM 0. 32.767 DISPLAY_IDENTIFIER C_T_RCHA_PULSE_DUR__0_ FORMAT "%5.3" /end CHARACTERISTIC
/begin CHARACTERISTIC c_t_rcha_pulse_dur_[1] "Recharge pulse time (cylinder individual)" VALUE 0x85cc74 _REC_VAL_20_u2 32.767 _CNV_A_R_LINEAR_____211_CM 0. 32.767 DISPLAY_IDENTIFIER C_T_RCHA_PULSE_DUR__1_ FORMAT "%5.3" /end CHARACTERISTIC
/begin CHARACTERISTIC c_t_rcha_pulse_dur_[2] "Recharge pulse time (cylinder individual)" VALUE 0x85cc76 _REC_VAL_20_u2 32.767 _CNV_A_R_LINEAR_____211_CM 0. 32.767 DISPLAY_IDENTIFIER C_T_RCHA_PULSE_DUR__2_ FORMAT "%5.3" /end CHARACTERISTIC
/begin CHARACTERISTIC c_t_rcha_pulse_dur_[3] "Recharge pulse time (cylinder individual)" VALUE 0x85cc78 _REC_VAL_20_u2 32.767 _CNV_A_R_LINEAR_____211_CM 0. 32.767 DISPLAY_IDENTIFIER C_T_RCHA_PULSE_DUR__3_ FORMAT "%5.3" /end CHARACTERISTIC
/begin MEASUREMENT soi_frze_prev1_pwr_on "power-on value of start of pulse FROM ZERO PREV1" SWORD _CNV_A_R_LINEAR_____119_CM 1 0. -120. 240. DISPLAY_IDENTIFIER SOI_FRZE_PREV1_PWR_ON ECU_ADDRESS 0x7fa1ee BYTE_ORDER MSB_LAST FORMAT "%5.2" /end MEASUREMENT
/begin MEASUREMENT t_cha_frze_prev1 "charging time of pulse FROM ZERO PREV1" UWORD _CNV_A_R_LINEAR_____211_CM 1 0. 0. 32.767 DISPLAY_IDENTIFIER T_CHA_FRZE_PREV1 ECU_ADDRESS 0x7fa1f0 BYTE_ORDER MSB_LAST FORMAT "%5.3" /end MEASUREMENT
/begin MEASUREMENT soi_prev1_pwr_on "power-on value of start of injection PREV1" SWORD _CNV_A_R_LINEAR_____119_CM 1 0. -120. 240. DISPLAY_IDENTIFIER SOI_PREV1_PWR_ON ECU_ADDRESS 0x7fa1f2 BYTE_ORDER MSB_LAST FORMAT "%5.2" /end MEASUREMENT
/begin MEASUREMENT t_cha_prev1 "charging time of injection PREV1" UWORD _CNV_A_R_LINEAR_____211_CM 1 0. 0. 32.767 DISPLAY_IDENTIFIER T_CHA_PREV1 ECU_ADDRESS 0x7fa1f4 BYTE_ORDER MSB_LAST FORMAT "%5.3" /end MEASUREMENT
/begin MEASUREMENT eoi_prev1_pwr_on "power-on value of end of injection PREV1" SWORD _CNV_A_R_LINEAR_____119_CM 1 0. -120. 240. DISPLAY_IDENTIFIER EOI_PREV1_PWR_ON ECU_ADDRESS 0x7fa1f6 BYTE_ORDER MSB_LAST FORMAT "%5.2" /end MEASUREMENT
/begin MEASUREMENT t_dcha_prev1 "discharging time of injection PREV1" UWORD _CNV_A_R_LINEAR_____211_CM 1 0. 0. 32.767 DISPLAY_IDENTIFIER T_DCHA_PREV1 ECU_ADDRESS 0x7fa1f8 BYTE_ORDER MSB_LAST FORMAT "%5.3" /end MEASUREMENT
/begin MEASUREMENT t_hld_toze_prev1 "hold time of pulse TO ZERO PREV1" UWORD _CNV_A_R_LINEAR_____211_CM 1 0. 0. 32.767 DISPLAY_IDENTIFIER T_HLD_TOZE_PREV1 ECU_ADDRESS 0x7fa1fa BYTE_ORDER MSB_LAST FORMAT "%5.3" /end MEASUREMENT
/begin MEASUREMENT t_dcha_toze_prev1 "discharging time of pulse TO ZERO PREV1" UWORD _CNV_A_R_LINEAR_____211_CM 1 0. 0. 32.767 DISPLAY_IDENTIFIER T_DCHA_TOZE_PREV1 ECU_ADDRESS 0x7fa1fc BYTE_ORDER MSB_LAST FORMAT "%5.3" /end MEASUREMENT
/begin MEASUREMENT lv_frze_prev1_act "activation status of pulse FROM ZERO PREV1" UBYTE _CNV_S_2_RANGE______11_CM 1 0. 0. 1. DISPLAY_IDENTIFIER LV_FRZE_PREV1_ACT ECU_ADDRESS 0x7fbba4 /end MEASUREMENT
/begin MEASUREMENT lv_prev1_act "activation status of injection PREV1" UBYTE _CNV_S_2_RANGE______11_CM 1 0. 0. 1. DISPLAY_IDENTIFIER LV_PREV1_ACT ECU_ADDRESS 0x7fbba5 /end MEASUREMENT
/begin MEASUREMENT lv_toze_prev1_act "activation status of pulse TO ZERO PREV1" UBYTE _CNV_S_2_RANGE______11_CM 1 0. 0. 1. DISPLAY_IDENTIFIER LV_TOZE_PREV1_ACT ECU_ADDRESS 0x7fbba6 /end MEASUREMENT
/begin MEASUREMENT soi_frze_main1_pwr_on "power-on value of start of pulse FROM ZERO MAIN1" SWORD _CNV_A_R_LINEAR_____119_CM 1 0. -120. 240. DISPLAY_IDENTIFIER SOI_FRZE_MAIN1_PWR_ON ECU_ADDRESS 0x7fa1fe BYTE_ORDER MSB_LAST FORMAT "%5.2" /end MEASUREMENT
/begin MEASUREMENT t_cha_frze_main1 "charging time of pulse FROM ZERO MAIN1" UWORD _CNV_A_R_LINEAR_____211_CM 1 0. 0. 32.767 DISPLAY_IDENTIFIER T_CHA_FRZE_MAIN1 ECU_ADDRESS 0x7fa200 BYTE_ORDER MSB_LAST FORMAT "%5.3" /end MEASUREMENT
/begin MEASUREMENT soi_main1_pwr_on "power-on value of start of injection MAIN1" SWORD _CNV_A_R_LINEAR_____119_CM 1 0. -120. 240. DISPLAY_IDENTIFIER SOI_MAIN1_PWR_ON ECU_ADDRESS 0x7fa202 BYTE_ORDER MSB_LAST FORMAT "%5.2" /end MEASUREMENT
/begin MEASUREMENT t_cha_main1 "charging time of injection MAIN1" UWORD _CNV_A_R_LINEAR_____211_CM 1 0. 0. 32.767 DISPLAY_IDENTIFIER T_CHA_MAIN1 ECU_ADDRESS 0x7fa204 BYTE_ORDER MSB_LAST FORMAT "%5.3" /end MEASUREMENT
/begin MEASUREMENT lv_frze_main1_act "activation status of pulse FROM ZERO MAIN1" UBYTE _CNV_S_2_RANGE______11_CM 1 0. 0. 1. DISPLAY_IDENTIFIER LV_FRZE_MAIN1_ACT ECU_ADDRESS 0x7fbba7 /end MEASUREMENT
/begin MEASUREMENT lv_main1_act "activation status of injection MAIN1" UBYTE _CNV_S_2_RANGE______11_CM 1 0. 0. 1. DISPLAY_IDENTIFIER LV_MAIN1_ACT ECU_ADDRESS 0x7fbba8 /end MEASUREMENT
/begin MEASUREMENT lv_toze_main1_act "activation status of pulse TO ZERO MAIN1" UBYTE _CNV_S_2_RANGE______11_CM 1 0. 0. 1. DISPLAY_IDENTIFIER LV_TOZE_MAIN1_ACT ECU_ADDRESS 0x7fbba9 /end MEASUREMENT
/begin MEASUREMENT lv_toze_prev1_req4 "activation status of pulse TO ZERO PREV1 (request of function PREV1)" UBYTE _CNV_S_2_RANGE______11_CM 1 0. 0. 1. DISPLAY_IDENTIFIER LV_TOZE_PREV1_REQ4 ECU_ADDRESS 0x7fbf86 /end MEASUREMENT
/begin MEASUREMENT dur_move_prev1 "duration shift of PREV1" UWORD _CNV_A_R_LINEAR_____119_CM 1 0. 0. 360. DISPLAY_IDENTIFIER DUR_MOVE_PREV1 ECU_ADDRESS 0x7fa206 BYTE_ORDER MSB_LAST FORMAT "%5.2" /end MEASUREMENT
/begin MEASUREMENT case_nr "case number of collision between PREV1 and MAIN1" UBYTE _CNV_A_R_LINEAR_____0_CM 1 0. 1. 3. DISPLAY_IDENTIFIER CASE_NR ECU_ADDRESS 0x7fbba3 FORMAT "%1.0" /end MEASUREMENT
/begin MEASUREMENT doi_main1_pwr_on "power-on value of start of injection MAIN1" UWORD _CNV_A_R_LINEAR_____119_CM 1 0. 0. 360. DISPLAY_IDENTIFIER DOI_MAIN1_PWR_ON ECU_ADDRESS 0x7fa208 BYTE_ORDER MSB_LAST FORMAT "%5.2" /end MEASUREMENT
/begin CHARACTERISTIC c_t_dist_prev1_main1_min "minimal time between PREV1 and MAIN1" VALUE 0x84ff5e _REC_VAL_20_u2 32.767 _CNV_A_R_LINEAR_____211_CM 0. 32.767 DISPLAY_IDENTIFIER C_T_DIST_PREV1_MAIN1_MIN FORMAT "%5.3" /end CHARACTERISTIC
/begin CHARACTERISTIC c_dur_dist_prev1_main1_min "minimal duration between PREV1 and MAIN1" VALUE 0x84fcac _REC_VAL_20_s2 360. _CNV_A_R_LINEAR_____119_CM -120. 240. DISPLAY_IDENTIFIER C_DUR_DIST_PREV1_MAIN1_MIN FORMAT "%5.2" /end CHARACTERISTIC
/begin CHARACTERISTIC c_swi_dist "switch for minimal distance calculation method" VALUE 0x84ff0d _REC_VAL_20_u1 6. _CNV_A_R_LINEAR_____0_CM 1. 7. DISPLAY_IDENTIFIER C_SWI_DIST FORMAT "%1.0" /end CHARACTERISTIC
/begin CHARACTERISTIC c_n_level_swi "rotational speed threshold for level change" VALUE 0x84fdf2 _REC_VAL_20_u2 6375. _CNV_A_R_LINEAR_____5_CM 0. 6375. DISPLAY_IDENTIFIER C_N_LEVEL_SWI FORMAT "%4.0" /end CHARACTERISTIC
/begin CHARACTERISTIC lc_dir_chg_n_level "manual switch for direction of effect of C_N_LEVEL_SWI" VALUE 0x850113 _REC_VAL_20_u1 1. _CNV_A_R_LINEAR_____0_CM 0. 1. DISPLAY_IDENTIFIER LC_DIR_CHG_N_LEVEL FORMAT "%1.0" /end CHARACTERISTIC
/begin CHARACTERISTIC lc_case_clc_on "manual switch for calculation on/off" VALUE 0x85010c _REC_VAL_20_u1 1. _CNV_A_R_LINEAR_____0_CM 0. 1. DISPLAY_IDENTIFIER LC_CASE_CLC_ON FORMAT "%1.0" /end CHARACTERISTIC
/begin CHARACTERISTIC c_t_swi_1_2_ofs "this time offset causes a previously collision case change from 1 to 2" VALUE 0x84fff6 _REC_VAL_20_u2 32.767 _CNV_A_R_LINEAR_____211_CM 0. 32.767 DISPLAY_IDENTIFIER C_T_SWI_1_2_OFS FORMAT "%5.3" /end CHARACTERISTIC
/begin CHARACTERISTIC c_t_swi_2_3_ofs "this time offset causes a previously collision case change from 2 to 3" VALUE 0x84fff8 _REC_VAL_20_u2 32.767 _CNV_A_R_LINEAR_____211_CM 0. 32.767 DISPLAY_IDENTIFIER C_T_SWI_2_3_OFS FORMAT "%5.3" /end CHARACTERISTIC
/begin MEASUREMENT soi_frze_prev1_pwr_on_tu "tuned power-on value of start of pulse FROM ZERO PREV1" SWORD _CNV_A_R_LINEAR_____119_CM 1 0. -120. 240. DISPLAY_IDENTIFIER SOI_FRZE_PREV1_PWR_ON_TU ECU_ADDRESS 0x7fa230 BYTE_ORDER MSB_LAST FORMAT "%5.2" /end MEASUREMENT
/begin MEASUREMENT t_cha_frze_prev1_tu "tuned value of charging time of pulse FROM ZERO PREV1" UBYTE _CNV_A_R_LINEAR_____223_CM 1 0. 0. 0.31 DISPLAY_IDENTIFIER T_CHA_FRZE_PREV1_TU ECU_ADDRESS 0x7fbbb6 FORMAT "%3.2" /end MEASUREMENT
/begin MEASUREMENT soi_prev1_pwr_on_tu "tuned power-on value of start of injection PREV1" SWORD _CNV_A_R_LINEAR_____119_CM 1 0. -120. 240. DISPLAY_IDENTIFIER SOI_PREV1_PWR_ON_TU ECU_ADDRESS 0x7fa232 BYTE_ORDER MSB_LAST FORMAT "%5.2" /end MEASUREMENT
/begin MEASUREMENT t_cha_prev1_tu "tuned value of charging time of injection PREV1" UBYTE _CNV_A_R_LINEAR_____223_CM 1 0. 0. 0.31 DISPLAY_IDENTIFIER T_CHA_PREV1_TU ECU_ADDRESS 0x7fbbb7 FORMAT "%3.2" /end MEASUREMENT
/begin MEASUREMENT eoi_prev1_pwr_on_tu "tuned power-on value of end of injection PREV1" SWORD _CNV_A_R_LINEAR_____119_CM 1 0. -120. 240. DISPLAY_IDENTIFIER EOI_PREV1_PWR_ON_TU ECU_ADDRESS 0x7fa234 BYTE_ORDER MSB_LAST FORMAT "%5.2" /end MEASUREMENT
/begin MEASUREMENT t_dcha_prev1_tu "tuned value of discharging time of injection PREV1" UBYTE _CNV_A_R_LINEAR_____223_CM 1 0. 0. 0.31 DISPLAY_IDENTIFIER T_DCHA_PREV1_TU ECU_ADDRESS 0x7fbbb8 FORMAT "%3.2" /end MEASUREMENT
/begin MEASUREMENT t_hld_toze_prev1_tu "tuned value of hold time of pulse TO ZERO PREV1" UWORD _CNV_A_R_LINEAR_____211_CM 1 0. 0. 32.767 DISPLAY_IDENTIFIER T_HLD_TOZE_PREV1_TU ECU_ADDRESS 0x7fa236 BYTE_ORDER MSB_LAST FORMAT "%5.3" /end MEASUREMENT
/begin MEASUREMENT t_dcha_toze_prev1_tu "tuned value of discharging time of pulse TO ZERO PREV1" UBYTE _CNV_A_R_LINEAR_____223_CM 1 0. 0. 0.31 DISPLAY_IDENTIFIER T_DCHA_TOZE_PREV1_TU ECU_ADDRESS 0x7fbbb9 FORMAT "%3.2" /end MEASUREMENT
/begin MEASUREMENT soi_frze_main1_pwr_on_tu "tuned power-on value of start of pulse FROM ZERO MAIN1" SWORD _CNV_A_R_LINEAR_____119_CM 1 0. -120. 240. DISPLAY_IDENTIFIER SOI_FRZE_MAIN1_PWR_ON_TU ECU_ADDRESS 0x7fa238 BYTE_ORDER MSB_LAST FORMAT "%5.2" /end MEASUREMENT
/begin MEASUREMENT t_cha_frze_main1_tu "tuned value of charging time of pulse FROM ZERO MAIN1" UBYTE _CNV_A_R_LINEAR_____223_CM 1 0. 0. 0.31 DISPLAY_IDENTIFIER T_CHA_FRZE_MAIN1_TU ECU_ADDRESS 0x7fbbba FORMAT "%3.2" /end MEASUREMENT
/begin MEASUREMENT soi_main1_pwr_on_tu "tuned power-on value of start of injection MAIN1" SWORD _CNV_A_R_LINEAR_____119_CM 1 0. -120. 240. DISPLAY_IDENTIFIER SOI_MAIN1_PWR_ON_TU ECU_ADDRESS 0x7fa23a BYTE_ORDER MSB_LAST FORMAT "%5.2" /end MEASUREMENT
/begin MEASUREMENT t_cha_main1_tu "tuned value of charging time of injection MAIN1" UBYTE _CNV_A_R_LINEAR_____223_CM 1 0. 0. 0.31 DISPLAY_IDENTIFIER T_CHA_MAIN1_TU ECU_ADDRESS 0x7fbbbb FORMAT "%3.2" /end MEASUREMENT
/begin MEASUREMENT eoi_main1_pwr_on_tu "tuned power-on value of end of injection MAIN1" SWORD _CNV_A_R_LINEAR_____119_CM 1 0. -120. 240. DISPLAY_IDENTIFIER EOI_MAIN1_PWR_ON_TU ECU_ADDRESS 0x7fa23c BYTE_ORDER MSB_LAST FORMAT "%5.2" /end MEASUREMENT
/begin MEASUREMENT t_dcha_main1_tu "tuned value of discharging time of injection MAIN1" UBYTE _CNV_A_R_LINEAR_____223_CM 1 0. 0. 0.31 DISPLAY_IDENTIFIER T_DCHA_MAIN1_TU ECU_ADDRESS 0x7fbbbc FORMAT "%3.2" /end MEASUREMENT
/begin MEASUREMENT t_hld_toze_main1_tu "tuned value of hold time of pulse TO ZERO MAIN1" UWORD _CNV_A_R_LINEAR_____211_CM 1 0. 0. 32.767 DISPLAY_IDENTIFIER T_HLD_TOZE_MAIN1_TU ECU_ADDRESS 0x7fa23e BYTE_ORDER MSB_LAST FORMAT "%5.3" /end MEASUREMENT
/begin MEASUREMENT t_dcha_toze_main1_tu "tuned value of discharging time of pulse TO ZERO MAIN1" UBYTE _CNV_A_R_LINEAR_____223_CM 1 0. 0. 0.31 DISPLAY_IDENTIFIER T_DCHA_TOZE_MAIN1_TU ECU_ADDRESS 0x7fbbbd FORMAT "%3.2" /end MEASUREMENT
/begin MEASUREMENT soi_frze_post1_pwr_on_tu "tuned power-on value of start of pulse FROM ZERO POST1" SWORD _CNV_A_R_LINEAR_____119_CM 1 0. -120. 240. DISPLAY_IDENTIFIER SOI_FRZE_POST1_PWR_ON_TU ECU_ADDRESS 0x7fa240 BYTE_ORDER MSB_LAST FORMAT "%5.2" /end MEASUREMENT
/begin MEASUREMENT t_cha_frze_post1_tu "tuned value of charging time of pulse FROM ZERO POST1" UBYTE _CNV_A_R_LINEAR_____223_CM 1 0. 0. 0.31 DISPLAY_IDENTIFIER T_CHA_FRZE_POST1_TU ECU_ADDRESS 0x7fbbbe FORMAT "%3.2" /end MEASUREMENT
/begin MEASUREMENT soi_post1_pwr_on_tu "tuned power-on value of start of injection POST1" SWORD _CNV_A_R_LINEAR_____119_CM 1 0. -120. 240. DISPLAY_IDENTIFIER SOI_POST1_PWR_ON_TU ECU_ADDRESS 0x7fa242 BYTE_ORDER MSB_LAST FORMAT "%5.2" /end MEASUREMENT
/begin MEASUREMENT t_cha_post1_tu "tuned value of charging time of injection POST1" UBYTE _CNV_A_R_LINEAR_____223_CM 1 0. 0. 0.31 DISPLAY_IDENTIFIER T_CHA_POST1_TU ECU_ADDRESS 0x7fbbbf FORMAT "%3.2" /end MEASUREMENT
/begin MEASUREMENT eoi_post1_pwr_on_tu "tuned power-on value of end of injection POST1" SWORD _CNV_A_R_LINEAR_____119_CM 1 0. -120. 240. DISPLAY_IDENTIFIER EOI_POST1_PWR_ON_TU ECU_ADDRESS 0x7fa244 BYTE_ORDER MSB_LAST FORMAT "%5.2" /end MEASUREMENT
/begin MEASUREMENT t_dcha_post1_tu "tuned value of discharging time of injection POST1" UBYTE _CNV_A_R_LINEAR_____223_CM 1 0. 0. 0.31 DISPLAY_IDENTIFIER T_DCHA_POST1_TU ECU_ADDRESS 0x7fbbc0 FORMAT "%3.2" /end MEASUREMENT
/begin MEASUREMENT t_hld_toze_post1_tu "tuned value of hold time of pulse TO ZERO POST1" UWORD _CNV_A_R_LINEAR_____211_CM 1 0. 0. 32.767 DISPLAY_IDENTIFIER T_HLD_TOZE_POST1_TU ECU_ADDRESS 0x7fa246 BYTE_ORDER MSB_LAST FORMAT "%5.3" /end MEASUREMENT
/begin MEASUREMENT t_dcha_toze_post1_tu "tuned value of discharging time of pulse TO ZERO POST1" UBYTE _CNV_A_R_LINEAR_____223_CM 1 0. 0. 0.31 DISPLAY_IDENTIFIER T_DCHA_TOZE_POST1_TU ECU_ADDRESS 0x7fbbc1 FORMAT "%3.2" /end MEASUREMENT
/begin MEASUREMENT sf_inj_state_tu.word "" UWORD _CNV_S_9_CONV_INJ_S_224_CM 1 0. 0. 8. DISPLAY_IDENTIFIER SF_INJ_STATE_TU ECU_ADDRESS 0x7fa248 BYTE_ORDER MSB_LAST /end MEASUREMENT
/begin MEASUREMENT sf_inj_state_tu.bf.unused "" UWORD _CNV_A_R_LINEAR_____0_CM 1 0. 0. 65535. DISPLAY_IDENTIFIER SF_INJ_STATE_TU_BF_UNUSED ECU_ADDRESS 0x7fa248 BYTE_ORDER MSB_LAST BIT_MASK 0xFFC00000 /end MEASUREMENT
/begin MEASUREMENT sf_inj_state_tu.bf.lv_inj_di "" UWORD _CNV_A_R_LINEAR_____0_CM 1 0. 0. 65535. DISPLAY_IDENTIFIER SF_INJ_STATE_TU_BF_LV_INJ_DI ECU_ADDRESS 0x7fa248 BYTE_ORDER MSB_LAST BIT_MASK 0x200000 /end MEASUREMENT
/begin MEASUREMENT sf_inj_state_tu.bf.lv_post1_inj_act "" UWORD _CNV_A_R_LINEAR_____0_CM 1 0. 0. 65535. DISPLAY_IDENTIFIER SF_INJ_STATE_TU_BF_LV_POST1_INJ_ACT ECU_ADDRESS 0x7fa248 BYTE_ORDER MSB_LAST BIT_MASK 0x100000 /end MEASUREMENT
/begin MEASUREMENT sf_inj_state_tu.bf.lv_main2_inj_act "" UWORD _CNV_A_R_LINEAR_____0_CM 1 0. 0. 65535. DISPLAY_IDENTIFIER SF_INJ_STATE_TU_BF_LV_MAIN2_INJ_ACT ECU_ADDRESS 0x7fa248 BYTE_ORDER MSB_LAST BIT_MASK 0x80000 /end MEASUREMENT
/begin MEASUREMENT sf_inj_state_tu.bf.lv_main1_inj_act "" UWORD _CNV_A_R_LINEAR_____0_CM 1 0. 0. 65535. DISPLAY_IDENTIFIER SF_INJ_STATE_TU_BF_LV_MAIN1_INJ_ACT ECU_ADDRESS 0x7fa248 BYTE_ORDER MSB_LAST BIT_MASK 0x40000 /end MEASUREMENT
/begin MEASUREMENT sf_inj_state_tu.bf.lv_prev2_inj_act "" UWORD _CNV_A_R_LINEAR_____0_CM 1 0. 0. 65535. DISPLAY_IDENTIFIER SF_INJ_STATE_TU_BF_LV_PREV2_INJ_ACT ECU_ADDRESS 0x7fa248 BYTE_ORDER MSB_LAST BIT_MASK 0x20000 /end MEASUREMENT
/begin MEASUREMENT sf_inj_state_tu.bf.lv_prev1_inj_act "" UWORD _CNV_A_R_LINEAR_____0_CM 1 0. 0. 65535. DISPLAY_IDENTIFIER SF_INJ_STATE_TU_BF_LV_PREV1_INJ_ACT ECU_ADDRESS 0x7fa248 BYTE_ORDER MSB_LAST BIT_MASK 0x10000 /end MEASUREMENT
/begin MEASUREMENT sf_pls_state_tu "tuned value of pulse activation status word" UWORD _CNV_A_R_LINEAR_____0_CM 1 0. 0. 65535. DISPLAY_IDENTIFIER SF_PLS_STATE_TU ECU_ADDRESS 0x7fa24c BYTE_ORDER MSB_LAST FORMAT "%5.0" /end MEASUREMENT
/begin MEASUREMENT nr_inj_seg_tu "tuned value of number of enabled injections" UBYTE _CNV_A_R_LINEAR_____0_CM 1 0. 0. 255. DISPLAY_IDENTIFIER NR_INJ_SEG_TU ECU_ADDRESS 0x7fbbc2 FORMAT "%3.0" /end MEASUREMENT
/begin MEASUREMENT ti_prev1 "injection time of injection PREV1" UWORD _CNV_A_R_LINEAR_____211_CM 1 0. 0. 32.767 DISPLAY_IDENTIFIER TI_PREV1 ECU_ADDRESS 0x7fa256 BYTE_ORDER MSB_LAST FORMAT "%5.3" /end MEASUREMENT
/begin MEASUREMENT ti_main1 "injection time of injection MAIN1" UWORD _CNV_A_R_LINEAR_____211_CM 1 0. 0. 32.767 DISPLAY_IDENTIFIER TI_MAIN1 ECU_ADDRESS 0x7fa258 BYTE_ORDER MSB_LAST FORMAT "%5.3" /end MEASUREMENT
/begin MEASUREMENT ti_post1 "injection time of injection POST1" UWORD _CNV_A_R_LINEAR_____211_CM 1 0. 0. 32.767 DISPLAY_IDENTIFIER TI_POST1 ECU_ADDRESS 0x7fa25a BYTE_ORDER MSB_LAST FORMAT "%5.3" /end MEASUREMENT
/begin MEASUREMENT ti_prev1_tu "tuned injection time of injection PREV1" UWORD _CNV_A_R_LINEAR_____211_CM 1 0. 0. 32.767 DISPLAY_IDENTIFIER TI_PREV1_TU ECU_ADDRESS 0x7fa25c BYTE_ORDER MSB_LAST FORMAT "%5.3" /end MEASUREMENT
/begin MEASUREMENT ti_main1_tu "tuned injection time of injection MAIN1" UWORD _CNV_A_R_LINEAR_____211_CM 1 0. 0. 32.767 DISPLAY_IDENTIFIER TI_MAIN1_TU ECU_ADDRESS 0x7fa25e BYTE_ORDER MSB_LAST FORMAT "%5.3" /end MEASUREMENT
/begin MEASUREMENT ti_post1_tu "tuned injection time of injection POST1" UWORD _CNV_A_R_LINEAR_____211_CM 1 0. 0. 32.767 DISPLAY_IDENTIFIER TI_POST1_TU ECU_ADDRESS 0x7fa260 BYTE_ORDER MSB_LAST FORMAT "%5.3" /end MEASUREMENT
/begin MEASUREMENT lv_t_cha_prev1_vld "charging time of injection PREV1 is long enough for a real injection" UBYTE _CNV_S_2_RANGE______11_CM 1 0. 0. 1. DISPLAY_IDENTIFIER LV_T_CHA_PREV1_VLD ECU_ADDRESS 0x7fbbc5 /end MEASUREMENT
/begin MEASUREMENT lv_t_cha_main1_vld "charging time of injection MAIN1 is long enough for a real injection" UBYTE _CNV_S_2_RANGE______11_CM 1 0. 0. 1. DISPLAY_IDENTIFIER LV_T_CHA_MAIN1_VLD ECU_ADDRESS 0x7fbbc6 /end MEASUREMENT
/begin MEASUREMENT lv_t_cha_post1_vld "charging time of injection POST1 is long enough for a real injection" UBYTE _CNV_S_2_RANGE______11_CM 1 0. 0. 1. DISPLAY_IDENTIFIER LV_T_CHA_POST1_VLD ECU_ADDRESS 0x7fbbc7 /end MEASUREMENT
/begin MEASUREMENT lv_t_cha_tot_vld "charging time of the first injection (PREV1 or MAIN1if available) is long enough for a real injection" UBYTE _CNV_S_2_RANGE______11_CM 1 0. 0. 1. DISPLAY_IDENTIFIER LV_T_CHA_TOT_VLD ECU_ADDRESS 0x7fbbc8 /end MEASUREMENT
/begin MEASUREMENT sf_t_cha_tot_vld_hys "LV_T_CHA_TOT_VLD smoothed using some kind of hysteresis (cylinder individual)" UWORD _CNV_A_R_LINEAR_____0_CM 1 0. 0. 65535. DISPLAY_IDENTIFIER SF_T_CHA_TOT_VLD_HYS ECU_ADDRESS 0x7fa262 BYTE_ORDER MSB_LAST FORMAT "%5.0" /end MEASUREMENT
/begin MEASUREMENT t_cha_seq1 "charging time of the first injection of sequence 1 (i.e. PREV1 or MAIN1)" UBYTE _CNV_A_R_LINEAR_____223_CM 1 0. 0. 0.31 DISPLAY_IDENTIFIER T_CHA_SEQ1 ECU_ADDRESS 0x7fbbc4 FORMAT "%3.2" /end MEASUREMENT
/begin MEASUREMENT doi_prev1_pwr_on_tu "tuned power-on value of duration of injection PREV1" UWORD _CNV_A_R_LINEAR_____119_CM 1 0. 0. 360. DISPLAY_IDENTIFIER DOI_PREV1_PWR_ON_TU ECU_ADDRESS 0x7fa264 BYTE_ORDER MSB_LAST FORMAT "%5.2" /end MEASUREMENT
/begin MEASUREMENT doi_main1_pwr_on_tu "tuned power-on value of duration of injection MAIN1" UWORD _CNV_A_R_LINEAR_____119_CM 1 0. 0. 360. DISPLAY_IDENTIFIER DOI_MAIN1_PWR_ON_TU ECU_ADDRESS 0x7fa266 BYTE_ORDER MSB_LAST FORMAT "%5.2" /end MEASUREMENT
/begin MEASUREMENT doi_post1_pwr_on_tu "tuned power-on value of duration of injection POST1" UWORD _CNV_A_R_LINEAR_____119_CM 1 0. 0. 360. DISPLAY_IDENTIFIER DOI_POST1_PWR_ON_TU ECU_ADDRESS 0x7fa268 BYTE_ORDER MSB_LAST FORMAT "%5.2" /end MEASUREMENT
/begin CHARACTERISTIC lc_tun_pui_man "button for setting manual values for all output variables of the injection timing" VALUE 0x850176 _REC_VAL_20_u1 1. _CNV_A_R_LINEAR_____0_CM 0. 1. DISPLAY_IDENTIFIER LC_TUN_PUI_MAN FORMAT "%1.0" /end CHARACTERISTIC
/begin CHARACTERISTIC c_soi_frze_prev1_man "manual value for start of pulse FROM ZERO PREV1" VALUE 0x84fef6 _REC_VAL_20_s2 360. _CNV_A_R_LINEAR_____119_CM -120. 240. DISPLAY_IDENTIFIER C_SOI_FRZE_PREV1_MAN FORMAT "%5.2" /end CHARACTERISTIC
/begin CHARACTERISTIC c_t_cha_frze_prev1_man "manual value for charge time of pulse FROM ZERO PREV1" VALUE 0x84ff36 _REC_VAL_20_u2 32.767 _CNV_A_R_LINEAR_____211_CM 0. 32.767 DISPLAY_IDENTIFIER C_T_CHA_FRZE_PREV1_MAN FORMAT "%5.3" /end CHARACTERISTIC
/begin CHARACTERISTIC c_soi_prev1_man "manual value for start of injection PREV1" VALUE 0x84fefc _REC_VAL_20_s2 360. _CNV_A_R_LINEAR_____119_CM -120. 240. DISPLAY_IDENTIFIER C_SOI_PREV1_MAN FORMAT "%5.2" /end CHARACTERISTIC
/begin CHARACTERISTIC c_t_cha_prev1_man "manual value for charge time of injection PREV1" VALUE 0x84ff3e _REC_VAL_20_u2 32.767 _CNV_A_R_LINEAR_____211_CM 0. 32.767 DISPLAY_IDENTIFIER C_T_CHA_PREV1_MAN FORMAT "%5.3" /end CHARACTERISTIC
/begin CHARACTERISTIC c_eoi_prev1_man "manual value for end of injection PREV1" VALUE 0x84fcf0 _REC_VAL_20_s2 360. _CNV_A_R_LINEAR_____119_CM -120. 240. DISPLAY_IDENTIFIER C_EOI_PREV1_MAN FORMAT "%5.2" /end CHARACTERISTIC
/begin CHARACTERISTIC c_t_dcha_prev1_man "manual value for discharge time of injection PREV1" VALUE 0x84ff50 _REC_VAL_20_u2 32.767 _CNV_A_R_LINEAR_____211_CM 0. 32.767 DISPLAY_IDENTIFIER C_T_DCHA_PREV1_MAN FORMAT "%5.3" /end CHARACTERISTIC
/begin CHARACTERISTIC c_t_hld_toze_prev1_man "manual value for hold time of pulse TO ZERO PREV1" VALUE 0x84ff98 _REC_VAL_20_u2 32.767 _CNV_A_R_LINEAR_____211_CM 0. 32.767 DISPLAY_IDENTIFIER C_T_HLD_TOZE_PREV1_MAN FORMAT "%5.3" /end CHARACTERISTIC
/begin CHARACTERISTIC c_t_dcha_toze_prev1_man "manual value for discharge time of pulse TO ZERO PREV1" VALUE 0x84ff58 _REC_VAL_20_u2 32.767 _CNV_A_R_LINEAR_____211_CM 0. 32.767 DISPLAY_IDENTIFIER C_T_DCHA_TOZE_PREV1_MAN FORMAT "%5.3" /end CHARACTERISTIC
/begin CHARACTERISTIC c_doi_prev1_man "manual value for duration o finjection of pulse PREV1" VALUE 0x84fc92 _REC_VAL_20_u2 360. _CNV_A_R_LINEAR_____119_CM 0. 360. DISPLAY_IDENTIFIER C_DOI_PREV1_MAN FORMAT "%5.2" /end CHARACTERISTIC
/begin CHARACTERISTIC c_soi_frze_main1_man "manual value for start of pulse FROM ZERO MAIN1" VALUE 0x84fef2 _REC_VAL_20_s2 360. _CNV_A_R_LINEAR_____119_CM -120. 240. DISPLAY_IDENTIFIER C_SOI_FRZE_MAIN1_MAN FORMAT "%5.2" /end CHARACTERISTIC
/begin CHARACTERISTIC c_t_cha_frze_main1_man "manual value for charge time of pulse FROM ZERO MAIN1" VALUE 0x84ff30 _REC_VAL_20_u2 32.767 _CNV_A_R_LINEAR_____211_CM 0. 32.767 DISPLAY_IDENTIFIER C_T_CHA_FRZE_MAIN1_MAN FORMAT "%5.3" /end CHARACTERISTIC
/begin CHARACTERISTIC c_soi_main1_man "manual value for start of injection MAIN1" VALUE 0x84fef8 _REC_VAL_20_s2 360. _CNV_A_R_LINEAR_____119_CM -120. 240. DISPLAY_IDENTIFIER C_SOI_MAIN1_MAN FORMAT "%5.2" /end CHARACTERISTIC
/begin CHARACTERISTIC c_t_cha_main1_man "manual value for charge time of injection MAIN1" VALUE 0x84ff38 _REC_VAL_20_u2 32.767 _CNV_A_R_LINEAR_____211_CM 0. 32.767 DISPLAY_IDENTIFIER C_T_CHA_MAIN1_MAN FORMAT "%5.3" /end CHARACTERISTIC
/begin CHARACTERISTIC c_eoi_main1_man "manual value for end of injection MAIN1" VALUE 0x84fcec _REC_VAL_20_s2 360. _CNV_A_R_LINEAR_____119_CM -120. 240. DISPLAY_IDENTIFIER C_EOI_MAIN1_MAN FORMAT "%5.2" /end CHARACTERISTIC
/begin CHARACTERISTIC c_t_dcha_main1_man "manual value for discharge time of injection MAIN1" VALUE 0x84ff4c _REC_VAL_20_u2 32.767 _CNV_A_R_LINEAR_____211_CM 0. 32.767 DISPLAY_IDENTIFIER C_T_DCHA_MAIN1_MAN FORMAT "%5.3" /end CHARACTERISTIC
/begin CHARACTERISTIC c_t_hld_toze_main1_man "manual value for hold time of pulse TO ZERO MAIN1" VALUE 0x84ff90 _REC_VAL_20_u2 32.767 _CNV_A_R_LINEAR_____211_CM 0. 32.767 DISPLAY_IDENTIFIER C_T_HLD_TOZE_MAIN1_MAN FORMAT "%5.3" /end CHARACTERISTIC
/begin CHARACTERISTIC c_t_dcha_toze_main1_man "manual value for discharge time of pulse TO ZERO MAIN1" VALUE 0x84ff54 _REC_VAL_20_u2 32.767 _CNV_A_R_LINEAR_____211_CM 0. 32.767 DISPLAY_IDENTIFIER C_T_DCHA_TOZE_MAIN1_MAN FORMAT "%5.3" /end CHARACTERISTIC
/begin CHARACTERISTIC c_doi_main1_man "manual value for duration o finjection of pulse MAIN1" VALUE 0x84fc7e _REC_VAL_20_u2 360. _CNV_A_R_LINEAR_____119_CM 0. 360. DISPLAY_IDENTIFIER C_DOI_MAIN1_MAN FORMAT "%5.2" /end CHARACTERISTIC
/begin CHARACTERISTIC c_soi_frze_post1_man "manual value for start of pulse FROM ZERO POST1" VALUE 0x84fef4 _REC_VAL_20_s2 360. _CNV_A_R_LINEAR_____119_CM -120. 240. DISPLAY_IDENTIFIER C_SOI_FRZE_POST1_MAN FORMAT "%5.2" /end CHARACTERISTIC
/begin CHARACTERISTIC c_t_cha_frze_post1_man "manual value for charge time of pulse FROM ZERO POST1" VALUE 0x84ff34 _REC_VAL_20_u2 32.767 _CNV_A_R_LINEAR_____211_CM 0. 32.767 DISPLAY_IDENTIFIER C_T_CHA_FRZE_POST1_MAN FORMAT "%5.3" /end CHARACTERISTIC
/begin CHARACTERISTIC c_soi_post1_man "manual value for start of injection POST1" VALUE 0x84fefa _REC_VAL_20_s2 360. _CNV_A_R_LINEAR_____119_CM -120. 240. DISPLAY_IDENTIFIER C_SOI_POST1_MAN FORMAT "%5.2" /end CHARACTERISTIC
/begin CHARACTERISTIC c_t_cha_post1_man "manual value for charge time of injection POST1" VALUE 0x84ff3c _REC_VAL_20_u2 32.767 _CNV_A_R_LINEAR_____211_CM 0. 32.767 DISPLAY_IDENTIFIER C_T_CHA_POST1_MAN FORMAT "%5.3" /end CHARACTERISTIC
/begin CHARACTERISTIC c_eoi_post1_man "manual value for end of injection POST1" VALUE 0x84fcee _REC_VAL_20_s2 360. _CNV_A_R_LINEAR_____119_CM -120. 240. DISPLAY_IDENTIFIER C_EOI_POST1_MAN FORMAT "%5.2" /end CHARACTERISTIC
/begin CHARACTERISTIC c_t_dcha_post1_man "manual value for discharge time of injection POST1" VALUE 0x84ff4e _REC_VAL_20_u2 32.767 _CNV_A_R_LINEAR_____211_CM 0. 32.767 DISPLAY_IDENTIFIER C_T_DCHA_POST1_MAN FORMAT "%5.3" /end CHARACTERISTIC
/begin CHARACTERISTIC c_t_hld_toze_post1_man "manual value for hold time of pulse TO ZERO POST1" VALUE 0x84ff94 _REC_VAL_20_u2 32.767 _CNV_A_R_LINEAR_____211_CM 0. 32.767 DISPLAY_IDENTIFIER C_T_HLD_TOZE_POST1_MAN FORMAT "%5.3" /end CHARACTERISTIC
/begin CHARACTERISTIC c_t_dcha_toze_post1_man "manual value for discharge time of pulse TO ZERO POST1" VALUE 0x84ff56 _REC_VAL_20_u2 32.767 _CNV_A_R_LINEAR_____211_CM 0. 32.767 DISPLAY_IDENTIFIER C_T_DCHA_TOZE_POST1_MAN FORMAT "%5.3" /end CHARACTERISTIC
/begin CHARACTERISTIC c_doi_post1_man "manual value for duration o finjection of pulse POST1" VALUE 0x84fc88 _REC_VAL_20_u2 360. _CNV_A_R_LINEAR_____119_CM 0. 360. DISPLAY_IDENTIFIER C_DOI_POST1_MAN FORMAT "%5.2" /end CHARACTERISTIC
/begin CHARACTERISTIC c_sf_pls_state_man "manual value for pulse activation status word" VALUE 0x84fef0 _REC_VAL_20_u2 65535. _CNV_A_R_LINEAR_____0_CM 0. 65535. DISPLAY_IDENTIFIER C_SF_PLS_STATE_MAN FORMAT "%5.0" /end CHARACTERISTIC
/begin CHARACTERISTIC c_t_cha_tot_min "minimal total charge time for an injection" VALUE 0x84ff42 _REC_VAL_20_u2 32.767 _CNV_A_R_LINEAR_____211_CM 0. 32.767 DISPLAY_IDENTIFIER C_T_CHA_TOT_MIN FORMAT "%5.3" /end CHARACTERISTIC
/begin CHARACTERISTIC c_ctr_t_cha_tot_vld_hys_on "switch on value of the hysteresis counter for LV_T_CHA_TOT_VLD" VALUE 0x84fc06 _REC_VAL_20_u1 255. _CNV_A_R_LINEAR_____0_CM 0. 255. DISPLAY_IDENTIFIER C_CTR_T_CHA_TOT_VLD_HYS_ON FORMAT "%3.0" /end CHARACTERISTIC
/begin MEASUREMENT mf_prev1_tu "" UWORD _CNV_A_R_LINEAR_____38_CM 1 0. 0. 262.14 DISPLAY_IDENTIFIER MF_PREV1_TU ECU_ADDRESS 0x7f9d92 BYTE_ORDER MSB_LAST FORMAT "%4.1" /end MEASUREMENT
/begin MEASUREMENT mf_prev2_tu "" UWORD _CNV_A_R_LINEAR_____38_CM 1 0. 0. 262.14 DISPLAY_IDENTIFIER MF_PREV2_TU ECU_ADDRESS 0x7f9d94 BYTE_ORDER MSB_LAST FORMAT "%4.1" /end MEASUREMENT
/begin MEASUREMENT mf_main1_tu "" UWORD _CNV_A_R_LINEAR_____38_CM 1 0. 0. 262.14 DISPLAY_IDENTIFIER MF_MAIN1_TU ECU_ADDRESS 0x7f9d96 BYTE_ORDER MSB_LAST FORMAT "%4.1" /end MEASUREMENT
/begin MEASUREMENT mf_main2_tu "" UWORD _CNV_A_R_LINEAR_____38_CM 1 0. 0. 262.14 DISPLAY_IDENTIFIER MF_MAIN2_TU ECU_ADDRESS 0x7f9d98 BYTE_ORDER MSB_LAST FORMAT "%4.1" /end MEASUREMENT
/begin MEASUREMENT mf_post1_tu "" UWORD _CNV_A_R_LINEAR_____38_CM 1 0. 0. 262.14 DISPLAY_IDENTIFIER MF_POST1_TU ECU_ADDRESS 0x7f9d9a BYTE_ORDER MSB_LAST FORMAT "%4.1" /end MEASUREMENT
/begin MEASUREMENT mf_post2_tu "" UWORD _CNV_A_R_LINEAR_____38_CM 1 0. 0. 262.14 DISPLAY_IDENTIFIER MF_POST2_TU ECU_ADDRESS 0x7f9d9c BYTE_ORDER MSB_LAST FORMAT "%4.1" /end MEASUREMENT
/begin MEASUREMENT mf_inj_sum "" UWORD _CNV_A_R_LINEAR_____38_CM 1 0. 0. 262.14 DISPLAY_IDENTIFIER MF_INJ_SUM ECU_ADDRESS 0x7f9d9e BYTE_ORDER MSB_LAST FORMAT "%4.1" /end MEASUREMENT
/begin CHARACTERISTIC lc_mf_prev1_tu_on "" VALUE 0x85ce92 _REC_VAL_20_u1 1. _CNV_A_R_LINEAR_____0_CM 0. 1. DISPLAY_IDENTIFIER LC_MF_PREV1_TU_ON FORMAT "%1.0" /end CHARACTERISTIC
/begin CHARACTERISTIC lc_mf_prev2_tu_on "" VALUE 0x85ce93 _REC_VAL_20_u1 1. _CNV_A_R_LINEAR_____0_CM 0. 1. DISPLAY_IDENTIFIER LC_MF_PREV2_TU_ON FORMAT "%1.0" /end CHARACTERISTIC
/begin CHARACTERISTIC lc_mf_main1_tu_on "" VALUE 0x85ce8e _REC_VAL_20_u1 1. _CNV_A_R_LINEAR_____0_CM 0. 1. DISPLAY_IDENTIFIER LC_MF_MAIN1_TU_ON FORMAT "%1.0" /end CHARACTERISTIC
/begin CHARACTERISTIC lc_mf_main2_tu_on "" VALUE 0x85ce8f _REC_VAL_20_u1 1. _CNV_A_R_LINEAR_____0_CM 0. 1. DISPLAY_IDENTIFIER LC_MF_MAIN2_TU_ON FORMAT "%1.0" /end CHARACTERISTIC
/begin CHARACTERISTIC lc_mf_post2_tu_on "" VALUE 0x85ce91 _REC_VAL_20_u1 1. _CNV_A_R_LINEAR_____0_CM 0. 1. DISPLAY_IDENTIFIER LC_MF_POST2_TU_ON FORMAT "%1.0" /end CHARACTERISTIC
/begin CHARACTERISTIC lc_mf_post1_tu_on "" VALUE 0x85ce90 _REC_VAL_20_u1 1. _CNV_A_R_LINEAR_____0_CM 0. 1. DISPLAY_IDENTIFIER LC_MF_POST1_TU_ON FORMAT "%1.0" /end CHARACTERISTIC
/begin CHARACTERISTIC c_mf_main1_add_tu "" VALUE 0x8501ae _REC_VAL_20_s2 262.14 _CNV_A_R_LINEAR_____38_CM -131.072 131.068 DISPLAY_IDENTIFIER C_MF_MAIN1_ADD_TU FORMAT "%6.2" /end CHARACTERISTIC
/begin CHARACTERISTIC c_mf_main2_add_tu "" VALUE 0x8501b0 _REC_VAL_20_s2 262.14 _CNV_A_R_LINEAR_____38_CM -131.072 131.068 DISPLAY_IDENTIFIER C_MF_MAIN2_ADD_TU FORMAT "%6.2" /end CHARACTERISTIC
/begin CHARACTERISTIC c_fac_mf_prev1_tu "Tuning PREV1" VALUE 0x8501d6 _REC_VAL_20_u2 1.9999696 _CNV_A_R_LINEAR_____48_CM 0. 1.9999696 DISPLAY_IDENTIFIER C_FAC_MF_PREV1_TU FORMAT "%5.4" /end CHARACTERISTIC
/begin CHARACTERISTIC c_fac_mf_prev2_tu "" VALUE 0x8501fa _REC_VAL_20_u2 1.9999696 _CNV_A_R_LINEAR_____48_CM 0. 1.9999696 DISPLAY_IDENTIFIER C_FAC_MF_PREV2_TU FORMAT "%5.4" /end CHARACTERISTIC
/begin CHARACTERISTIC c_mf_post1_add_tu "" VALUE 0x850214 _REC_VAL_20_s2 262.14 _CNV_A_R_LINEAR_____38_CM -131.072 131.068 DISPLAY_IDENTIFIER C_MF_POST1_ADD_TU FORMAT "%6.2" /end CHARACTERISTIC
/begin CHARACTERISTIC c_mf_post2_add_tu "" VALUE 0x850200 _REC_VAL_20_s2 262.14 _CNV_A_R_LINEAR_____38_CM -131.072 131.068 DISPLAY_IDENTIFIER C_MF_POST2_ADD_TU FORMAT "%6.2" /end CHARACTERISTIC
/begin CHARACTERISTIC c_mf_main1_test_add_tu[0] "" VALUE 0x8501b2 _REC_VAL_20_s2 262.14 _CNV_A_R_LINEAR_____38_CM -131.072 131.068 DISPLAY_IDENTIFIER C_MF_MAIN1_TEST_ADD_TU_0_ FORMAT "%6.2" /end CHARACTERISTIC
/begin CHARACTERISTIC c_mf_main1_test_add_tu[1] "" VALUE 0x8501b4 _REC_VAL_20_s2 262.14 _CNV_A_R_LINEAR_____38_CM -131.072 131.068 DISPLAY_IDENTIFIER C_MF_MAIN1_TEST_ADD_TU_1_ FORMAT "%6.2" /end CHARACTERISTIC
/begin CHARACTERISTIC c_mf_main1_test_add_tu[2] "" VALUE 0x8501b6 _REC_VAL_20_s2 262.14 _CNV_A_R_LINEAR_____38_CM -131.072 131.068 DISPLAY_IDENTIFIER C_MF_MAIN1_TEST_ADD_TU_2_ FORMAT "%6.2" /end CHARACTERISTIC
/begin CHARACTERISTIC c_mf_main1_test_add_tu[3] "" VALUE 0x8501b8 _REC_VAL_20_s2 262.14 _CNV_A_R_LINEAR_____38_CM -131.072 131.068 DISPLAY_IDENTIFIER C_MF_MAIN1_TEST_ADD_TU_3_ FORMAT "%6.2" /end CHARACTERISTIC
/begin CHARACTERISTIC c_mf_main2_test_add_tu[0] "" VALUE 0x8501ba _REC_VAL_20_s2 262.14 _CNV_A_R_LINEAR_____38_CM -131.072 131.068 DISPLAY_IDENTIFIER C_MF_MAIN2_TEST_ADD_TU_0_ FORMAT "%6.2" /end CHARACTERISTIC
/begin CHARACTERISTIC c_mf_main2_test_add_tu[1] "" VALUE 0x8501bc _REC_VAL_20_s2 262.14 _CNV_A_R_LINEAR_____38_CM -131.072 131.068 DISPLAY_IDENTIFIER C_MF_MAIN2_TEST_ADD_TU_1_ FORMAT "%6.2" /end CHARACTERISTIC
/begin CHARACTERISTIC c_mf_main2_test_add_tu[2] "" VALUE 0x8501be _REC_VAL_20_s2 262.14 _CNV_A_R_LINEAR_____38_CM -131.072 131.068 DISPLAY_IDENTIFIER C_MF_MAIN2_TEST_ADD_TU_2_ FORMAT "%6.2" /end CHARACTERISTIC
/begin CHARACTERISTIC c_mf_main2_test_add_tu[3] "" VALUE 0x8501c0 _REC_VAL_20_s2 262.14 _CNV_A_R_LINEAR_____38_CM -131.072 131.068 DISPLAY_IDENTIFIER C_MF_MAIN2_TEST_ADD_TU_3_ FORMAT "%6.2" /end CHARACTERISTIC
/begin CHARACTERISTIC c_mf_prev1_test_add_tu[0] "" VALUE 0x8501c4 _REC_VAL_20_s2 262.14 _CNV_A_R_LINEAR_____38_CM -131.072 131.068 DISPLAY_IDENTIFIER C_MF_PREV1_TEST_ADD_TU_0_ FORMAT "%6.2" /end CHARACTERISTIC
/begin CHARACTERISTIC c_mf_prev1_test_add_tu[1] "" VALUE 0x8501c6 _REC_VAL_20_s2 262.14 _CNV_A_R_LINEAR_____38_CM -131.072 131.068 DISPLAY_IDENTIFIER C_MF_PREV1_TEST_ADD_TU_1_ FORMAT "%6.2" /end CHARACTERISTIC
/begin CHARACTERISTIC c_mf_prev1_test_add_tu[2] "" VALUE 0x8501c8 _REC_VAL_20_s2 262.14 _CNV_A_R_LINEAR_____38_CM -131.072 131.068 DISPLAY_IDENTIFIER C_MF_PREV1_TEST_ADD_TU_2_ FORMAT "%6.2" /end CHARACTERISTIC
/begin CHARACTERISTIC c_mf_prev1_test_add_tu[3] "" VALUE 0x8501ca _REC_VAL_20_s2 262.14 _CNV_A_R_LINEAR_____38_CM -131.072 131.068 DISPLAY_IDENTIFIER C_MF_PREV1_TEST_ADD_TU_3_ FORMAT "%6.2" /end CHARACTERISTIC
/begin CHARACTERISTIC c_mf_prev2_test_add_tu[0] "" VALUE 0x8501ce _REC_VAL_20_s2 262.14 _CNV_A_R_LINEAR_____38_CM -131.072 131.068 DISPLAY_IDENTIFIER C_MF_PREV2_TEST_ADD_TU_0_ FORMAT "%6.2" /end CHARACTERISTIC
/begin CHARACTERISTIC c_mf_prev2_test_add_tu[1] "" VALUE 0x8501d0 _REC_VAL_20_s2 262.14 _CNV_A_R_LINEAR_____38_CM -131.072 131.068 DISPLAY_IDENTIFIER C_MF_PREV2_TEST_ADD_TU_1_ FORMAT "%6.2" /end CHARACTERISTIC
/begin CHARACTERISTIC c_mf_prev2_test_add_tu[2] "" VALUE 0x8501d2 _REC_VAL_20_s2 262.14 _CNV_A_R_LINEAR_____38_CM -131.072 131.068 DISPLAY_IDENTIFIER C_MF_PREV2_TEST_ADD_TU_2_ FORMAT "%6.2" /end CHARACTERISTIC
/begin CHARACTERISTIC c_mf_prev2_test_add_tu[3] "" VALUE 0x8501d4 _REC_VAL_20_s2 262.14 _CNV_A_R_LINEAR_____38_CM -131.072 131.068 DISPLAY_IDENTIFIER C_MF_PREV2_TEST_ADD_TU_3_ FORMAT "%6.2" /end CHARACTERISTIC
/begin CHARACTERISTIC c_mf_post2_test_add_tu[0] "" VALUE 0x85020a _REC_VAL_20_s2 262.14 _CNV_A_R_LINEAR_____38_CM -131.072 131.068 DISPLAY_IDENTIFIER C_MF_POST2_TEST_ADD_TU_0_ FORMAT "%6.2" /end CHARACTERISTIC
/begin CHARACTERISTIC c_mf_post2_test_add_tu[1] "" VALUE 0x85020c _REC_VAL_20_s2 262.14 _CNV_A_R_LINEAR_____38_CM -131.072 131.068 DISPLAY_IDENTIFIER C_MF_POST2_TEST_ADD_TU_1_ FORMAT "%6.2" /end CHARACTERISTIC
/begin CHARACTERISTIC c_mf_post2_test_add_tu[2] "" VALUE 0x85020e _REC_VAL_20_s2 262.14 _CNV_A_R_LINEAR_____38_CM -131.072 131.068 DISPLAY_IDENTIFIER C_MF_POST2_TEST_ADD_TU_2_ FORMAT "%6.2" /end CHARACTERISTIC
/begin CHARACTERISTIC c_mf_post2_test_add_tu[3] "" VALUE 0x850210 _REC_VAL_20_s2 262.14 _CNV_A_R_LINEAR_____38_CM -131.072 131.068 DISPLAY_IDENTIFIER C_MF_POST2_TEST_ADD_TU_3_ FORMAT "%6.2" /end CHARACTERISTIC
/begin CHARACTERISTIC c_mf_post1_test_add_tu[0] "" VALUE 0x850216 _REC_VAL_20_s2 262.14 _CNV_A_R_LINEAR_____38_CM -131.072 131.068 DISPLAY_IDENTIFIER C_MF_POST1_TEST_ADD_TU_0_ FORMAT "%6.2" /end CHARACTERISTIC
/begin CHARACTERISTIC c_mf_post1_test_add_tu[1] "" VALUE 0x850218 _REC_VAL_20_s2 262.14 _CNV_A_R_LINEAR_____38_CM -131.072 131.068 DISPLAY_IDENTIFIER C_MF_POST1_TEST_ADD_TU_1_ FORMAT "%6.2" /end CHARACTERISTIC
/begin CHARACTERISTIC c_mf_post1_test_add_tu[2] "" VALUE 0x85021a _REC_VAL_20_s2 262.14 _CNV_A_R_LINEAR_____38_CM -131.072 131.068 DISPLAY_IDENTIFIER C_MF_POST1_TEST_ADD_TU_2_ FORMAT "%6.2" /end CHARACTERISTIC
/begin CHARACTERISTIC c_mf_post1_test_add_tu[3] "" VALUE 0x85021c _REC_VAL_20_s2 262.14 _CNV_A_R_LINEAR_____38_CM -131.072 131.068 DISPLAY_IDENTIFIER C_MF_POST1_TEST_ADD_TU_3_ FORMAT "%6.2" /end CHARACTERISTIC
/begin CHARACTERISTIC c_mf_main1_add_tu_cyl[0] "" VALUE 0x8501da _REC_VAL_20_s2 262.14 _CNV_A_R_LINEAR_____38_CM -131.072 131.068 DISPLAY_IDENTIFIER C_MF_MAIN1_ADD_TU_CYL_0_ FORMAT "%6.2" /end CHARACTERISTIC
/begin CHARACTERISTIC c_mf_main1_add_tu_cyl[1] "" VALUE 0x8501dc _REC_VAL_20_s2 262.14 _CNV_A_R_LINEAR_____38_CM -131.072 131.068 DISPLAY_IDENTIFIER C_MF_MAIN1_ADD_TU_CYL_1_ FORMAT "%6.2" /end CHARACTERISTIC
/begin CHARACTERISTIC c_mf_main1_add_tu_cyl[2] "" VALUE 0x8501de _REC_VAL_20_s2 262.14 _CNV_A_R_LINEAR_____38_CM -131.072 131.068 DISPLAY_IDENTIFIER C_MF_MAIN1_ADD_TU_CYL_2_ FORMAT "%6.2" /end CHARACTERISTIC
/begin CHARACTERISTIC c_mf_main1_add_tu_cyl[3] "" VALUE 0x8501e0 _REC_VAL_20_s2 262.14 _CNV_A_R_LINEAR_____38_CM -131.072 131.068 DISPLAY_IDENTIFIER C_MF_MAIN1_ADD_TU_CYL_3_ FORMAT "%6.2" /end CHARACTERISTIC
/begin CHARACTERISTIC c_mf_main2_add_tu_cyl[0] "" VALUE 0x8501e2 _REC_VAL_20_s2 262.14 _CNV_A_R_LINEAR_____38_CM -131.072 131.068 DISPLAY_IDENTIFIER C_MF_MAIN2_ADD_TU_CYL_0_ FORMAT "%6.2" /end CHARACTERISTIC
/begin CHARACTERISTIC c_mf_main2_add_tu_cyl[1] "" VALUE 0x8501e4 _REC_VAL_20_s2 262.14 _CNV_A_R_LINEAR_____38_CM -131.072 131.068 DISPLAY_IDENTIFIER C_MF_MAIN2_ADD_TU_CYL_1_ FORMAT "%6.2" /end CHARACTERISTIC
/begin CHARACTERISTIC c_mf_main2_add_tu_cyl[2] "" VALUE 0x8501e6 _REC_VAL_20_s2 262.14 _CNV_A_R_LINEAR_____38_CM -131.072 131.068 DISPLAY_IDENTIFIER C_MF_MAIN2_ADD_TU_CYL_2_ FORMAT "%6.2" /end CHARACTERISTIC
/begin CHARACTERISTIC c_mf_main2_add_tu_cyl[3] "" VALUE 0x8501e8 _REC_VAL_20_s2 262.14 _CNV_A_R_LINEAR_____38_CM -131.072 131.068 DISPLAY_IDENTIFIER C_MF_MAIN2_ADD_TU_CYL_3_ FORMAT "%6.2" /end CHARACTERISTIC
/begin CHARACTERISTIC c_mf_prev1_add_tu_cyl[0] "" VALUE 0x8501ea _REC_VAL_20_s2 262.14 _CNV_A_R_LINEAR_____38_CM -131.072 131.068 DISPLAY_IDENTIFIER C_MF_PREV1_ADD_TU_CYL_0_ FORMAT "%6.2" /end CHARACTERISTIC
/begin CHARACTERISTIC c_mf_prev1_add_tu_cyl[1] "" VALUE 0x8501ec _REC_VAL_20_s2 262.14 _CNV_A_R_LINEAR_____38_CM -131.072 131.068 DISPLAY_IDENTIFIER C_MF_PREV1_ADD_TU_CYL_1_ FORMAT "%6.2" /end CHARACTERISTIC
/begin CHARACTERISTIC c_mf_prev1_add_tu_cyl[2] "" VALUE 0x8501ee _REC_VAL_20_s2 262.14 _CNV_A_R_LINEAR_____38_CM -131.072 131.068 DISPLAY_IDENTIFIER C_MF_PREV1_ADD_TU_CYL_2_ FORMAT "%6.2" /end CHARACTERISTIC
/begin CHARACTERISTIC c_mf_prev1_add_tu_cyl[3] "" VALUE 0x8501f0 _REC_VAL_20_s2 262.14 _CNV_A_R_LINEAR_____38_CM -131.072 131.068 DISPLAY_IDENTIFIER C_MF_PREV1_ADD_TU_CYL_3_ FORMAT "%6.2" /end CHARACTERISTIC
/begin CHARACTERISTIC c_mf_prev2_add_tu_cyl[0] "" VALUE 0x8501f2 _REC_VAL_20_s2 262.14 _CNV_A_R_LINEAR_____38_CM -131.072 131.068 DISPLAY_IDENTIFIER C_MF_PREV2_ADD_TU_CYL_0_ FORMAT "%6.2" /end CHARACTERISTIC
/begin CHARACTERISTIC c_mf_prev2_add_tu_cyl[1] "" VALUE 0x8501f4 _REC_VAL_20_s2 262.14 _CNV_A_R_LINEAR_____38_CM -131.072 131.068 DISPLAY_IDENTIFIER C_MF_PREV2_ADD_TU_CYL_1_ FORMAT "%6.2" /end CHARACTERISTIC
/begin CHARACTERISTIC c_mf_prev2_add_tu_cyl[2] "" VALUE 0x8501f6 _REC_VAL_20_s2 262.14 _CNV_A_R_LINEAR_____38_CM -131.072 131.068 DISPLAY_IDENTIFIER C_MF_PREV2_ADD_TU_CYL_2_ FORMAT "%6.2" /end CHARACTERISTIC
/begin CHARACTERISTIC c_mf_prev2_add_tu_cyl[3] "" VALUE 0x8501f8 _REC_VAL_20_s2 262.14 _CNV_A_R_LINEAR_____38_CM -131.072 131.068 DISPLAY_IDENTIFIER C_MF_PREV2_ADD_TU_CYL_3_ FORMAT "%6.2" /end CHARACTERISTIC
/begin CHARACTERISTIC c_mf_post1_add_tu_cyl[0] "" VALUE 0x850226 _REC_VAL_20_s2 262.14 _CNV_A_R_LINEAR_____38_CM -131.072 131.068 DISPLAY_IDENTIFIER C_MF_POST1_ADD_TU_CYL_0_ FORMAT "%6.2" /end CHARACTERISTIC
/begin CHARACTERISTIC c_mf_post1_add_tu_cyl[1] "" VALUE 0x850228 _REC_VAL_20_s2 262.14 _CNV_A_R_LINEAR_____38_CM -131.072 131.068 DISPLAY_IDENTIFIER C_MF_POST1_ADD_TU_CYL_1_ FORMAT "%6.2" /end CHARACTERISTIC
/begin CHARACTERISTIC c_mf_post1_add_tu_cyl[2] "" VALUE 0x85022a _REC_VAL_20_s2 262.14 _CNV_A_R_LINEAR_____38_CM -131.072 131.068 DISPLAY_IDENTIFIER C_MF_POST1_ADD_TU_CYL_2_ FORMAT "%6.2" /end CHARACTERISTIC
/begin CHARACTERISTIC c_mf_post1_add_tu_cyl[3] "" VALUE 0x85022c _REC_VAL_20_s2 262.14 _CNV_A_R_LINEAR_____38_CM -131.072 131.068 DISPLAY_IDENTIFIER C_MF_POST1_ADD_TU_CYL_3_ FORMAT "%6.2" /end CHARACTERISTIC
/begin CHARACTERISTIC c_mf_post2_add_tu_cyl[0] "" VALUE 0x850202 _REC_VAL_20_s2 262.14 _CNV_A_R_LINEAR_____38_CM -131.072 131.068 DISPLAY_IDENTIFIER C_MF_POST2_ADD_TU_CYL_0_ FORMAT "%6.2" /end CHARACTERISTIC
/begin CHARACTERISTIC c_mf_post2_add_tu_cyl[1] "" VALUE 0x850204 _REC_VAL_20_s2 262.14 _CNV_A_R_LINEAR_____38_CM -131.072 131.068 DISPLAY_IDENTIFIER C_MF_POST2_ADD_TU_CYL_1_ FORMAT "%6.2" /end CHARACTERISTIC
/begin CHARACTERISTIC c_mf_post2_add_tu_cyl[2] "" VALUE 0x850206 _REC_VAL_20_s2 262.14 _CNV_A_R_LINEAR_____38_CM -131.072 131.068 DISPLAY_IDENTIFIER C_MF_POST2_ADD_TU_CYL_2_ FORMAT "%6.2" /end CHARACTERISTIC
/begin CHARACTERISTIC c_mf_post2_add_tu_cyl[3] "" VALUE 0x850208 _REC_VAL_20_s2 262.14 _CNV_A_R_LINEAR_____38_CM -131.072 131.068 DISPLAY_IDENTIFIER C_MF_POST2_ADD_TU_CYL_3_ FORMAT "%6.2" /end CHARACTERISTIC
/begin CHARACTERISTIC c_fac_mf_main1_tu "" VALUE 0x8501d8 _REC_VAL_20_u2 1.9999696 _CNV_A_R_LINEAR_____48_CM 0. 1.9999696 DISPLAY_IDENTIFIER C_FAC_MF_MAIN1_TU FORMAT "%5.4" /end CHARACTERISTIC
/begin CHARACTERISTIC c_fac_mf_main2_tu "" VALUE 0x8501fc _REC_VAL_20_u2 1.9999696 _CNV_A_R_LINEAR_____48_CM 0. 1.9999696 DISPLAY_IDENTIFIER C_FAC_MF_MAIN2_TU FORMAT "%5.4" /end CHARACTERISTIC
/begin CHARACTERISTIC c_fac_mf_post1_tu "" VALUE 0x850212 _REC_VAL_20_u2 1.9999696 _CNV_A_R_LINEAR_____48_CM 0. 1.9999696 DISPLAY_IDENTIFIER C_FAC_MF_POST1_TU FORMAT "%5.4" /end CHARACTERISTIC
/begin CHARACTERISTIC c_fac_mf_post2_tu "" VALUE 0x8501fe _REC_VAL_20_u2 1.9999696 _CNV_A_R_LINEAR_____48_CM 0. 1.9999696 DISPLAY_IDENTIFIER C_FAC_MF_POST2_TU FORMAT "%5.4" /end CHARACTERISTIC
/begin CHARACTERISTIC ip_mf_main1_inj_test_ad "MF: Fuel Mass Tuning" MAP 0x856bcc _REC_MAP_20_u2_u2_u2 262.14 _CNV_A_R_LINEAR_____131_CM -131.072 131.068 DISPLAY_IDENTIFIER IP_MF_MAIN1_INJ_TEST_AD FORMAT "%5.3"
 /begin AXIS_DESCR COM_AXIS n _CNV_A_R_LINEAR_____5_CM 16 0. 6375. FORMAT "%4.0" AXIS_PTS_REF ldp_n_ip_mf_main1_inj_test_ad /end AXIS_DESCR
 /begin AXIS_DESCR COM_AXIS tqi_sp _CNV_A_R_LINEAR_____343_CM 16 -1024. 1023.97 FORMAT "%7.2" AXIS_PTS_REF ldp_tqi_sp_ip_mf_main1_inj_test_ad /end AXIS_DESCR
/end CHARACTERISTIC
/begin AXIS_PTS ldp_n_ip_mf_main1_inj_test_ad "" 0x841c50 n _REC_AXS_20_u2 6375. _CNV_A_R_LINEAR_____5_CM 16 0. 6375. FORMAT "%4.0" /end AXIS_PTS
/begin AXIS_PTS ldp_tqi_sp_ip_mf_main1_inj_test_ad "" 0x842812 tqi_sp _REC_AXS_20_u2 2047.97 _CNV_A_R_LINEAR_____343_CM 16 -1024. 1023.97 FORMAT "%7.2" /end AXIS_PTS
/begin MEASUREMENT lv_tqi_slm_bol_plaus "Blue smoke limitation enable" UBYTE _CNV_S_2_RANGE______11_CM 1 0. 0. 1. DISPLAY_IDENTIFIER LV_TQI_SLM_BOL_PLAUS ECU_ADDRESS 0x7fba2b /end MEASUREMENT
/begin MEASUREMENT tqi_slm_bol "Indicated torque for blue smoke limitation" SWORD _CNV_A_R_LINEAR_____52_CM 1 0. -1024. 1023.96875 DISPLAY_IDENTIFIER TQI_SLM_BOL ECU_ADDRESS 0x7f9d0e BYTE_ORDER MSB_LAST FORMAT "%6.2" /end MEASUREMENT
/begin CHARACTERISTIC c_dri_tqi_bol "Lower gear threshold" VALUE 0x85c985 _REC_VAL_20_u1 15. _CNV_A_R_LINEAR_____0_CM 0. 15. DISPLAY_IDENTIFIER C_DRI_TQI_BOL FORMAT "%2.0" /end CHARACTERISTIC
/begin CHARACTERISTIC c_lgrd_tqi_dec_tq_bol "Decrement limitation for the TQI_SLM_BOL transition" VALUE 0x85ca4a _REC_VAL_20_u2 1023.96875 _CNV_A_R_LINEAR_____52_CM 0. 1023.96875 DISPLAY_IDENTIFIER C_LGRD_TQI_DEC_TQ_BOL FORMAT "%6.2" /end CHARACTERISTIC
/begin CHARACTERISTIC c_lgrd_tqi_inc_tq_bol "Increment limitation for the TQI_SLM_BOL transition" VALUE 0x85ca4c _REC_VAL_20_u2 1023.96875 _CNV_A_R_LINEAR_____52_CM 0. 1023.96875 DISPLAY_IDENTIFIER C_LGRD_TQI_INC_TQ_BOL FORMAT "%6.2" /end CHARACTERISTIC
/begin CHARACTERISTIC ip_tqi_bol_amp_tco "MFBOL: minimum indicated torque to avoid blue smoke" MAP 0x85bafc _REC_MAP_20_u2_u1_u2 2047.96875 _CNV_A_R_LINEAR_____86_CM -1024. 1023.96875 DISPLAY_IDENTIFIER IP_TQI_BOL_AMP_TCO FORMAT "%6.2"
 /begin AXIS_DESCR COM_AXIS tco _CNV_A_R_LINEAR_____18_CM 6 -50. 205. FORMAT "%3.0" AXIS_PTS_REF ldpm_tco_ip_mf /end AXIS_DESCR
 /begin AXIS_DESCR COM_AXIS amp _CNV_A_R_LINEAR_____45_CM 6 0. 5434. FORMAT "%6.2" AXIS_PTS_REF ldp_amp_ip_mf /end AXIS_DESCR
/end CHARACTERISTIC
/begin AXIS_PTS ldpm_tco_ip_mf "minimum indicated torque to avoid blue smoke" 0x8437af tco _REC_AXS_20_u1 255. _CNV_A_R_LINEAR_____18_CM 6 -50. 205. FORMAT "%3.0" /end AXIS_PTS
/begin AXIS_PTS ldp_amp_ip_mf "minimum indicated torque to avoid blue smoke" 0x84130c amp _REC_AXS_20_u2 5434. _CNV_A_R_LINEAR_____45_CM 6 0. 5434. FORMAT "%6.2" /end AXIS_PTS
/begin MEASUREMENT mf_prev1_cor "fuel mass ambient correction of injection PREV1" SWORD _CNV_A_R_LINEAR_____38_CM 1 0. -131.072 131.068 DISPLAY_IDENTIFIER MF_PREV1_COR ECU_ADDRESS 0x7f9d10 BYTE_ORDER MSB_LAST /end MEASUREMENT
/begin MEASUREMENT mf_prev2_cor "fuel mass ambient correction of injection PREV2" SWORD _CNV_A_R_LINEAR_____38_CM 1 0. -131.072 131.068 DISPLAY_IDENTIFIER MF_PREV2_COR ECU_ADDRESS 0x7f9d1e BYTE_ORDER MSB_LAST /end MEASUREMENT
/begin MEASUREMENT mf_main2_cor "fuel mass ambient correction of injection MAIN2" SWORD _CNV_A_R_LINEAR_____38_CM 1 0. -131.072 131.068 DISPLAY_IDENTIFIER MF_MAIN2_COR ECU_ADDRESS 0x7f9d20 BYTE_ORDER MSB_LAST /end MEASUREMENT
/begin MEASUREMENT mf_post1_cor "fuel mass ambient correction of injection POST1" SWORD _CNV_A_R_LINEAR_____38_CM 1 0. -131.072 131.068 DISPLAY_IDENTIFIER MF_POST1_COR ECU_ADDRESS 0x7f9d1c BYTE_ORDER MSB_LAST /end MEASUREMENT
/begin MEASUREMENT mf_bas_cor_conf_0 "fuel mass correction of injection MAIN_BAS at inj conf 0" SWORD _CNV_A_R_LINEAR_____38_CM 1 0. -131.072 131.068 DISPLAY_IDENTIFIER MF_BAS_COR_CONF_0 ECU_ADDRESS 0x7f9d12 BYTE_ORDER MSB_LAST /end MEASUREMENT
/begin MEASUREMENT mf_bas_cor_conf_1 "fuel mass correction of injection MAIN_BAS at inj conf 1" SWORD _CNV_A_R_LINEAR_____38_CM 1 0. -131.072 131.068 DISPLAY_IDENTIFIER MF_BAS_COR_CONF_1 ECU_ADDRESS 0x7f9d14 BYTE_ORDER MSB_LAST /end MEASUREMENT
/begin MEASUREMENT mf_bas_cor_conf_2 "fuel mass correction of injection MAIN_BAS at inj conf 2" SWORD _CNV_A_R_LINEAR_____38_CM 1 0. -131.072 131.068 DISPLAY_IDENTIFIER MF_BAS_COR_CONF_2 ECU_ADDRESS 0x7f9d16 BYTE_ORDER MSB_LAST /end MEASUREMENT
/begin MEASUREMENT mf_bas_cor_conf_3 "fuel mass correction of injection MAIN_BAS at inj conf 3" SWORD _CNV_A_R_LINEAR_____38_CM 1 0. -131.072 131.068 DISPLAY_IDENTIFIER MF_BAS_COR_CONF_3 ECU_ADDRESS 0x7f9d18 BYTE_ORDER MSB_LAST /end MEASUREMENT
/begin MEASUREMENT mf_bas_cor_conf_4 "fuel mass correction of injection MAIN_BAS at inj conf 4" SWORD _CNV_A_R_LINEAR_____38_CM 1 0. -131.072 131.068 DISPLAY_IDENTIFIER MF_BAS_COR_CONF_4 ECU_ADDRESS 0x7f9d1a BYTE_ORDER MSB_LAST /end MEASUREMENT
/begin MEASUREMENT sf_bas_cor_rgn_1 "enabling correction of main injection at rgn level 1" UBYTE _CNV_A_R_LINEAR_____0_CM 1 0. 0. 2. DISPLAY_IDENTIFIER SF_BAS_COR_RGN_1 ECU_ADDRESS 0x7fba34 FORMAT "%1.0" /end MEASUREMENT
/begin MEASUREMENT sf_bas_cor_rgn_2 "enabling correction of main injection at rgn level 2" UBYTE _CNV_A_R_LINEAR_____0_CM 1 0. 0. 2. DISPLAY_IDENTIFIER SF_BAS_COR_RGN_2 ECU_ADDRESS 0x7fba35 FORMAT "%1.0" /end MEASUREMENT
/begin MEASUREMENT sf_prev1_cor_rgn_1 "enabling correction of minor injection PREV1 at rgn level 1" UBYTE _CNV_A_R_LINEAR_____0_CM 1 0. 0. 2. DISPLAY_IDENTIFIER SF_PREV1_COR_RGN_1 ECU_ADDRESS 0x7fba30 FORMAT "%1.0" /end MEASUREMENT
/begin MEASUREMENT sf_prev2_cor_rgn_1 "enabling correction of minor injection PREV2 at rgn level 1" UBYTE _CNV_A_R_LINEAR_____0_CM 1 0. 0. 2. DISPLAY_IDENTIFIER SF_PREV2_COR_RGN_1 ECU_ADDRESS 0x7fba31 FORMAT "%1.0" /end MEASUREMENT
/begin MEASUREMENT sf_main2_cor_rgn_1 "enabling correction of minor injection MAIN2 at rgn level 1" UBYTE _CNV_A_R_LINEAR_____0_CM 1 0. 0. 2. DISPLAY_IDENTIFIER SF_MAIN2_COR_RGN_1 ECU_ADDRESS 0x7fba32 FORMAT "%1.0" /end MEASUREMENT
/begin MEASUREMENT sf_post1_cor_rgn_1 "enabling correction of minor injection POST1 at rgn level 1" UBYTE _CNV_A_R_LINEAR_____0_CM 1 0. 0. 2. DISPLAY_IDENTIFIER SF_POST1_COR_RGN_1 ECU_ADDRESS 0x7fba33 FORMAT "%1.0" /end MEASUREMENT
/begin MEASUREMENT sf_prev2_cor_rgn_2 "enabling correction of minor injection PREV2 at rgn level 2" UBYTE _CNV_A_R_LINEAR_____0_CM 1 0. 0. 2. DISPLAY_IDENTIFIER SF_PREV2_COR_RGN_2 ECU_ADDRESS 0x7fba2c FORMAT "%1.0" /end MEASUREMENT
/begin MEASUREMENT sf_prev1_cor_rgn_2 "enabling correction of minor injection PREV1 at rgn level 2" UBYTE _CNV_A_R_LINEAR_____0_CM 1 0. 0. 2. DISPLAY_IDENTIFIER SF_PREV1_COR_RGN_2 ECU_ADDRESS 0x7fba2d FORMAT "%1.0" /end MEASUREMENT
/begin MEASUREMENT sf_main2_cor_rgn_2 "enabling correction of minor injection MAIN2 at rgn level 2" UBYTE _CNV_A_R_LINEAR_____0_CM 1 0. 0. 2. DISPLAY_IDENTIFIER SF_MAIN2_COR_RGN_2 ECU_ADDRESS 0x7fba2e FORMAT "%1.0" /end MEASUREMENT
/begin MEASUREMENT sf_post1_cor_rgn_2 "enabling correction of minor injection POST1 at rgn level 2" UBYTE _CNV_A_R_LINEAR_____0_CM 1 0. 0. 2. DISPLAY_IDENTIFIER SF_POST1_COR_RGN_2 ECU_ADDRESS 0x7fba2f FORMAT "%1.0" /end MEASUREMENT
/begin CHARACTERISTIC c_sf_prev2_cor_rgn_1 "enabling correction of minor injection PREV2 at rgn level 1" VALUE 0x85cb9c _REC_VAL_20_u1 2. _CNV_A_R_LINEAR_____0_CM 0. 2. DISPLAY_IDENTIFIER C_SF_PREV2_COR_RGN_1 FORMAT "%1.0" /end CHARACTERISTIC
/begin CHARACTERISTIC c_sf_prev2_cor_rgn_2 "enabling correction of minor injection PREV2 at rgn level 2" VALUE 0x85cb9d _REC_VAL_20_u1 2. _CNV_A_R_LINEAR_____0_CM 0. 2. DISPLAY_IDENTIFIER C_SF_PREV2_COR_RGN_2 FORMAT "%1.0" /end CHARACTERISTIC
/begin CHARACTERISTIC c_sf_main2_cor_rgn_1 "enabling correction of minor injection MAIN2 at rgn level 1" VALUE 0x85cb96 _REC_VAL_20_u1 2. _CNV_A_R_LINEAR_____0_CM 0. 2. DISPLAY_IDENTIFIER C_SF_MAIN2_COR_RGN_1 FORMAT "%1.0" /end CHARACTERISTIC
/begin CHARACTERISTIC c_sf_main2_cor_rgn_2 "enabling correction of minor injection MAIN2 at rgn level 2" VALUE 0x85cb97 _REC_VAL_20_u1 2. _CNV_A_R_LINEAR_____0_CM 0. 2. DISPLAY_IDENTIFIER C_SF_MAIN2_COR_RGN_2 FORMAT "%1.0" /end CHARACTERISTIC
/begin CHARACTERISTIC c_sf_post1_cor_rgn_1 "enabling correction of minor injection POST1 at rgn level 1" VALUE 0x85cb98 _REC_VAL_20_u1 2. _CNV_A_R_LINEAR_____0_CM 0. 2. DISPLAY_IDENTIFIER C_SF_POST1_COR_RGN_1 FORMAT "%1.0" /end CHARACTERISTIC
/begin CHARACTERISTIC c_sf_post1_cor_rgn_2 "enabling correction of minor injection POST1 at rgn level 2" VALUE 0x85cb99 _REC_VAL_20_u1 2. _CNV_A_R_LINEAR_____0_CM 0. 2. DISPLAY_IDENTIFIER C_SF_POST1_COR_RGN_2 FORMAT "%1.0" /end CHARACTERISTIC
/begin CHARACTERISTIC c_sf_bas_cor_rgn_1 "enabling correction of main injection at rgn level 1" VALUE 0x85cb94 _REC_VAL_20_u1 2. _CNV_A_R_LINEAR_____0_CM 0. 2. DISPLAY_IDENTIFIER C_SF_BAS_COR_RGN_1 FORMAT "%1.0" /end CHARACTERISTIC
/begin CHARACTERISTIC c_sf_bas_cor_rgn_2 "enabling correction of main injection at rgn level 2" VALUE 0x85cb95 _REC_VAL_20_u1 2. _CNV_A_R_LINEAR_____0_CM 0. 2. DISPLAY_IDENTIFIER C_SF_BAS_COR_RGN_2 FORMAT "%1.0" /end CHARACTERISTIC
/begin CHARACTERISTIC c_sf_prev1_cor_rgn_1 "enabling correction of minor injection 1 at rgn level 1" VALUE 0x85cb9a _REC_VAL_20_u1 2. _CNV_A_R_LINEAR_____0_CM 0. 2. DISPLAY_IDENTIFIER C_SF_PREV1_COR_RGN_1 FORMAT "%1.0" /end CHARACTERISTIC
/begin CHARACTERISTIC c_sf_prev1_cor_rgn_2 "enabling correction of minor injection 1 at rgn level 2" VALUE 0x85cb9b _REC_VAL_20_u1 2. _CNV_A_R_LINEAR_____0_CM 0. 2. DISPLAY_IDENTIFIER C_SF_PREV1_COR_RGN_2 FORMAT "%1.0" /end CHARACTERISTIC
/begin MEASUREMENT mf_prev1_bas_sel "basic fuel mass of minor injections PREV1 after temperature selection" UWORD _CNV_A_R_LINEAR_____38_CM 1 0. 0. 262.14 DISPLAY_IDENTIFIER MF_PREV1_BAS_SEL ECU_ADDRESS 0x7f9d22 BYTE_ORDER MSB_LAST /end MEASUREMENT
/begin MEASUREMENT mf_prev2_bas_sel "basic fuel mass of minor injections PREV2 after temperature selection" UWORD _CNV_A_R_LINEAR_____38_CM 1 0. 0. 262.14 DISPLAY_IDENTIFIER MF_PREV2_BAS_SEL ECU_ADDRESS 0x7f9d24 BYTE_ORDER MSB_LAST /end MEASUREMENT
/begin MEASUREMENT mf_main2_bas_sel "basic fuel mass of minor injections MAIN2 after temperature selection" UWORD _CNV_A_R_LINEAR_____38_CM 1 0. 0. 262.14 DISPLAY_IDENTIFIER MF_MAIN2_BAS_SEL ECU_ADDRESS 0x7f9d26 BYTE_ORDER MSB_LAST /end MEASUREMENT
/begin MEASUREMENT mf_post1_bas_sel "basic fuel mass of minor injections POST1 after temperature selection" UWORD _CNV_A_R_LINEAR_____38_CM 1 0. 0. 262.14 DISPLAY_IDENTIFIER MF_POST1_BAS_SEL ECU_ADDRESS 0x7f9d28 BYTE_ORDER MSB_LAST /end MEASUREMENT
/begin MEASUREMENT lv_temp_inter_sel "Interpolation required" UBYTE _CNV_S_2_RANGE______11_CM 1 0. 0. 1. DISPLAY_IDENTIFIER LV_TEMP_INTER_SEL ECU_ADDRESS 0x7fba36 /end MEASUREMENT
/begin MEASUREMENT lv_act_prev1_inj_bas "basic activation of injection PREV1" UBYTE _CNV_S_2_RANGE______11_CM 1 0. 0. 1. DISPLAY_IDENTIFIER LV_ACT_PREV1_INJ_BAS ECU_ADDRESS 0x7fba37 /end MEASUREMENT
/begin MEASUREMENT lv_act_prev2_inj_bas "basic activation of injection PREV2" UBYTE _CNV_S_2_RANGE______11_CM 1 0. 0. 1. DISPLAY_IDENTIFIER LV_ACT_PREV2_INJ_BAS ECU_ADDRESS 0x7fba38 /end MEASUREMENT
/begin MEASUREMENT lv_act_main2_inj_bas "basic activation of injection MAIN2" UBYTE _CNV_S_2_RANGE______11_CM 1 0. 0. 1. DISPLAY_IDENTIFIER LV_ACT_MAIN2_INJ_BAS ECU_ADDRESS 0x7fba39 /end MEASUREMENT
/begin MEASUREMENT lv_act_post1_inj_bas "basic activation of injection POST1" UBYTE _CNV_S_2_RANGE______11_CM 1 0. 0. 1. DISPLAY_IDENTIFIER LV_ACT_POST1_INJ_BAS ECU_ADDRESS 0x7fba3a /end MEASUREMENT
/begin MEASUREMENT lv_mf_prev1_bas_clc "activation of calculation of basic fuel mass PREV1" UBYTE _CNV_S_2_RANGE______11_CM 1 0. 0. 1. DISPLAY_IDENTIFIER LV_MF_PREV1_BAS_CLC ECU_ADDRESS 0x7fba3b /end MEASUREMENT
/begin MEASUREMENT lv_mf_prev2_bas_clc "activation of calculation of basic fuel mass PREV2" UBYTE _CNV_S_2_RANGE______11_CM 1 0. 0. 1. DISPLAY_IDENTIFIER LV_MF_PREV2_BAS_CLC ECU_ADDRESS 0x7fba3c /end MEASUREMENT
/begin MEASUREMENT lv_mf_main2_bas_clc "activation of calculation of basic fuel mass MAIN2" UBYTE _CNV_S_2_RANGE______11_CM 1 0. 0. 1. DISPLAY_IDENTIFIER LV_MF_MAIN2_BAS_CLC ECU_ADDRESS 0x7fba3d /end MEASUREMENT
/begin MEASUREMENT lv_mf_post1_bas_clc "activation of calculation of basic fuel mass POST1" UBYTE _CNV_S_2_RANGE______11_CM 1 0. 0. 1. DISPLAY_IDENTIFIER LV_MF_POST1_BAS_CLC ECU_ADDRESS 0x7fba3e /end MEASUREMENT
/begin CHARACTERISTIC lc_inj_prev1_on "button to activate injection PREV1" VALUE 0x85ce83 _REC_VAL_20_u1 1. _CNV_A_R_LINEAR_____0_CM 0. 1. DISPLAY_IDENTIFIER LC_INJ_PREV1_ON FORMAT "%1.0" /end CHARACTERISTIC
/begin CHARACTERISTIC c_n_32_max_inj_prev1 "maximum engine speed for injection PREV1" VALUE 0x85cafa _REC_VAL_20_u1 8160. _CNV_A_R_LINEAR_____55_CM 0. 8160. DISPLAY_IDENTIFIER C_N_32_MAX_INJ_PREV1 FORMAT "%4.0" /end CHARACTERISTIC
/begin CHARACTERISTIC lc_inj_prev2_on "button to activate injection PREV2" VALUE 0x85ce84 _REC_VAL_20_u1 1. _CNV_A_R_LINEAR_____0_CM 0. 1. DISPLAY_IDENTIFIER LC_INJ_PREV2_ON FORMAT "%1.0" /end CHARACTERISTIC
/begin CHARACTERISTIC c_n_32_max_inj_prev2 "maximum engine speed for injection PREV2" VALUE 0x85cafb _REC_VAL_20_u1 8160. _CNV_A_R_LINEAR_____55_CM 0. 8160. DISPLAY_IDENTIFIER C_N_32_MAX_INJ_PREV2 FORMAT "%4.0" /end CHARACTERISTIC
/begin CHARACTERISTIC lc_inj_main2_on "button to activate injection MAIN2" VALUE 0x85ce81 _REC_VAL_20_u1 1. _CNV_A_R_LINEAR_____0_CM 0. 1. DISPLAY_IDENTIFIER LC_INJ_MAIN2_ON FORMAT "%1.0" /end CHARACTERISTIC
/begin CHARACTERISTIC c_n_32_max_inj_main2 "maximum engine speed for injection MAIN2" VALUE 0x85caf8 _REC_VAL_20_u1 8160. _CNV_A_R_LINEAR_____55_CM 0. 8160. DISPLAY_IDENTIFIER C_N_32_MAX_INJ_MAIN2 FORMAT "%4.0" /end CHARACTERISTIC
/begin CHARACTERISTIC lc_inj_post1_on "button to activate injection POST1" VALUE 0x85ce82 _REC_VAL_20_u1 1. _CNV_A_R_LINEAR_____0_CM 0. 1. DISPLAY_IDENTIFIER LC_INJ_POST1_ON FORMAT "%1.0" /end CHARACTERISTIC
/begin CHARACTERISTIC c_n_32_max_inj_post1 "maximum engine speed for injection POST1" VALUE 0x85caf9 _REC_VAL_20_u1 8160. _CNV_A_R_LINEAR_____55_CM 0. 8160. DISPLAY_IDENTIFIER C_N_32_MAX_INJ_POST1 FORMAT "%4.0" /end CHARACTERISTIC
/begin MEASUREMENT mf_prev1_st "fuel mass of injection PREV1 during ST" UWORD _CNV_A_R_LINEAR_____38_CM 1 0. 0. 262.14 DISPLAY_IDENTIFIER MF_PREV1_ST ECU_ADDRESS 0x7f9d2a BYTE_ORDER MSB_LAST /end MEASUREMENT
/begin MEASUREMENT mf_prev2_st "fuel mass of injection PREV2 during ST" UWORD _CNV_A_R_LINEAR_____38_CM 1 0. 0. 262.14 DISPLAY_IDENTIFIER MF_PREV2_ST ECU_ADDRESS 0x7f9d2c BYTE_ORDER MSB_LAST /end MEASUREMENT
/begin MEASUREMENT mf_main2_st "fuel mass of injection MAIN2 during ST" UWORD _CNV_A_R_LINEAR_____38_CM 1 0. 0. 262.14 DISPLAY_IDENTIFIER MF_MAIN2_ST ECU_ADDRESS 0x7f9d2e BYTE_ORDER MSB_LAST /end MEASUREMENT
/begin MEASUREMENT mf_post1_st "fuel mass of injection POST1 during ST" UWORD _CNV_A_R_LINEAR_____38_CM 1 0. 0. 262.14 DISPLAY_IDENTIFIER MF_POST1_ST ECU_ADDRESS 0x7f9d30 BYTE_ORDER MSB_LAST /end MEASUREMENT
/begin CHARACTERISTIC ip_fac_mf_prev1_st_cor_amp "MF: fuel mass AMP-correction factor of PREV1 at ST" CURVE 0x85280e _REC_CUR_20_u2_u2 3.99998471 _CNV_A_R_LINEAR_____59_CM 0. 3.99998471 DISPLAY_IDENTIFIER IP_FAC_MF_PREV1_ST_COR_AMP FORMAT "%6.5"
 /begin AXIS_DESCR COM_AXIS amp _CNV_A_R_LINEAR_____45_CM 4 0. 5434. FORMAT "%6.2" AXIS_PTS_REF ldpm_amp_2_inj /end AXIS_DESCR
/end CHARACTERISTIC
/begin CHARACTERISTIC ip_fac_mf_prev1_st_cor_tia "MF: TIA correction factor of fuel masses PREV1 at Start" CURVE 0x852816 _REC_CUR_20_u2_u1 3.99998471 _CNV_A_R_LINEAR_____59_CM 0. 3.99998471 DISPLAY_IDENTIFIER IP_FAC_MF_PREV1_ST_COR_TIA FORMAT "%6.5"
 /begin AXIS_DESCR COM_AXIS tia _CNV_A_R_LINEAR_____18_CM 4 -50. 205. FORMAT "%3.0" AXIS_PTS_REF ldpm_tia_2_inj /end AXIS_DESCR
/end CHARACTERISTIC
/begin AXIS_PTS ldpm_tia_2_inj "" 0x843808 tia _REC_AXS_20_u1 255. _CNV_A_R_LINEAR_____18_CM 4 -50. 205. FORMAT "%3.0" /end AXIS_PTS
/begin CHARACTERISTIC ip_mf_prev1_st "MF: start fuel mass of injection PREV1" MAP 0x857c64 _REC_MAP_20_u2_u2_u1 262.14 _CNV_A_R_LINEAR_____38_CM 0. 262.14 DISPLAY_IDENTIFIER IP_MF_PREV1_ST
 /begin AXIS_DESCR COM_AXIS n _CNV_A_R_LINEAR_____5_CM 7 0. 6375. FORMAT "%4.0" AXIS_PTS_REF ldpm_n_3_inj /end AXIS_DESCR
 /begin AXIS_DESCR COM_AXIS tco _CNV_A_R_LINEAR_____18_CM 12 -50. 205. FORMAT "%3.0" AXIS_PTS_REF ldpm_tco_2_inj /end AXIS_DESCR
/end CHARACTERISTIC
/begin CHARACTERISTIC ip_mf_prev1_st_cor_amp "MF: amp correction of fuel mass of injection PREV1 at ST" MAP 0x857d0c _REC_MAP_20_u2_u2_u1 262.14 _CNV_A_R_LINEAR_____131_CM -131.072 131.068 DISPLAY_IDENTIFIER IP_MF_PREV1_ST_COR_AMP
 /begin AXIS_DESCR COM_AXIS n _CNV_A_R_LINEAR_____5_CM 4 0. 6375. FORMAT "%4.0" AXIS_PTS_REF ldpm_n_4_inj /end AXIS_DESCR
 /begin AXIS_DESCR COM_AXIS tco _CNV_A_R_LINEAR_____18_CM 6 -50. 205. FORMAT "%3.0" AXIS_PTS_REF ldpm_tco_3_inj /end AXIS_DESCR
/end CHARACTERISTIC
/begin CHARACTERISTIC ip_mf_prev1_st_cor_tia "MF: tia correction of fuel mass of injection PREV1 at ST" MAP 0x857d3c _REC_MAP_20_u2_u2_u1 262.14 _CNV_A_R_LINEAR_____131_CM -131.072 131.068 DISPLAY_IDENTIFIER IP_MF_PREV1_ST_COR_TIA
 /begin AXIS_DESCR COM_AXIS n _CNV_A_R_LINEAR_____5_CM 4 0. 6375. FORMAT "%4.0" AXIS_PTS_REF ldpm_n_4_inj /end AXIS_DESCR
 /begin AXIS_DESCR COM_AXIS tco _CNV_A_R_LINEAR_____18_CM 6 -50. 205. FORMAT "%3.0" AXIS_PTS_REF ldpm_tco_3_inj /end AXIS_DESCR
/end CHARACTERISTIC
/begin CHARACTERISTIC ip_fac_mf_prev2_st_cor_amp "MF: fuel mass AMP-correction factor of PREV2 at ST" CURVE 0x852824 _REC_CUR_20_u2_u2 3.99998471 _CNV_A_R_LINEAR_____59_CM 0. 3.99998471 DISPLAY_IDENTIFIER IP_FAC_MF_PREV2_ST_COR_AMP FORMAT "%6.5"
 /begin AXIS_DESCR COM_AXIS amp _CNV_A_R_LINEAR_____45_CM 1 0. 5434. FORMAT "%7.3" AXIS_PTS_REF ldp_amp_2_inj_x /end AXIS_DESCR
/end CHARACTERISTIC
/begin CHARACTERISTIC ip_fac_mf_prev2_st_cor_tia "MF: TIA correction factor of fuel masses PREV2 at Start" CURVE 0x852826 _REC_CUR_20_u2_u1 3.99998471 _CNV_A_R_LINEAR_____59_CM 0. 3.99998471 DISPLAY_IDENTIFIER IP_FAC_MF_PREV2_ST_COR_TIA FORMAT "%6.5"
 /begin AXIS_DESCR COM_AXIS tia _CNV_A_R_LINEAR_____18_CM 1 -50. 205. FORMAT "%3.0" AXIS_PTS_REF ldp_tia_2_inj_x /end AXIS_DESCR
/end CHARACTERISTIC
/begin CHARACTERISTIC ip_mf_prev2_st "MF: start fuel mass of injection PREV2" MAP 0x857df4 _REC_MAP_20_u2_u2_u1 262.14 _CNV_A_R_LINEAR_____38_CM 0. 262.14 DISPLAY_IDENTIFIER IP_MF_PREV2_ST
 /begin AXIS_DESCR COM_AXIS n _CNV_A_R_LINEAR_____5_CM 1 0. 6375. FORMAT "%4.0" AXIS_PTS_REF ldp_n_3_inj_x /end AXIS_DESCR
 /begin AXIS_DESCR COM_AXIS tco _CNV_A_R_LINEAR_____18_CM 1 -50. 205. FORMAT "%3.0" AXIS_PTS_REF ldp_tco_2_inj_x /end AXIS_DESCR
/end CHARACTERISTIC
/begin CHARACTERISTIC ip_mf_prev2_st_cor_amp "MF: amp correction of fuel mass of injection PREV2 at ST" MAP 0x857df6 _REC_MAP_20_u2_u2_u1 262.14 _CNV_A_R_LINEAR_____131_CM -131.072 131.068 DISPLAY_IDENTIFIER IP_MF_PREV2_ST_COR_AMP
 /begin AXIS_DESCR COM_AXIS n _CNV_A_R_LINEAR_____5_CM 1 0. 6375. FORMAT "%4.0" AXIS_PTS_REF ldp_n_4_inj_x /end AXIS_DESCR
 /begin AXIS_DESCR COM_AXIS tco _CNV_A_R_LINEAR_____18_CM 1 -50. 205. FORMAT "%3.0" AXIS_PTS_REF ldp_tco_3_inj_x /end AXIS_DESCR
/end CHARACTERISTIC
/begin CHARACTERISTIC ip_mf_prev2_st_cor_tia "MF: tia correction of fuel mass of injection PREV2 at ST" MAP 0x857df8 _REC_MAP_20_u2_u2_u1 262.14 _CNV_A_R_LINEAR_____131_CM -131.072 131.068 DISPLAY_IDENTIFIER IP_MF_PREV2_ST_COR_TIA
 /begin AXIS_DESCR COM_AXIS n _CNV_A_R_LINEAR_____5_CM 1 0. 6375. FORMAT "%4.0" AXIS_PTS_REF ldp_n_4_inj_x /end AXIS_DESCR
 /begin AXIS_DESCR COM_AXIS tco _CNV_A_R_LINEAR_____18_CM 1 -50. 205. FORMAT "%3.0" AXIS_PTS_REF ldp_tco_3_inj_x /end AXIS_DESCR
/end CHARACTERISTIC
/begin CHARACTERISTIC ip_fac_mf_main2_st_cor_amp "MF: fuel mass AMP-correction factor of MAIN2 at ST" CURVE 0x85279a _REC_CUR_20_u2_u2 3.99998471 _CNV_A_R_LINEAR_____59_CM 0. 3.99998471 DISPLAY_IDENTIFIER IP_FAC_MF_MAIN2_ST_COR_AMP FORMAT "%6.5"
 /begin AXIS_DESCR COM_AXIS amp _CNV_A_R_LINEAR_____45_CM 1 0. 5434. FORMAT "%7.3" AXIS_PTS_REF ldp_amp_2_inj_x /end AXIS_DESCR
/end CHARACTERISTIC
/begin CHARACTERISTIC ip_fac_mf_main2_st_cor_tia "MF: TIA correction factor of fuel masses MAIN2 at Start" CURVE 0x85279c _REC_CUR_20_u2_u1 3.99998471 _CNV_A_R_LINEAR_____59_CM 0. 3.99998471 DISPLAY_IDENTIFIER IP_FAC_MF_MAIN2_ST_COR_TIA FORMAT "%6.5"
 /begin AXIS_DESCR COM_AXIS tia _CNV_A_R_LINEAR_____18_CM 1 -50. 205. FORMAT "%3.0" AXIS_PTS_REF ldp_tia_2_inj_x /end AXIS_DESCR
/end CHARACTERISTIC
/begin CHARACTERISTIC ip_mf_main2_st "MF: start fuel mass of injection MAIN2" MAP 0x856dd4 _REC_MAP_20_u2_u2_u1 262.14 _CNV_A_R_LINEAR_____38_CM 0. 262.14 DISPLAY_IDENTIFIER IP_MF_MAIN2_ST
 /begin AXIS_DESCR COM_AXIS n _CNV_A_R_LINEAR_____5_CM 1 0. 6375. FORMAT "%4.0" AXIS_PTS_REF ldp_n_3_inj_x /end AXIS_DESCR
 /begin AXIS_DESCR COM_AXIS tco _CNV_A_R_LINEAR_____18_CM 1 -50. 205. FORMAT "%3.0" AXIS_PTS_REF ldp_tco_2_inj_x /end AXIS_DESCR
/end CHARACTERISTIC
/begin CHARACTERISTIC ip_mf_main2_st_cor_amp "MF: amp correction of fuel mass of injection MAIN2 at ST" MAP 0x856dd6 _REC_MAP_20_u2_u2_u1 262.14 _CNV_A_R_LINEAR_____131_CM -131.072 131.068 DISPLAY_IDENTIFIER IP_MF_MAIN2_ST_COR_AMP
 /begin AXIS_DESCR COM_AXIS n _CNV_A_R_LINEAR_____5_CM 1 0. 6375. FORMAT "%4.0" AXIS_PTS_REF ldp_n_4_inj_x /end AXIS_DESCR
 /begin AXIS_DESCR COM_AXIS tco _CNV_A_R_LINEAR_____18_CM 1 -50. 205. FORMAT "%3.0" AXIS_PTS_REF ldp_tco_3_inj_x /end AXIS_DESCR
/end CHARACTERISTIC
/begin CHARACTERISTIC ip_mf_main2_st_cor_tia "MF: tia correction of fuel mass of injection MAIN2 at ST" MAP 0x856dd8 _REC_MAP_20_u2_u2_u1 262.14 _CNV_A_R_LINEAR_____131_CM -131.072 131.068 DISPLAY_IDENTIFIER IP_MF_MAIN2_ST_COR_TIA
 /begin AXIS_DESCR COM_AXIS n _CNV_A_R_LINEAR_____5_CM 1 0. 6375. FORMAT "%4.0" AXIS_PTS_REF ldp_n_4_inj_x /end AXIS_DESCR
 /begin AXIS_DESCR COM_AXIS tco _CNV_A_R_LINEAR_____18_CM 1 -50. 205. FORMAT "%3.0" AXIS_PTS_REF ldp_tco_3_inj_x /end AXIS_DESCR
/end CHARACTERISTIC
/begin CHARACTERISTIC ip_fac_mf_post1_st_cor_amp "MF: fuel mass AMP-correction factor of POST1 at ST" CURVE 0x8527ce _REC_CUR_20_u2_u2 3.99998471 _CNV_A_R_LINEAR_____59_CM 0. 3.99998471 DISPLAY_IDENTIFIER IP_FAC_MF_POST1_ST_COR_AMP FORMAT "%6.5"
 /begin AXIS_DESCR COM_AXIS amp _CNV_A_R_LINEAR_____45_CM 4 0. 5434. FORMAT "%6.2" AXIS_PTS_REF ldpm_amp_2_inj /end AXIS_DESCR
/end CHARACTERISTIC
/begin CHARACTERISTIC ip_fac_mf_post1_st_cor_tia "MF: TIA correction factor of fuel masses POST1 at Start" CURVE 0x8527d6 _REC_CUR_20_u2_u1 3.99998471 _CNV_A_R_LINEAR_____59_CM 0. 3.99998471 DISPLAY_IDENTIFIER IP_FAC_MF_POST1_ST_COR_TIA FORMAT "%6.5"
 /begin AXIS_DESCR COM_AXIS tia _CNV_A_R_LINEAR_____18_CM 4 -50. 205. FORMAT "%3.0" AXIS_PTS_REF ldpm_tia_2_inj /end AXIS_DESCR
/end CHARACTERISTIC
/begin CHARACTERISTIC ip_mf_post1_st "MF: start fuel mass of injection POST1" MAP 0x85745c _REC_MAP_20_u2_u2_u1 262.14 _CNV_A_R_LINEAR_____38_CM 0. 262.14 DISPLAY_IDENTIFIER IP_MF_POST1_ST
 /begin AXIS_DESCR COM_AXIS n _CNV_A_R_LINEAR_____5_CM 7 0. 6375. FORMAT "%4.0" AXIS_PTS_REF ldpm_n_3_inj /end AXIS_DESCR
 /begin AXIS_DESCR COM_AXIS tco _CNV_A_R_LINEAR_____18_CM 12 -50. 205. FORMAT "%3.0" AXIS_PTS_REF ldpm_tco_2_inj /end AXIS_DESCR
/end CHARACTERISTIC
/begin CHARACTERISTIC ip_mf_post1_st_cor_amp "MF: amp correction of fuel mass of injection POST1 at ST" MAP 0x857504 _REC_MAP_20_u2_u2_u1 262.14 _CNV_A_R_LINEAR_____131_CM -131.072 131.068 DISPLAY_IDENTIFIER IP_MF_POST1_ST_COR_AMP
 /begin AXIS_DESCR COM_AXIS n _CNV_A_R_LINEAR_____5_CM 4 0. 6375. FORMAT "%4.0" AXIS_PTS_REF ldpm_n_4_inj /end AXIS_DESCR
 /begin AXIS_DESCR COM_AXIS tco _CNV_A_R_LINEAR_____18_CM 6 -50. 205. FORMAT "%3.0" AXIS_PTS_REF ldpm_tco_3_inj /end AXIS_DESCR
/end CHARACTERISTIC
/begin CHARACTERISTIC ip_mf_post1_st_cor_tia "MF: tia correction of fuel mass of injection POST1 at ST" MAP 0x857534 _REC_MAP_20_u2_u2_u1 262.14 _CNV_A_R_LINEAR_____131_CM -131.072 131.068 DISPLAY_IDENTIFIER IP_MF_POST1_ST_COR_TIA
 /begin AXIS_DESCR COM_AXIS n _CNV_A_R_LINEAR_____5_CM 4 0. 6375. FORMAT "%4.0" AXIS_PTS_REF ldpm_n_4_inj /end AXIS_DESCR
 /begin AXIS_DESCR COM_AXIS tco _CNV_A_R_LINEAR_____18_CM 6 -50. 205. FORMAT "%3.0" AXIS_PTS_REF ldpm_tco_3_inj /end AXIS_DESCR
/end CHARACTERISTIC
/begin AXIS_PTS ldp_amp_2_inj_x "" 0x841082 amp _REC_AXS_20_u2 5434. _CNV_A_R_LINEAR_____45_CM 1 0. 5434. FORMAT "%7.3" /end AXIS_PTS
/begin AXIS_PTS ldp_tia_2_inj_x "" 0x842574 tia _REC_AXS_20_u1 255. _CNV_A_R_LINEAR_____18_CM 1 -50. 205. FORMAT "%3.0" /end AXIS_PTS
/begin AXIS_PTS ldp_n_3_inj_x "" 0x841924 n _REC_AXS_20_u2 6375. _CNV_A_R_LINEAR_____5_CM 1 0. 6375. FORMAT "%4.0" /end AXIS_PTS
/begin AXIS_PTS ldp_tco_2_inj_x "" 0x842272 tco _REC_AXS_20_u1 255. _CNV_A_R_LINEAR_____18_CM 1 -50. 205. FORMAT "%3.0" /end AXIS_PTS
/begin AXIS_PTS ldp_n_4_inj_x "" 0x841928 n _REC_AXS_20_u2 6375. _CNV_A_R_LINEAR_____5_CM 1 0. 6375. FORMAT "%4.0" /end AXIS_PTS
/begin AXIS_PTS ldp_tco_3_inj_x "" 0x842274 tco _REC_AXS_20_u1 255. _CNV_A_R_LINEAR_____18_CM 1 -50. 205. FORMAT "%3.0" /end AXIS_PTS
/begin MEASUREMENT mf_prev1_is_pl_rgl "fuel mass of injection PREV1 during IS/PL" UWORD _CNV_A_R_LINEAR_____38_CM 1 0. 0. 262.14 DISPLAY_IDENTIFIER MF_PREV1_IS_PL_RGL ECU_ADDRESS 0x7f9d32 BYTE_ORDER MSB_LAST /end MEASUREMENT
/begin MEASUREMENT mf_prev2_is_pl_rgl "fuel mass of injection PREV2 during IS/PL" UWORD _CNV_A_R_LINEAR_____38_CM 1 0. 0. 262.14 DISPLAY_IDENTIFIER MF_PREV2_IS_PL_RGL ECU_ADDRESS 0x7f9d34 BYTE_ORDER MSB_LAST /end MEASUREMENT
/begin MEASUREMENT mf_main2_is_pl_rgl "fuel mass of injection MAIN2 during IS/PL" UWORD _CNV_A_R_LINEAR_____38_CM 1 0. 0. 262.14 DISPLAY_IDENTIFIER MF_MAIN2_IS_PL_RGL ECU_ADDRESS 0x7f9d36 BYTE_ORDER MSB_LAST /end MEASUREMENT
/begin MEASUREMENT mf_post1_is_pl_rgl "fuel mass of injection POST1 during IS/PL" UWORD _CNV_A_R_LINEAR_____38_CM 1 0. 0. 262.14 DISPLAY_IDENTIFIER MF_POST1_IS_PL_RGL ECU_ADDRESS 0x7f9d38 BYTE_ORDER MSB_LAST /end MEASUREMENT
/begin MEASUREMENT mf_prev1_cor_rgl "sum of fuel mass correction of injection PREV1 during IS/PL" SWORD _CNV_A_R_LINEAR_____38_CM 1 0. -131.072 131.068 DISPLAY_IDENTIFIER MF_PREV1_COR_RGL ECU_ADDRESS 0x7f9d3a BYTE_ORDER MSB_LAST /end MEASUREMENT
/begin MEASUREMENT mf_prev2_cor_rgl "sum of fuel mass correction of injection PREV2 during IS/PL" SWORD _CNV_A_R_LINEAR_____38_CM 1 0. -131.072 131.068 DISPLAY_IDENTIFIER MF_PREV2_COR_RGL ECU_ADDRESS 0x7f9d3c BYTE_ORDER MSB_LAST /end MEASUREMENT
/begin MEASUREMENT mf_main2_cor_rgl "sum of fuel mass correction of injection MAIN2 during IS/PL" SWORD _CNV_A_R_LINEAR_____38_CM 1 0. -131.072 131.068 DISPLAY_IDENTIFIER MF_MAIN2_COR_RGL ECU_ADDRESS 0x7f9d3e BYTE_ORDER MSB_LAST /end MEASUREMENT
/begin MEASUREMENT mf_post1_cor_rgl "sum of fuel mass correction of injection POST1 during IS/PL" SWORD _CNV_A_R_LINEAR_____38_CM 1 0. -131.072 131.068 DISPLAY_IDENTIFIER MF_POST1_COR_RGL ECU_ADDRESS 0x7f9d40 BYTE_ORDER MSB_LAST /end MEASUREMENT
/begin CHARACTERISTIC c_mf_prev1_max "maximal fuel mass of minor injection prev1" VALUE 0x85cae4 _REC_VAL_20_u2 262.14 _CNV_A_R_LINEAR_____38_CM 0. 262.14 DISPLAY_IDENTIFIER C_MF_PREV1_MAX /end CHARACTERISTIC
/begin CHARACTERISTIC ip_fac_mf_prev1_cor_tco "MF: fuel mass interpolation prev1 dependent on TCO" CURVE 0x8527ee _REC_CUR_20_u2_u1 1.9999696 _CNV_A_R_LINEAR_____48_CM 0. 1.9999696 DISPLAY_IDENTIFIER IP_FAC_MF_PREV1_COR_TCO FORMAT "%6.5"
 /begin AXIS_DESCR COM_AXIS tco _CNV_A_R_LINEAR_____18_CM 8 -50. 205. FORMAT "%3.0" AXIS_PTS_REF ldp_tco_ip_fac_mf_prev1_cor /end AXIS_DESCR
/end CHARACTERISTIC
/begin AXIS_PTS ldp_tco_ip_fac_mf_prev1_cor "" 0x8422cf tco _REC_AXS_20_u1 255. _CNV_A_R_LINEAR_____18_CM 8 -50. 205. FORMAT "%3.0" /end AXIS_PTS
/begin CHARACTERISTIC ip_fac_mf_prev1_cor_amp "MF: amp correction factor for fuel mass of minor injections prev1" CURVE 0x8527de _REC_CUR_20_u2_u2 0.9999847412109381 _CNV_A_R_LINEAR_____14_CM 0. 0.9999847412109381 DISPLAY_IDENTIFIER IP_FAC_MF_PREV1_COR_AMP FORMAT "%6.5"
 /begin AXIS_DESCR COM_AXIS amp _CNV_A_R_LINEAR_____45_CM 8 0. 5434. FORMAT "%6.2" AXIS_PTS_REF ldp_amp_ip_fac_mf_prev1_cor /end AXIS_DESCR
/end CHARACTERISTIC
/begin AXIS_PTS ldp_amp_ip_fac_mf_prev1_cor "" 0x841210 amp _REC_AXS_20_u2 5434. _CNV_A_R_LINEAR_____45_CM 8 0. 5434. FORMAT "%6.2" /end AXIS_PTS
/begin CHARACTERISTIC ip_fac_mf_prev1_cor_tgas "MF: fuel mass correction prev1 dependent on TGAS" CURVE 0x8527fe _REC_CUR_20_u2_u1 0.9999847412109381 _CNV_A_R_LINEAR_____14_CM 0. 0.9999847412109381 DISPLAY_IDENTIFIER IP_FAC_MF_PREV1_COR_TGAS FORMAT "%6.5"
 /begin AXIS_DESCR COM_AXIS tgas _CNV_A_R_LINEAR_____18_CM 8 -50. 205. FORMAT "%3.0" AXIS_PTS_REF ldp_tgas_ip_fac_mf_prev1_cor /end AXIS_DESCR
/end CHARACTERISTIC
/begin AXIS_PTS ldp_tgas_ip_fac_mf_prev1_cor "" 0x842517 tgas _REC_AXS_20_u1 255. _CNV_A_R_LINEAR_____18_CM 8 -50. 205. FORMAT "%3.0" /end AXIS_PTS
/begin CHARACTERISTIC ip_mf_prev1_0_0 "MF: basic fuel mass of minor injection prev1 at temperature level 0" MAP 0x8575e4 _REC_MAP_20_u2_u2_u2 262.14 _CNV_A_R_LINEAR_____38_CM 0. 262.14 DISPLAY_IDENTIFIER IP_MF_PREV1_0_0
 /begin AXIS_DESCR COM_AXIS n _CNV_A_R_LINEAR_____5_CM 16 0. 6375. FORMAT "%4.0" AXIS_PTS_REF ldpm_n_1_ip_mf_prev1 /end AXIS_DESCR
 /begin AXIS_DESCR COM_AXIS tqi_sp _CNV_A_R_LINEAR_____86_CM 16 -1024. 1023.96875 FORMAT "%6.2" AXIS_PTS_REF ldpm_tqi_sp_1_ip_mf_prev1 /end AXIS_DESCR
/end CHARACTERISTIC
/begin AXIS_PTS ldpm_n_1_ip_mf_prev1 "" 0x842da4 n _REC_AXS_20_u2 6375. _CNV_A_R_LINEAR_____5_CM 16 0. 6375. FORMAT "%4.0" /end AXIS_PTS
/begin AXIS_PTS ldpm_tqi_sp_1_ip_mf_prev1 "" 0x843b94 tqi_sp _REC_AXS_20_u2 2047.96875 _CNV_A_R_LINEAR_____86_CM 16 -1024. 1023.96875 FORMAT "%6.2" /end AXIS_PTS
/begin CHARACTERISTIC ip_mf_prev1_0_1 "MF: basic fuel mass of minor injection prev1 at temperature level 1" MAP 0x8577e4 _REC_MAP_20_u2_u2_u2 262.14 _CNV_A_R_LINEAR_____38_CM 0. 262.14 DISPLAY_IDENTIFIER IP_MF_PREV1_0_1
 /begin AXIS_DESCR COM_AXIS n _CNV_A_R_LINEAR_____5_CM 16 0. 6375. FORMAT "%4.0" AXIS_PTS_REF ldpm_n_1_ip_mf_prev1 /end AXIS_DESCR
 /begin AXIS_DESCR COM_AXIS tqi_sp _CNV_A_R_LINEAR_____86_CM 16 -1024. 1023.96875 FORMAT "%6.2" AXIS_PTS_REF ldpm_tqi_sp_1_ip_mf_prev1 /end AXIS_DESCR
/end CHARACTERISTIC
/begin CHARACTERISTIC ip_mf_prev1_0_2 "MF: basic fuel mass of minor injection prev1 at temperature level 2" MAP 0x8579e4 _REC_MAP_20_u2_u2_u2 262.14 _CNV_A_R_LINEAR_____38_CM 0. 262.14 DISPLAY_IDENTIFIER IP_MF_PREV1_0_2
 /begin AXIS_DESCR COM_AXIS n _CNV_A_R_LINEAR_____5_CM 16 0. 6375. FORMAT "%4.0" AXIS_PTS_REF ldpm_n_1_ip_mf_prev1 /end AXIS_DESCR
 /begin AXIS_DESCR COM_AXIS tqi_sp _CNV_A_R_LINEAR_____86_CM 16 -1024. 1023.96875 FORMAT "%6.2" AXIS_PTS_REF ldpm_tqi_sp_1_ip_mf_prev1 /end AXIS_DESCR
/end CHARACTERISTIC
/begin CHARACTERISTIC ip_mf_prev1_amp "MF: ambient pressure temperature correction of fuel mass for minor injections prev1" MAP 0x857be4 _REC_MAP_20_u2_u2_u2 262.14 _CNV_A_R_LINEAR_____131_CM -131.072 131.068 DISPLAY_IDENTIFIER IP_MF_PREV1_AMP
 /begin AXIS_DESCR COM_AXIS n _CNV_A_R_LINEAR_____5_CM 8 0. 6375. FORMAT "%4.0" AXIS_PTS_REF ldp_n_ip_mf_prev1_amp /end AXIS_DESCR
 /begin AXIS_DESCR COM_AXIS tqi_sp _CNV_A_R_LINEAR_____86_CM 8 -1024. 1023.96875 FORMAT "%6.2" AXIS_PTS_REF ldp_tqi_sp_ip_mf_prev1_amp /end AXIS_DESCR
/end CHARACTERISTIC
/begin AXIS_PTS ldp_n_ip_mf_prev1_amp "" 0x841c9e n _REC_AXS_20_u2 6375. _CNV_A_R_LINEAR_____5_CM 8 0. 6375. FORMAT "%4.0" /end AXIS_PTS
/begin AXIS_PTS ldp_tqi_sp_ip_mf_prev1_amp "" 0x842860 tqi_sp _REC_AXS_20_u2 2047.96875 _CNV_A_R_LINEAR_____86_CM 8 -1024. 1023.96875 FORMAT "%6.2" /end AXIS_PTS
/begin CHARACTERISTIC ip_mf_prev1_tgas "MF: air charge temperature correction of minor injections prev1" MAP 0x857d6c _REC_MAP_20_u2_u2_u2 262.14 _CNV_A_R_LINEAR_____131_CM -131.072 131.068 DISPLAY_IDENTIFIER IP_MF_PREV1_TGAS
 /begin AXIS_DESCR COM_AXIS n _CNV_A_R_LINEAR_____5_CM 8 0. 6375. FORMAT "%4.0" AXIS_PTS_REF ldp_n_ip_mf_prev1_tgas /end AXIS_DESCR
 /begin AXIS_DESCR COM_AXIS tqi_sp _CNV_A_R_LINEAR_____86_CM 8 -1024. 1023.96875 FORMAT "%6.2" AXIS_PTS_REF ldp_tqi_sp_ip_mf_prev1_tgas /end AXIS_DESCR
/end CHARACTERISTIC
/begin AXIS_PTS ldp_n_ip_mf_prev1_tgas "" 0x841cb0 n _REC_AXS_20_u2 6375. _CNV_A_R_LINEAR_____5_CM 8 0. 6375. FORMAT "%4.0" /end AXIS_PTS
/begin AXIS_PTS ldp_tqi_sp_ip_mf_prev1_tgas "" 0x842872 tqi_sp _REC_AXS_20_u2 2047.96875 _CNV_A_R_LINEAR_____86_CM 8 -1024. 1023.96875 FORMAT "%6.2" /end AXIS_PTS
/begin CHARACTERISTIC c_mf_prev2_max "maximal fuel mass of minor injection prev2" VALUE 0x85cae6 _REC_VAL_20_u2 262.14 _CNV_A_R_LINEAR_____38_CM 0. 262.14 DISPLAY_IDENTIFIER C_MF_PREV2_MAX /end CHARACTERISTIC
/begin CHARACTERISTIC ip_fac_mf_prev2_cor_tco "MF: fuel mass interpolation prev2 dependent on TCO" CURVE 0x852820 _REC_CUR_20_u2_u1 1.9999696 _CNV_A_R_LINEAR_____48_CM 0. 1.9999696 DISPLAY_IDENTIFIER IP_FAC_MF_PREV2_COR_TCO FORMAT "%6.5"
 /begin AXIS_DESCR COM_AXIS tco _CNV_A_R_LINEAR_____18_CM 1 -50. 205. FORMAT "%3.0" AXIS_PTS_REF ldp_tco_ip_fac_mf_prev2_cor /end AXIS_DESCR
/end CHARACTERISTIC
/begin AXIS_PTS ldp_tco_ip_fac_mf_prev2_cor "" 0x8422d8 tco _REC_AXS_20_u1 255. _CNV_A_R_LINEAR_____18_CM 1 -50. 205. FORMAT "%3.0" /end AXIS_PTS
/begin CHARACTERISTIC ip_fac_mf_prev2_cor_amp "MF: amp correction factor for fuel mass of minor injections prev2" CURVE 0x85281e _REC_CUR_20_u2_u2 0.9999847412109381 _CNV_A_R_LINEAR_____14_CM 0. 0.9999847412109381 DISPLAY_IDENTIFIER IP_FAC_MF_PREV2_COR_AMP FORMAT "%6.5"
 /begin AXIS_DESCR COM_AXIS amp _CNV_A_R_LINEAR_____45_CM 1 0. 5434. FORMAT "%6.2" AXIS_PTS_REF ldp_amp_ip_fac_mf_prev2_cor /end AXIS_DESCR
/end CHARACTERISTIC
/begin AXIS_PTS ldp_amp_ip_fac_mf_prev2_cor "" 0x84122e amp _REC_AXS_20_u2 5434. _CNV_A_R_LINEAR_____45_CM 1 0. 5434. FORMAT "%6.2" /end AXIS_PTS
/begin CHARACTERISTIC ip_fac_mf_prev2_cor_tgas "MF: fuel mass correction prev2 dependent on TGAS" CURVE 0x852822 _REC_CUR_20_u2_u1 0.9999847412109381 _CNV_A_R_LINEAR_____14_CM 0. 0.9999847412109381 DISPLAY_IDENTIFIER IP_FAC_MF_PREV2_COR_TGAS FORMAT "%6.5"
 /begin AXIS_DESCR COM_AXIS tgas _CNV_A_R_LINEAR_____18_CM 1 -50. 205. FORMAT "%3.0" AXIS_PTS_REF ldp_tgas_ip_fac_mf_prev2_cor /end AXIS_DESCR
/end CHARACTERISTIC
/begin AXIS_PTS ldp_tgas_ip_fac_mf_prev2_cor "" 0x842520 tgas _REC_AXS_20_u1 255. _CNV_A_R_LINEAR_____18_CM 1 -50. 205. FORMAT "%3.0" /end AXIS_PTS
/begin CHARACTERISTIC ip_mf_prev2_0_0 "MF: basic fuel mass of minor injection prev2 at temperature level 0" MAP 0x857dec _REC_MAP_20_u2_u2_u2 262.14 _CNV_A_R_LINEAR_____38_CM 0. 262.14 DISPLAY_IDENTIFIER IP_MF_PREV2_0_0
 /begin AXIS_DESCR COM_AXIS n _CNV_A_R_LINEAR_____5_CM 1 0. 6375. FORMAT "%4.0" AXIS_PTS_REF ldpm_n_1_ip_mf_prev2 /end AXIS_DESCR
 /begin AXIS_DESCR COM_AXIS tqi_sp _CNV_A_R_LINEAR_____86_CM 1 -1024. 1023.96875 FORMAT "%6.2" AXIS_PTS_REF ldpm_tqi_sp_1_ip_mf_prev2 /end AXIS_DESCR
/end CHARACTERISTIC
/begin AXIS_PTS ldpm_n_1_ip_mf_prev2 "" 0x842dc6 n _REC_AXS_20_u2 6375. _CNV_A_R_LINEAR_____5_CM 1 0. 6375. FORMAT "%4.0" /end AXIS_PTS
/begin AXIS_PTS ldpm_tqi_sp_1_ip_mf_prev2 "" 0x843bb6 tqi_sp _REC_AXS_20_u2 2047.96875 _CNV_A_R_LINEAR_____86_CM 1 -1024. 1023.96875 FORMAT "%6.2" /end AXIS_PTS
/begin CHARACTERISTIC ip_mf_prev2_0_1 "MF: basic fuel mass of minor injection prev2 at temperature level 1" MAP 0x857dee _REC_MAP_20_u2_u2_u2 262.14 _CNV_A_R_LINEAR_____38_CM 0. 262.14 DISPLAY_IDENTIFIER IP_MF_PREV2_0_1
 /begin AXIS_DESCR COM_AXIS n _CNV_A_R_LINEAR_____5_CM 1 0. 6375. FORMAT "%4.0" AXIS_PTS_REF ldpm_n_1_ip_mf_prev2 /end AXIS_DESCR
 /begin AXIS_DESCR COM_AXIS tqi_sp _CNV_A_R_LINEAR_____86_CM 1 -1024. 1023.96875 FORMAT "%6.2" AXIS_PTS_REF ldpm_tqi_sp_1_ip_mf_prev2 /end AXIS_DESCR
/end CHARACTERISTIC
/begin CHARACTERISTIC ip_mf_prev2_0_2 "MF: basic fuel mass of minor injection prev2 at temperature level 2" MAP 0x857df0 _REC_MAP_20_u2_u2_u2 262.14 _CNV_A_R_LINEAR_____38_CM 0. 262.14 DISPLAY_IDENTIFIER IP_MF_PREV2_0_2
 /begin AXIS_DESCR COM_AXIS n _CNV_A_R_LINEAR_____5_CM 1 0. 6375. FORMAT "%4.0" AXIS_PTS_REF ldpm_n_1_ip_mf_prev2 /end AXIS_DESCR
 /begin AXIS_DESCR COM_AXIS tqi_sp _CNV_A_R_LINEAR_____86_CM 1 -1024. 1023.96875 FORMAT "%6.2" AXIS_PTS_REF ldpm_tqi_sp_1_ip_mf_prev2 /end AXIS_DESCR
/end CHARACTERISTIC
/begin CHARACTERISTIC ip_mf_prev2_amp "MF: ambient pressure temperature correction of fuel mass for minor injections prev2" MAP 0x857df2 _REC_MAP_20_u2_u2_u2 262.14 _CNV_A_R_LINEAR_____131_CM -131.072 131.068 DISPLAY_IDENTIFIER IP_MF_PREV2_AMP
 /begin AXIS_DESCR COM_AXIS n _CNV_A_R_LINEAR_____5_CM 1 0. 6375. FORMAT "%4.0" AXIS_PTS_REF ldp_n_ip_mf_prev2_amp /end AXIS_DESCR
 /begin AXIS_DESCR COM_AXIS tqi_sp _CNV_A_R_LINEAR_____86_CM 1 -1024. 1023.96875 FORMAT "%6.2" AXIS_PTS_REF ldp_tqi_sp_ip_mf_prev2_amp /end AXIS_DESCR
/end CHARACTERISTIC
/begin AXIS_PTS ldp_n_ip_mf_prev2_amp "" 0x841cc2 n _REC_AXS_20_u2 6375. _CNV_A_R_LINEAR_____5_CM 1 0. 6375. FORMAT "%4.0" /end AXIS_PTS
/begin AXIS_PTS ldp_tqi_sp_ip_mf_prev2_amp "" 0x842884 tqi_sp _REC_AXS_20_u2 2047.96875 _CNV_A_R_LINEAR_____86_CM 1 -1024. 1023.96875 FORMAT "%6.2" /end AXIS_PTS
/begin CHARACTERISTIC ip_mf_prev2_tgas "MF: air charge temperature correction of minor injections prev2" MAP 0x857dfa _REC_MAP_20_u2_u2_u2 262.14 _CNV_A_R_LINEAR_____131_CM -131.072 131.068 DISPLAY_IDENTIFIER IP_MF_PREV2_TGAS
 /begin AXIS_DESCR COM_AXIS n _CNV_A_R_LINEAR_____5_CM 1 0. 6375. FORMAT "%4.0" AXIS_PTS_REF ldp_n_ip_mf_prev2_tgas /end AXIS_DESCR
 /begin AXIS_DESCR COM_AXIS tqi_sp _CNV_A_R_LINEAR_____86_CM 1 -1024. 1023.96875 FORMAT "%6.2" AXIS_PTS_REF ldp_tqi_sp_ip_mf_prev2_tgas /end AXIS_DESCR
/end CHARACTERISTIC
/begin AXIS_PTS ldp_n_ip_mf_prev2_tgas "" 0x841cc6 n _REC_AXS_20_u2 6375. _CNV_A_R_LINEAR_____5_CM 1 0. 6375. FORMAT "%4.0" /end AXIS_PTS
/begin AXIS_PTS ldp_tqi_sp_ip_mf_prev2_tgas "" 0x842888 tqi_sp _REC_AXS_20_u2 2047.96875 _CNV_A_R_LINEAR_____86_CM 1 -1024. 1023.96875 FORMAT "%6.2" /end AXIS_PTS
/begin CHARACTERISTIC c_mf_main2_max "maximal fuel mass of minor injection main2" VALUE 0x85cada _REC_VAL_20_u2 262.14 _CNV_A_R_LINEAR_____38_CM 0. 262.14 DISPLAY_IDENTIFIER C_MF_MAIN2_MAX /end CHARACTERISTIC
/begin CHARACTERISTIC ip_fac_mf_main2_cor_tco "MF: fuel mass interpolation main2 dependent on TCO" CURVE 0x852796 _REC_CUR_20_u2_u1 1.9999696 _CNV_A_R_LINEAR_____48_CM 0. 1.9999696 DISPLAY_IDENTIFIER IP_FAC_MF_MAIN2_COR_TCO FORMAT "%6.5"
 /begin AXIS_DESCR COM_AXIS tco _CNV_A_R_LINEAR_____18_CM 1 -50. 205. FORMAT "%3.0" AXIS_PTS_REF ldp_tco_ip_fac_mf_main2_cor /end AXIS_DESCR
/end CHARACTERISTIC
/begin AXIS_PTS ldp_tco_ip_fac_mf_main2_cor "" 0x8422c4 tco _REC_AXS_20_u1 255. _CNV_A_R_LINEAR_____18_CM 1 -50. 205. FORMAT "%3.0" /end AXIS_PTS
/begin CHARACTERISTIC ip_fac_mf_main2_cor_amp "MF: amp correction factor for fuel mass of minor injections main2" CURVE 0x852794 _REC_CUR_20_u2_u2 0.9999847412109381 _CNV_A_R_LINEAR_____14_CM 0. 0.9999847412109381 DISPLAY_IDENTIFIER IP_FAC_MF_MAIN2_COR_AMP FORMAT "%6.5"
 /begin AXIS_DESCR COM_AXIS amp _CNV_A_R_LINEAR_____45_CM 1 0. 5434. FORMAT "%6.2" AXIS_PTS_REF ldp_amp_ip_fac_mf_main2_cor /end AXIS_DESCR
/end CHARACTERISTIC
/begin AXIS_PTS ldp_amp_ip_fac_mf_main2_cor "" 0x8411e2 amp _REC_AXS_20_u2 5434. _CNV_A_R_LINEAR_____45_CM 1 0. 5434. FORMAT "%6.2" /end AXIS_PTS
/begin CHARACTERISTIC ip_fac_mf_main2_cor_tgas "MF: fuel mass correction main2 dependent on TGAS" CURVE 0x852798 _REC_CUR_20_u2_u1 0.9999847412109381 _CNV_A_R_LINEAR_____14_CM 0. 0.9999847412109381 DISPLAY_IDENTIFIER IP_FAC_MF_MAIN2_COR_TGAS FORMAT "%6.5"
 /begin AXIS_DESCR COM_AXIS tgas _CNV_A_R_LINEAR_____18_CM 1 -50. 205. FORMAT "%3.0" AXIS_PTS_REF ldp_tgas_ip_fac_mf_main2_cor /end AXIS_DESCR
/end CHARACTERISTIC
/begin AXIS_PTS ldp_tgas_ip_fac_mf_main2_cor "" 0x84250c tgas _REC_AXS_20_u1 255. _CNV_A_R_LINEAR_____18_CM 1 -50. 205. FORMAT "%3.0" /end AXIS_PTS
/begin CHARACTERISTIC ip_mf_main2_0_0 "MF: basic fuel mass of minor injection main2 at temperature level 0" MAP 0x856dcc _REC_MAP_20_u2_u2_u2 262.14 _CNV_A_R_LINEAR_____38_CM 0. 262.14 DISPLAY_IDENTIFIER IP_MF_MAIN2_0_0
 /begin AXIS_DESCR COM_AXIS n _CNV_A_R_LINEAR_____5_CM 1 0. 6375. FORMAT "%4.0" AXIS_PTS_REF ldpm_n_1_ip_mf_main2 /end AXIS_DESCR
 /begin AXIS_DESCR COM_AXIS tqi_sp _CNV_A_R_LINEAR_____86_CM 1 -1024. 1023.96875 FORMAT "%6.2" AXIS_PTS_REF ldpm_tqi_sp_1_ip_mf_main2 /end AXIS_DESCR
/end CHARACTERISTIC
/begin AXIS_PTS ldpm_n_1_ip_mf_main2 "" 0x842d7e n _REC_AXS_20_u2 6375. _CNV_A_R_LINEAR_____5_CM 1 0. 6375. FORMAT "%4.0" /end AXIS_PTS
/begin AXIS_PTS ldpm_tqi_sp_1_ip_mf_main2 "" 0x843b6e tqi_sp _REC_AXS_20_u2 2047.96875 _CNV_A_R_LINEAR_____86_CM 1 -1024. 1023.96875 FORMAT "%6.2" /end AXIS_PTS
/begin CHARACTERISTIC ip_mf_main2_0_1 "MF: basic fuel mass of minor injection main2 at temperature level 1" MAP 0x856dce _REC_MAP_20_u2_u2_u2 262.14 _CNV_A_R_LINEAR_____38_CM 0. 262.14 DISPLAY_IDENTIFIER IP_MF_MAIN2_0_1
 /begin AXIS_DESCR COM_AXIS n _CNV_A_R_LINEAR_____5_CM 1 0. 6375. FORMAT "%4.0" AXIS_PTS_REF ldpm_n_1_ip_mf_main2 /end AXIS_DESCR
 /begin AXIS_DESCR COM_AXIS tqi_sp _CNV_A_R_LINEAR_____86_CM 1 -1024. 1023.96875 FORMAT "%6.2" AXIS_PTS_REF ldpm_tqi_sp_1_ip_mf_main2 /end AXIS_DESCR
/end CHARACTERISTIC
/begin CHARACTERISTIC ip_mf_main2_0_2 "MF: basic fuel mass of minor injection main2 at temperature level 2" MAP 0x856dd0 _REC_MAP_20_u2_u2_u2 262.14 _CNV_A_R_LINEAR_____38_CM 0. 262.14 DISPLAY_IDENTIFIER IP_MF_MAIN2_0_2
 /begin AXIS_DESCR COM_AXIS n _CNV_A_R_LINEAR_____5_CM 1 0. 6375. FORMAT "%4.0" AXIS_PTS_REF ldpm_n_1_ip_mf_main2 /end AXIS_DESCR
 /begin AXIS_DESCR COM_AXIS tqi_sp _CNV_A_R_LINEAR_____86_CM 1 -1024. 1023.96875 FORMAT "%6.2" AXIS_PTS_REF ldpm_tqi_sp_1_ip_mf_main2 /end AXIS_DESCR
/end CHARACTERISTIC
/begin CHARACTERISTIC ip_mf_main2_amp "MF: ambient pressure temperature correction of fuel mass for minor injections main2" MAP 0x856dd2 _REC_MAP_20_u2_u2_u2 262.14 _CNV_A_R_LINEAR_____131_CM -131.072 131.068 DISPLAY_IDENTIFIER IP_MF_MAIN2_AMP
 /begin AXIS_DESCR COM_AXIS n _CNV_A_R_LINEAR_____5_CM 1 0. 6375. FORMAT "%4.0" AXIS_PTS_REF ldp_n_ip_mf_main2_amp /end AXIS_DESCR
 /begin AXIS_DESCR COM_AXIS tqi_sp _CNV_A_R_LINEAR_____86_CM 1 -1024. 1023.96875 FORMAT "%6.2" AXIS_PTS_REF ldp_tqi_sp_ip_mf_main2_amp /end AXIS_DESCR
/end CHARACTERISTIC
/begin AXIS_PTS ldp_n_ip_mf_main2_amp "" 0x841c72 n _REC_AXS_20_u2 6375. _CNV_A_R_LINEAR_____5_CM 1 0. 6375. FORMAT "%4.0" /end AXIS_PTS
/begin AXIS_PTS ldp_tqi_sp_ip_mf_main2_amp "" 0x842834 tqi_sp _REC_AXS_20_u2 2047.96875 _CNV_A_R_LINEAR_____86_CM 1 -1024. 1023.96875 FORMAT "%6.2" /end AXIS_PTS
/begin CHARACTERISTIC ip_mf_main2_tgas "MF: air charge temperature correction of minor injections main2" MAP 0x856dda _REC_MAP_20_u2_u2_u2 262.14 _CNV_A_R_LINEAR_____131_CM -131.072 131.068 DISPLAY_IDENTIFIER IP_MF_MAIN2_TGAS
 /begin AXIS_DESCR COM_AXIS n _CNV_A_R_LINEAR_____5_CM 1 0. 6375. FORMAT "%4.0" AXIS_PTS_REF ldp_n_ip_mf_main2_tgas /end AXIS_DESCR
 /begin AXIS_DESCR COM_AXIS tqi_sp _CNV_A_R_LINEAR_____86_CM 1 -1024. 1023.96875 FORMAT "%6.2" AXIS_PTS_REF ldp_tqi_sp_ip_mf_main2_tgas /end AXIS_DESCR
/end CHARACTERISTIC
/begin AXIS_PTS ldp_n_ip_mf_main2_tgas "" 0x841c76 n _REC_AXS_20_u2 6375. _CNV_A_R_LINEAR_____5_CM 1 0. 6375. FORMAT "%4.0" /end AXIS_PTS
/begin AXIS_PTS ldp_tqi_sp_ip_mf_main2_tgas "" 0x842838 tqi_sp _REC_AXS_20_u2 2047.96875 _CNV_A_R_LINEAR_____86_CM 1 -1024. 1023.96875 FORMAT "%6.2" /end AXIS_PTS
/begin CHARACTERISTIC c_mf_post1_max "maximal fuel mass of minor injection post1" VALUE 0x85cae2 _REC_VAL_20_u2 262.14 _CNV_A_R_LINEAR_____38_CM 0. 262.14 DISPLAY_IDENTIFIER C_MF_POST1_MAX /end CHARACTERISTIC
/begin CHARACTERISTIC ip_fac_mf_post1_cor_tco "MF: fuel mass interpolation post1 dependent on TCO" CURVE 0x8527ae _REC_CUR_20_u2_u1 1.9999696 _CNV_A_R_LINEAR_____48_CM 0. 1.9999696 DISPLAY_IDENTIFIER IP_FAC_MF_POST1_COR_TCO FORMAT "%6.5"
 /begin AXIS_DESCR COM_AXIS tco _CNV_A_R_LINEAR_____18_CM 8 -50. 205. FORMAT "%3.0" AXIS_PTS_REF ldp_tco_ip_fac_mf_post1_cor /end AXIS_DESCR
/end CHARACTERISTIC
/begin AXIS_PTS ldp_tco_ip_fac_mf_post1_cor "" 0x8422c6 tco _REC_AXS_20_u1 255. _CNV_A_R_LINEAR_____18_CM 8 -50. 205. FORMAT "%3.0" /end AXIS_PTS
/begin CHARACTERISTIC ip_fac_mf_post1_cor_amp "MF: amp correction factor for fuel mass of minor injections post1" CURVE 0x85279e _REC_CUR_20_u2_u2 0.9999847412109381 _CNV_A_R_LINEAR_____14_CM 0. 0.9999847412109381 DISPLAY_IDENTIFIER IP_FAC_MF_POST1_COR_AMP FORMAT "%6.5"
 /begin AXIS_DESCR COM_AXIS amp _CNV_A_R_LINEAR_____45_CM 8 0. 5434. FORMAT "%6.2" AXIS_PTS_REF ldp_amp_ip_fac_mf_post1_cor /end AXIS_DESCR
/end CHARACTERISTIC
/begin AXIS_PTS ldp_amp_ip_fac_mf_post1_cor "" 0x8411f2 amp _REC_AXS_20_u2 5434. _CNV_A_R_LINEAR_____45_CM 8 0. 5434. FORMAT "%6.2" /end AXIS_PTS
/begin CHARACTERISTIC ip_fac_mf_post1_cor_tgas "MF: fuel mass correction post1 dependent on TGAS" CURVE 0x8527be _REC_CUR_20_u2_u1 0.9999847412109381 _CNV_A_R_LINEAR_____14_CM 0. 0.9999847412109381 DISPLAY_IDENTIFIER IP_FAC_MF_POST1_COR_TGAS FORMAT "%6.5"
 /begin AXIS_DESCR COM_AXIS tgas _CNV_A_R_LINEAR_____18_CM 8 -50. 205. FORMAT "%3.0" AXIS_PTS_REF ldp_tgas_ip_fac_mf_post1_cor /end AXIS_DESCR
/end CHARACTERISTIC
/begin AXIS_PTS ldp_tgas_ip_fac_mf_post1_cor "" 0x84250e tgas _REC_AXS_20_u1 255. _CNV_A_R_LINEAR_____18_CM 8 -50. 205. FORMAT "%3.0" /end AXIS_PTS
/begin CHARACTERISTIC ip_mf_post1_0_0 "MF: basic fuel mass of minor injection post1 at temperature level 0" MAP 0x856ddc _REC_MAP_20_u2_u2_u2 262.14 _CNV_A_R_LINEAR_____38_CM 0. 262.14 DISPLAY_IDENTIFIER IP_MF_POST1_0_0
 /begin AXIS_DESCR COM_AXIS n _CNV_A_R_LINEAR_____5_CM 16 0. 6375. FORMAT "%4.0" AXIS_PTS_REF ldpm_n_1_ip_mf_post1 /end AXIS_DESCR
 /begin AXIS_DESCR COM_AXIS tqi_sp _CNV_A_R_LINEAR_____86_CM 16 -1024. 1023.96875 FORMAT "%6.2" AXIS_PTS_REF ldpm_tqi_sp_1_ip_mf_post1 /end AXIS_DESCR
/end CHARACTERISTIC
/begin AXIS_PTS ldpm_n_1_ip_mf_post1 "" 0x842d82 n _REC_AXS_20_u2 6375. _CNV_A_R_LINEAR_____5_CM 16 0. 6375. FORMAT "%4.0" /end AXIS_PTS
/begin AXIS_PTS ldpm_tqi_sp_1_ip_mf_post1 "" 0x843b72 tqi_sp _REC_AXS_20_u2 2047.96875 _CNV_A_R_LINEAR_____86_CM 16 -1024. 1023.96875 FORMAT "%6.2" /end AXIS_PTS
/begin CHARACTERISTIC ip_mf_post1_0_1 "MF: basic fuel mass of minor injection post1 at temperature level 1" MAP 0x856fdc _REC_MAP_20_u2_u2_u2 262.14 _CNV_A_R_LINEAR_____38_CM 0. 262.14 DISPLAY_IDENTIFIER IP_MF_POST1_0_1
 /begin AXIS_DESCR COM_AXIS n _CNV_A_R_LINEAR_____5_CM 16 0. 6375. FORMAT "%4.0" AXIS_PTS_REF ldpm_n_1_ip_mf_post1 /end AXIS_DESCR
 /begin AXIS_DESCR COM_AXIS tqi_sp _CNV_A_R_LINEAR_____86_CM 16 -1024. 1023.96875 FORMAT "%6.2" AXIS_PTS_REF ldpm_tqi_sp_1_ip_mf_post1 /end AXIS_DESCR
/end CHARACTERISTIC
/begin CHARACTERISTIC ip_mf_post1_0_2 "MF: basic fuel mass of minor injection post1 at temperature level 2" MAP 0x8571dc _REC_MAP_20_u2_u2_u2 262.14 _CNV_A_R_LINEAR_____38_CM 0. 262.14 DISPLAY_IDENTIFIER IP_MF_POST1_0_2
 /begin AXIS_DESCR COM_AXIS n _CNV_A_R_LINEAR_____5_CM 16 0. 6375. FORMAT "%4.0" AXIS_PTS_REF ldpm_n_1_ip_mf_post1 /end AXIS_DESCR
 /begin AXIS_DESCR COM_AXIS tqi_sp _CNV_A_R_LINEAR_____86_CM 16 -1024. 1023.96875 FORMAT "%6.2" AXIS_PTS_REF ldpm_tqi_sp_1_ip_mf_post1 /end AXIS_DESCR
/end CHARACTERISTIC
/begin CHARACTERISTIC ip_mf_post1_amp "MF: ambient pressure temperature correction of fuel mass for minor injections post1" MAP 0x8573dc _REC_MAP_20_u2_u2_u2 262.14 _CNV_A_R_LINEAR_____131_CM -131.072 131.068 DISPLAY_IDENTIFIER IP_MF_POST1_AMP
 /begin AXIS_DESCR COM_AXIS n _CNV_A_R_LINEAR_____5_CM 8 0. 6375. FORMAT "%4.0" AXIS_PTS_REF ldp_n_ip_mf_post1_amp /end AXIS_DESCR
 /begin AXIS_DESCR COM_AXIS tqi_sp _CNV_A_R_LINEAR_____86_CM 8 -1024. 1023.96875 FORMAT "%6.2" AXIS_PTS_REF ldp_tqi_sp_ip_mf_post1_amp /end AXIS_DESCR
/end CHARACTERISTIC
/begin AXIS_PTS ldp_n_ip_mf_post1_amp "" 0x841c7a n _REC_AXS_20_u2 6375. _CNV_A_R_LINEAR_____5_CM 8 0. 6375. FORMAT "%4.0" /end AXIS_PTS
/begin AXIS_PTS ldp_tqi_sp_ip_mf_post1_amp "" 0x84283c tqi_sp _REC_AXS_20_u2 2047.96875 _CNV_A_R_LINEAR_____86_CM 8 -1024. 1023.96875 FORMAT "%6.2" /end AXIS_PTS
/begin CHARACTERISTIC ip_mf_post1_tgas "MF: air charge temperature correction of minor injections post1" MAP 0x857564 _REC_MAP_20_u2_u2_u2 262.14 _CNV_A_R_LINEAR_____131_CM -131.072 131.068 DISPLAY_IDENTIFIER IP_MF_POST1_TGAS
 /begin AXIS_DESCR COM_AXIS n _CNV_A_R_LINEAR_____5_CM 8 0. 6375. FORMAT "%4.0" AXIS_PTS_REF ldp_n_ip_mf_post1_tgas /end AXIS_DESCR
 /begin AXIS_DESCR COM_AXIS tqi_sp _CNV_A_R_LINEAR_____86_CM 8 -1024. 1023.96875 FORMAT "%6.2" AXIS_PTS_REF ldp_tqi_sp_ip_mf_post1_tgas /end AXIS_DESCR
/end CHARACTERISTIC
/begin AXIS_PTS ldp_n_ip_mf_post1_tgas "" 0x841c8c n _REC_AXS_20_u2 6375. _CNV_A_R_LINEAR_____5_CM 8 0. 6375. FORMAT "%4.0" /end AXIS_PTS
/begin AXIS_PTS ldp_tqi_sp_ip_mf_post1_tgas "" 0x84284e tqi_sp _REC_AXS_20_u2 2047.96875 _CNV_A_R_LINEAR_____86_CM 8 -1024. 1023.96875 FORMAT "%6.2" /end AXIS_PTS
/begin MEASUREMENT mf_inj_min "minimal injection fuel mass" UWORD _CNV_A_R_LINEAR_____38_CM 1 0. 0. 262.14 DISPLAY_IDENTIFIER MF_INJ_MIN ECU_ADDRESS 0x7f9d5a BYTE_ORDER MSB_LAST /end MEASUREMENT
/begin CHARACTERISTIC c_mf_inj_min "" VALUE 0x85cad4 _REC_VAL_20_u2 262.14 _CNV_A_R_LINEAR_____38_CM 0. 262.14 DISPLAY_IDENTIFIER C_MF_INJ_MIN FORMAT "%5.2" /end CHARACTERISTIC
/begin MEASUREMENT mf_prev1_req "requested fuel mass of injection PREV1" UWORD _CNV_A_R_LINEAR_____38_CM 1 0. 0. 262.14 DISPLAY_IDENTIFIER MF_PREV1_REQ ECU_ADDRESS 0x7fa9f4 BYTE_ORDER MSB_LAST /end MEASUREMENT
/begin MEASUREMENT mf_prev2_req "requested fuel mass of injection PREV2" UWORD _CNV_A_R_LINEAR_____38_CM 1 0. 0. 262.14 DISPLAY_IDENTIFIER MF_PREV2_REQ ECU_ADDRESS 0x7fa9f6 BYTE_ORDER MSB_LAST /end MEASUREMENT
/begin MEASUREMENT mf_main2_req "requested fuel mass of injection MAIN2" UWORD _CNV_A_R_LINEAR_____38_CM 1 0. 0. 262.14 DISPLAY_IDENTIFIER MF_MAIN2_REQ ECU_ADDRESS 0x7fa9f8 BYTE_ORDER MSB_LAST /end MEASUREMENT
/begin MEASUREMENT mf_post1_req "requested fuel mass of injection POST1" UWORD _CNV_A_R_LINEAR_____38_CM 1 0. 0. 262.14 DISPLAY_IDENTIFIER MF_POST1_REQ ECU_ADDRESS 0x7fa9fa BYTE_ORDER MSB_LAST /end MEASUREMENT
/begin MEASUREMENT ctr_tran_st_is_inter "intermediate counter for transition ST-IS" UBYTE _CNV_A_R_LINEAR_____0_CM 1 0. 0. 255. DISPLAY_IDENTIFIER CTR_TRAN_ST_IS_INTER ECU_ADDRESS 0x7fba3f FORMAT "%3.0" /end MEASUREMENT
/begin MEASUREMENT lv_act_prev1_inj "activation of injection PREV1" UBYTE _CNV_S_2_RANGE______11_CM 1 0. 0. 1. DISPLAY_IDENTIFIER LV_ACT_PREV1_INJ ECU_ADDRESS 0x7fba40 /end MEASUREMENT
/begin MEASUREMENT lv_act_prev2_inj "activation of injection PREV2" UBYTE _CNV_S_2_RANGE______11_CM 1 0. 0. 1. DISPLAY_IDENTIFIER LV_ACT_PREV2_INJ ECU_ADDRESS 0x7fba41 /end MEASUREMENT
/begin MEASUREMENT lv_act_main2_inj "activation of injection MAIN2" UBYTE _CNV_S_2_RANGE______11_CM 1 0. 0. 1. DISPLAY_IDENTIFIER LV_ACT_MAIN2_INJ ECU_ADDRESS 0x7fba42 /end MEASUREMENT
/begin MEASUREMENT lv_act_post1_inj "activation of injection POST1" UBYTE _CNV_S_2_RANGE______11_CM 1 0. 0. 1. DISPLAY_IDENTIFIER LV_ACT_POST1_INJ ECU_ADDRESS 0x7fba43 /end MEASUREMENT
/begin MEASUREMENT mf_post2_hys "fuel mass of injection POST2 after Hysteresis" UWORD _CNV_A_R_LINEAR_____38_CM 1 0. 0. 262.14 DISPLAY_IDENTIFIER MF_POST2_HYS ECU_ADDRESS 0x7f9d5c BYTE_ORDER MSB_LAST /end MEASUREMENT
/begin MEASUREMENT mf_prev1_hys "fuel mass of injection PREV1 after Hysteresis" UWORD _CNV_A_R_LINEAR_____38_CM 1 0. 0. 262.14 DISPLAY_IDENTIFIER MF_PREV1_HYS ECU_ADDRESS 0x7f9d5e BYTE_ORDER MSB_LAST /end MEASUREMENT
/begin MEASUREMENT mf_prev2_hys "fuel mass of injection PREV2 after Hysteresis" UWORD _CNV_A_R_LINEAR_____38_CM 1 0. 0. 262.14 DISPLAY_IDENTIFIER MF_PREV2_HYS ECU_ADDRESS 0x7f9d60 BYTE_ORDER MSB_LAST /end MEASUREMENT
/begin MEASUREMENT mf_main2_hys "fuel mass of injection MAIN2 after Hysteresis" UWORD _CNV_A_R_LINEAR_____38_CM 1 0. 0. 262.14 DISPLAY_IDENTIFIER MF_MAIN2_HYS ECU_ADDRESS 0x7f9d62 BYTE_ORDER MSB_LAST /end MEASUREMENT
/begin MEASUREMENT mf_post1_hys "fuel mass of injection POST1 after Hysteresis" UWORD _CNV_A_R_LINEAR_____38_CM 1 0. 0. 262.14 DISPLAY_IDENTIFIER MF_POST1_HYS ECU_ADDRESS 0x7f9d64 BYTE_ORDER MSB_LAST /end MEASUREMENT
/begin MEASUREMENT lv_act_prev_inj "activation of injection PREV1 or PREV2" UBYTE _CNV_S_2_RANGE______11_CM 1 0. 0. 1. DISPLAY_IDENTIFIER LV_ACT_PREV_INJ ECU_ADDRESS 0x7fba44 /end MEASUREMENT
/begin CHARACTERISTIC c_max_thd_hys "maximal threshold for minor injections fuel mass hysteresis" VALUE 0x85cacc _REC_VAL_20_u1 0.99609375 _CNV_A_R_LINEAR_____29_CM 0. 0.99609375 DISPLAY_IDENTIFIER C_MAX_THD_HYS FORMAT "%4.3" /end CHARACTERISTIC
/begin CHARACTERISTIC c_min_thd_hys "minimal threshold for minor injections fuel mass hysteresis" VALUE 0x85caf0 _REC_VAL_20_u1 0.99609375 _CNV_A_R_LINEAR_____29_CM 0. 0.99609375 DISPLAY_IDENTIFIER C_MIN_THD_HYS FORMAT "%4.3" /end CHARACTERISTIC
/begin MEASUREMENT mf_prev1_is_pl_rgn_1 "Fuel Mass of Injection PREV2 during IS/PL at rgn level 1" UWORD _CNV_A_R_LINEAR_____38_CM 1 0. 0. 262.14 DISPLAY_IDENTIFIER MF_PREV1_IS_PL_RGN_1 ECU_ADDRESS 0x7f9d42 BYTE_ORDER MSB_LAST /end MEASUREMENT
/begin MEASUREMENT mf_prev2_is_pl_rgn_1 "Fuel Mass of Injection PREV1 during IS/PL at rgn level 1" UWORD _CNV_A_R_LINEAR_____38_CM 1 0. 0. 262.14 DISPLAY_IDENTIFIER MF_PREV2_IS_PL_RGN_1 ECU_ADDRESS 0x7f9d44 BYTE_ORDER MSB_LAST /end MEASUREMENT
/begin MEASUREMENT mf_main2_is_pl_rgn_1 "Fuel Mass of Injection MAIN2 during IS/PL at rgn level 1" UWORD _CNV_A_R_LINEAR_____38_CM 1 0. 0. 262.14 DISPLAY_IDENTIFIER MF_MAIN2_IS_PL_RGN_1 ECU_ADDRESS 0x7f9d46 BYTE_ORDER MSB_LAST /end MEASUREMENT
/begin MEASUREMENT mf_post1_is_pl_rgn_1 "Fuel Mass of Injection POST1 during IS/PL at rgn level 1" UWORD _CNV_A_R_LINEAR_____38_CM 1 0. 0. 262.14 DISPLAY_IDENTIFIER MF_POST1_IS_PL_RGN_1 ECU_ADDRESS 0x7f9d48 BYTE_ORDER MSB_LAST /end MEASUREMENT
/begin MEASUREMENT mf_main2_is_pl_rgn_2 "Fuel Mass of Injection MAIN2 during IS/PL at rgn level 2" UWORD _CNV_A_R_LINEAR_____38_CM 1 0. 0. 262.14 DISPLAY_IDENTIFIER MF_MAIN2_IS_PL_RGN_2 ECU_ADDRESS 0x7f9d4e BYTE_ORDER MSB_LAST /end MEASUREMENT
/begin MEASUREMENT mf_post1_is_pl_rgn_2 "Fuel Mass of Injection POST1 during IS/PL at rgn level 2" UWORD _CNV_A_R_LINEAR_____38_CM 1 0. 0. 262.14 DISPLAY_IDENTIFIER MF_POST1_IS_PL_RGN_2 ECU_ADDRESS 0x7f9d50 BYTE_ORDER MSB_LAST /end MEASUREMENT
/begin MEASUREMENT mf_prev2_is_pl_rgn_2 "Fuel Mass of Injection PREV2 during IS/PL at rgn level 2" UWORD _CNV_A_R_LINEAR_____38_CM 1 0. 0. 262.14 DISPLAY_IDENTIFIER MF_PREV2_IS_PL_RGN_2 ECU_ADDRESS 0x7f9d4c BYTE_ORDER MSB_LAST /end MEASUREMENT
/begin MEASUREMENT mf_prev1_is_pl_rgn_2 "Fuel Mass of Injection PREV1 during IS/PL at rgn level 2" UWORD _CNV_A_R_LINEAR_____38_CM 1 0. 0. 262.14 DISPLAY_IDENTIFIER MF_PREV1_IS_PL_RGN_2 ECU_ADDRESS 0x7f9d4a BYTE_ORDER MSB_LAST /end MEASUREMENT
/begin CHARACTERISTIC ip_fac_mf_prev1_cor_amp_rgn_1 "MF_AMF_MINOR_RGN : Amp correction factor for mf Minor injection during regeneration 1 - prev1" CURVE 0x84822e _REC_CUR_20_u2_u2 0.9999874 _CNV_A_R_LINEAR_____87_CM 0. 0.9999874 DISPLAY_IDENTIFIER IP_FAC_MF_PREV1_COR_AMP_RGN_1 FORMAT "%6.5"
 /begin AXIS_DESCR COM_AXIS amp _CNV_A_R_LINEAR_____45_CM 2 0. 5434. FORMAT "%6.2" AXIS_PTS_REF ldp_amp_ip_fac_mf_prev1_cor_rgn_1 /end AXIS_DESCR
/end CHARACTERISTIC
/begin CHARACTERISTIC ip_fac_mf_prev2_cor_amp_rgn_1 "MF_AMF_MINOR_RGN : Amp correction factor for mf Minor injection during regeneration 1 - prev2" CURVE 0x848236 _REC_CUR_20_u2_u2 0.9999874 _CNV_A_R_LINEAR_____87_CM 0. 0.9999874 DISPLAY_IDENTIFIER IP_FAC_MF_PREV2_COR_AMP_RGN_1 FORMAT "%6.5"
 /begin AXIS_DESCR COM_AXIS amp _CNV_A_R_LINEAR_____45_CM 2 0. 5434. FORMAT "%6.2" AXIS_PTS_REF ldp_amp_ip_fac_mf_prev2_cor_rgn_1 /end AXIS_DESCR
/end CHARACTERISTIC
/begin CHARACTERISTIC ip_fac_mf_main2_cor_amp_rgn_1 "MF_AMF_MINOR_RGN : Amp correction factor for mf Minor injection during regeneration 1 - main2" CURVE 0x84821e _REC_CUR_20_u2_u2 0.9999874 _CNV_A_R_LINEAR_____87_CM 0. 0.9999874 DISPLAY_IDENTIFIER IP_FAC_MF_MAIN2_COR_AMP_RGN_1 FORMAT "%6.5"
 /begin AXIS_DESCR COM_AXIS amp _CNV_A_R_LINEAR_____45_CM 2 0. 5434. FORMAT "%6.2" AXIS_PTS_REF ldp_amp_ip_fac_mf_main2_cor_rgn_1 /end AXIS_DESCR
/end CHARACTERISTIC
/begin CHARACTERISTIC ip_fac_mf_post1_cor_amp_rgn_1 "MF_AMF_MINOR_RGN : Amp correction factor for mf Minor injection during regeneration 1 - post1" CURVE 0x848226 _REC_CUR_20_u2_u2 0.9999874 _CNV_A_R_LINEAR_____87_CM 0. 0.9999874 DISPLAY_IDENTIFIER IP_FAC_MF_POST1_COR_AMP_RGN_1 FORMAT "%6.5"
 /begin AXIS_DESCR COM_AXIS amp _CNV_A_R_LINEAR_____45_CM 2 0. 5434. FORMAT "%6.2" AXIS_PTS_REF ldp_amp_ip_fac_mf_post1_cor_rgn_1 /end AXIS_DESCR
/end CHARACTERISTIC
/begin AXIS_PTS ldp_amp_ip_fac_mf_prev1_cor_rgn_1 "" 0x841222 amp _REC_AXS_20_u2 5434. _CNV_A_R_LINEAR_____45_CM 2 0. 5434. FORMAT "%6.2" /end AXIS_PTS
/begin AXIS_PTS ldp_amp_ip_fac_mf_prev2_cor_rgn_1 "" 0x841232 amp _REC_AXS_20_u2 5434. _CNV_A_R_LINEAR_____45_CM 2 0. 5434. FORMAT "%6.2" /end AXIS_PTS
/begin AXIS_PTS ldp_amp_ip_fac_mf_main2_cor_rgn_1 "" 0x8411e6 amp _REC_AXS_20_u2 5434. _CNV_A_R_LINEAR_____45_CM 2 0. 5434. FORMAT "%6.2" /end AXIS_PTS
/begin AXIS_PTS ldp_amp_ip_fac_mf_post1_cor_rgn_1 "" 0x841204 amp _REC_AXS_20_u2 5434. _CNV_A_R_LINEAR_____45_CM 2 0. 5434. FORMAT "%6.2" /end AXIS_PTS
/begin CHARACTERISTIC ip_fac_mf_prev1_cor_amp_rgn_2 "MF_AMF_MINOR_RGN : Amp correction factor for mf Major injection during regeneration 2 - prev1" CURVE 0x848232 _REC_CUR_20_u2_u2 0.9999874 _CNV_A_R_LINEAR_____87_CM 0. 0.9999874 DISPLAY_IDENTIFIER IP_FAC_MF_PREV1_COR_AMP_RGN_2 FORMAT "%6.5"
 /begin AXIS_DESCR COM_AXIS amp _CNV_A_R_LINEAR_____45_CM 2 0. 5434. FORMAT "%6.2" AXIS_PTS_REF ldp_amp_ip_fac_mf_prev1_cor_rgn_2 /end AXIS_DESCR
/end CHARACTERISTIC
/begin CHARACTERISTIC ip_fac_mf_prev2_cor_amp_rgn_2 "MF_AMF_MINOR_RGN : Amp correction factor for mf Major injection during regeneration 2 - prev2" CURVE 0x84823a _REC_CUR_20_u2_u2 0.9999874 _CNV_A_R_LINEAR_____87_CM 0. 0.9999874 DISPLAY_IDENTIFIER IP_FAC_MF_PREV2_COR_AMP_RGN_2 FORMAT "%6.5"
 /begin AXIS_DESCR COM_AXIS amp _CNV_A_R_LINEAR_____45_CM 2 0. 5434. FORMAT "%6.2" AXIS_PTS_REF ldp_amp_ip_fac_mf_prev2_cor_rgn_2 /end AXIS_DESCR
/end CHARACTERISTIC
/begin CHARACTERISTIC ip_fac_mf_main2_cor_amp_rgn_2 "MF_AMF_MINOR_RGN : Amp correction factor for mf Major injection during regeneration 2 - main2" CURVE 0x848222 _REC_CUR_20_u2_u2 0.9999874 _CNV_A_R_LINEAR_____87_CM 0. 0.9999874 DISPLAY_IDENTIFIER IP_FAC_MF_MAIN2_COR_AMP_RGN_2 FORMAT "%6.5"
 /begin AXIS_DESCR COM_AXIS amp _CNV_A_R_LINEAR_____45_CM 2 0. 5434. FORMAT "%6.2" AXIS_PTS_REF ldp_amp_ip_fac_mf_main2_cor_rgn_2 /end AXIS_DESCR
/end CHARACTERISTIC
/begin CHARACTERISTIC ip_fac_mf_post1_cor_amp_rgn_2 "MF_AMF_MINOR_RGN : Amp correction factor for mf Major injection during regeneration 2 - post1" CURVE 0x84822a _REC_CUR_20_u2_u2 0.9999874 _CNV_A_R_LINEAR_____87_CM 0. 0.9999874 DISPLAY_IDENTIFIER IP_FAC_MF_POST1_COR_AMP_RGN_2 FORMAT "%6.5"
 /begin AXIS_DESCR COM_AXIS amp _CNV_A_R_LINEAR_____45_CM 2 0. 5434. FORMAT "%6.2" AXIS_PTS_REF ldp_amp_ip_fac_mf_post1_cor_rgn_2 /end AXIS_DESCR
/end CHARACTERISTIC
/begin AXIS_PTS ldp_amp_ip_fac_mf_prev1_cor_rgn_2 "" 0x841228 amp _REC_AXS_20_u2 5434. _CNV_A_R_LINEAR_____45_CM 2 0. 5434. FORMAT "%6.2" /end AXIS_PTS
/begin AXIS_PTS ldp_amp_ip_fac_mf_prev2_cor_rgn_2 "" 0x841238 amp _REC_AXS_20_u2 5434. _CNV_A_R_LINEAR_____45_CM 2 0. 5434. FORMAT "%6.2" /end AXIS_PTS
/begin AXIS_PTS ldp_amp_ip_fac_mf_main2_cor_rgn_2 "" 0x8411ec amp _REC_AXS_20_u2 5434. _CNV_A_R_LINEAR_____45_CM 2 0. 5434. FORMAT "%6.2" /end AXIS_PTS
/begin AXIS_PTS ldp_amp_ip_fac_mf_post1_cor_rgn_2 "" 0x84120a amp _REC_AXS_20_u2 5434. _CNV_A_R_LINEAR_____45_CM 2 0. 5434. FORMAT "%6.2" /end AXIS_PTS
/begin CHARACTERISTIC ip_mf_prev1_amp_h_rgn_1 "MF_AMF_MINOR_RGN : AMP correction (=1) of MF j during regeneration 1 - prev1" MAP 0x84c574 _REC_MAP_20_u2_u2_u2 262.14 _CNV_A_R_LINEAR_____38_CM 0. 262.14 DISPLAY_IDENTIFIER IP_MF_PREV1_AMP_H_RGN_1
 /begin AXIS_DESCR COM_AXIS n _CNV_A_R_LINEAR_____5_CM 12 0. 8160. FORMAT "%4.0" AXIS_PTS_REF ldpm_n_ip_mf_prev1_amp_rgn_1 /end AXIS_DESCR
 /begin AXIS_DESCR COM_AXIS tqi_sp _CNV_A_R_LINEAR_____86_CM 12 -1024. 1023.96875 FORMAT "%6.2" AXIS_PTS_REF ldpm_tqi_sp_ip_mf_prev1_amp_rgn_1 /end AXIS_DESCR
/end CHARACTERISTIC
/begin CHARACTERISTIC ip_mf_prev2_amp_h_rgn_1 "MF_AMF_MINOR_RGN : AMP correction (=1) of MF j during regeneration 1 - prev2" MAP 0x84c9f4 _REC_MAP_20_u2_u2_u2 262.14 _CNV_A_R_LINEAR_____38_CM 0. 262.14 DISPLAY_IDENTIFIER IP_MF_PREV2_AMP_H_RGN_1
 /begin AXIS_DESCR COM_AXIS n _CNV_A_R_LINEAR_____5_CM 12 0. 8160. FORMAT "%4.0" AXIS_PTS_REF ldpm_n_ip_mf_prev2_amp_rgn_1 /end AXIS_DESCR
 /begin AXIS_DESCR COM_AXIS tqi_sp _CNV_A_R_LINEAR_____86_CM 12 -1024. 1023.96875 FORMAT "%6.2" AXIS_PTS_REF ldpm_tqi_sp_ip_mf_prev2_amp_rgn_1 /end AXIS_DESCR
/end CHARACTERISTIC
/begin CHARACTERISTIC ip_mf_main2_amp_h_rgn_1 "MF_AMF_MINOR_RGN : AMP correction (=1) of MF j during regeneration 1 - main2" MAP 0x84bc74 _REC_MAP_20_u2_u2_u2 262.14 _CNV_A_R_LINEAR_____38_CM 0. 262.14 DISPLAY_IDENTIFIER IP_MF_MAIN2_AMP_H_RGN_1
 /begin AXIS_DESCR COM_AXIS n _CNV_A_R_LINEAR_____5_CM 12 0. 8160. FORMAT "%4.0" AXIS_PTS_REF ldpm_n_ip_mf_main2_amp_rgn_1 /end AXIS_DESCR
 /begin AXIS_DESCR COM_AXIS tqi_sp _CNV_A_R_LINEAR_____86_CM 12 -1024. 1023.96875 FORMAT "%6.2" AXIS_PTS_REF ldpm_tqi_sp_ip_mf_main2_amp_rgn_1 /end AXIS_DESCR
/end CHARACTERISTIC
/begin CHARACTERISTIC ip_mf_post1_amp_h_rgn_1 "MF_AMF_MINOR_RGN : AMP correction (=1) of MF j during regeneration 1 - post1" MAP 0x84c0f4 _REC_MAP_20_u2_u2_u2 262.14 _CNV_A_R_LINEAR_____38_CM 0. 262.14 DISPLAY_IDENTIFIER IP_MF_POST1_AMP_H_RGN_1
 /begin AXIS_DESCR COM_AXIS n _CNV_A_R_LINEAR_____5_CM 12 0. 8160. FORMAT "%4.0" AXIS_PTS_REF ldpm_n_ip_mf_post1_amp_rgn_1 /end AXIS_DESCR
 /begin AXIS_DESCR COM_AXIS tqi_sp _CNV_A_R_LINEAR_____86_CM 12 -1024. 1023.96875 FORMAT "%6.2" AXIS_PTS_REF ldpm_tqi_sp_ip_mf_post1_amp_rgn_1 /end AXIS_DESCR
/end CHARACTERISTIC
/begin AXIS_PTS ldpm_n_ip_mf_prev1_amp_rgn_1 "" 0x843384 n _REC_AXS_20_u2 8160. _CNV_A_R_LINEAR_____5_CM 12 0. 8160. FORMAT "%4.0" /end AXIS_PTS
/begin AXIS_PTS ldpm_n_ip_mf_prev2_amp_rgn_1 "" 0x8433b8 n _REC_AXS_20_u2 8160. _CNV_A_R_LINEAR_____5_CM 12 0. 8160. FORMAT "%4.0" /end AXIS_PTS
/begin AXIS_PTS ldpm_n_ip_mf_main2_amp_rgn_1 "" 0x8432ea n _REC_AXS_20_u2 8160. _CNV_A_R_LINEAR_____5_CM 12 0. 8160. FORMAT "%4.0" /end AXIS_PTS
/begin AXIS_PTS ldpm_n_ip_mf_post1_amp_rgn_1 "" 0x843350 n _REC_AXS_20_u2 8160. _CNV_A_R_LINEAR_____5_CM 12 0. 8160. FORMAT "%4.0" /end AXIS_PTS
/begin AXIS_PTS ldpm_tqi_sp_ip_mf_prev1_amp_rgn_1 "" 0x843d82 tqi_sp _REC_AXS_20_u2 2047.96875 _CNV_A_R_LINEAR_____86_CM 12 -1024. 1023.96875 FORMAT "%6.2" /end AXIS_PTS
/begin AXIS_PTS ldpm_tqi_sp_ip_mf_prev2_amp_rgn_1 "" 0x843db6 tqi_sp _REC_AXS_20_u2 2047.96875 _CNV_A_R_LINEAR_____86_CM 12 -1024. 1023.96875 FORMAT "%6.2" /end AXIS_PTS
/begin AXIS_PTS ldpm_tqi_sp_ip_mf_main2_amp_rgn_1 "" 0x843cf0 tqi_sp _REC_AXS_20_u2 2047.96875 _CNV_A_R_LINEAR_____86_CM 12 -1024. 1023.96875 FORMAT "%6.2" /end AXIS_PTS
/begin AXIS_PTS ldpm_tqi_sp_ip_mf_post1_amp_rgn_1 "" 0x843d4e tqi_sp _REC_AXS_20_u2 2047.96875 _CNV_A_R_LINEAR_____86_CM 12 -1024. 1023.96875 FORMAT "%6.2" /end AXIS_PTS
/begin CHARACTERISTIC ip_mf_prev1_amp_l_rgn_1 "MF_AMF_MINOR_RGN : AMP correction (= 0) of MF j during regeneration 1 - prev1" MAP 0x84c7b4 _REC_MAP_20_u2_u2_u2 262.14 _CNV_A_R_LINEAR_____38_CM 0. 262.14 DISPLAY_IDENTIFIER IP_MF_PREV1_AMP_L_RGN_1
 /begin AXIS_DESCR COM_AXIS n _CNV_A_R_LINEAR_____5_CM 12 0. 8160. FORMAT "%4.0" AXIS_PTS_REF ldpm_n_ip_mf_prev1_amp_rgn_1 /end AXIS_DESCR
 /begin AXIS_DESCR COM_AXIS tqi_sp _CNV_A_R_LINEAR_____86_CM 12 -1024. 1023.96875 FORMAT "%6.2" AXIS_PTS_REF ldpm_tqi_sp_ip_mf_prev1_amp_rgn_1 /end AXIS_DESCR
/end CHARACTERISTIC
/begin CHARACTERISTIC ip_mf_prev2_amp_l_rgn_1 "MF_AMF_MINOR_RGN : AMP correction (= 0) of MF j during regeneration 1 - prev2" MAP 0x84cc34 _REC_MAP_20_u2_u2_u2 262.14 _CNV_A_R_LINEAR_____38_CM 0. 262.14 DISPLAY_IDENTIFIER IP_MF_PREV2_AMP_L_RGN_1
 /begin AXIS_DESCR COM_AXIS n _CNV_A_R_LINEAR_____5_CM 12 0. 8160. FORMAT "%4.0" AXIS_PTS_REF ldpm_n_ip_mf_prev2_amp_rgn_1 /end AXIS_DESCR
 /begin AXIS_DESCR COM_AXIS tqi_sp _CNV_A_R_LINEAR_____86_CM 12 -1024. 1023.96875 FORMAT "%6.2" AXIS_PTS_REF ldpm_tqi_sp_ip_mf_prev2_amp_rgn_1 /end AXIS_DESCR
/end CHARACTERISTIC
/begin CHARACTERISTIC ip_mf_main2_amp_l_rgn_1 "MF_AMF_MINOR_RGN : AMP correction (= 0) of MF j during regeneration 1 - main2" MAP 0x84beb4 _REC_MAP_20_u2_u2_u2 262.14 _CNV_A_R_LINEAR_____38_CM 0. 262.14 DISPLAY_IDENTIFIER IP_MF_MAIN2_AMP_L_RGN_1
 /begin AXIS_DESCR COM_AXIS n _CNV_A_R_LINEAR_____5_CM 12 0. 8160. FORMAT "%4.0" AXIS_PTS_REF ldpm_n_ip_mf_main2_amp_rgn_1 /end AXIS_DESCR
 /begin AXIS_DESCR COM_AXIS tqi_sp _CNV_A_R_LINEAR_____86_CM 12 -1024. 1023.96875 FORMAT "%6.2" AXIS_PTS_REF ldpm_tqi_sp_ip_mf_main2_amp_rgn_1 /end AXIS_DESCR
/end CHARACTERISTIC
/begin CHARACTERISTIC ip_mf_post1_amp_l_rgn_1 "MF_AMF_MINOR_RGN : AMP correction (= 0) of MF j during regeneration 1 - post1" MAP 0x84c334 _REC_MAP_20_u2_u2_u2 262.14 _CNV_A_R_LINEAR_____38_CM 0. 262.14 DISPLAY_IDENTIFIER IP_MF_POST1_AMP_L_RGN_1
 /begin AXIS_DESCR COM_AXIS n _CNV_A_R_LINEAR_____5_CM 12 0. 8160. FORMAT "%4.0" AXIS_PTS_REF ldpm_n_ip_mf_post1_amp_rgn_1 /end AXIS_DESCR
 /begin AXIS_DESCR COM_AXIS tqi_sp _CNV_A_R_LINEAR_____86_CM 12 -1024. 1023.96875 FORMAT "%6.2" AXIS_PTS_REF ldpm_tqi_sp_ip_mf_post1_amp_rgn_1 /end AXIS_DESCR
/end CHARACTERISTIC
/begin CHARACTERISTIC ip_mf_prev1_amp_h_rgn_2 "MF_AMF_MINOR_RGN : AMP correction (=1) of MF j during regeneration 2 - prev1" MAP 0x84c694 _REC_MAP_20_u2_u2_u2 262.14 _CNV_A_R_LINEAR_____38_CM 0. 262.14 DISPLAY_IDENTIFIER IP_MF_PREV1_AMP_H_RGN_2
 /begin AXIS_DESCR COM_AXIS n _CNV_A_R_LINEAR_____5_CM 12 0. 8160. FORMAT "%4.0" AXIS_PTS_REF ldpm_n_ip_mf_prev1_amp_rgn_2 /end AXIS_DESCR
 /begin AXIS_DESCR COM_AXIS tqi_sp _CNV_A_R_LINEAR_____86_CM 12 -1024. 1023.96875 FORMAT "%6.2" AXIS_PTS_REF ldpm_tqi_sp_ip_mf_prev1_amp_rgn_2 /end AXIS_DESCR
/end CHARACTERISTIC
/begin CHARACTERISTIC ip_mf_prev2_amp_h_rgn_2 "MF_AMF_MINOR_RGN : AMP correction (=1) of MF j during regeneration 2 - prev2" MAP 0x84cb14 _REC_MAP_20_u2_u2_u2 262.14 _CNV_A_R_LINEAR_____38_CM 0. 262.14 DISPLAY_IDENTIFIER IP_MF_PREV2_AMP_H_RGN_2
 /begin AXIS_DESCR COM_AXIS n _CNV_A_R_LINEAR_____5_CM 12 0. 8160. FORMAT "%4.0" AXIS_PTS_REF ldpm_n_ip_mf_prev2_amp_rgn_2 /end AXIS_DESCR
 /begin AXIS_DESCR COM_AXIS tqi_sp _CNV_A_R_LINEAR_____86_CM 12 -1024. 1023.96875 FORMAT "%6.2" AXIS_PTS_REF ldpm_tqi_sp_ip_mf_prev2_amp_rgn_2 /end AXIS_DESCR
/end CHARACTERISTIC
/begin CHARACTERISTIC ip_mf_main2_amp_h_rgn_2 "MF_AMF_MINOR_RGN : AMP correction (=1) of MF j during regeneration 2 - main2" MAP 0x84bd94 _REC_MAP_20_u2_u2_u2 262.14 _CNV_A_R_LINEAR_____38_CM 0. 262.14 DISPLAY_IDENTIFIER IP_MF_MAIN2_AMP_H_RGN_2
 /begin AXIS_DESCR COM_AXIS n _CNV_A_R_LINEAR_____5_CM 12 0. 8160. FORMAT "%4.0" AXIS_PTS_REF ldpm_n_ip_mf_main2_amp_rgn_2 /end AXIS_DESCR
 /begin AXIS_DESCR COM_AXIS tqi_sp _CNV_A_R_LINEAR_____86_CM 12 -1024. 1023.96875 FORMAT "%6.2" AXIS_PTS_REF ldpm_tqi_sp_ip_mf_main2_amp_rgn_2 /end AXIS_DESCR
/end CHARACTERISTIC
/begin CHARACTERISTIC ip_mf_post1_amp_h_rgn_2 "MF_AMF_MINOR_RGN : AMP correction (=1) of MF j during regeneration 2 - post1" MAP 0x84c214 _REC_MAP_20_u2_u2_u2 262.14 _CNV_A_R_LINEAR_____38_CM 0. 262.14 DISPLAY_IDENTIFIER IP_MF_POST1_AMP_H_RGN_2
 /begin AXIS_DESCR COM_AXIS n _CNV_A_R_LINEAR_____5_CM 12 0. 8160. FORMAT "%4.0" AXIS_PTS_REF ldpm_n_ip_mf_post1_amp_rgn_2 /end AXIS_DESCR
 /begin AXIS_DESCR COM_AXIS tqi_sp _CNV_A_R_LINEAR_____86_CM 12 -1024. 1023.96875 FORMAT "%6.2" AXIS_PTS_REF ldpm_tqi_sp_ip_mf_post1_amp_rgn_2 /end AXIS_DESCR
/end CHARACTERISTIC
/begin AXIS_PTS ldpm_n_ip_mf_prev1_amp_rgn_2 "" 0x84339e n _REC_AXS_20_u2 8160. _CNV_A_R_LINEAR_____5_CM 12 0. 8160. FORMAT "%4.0" /end AXIS_PTS
/begin AXIS_PTS ldpm_n_ip_mf_prev2_amp_rgn_2 "" 0x8433d2 n _REC_AXS_20_u2 8160. _CNV_A_R_LINEAR_____5_CM 12 0. 8160. FORMAT "%4.0" /end AXIS_PTS
/begin AXIS_PTS ldpm_n_ip_mf_main2_amp_rgn_2 "" 0x843304 n _REC_AXS_20_u2 8160. _CNV_A_R_LINEAR_____5_CM 12 0. 8160. FORMAT "%4.0" /end AXIS_PTS
/begin AXIS_PTS ldpm_n_ip_mf_post1_amp_rgn_2 "" 0x84336a n _REC_AXS_20_u2 8160. _CNV_A_R_LINEAR_____5_CM 12 0. 8160. FORMAT "%4.0" /end AXIS_PTS
/begin AXIS_PTS ldpm_tqi_sp_ip_mf_prev1_amp_rgn_2 "" 0x843d9c tqi_sp _REC_AXS_20_u2 2047.96875 _CNV_A_R_LINEAR_____86_CM 12 -1024. 1023.96875 FORMAT "%6.2" /end AXIS_PTS
/begin AXIS_PTS ldpm_tqi_sp_ip_mf_prev2_amp_rgn_2 "" 0x843dd0 tqi_sp _REC_AXS_20_u2 2047.96875 _CNV_A_R_LINEAR_____86_CM 12 -1024. 1023.96875 FORMAT "%6.2" /end AXIS_PTS
/begin AXIS_PTS ldpm_tqi_sp_ip_mf_main2_amp_rgn_2 "" 0x843d0a tqi_sp _REC_AXS_20_u2 2047.96875 _CNV_A_R_LINEAR_____86_CM 12 -1024. 1023.96875 FORMAT "%6.2" /end AXIS_PTS
/begin AXIS_PTS ldpm_tqi_sp_ip_mf_post1_amp_rgn_2 "" 0x843d68 tqi_sp _REC_AXS_20_u2 2047.96875 _CNV_A_R_LINEAR_____86_CM 12 -1024. 1023.96875 FORMAT "%6.2" /end AXIS_PTS
/begin CHARACTERISTIC ip_mf_prev1_amp_l_rgn_2 "MF_AMF_MINOR_RGN : AMP correction (= 0) of MF j during regeneration 2 - prev1" MAP 0x84c8d4 _REC_MAP_20_u2_u2_u2 262.14 _CNV_A_R_LINEAR_____38_CM 0. 262.14 DISPLAY_IDENTIFIER IP_MF_PREV1_AMP_L_RGN_2
 /begin AXIS_DESCR COM_AXIS n _CNV_A_R_LINEAR_____5_CM 12 0. 8160. FORMAT "%4.0" AXIS_PTS_REF ldpm_n_ip_mf_prev1_amp_rgn_2 /end AXIS_DESCR
 /begin AXIS_DESCR COM_AXIS tqi_sp _CNV_A_R_LINEAR_____86_CM 12 -1024. 1023.96875 FORMAT "%6.2" AXIS_PTS_REF ldpm_tqi_sp_ip_mf_prev1_amp_rgn_2 /end AXIS_DESCR
/end CHARACTERISTIC
/begin CHARACTERISTIC ip_mf_prev2_amp_l_rgn_2 "MF_AMF_MINOR_RGN : AMP correction (= 0) of MF j during regeneration 2 - prev2" MAP 0x84cd54 _REC_MAP_20_u2_u2_u2 262.14 _CNV_A_R_LINEAR_____38_CM 0. 262.14 DISPLAY_IDENTIFIER IP_MF_PREV2_AMP_L_RGN_2
 /begin AXIS_DESCR COM_AXIS n _CNV_A_R_LINEAR_____5_CM 12 0. 8160. FORMAT "%4.0" AXIS_PTS_REF ldpm_n_ip_mf_prev2_amp_rgn_2 /end AXIS_DESCR
 /begin AXIS_DESCR COM_AXIS tqi_sp _CNV_A_R_LINEAR_____86_CM 12 -1024. 1023.96875 FORMAT "%6.2" AXIS_PTS_REF ldpm_tqi_sp_ip_mf_prev2_amp_rgn_2 /end AXIS_DESCR
/end CHARACTERISTIC
/begin CHARACTERISTIC ip_mf_main2_amp_l_rgn_2 "MF_AMF_MINOR_RGN : AMP correction (= 0) of MF j during regeneration 2 - main2" MAP 0x84bfd4 _REC_MAP_20_u2_u2_u2 262.14 _CNV_A_R_LINEAR_____38_CM 0. 262.14 DISPLAY_IDENTIFIER IP_MF_MAIN2_AMP_L_RGN_2
 /begin AXIS_DESCR COM_AXIS n _CNV_A_R_LINEAR_____5_CM 12 0. 8160. FORMAT "%4.0" AXIS_PTS_REF ldpm_n_ip_mf_main2_amp_rgn_2 /end AXIS_DESCR
 /begin AXIS_DESCR COM_AXIS tqi_sp _CNV_A_R_LINEAR_____86_CM 12 -1024. 1023.96875 FORMAT "%6.2" AXIS_PTS_REF ldpm_tqi_sp_ip_mf_main2_amp_rgn_2 /end AXIS_DESCR
/end CHARACTERISTIC
/begin CHARACTERISTIC ip_mf_post1_amp_l_rgn_2 "MF_AMF_MINOR_RGN : AMP correction (= 0) of MF j during regeneration 2 - post1" MAP 0x84c454 _REC_MAP_20_u2_u2_u2 262.14 _CNV_A_R_LINEAR_____38_CM 0. 262.14 DISPLAY_IDENTIFIER IP_MF_POST1_AMP_L_RGN_2
 /begin AXIS_DESCR COM_AXIS n _CNV_A_R_LINEAR_____5_CM 12 0. 8160. FORMAT "%4.0" AXIS_PTS_REF ldpm_n_ip_mf_post1_amp_rgn_2 /end AXIS_DESCR
 /begin AXIS_DESCR COM_AXIS tqi_sp _CNV_A_R_LINEAR_____86_CM 12 -1024. 1023.96875 FORMAT "%6.2" AXIS_PTS_REF ldpm_tqi_sp_ip_mf_post1_amp_rgn_2 /end AXIS_DESCR
/end CHARACTERISTIC
/begin MEASUREMENT mf_prev1_is_pl "fuel mass of injection PREV1 during IS/PL" UWORD _CNV_A_R_LINEAR_____38_CM 1 0. 0. 262.14 DISPLAY_IDENTIFIER MF_PREV1_IS_PL ECU_ADDRESS 0x7f9d52 BYTE_ORDER MSB_LAST /end MEASUREMENT
/begin MEASUREMENT mf_prev2_is_pl "fuel mass of injection PREV2 during IS/PL" UWORD _CNV_A_R_LINEAR_____38_CM 1 0. 0. 262.14 DISPLAY_IDENTIFIER MF_PREV2_IS_PL ECU_ADDRESS 0x7f9d54 BYTE_ORDER MSB_LAST /end MEASUREMENT
/begin MEASUREMENT mf_main2_is_pl "fuel mass of injection MAIN2 during IS/PL" UWORD _CNV_A_R_LINEAR_____38_CM 1 0. 0. 262.14 DISPLAY_IDENTIFIER MF_MAIN2_IS_PL ECU_ADDRESS 0x7f9d56 BYTE_ORDER MSB_LAST /end MEASUREMENT
/begin MEASUREMENT mf_post1_is_pl "fuel mass of injection POST1 during IS/PL" UWORD _CNV_A_R_LINEAR_____38_CM 1 0. 0. 262.14 DISPLAY_IDENTIFIER MF_POST1_IS_PL ECU_ADDRESS 0x7f9d58 BYTE_ORDER MSB_LAST /end MEASUREMENT
/begin CHARACTERISTIC c_t_rgn_trn_mf_prev1 "time constant of rgn transition of mf PREV1" VALUE 0x85cc8a _REC_VAL_20_u2 4.19424 _CNV_A_R_LINEAR_____64_CM 0. 4.19424 DISPLAY_IDENTIFIER C_T_RGN_TRN_MF_PREV1 FORMAT "%6.5" /end CHARACTERISTIC
/begin CHARACTERISTIC c_t_rgn_trn_mf_prev2 "time constant of rgn transition of mf PREV2" VALUE 0x85cc8c _REC_VAL_20_u2 4.19424 _CNV_A_R_LINEAR_____64_CM 0. 4.19424 DISPLAY_IDENTIFIER C_T_RGN_TRN_MF_PREV2 FORMAT "%6.5" /end CHARACTERISTIC
/begin CHARACTERISTIC c_t_rgn_trn_mf_main2 "time constant of rgn transition of mf MAIN2" VALUE 0x85cc86 _REC_VAL_20_u2 4.19424 _CNV_A_R_LINEAR_____64_CM 0. 4.19424 DISPLAY_IDENTIFIER C_T_RGN_TRN_MF_MAIN2 FORMAT "%6.5" /end CHARACTERISTIC
/begin CHARACTERISTIC c_t_rgn_trn_mf_post1 "time constant of rgn transition of mf POST1" VALUE 0x85cc88 _REC_VAL_20_u2 4.19424 _CNV_A_R_LINEAR_____64_CM 0. 4.19424 DISPLAY_IDENTIFIER C_T_RGN_TRN_MF_POST1 FORMAT "%6.5" /end CHARACTERISTIC
/begin MEASUREMENT mf_bas_rgl "basic fuel mass after injection configuration selection during IS/PL" UWORD _CNV_A_R_LINEAR_____399_CM 1 0. -20. 242.14 DISPLAY_IDENTIFIER MF_BAS_RGL ECU_ADDRESS 0x7f9d70 BYTE_ORDER MSB_LAST /end MEASUREMENT
/begin MEASUREMENT mf_bas_cor_sum_rgl "sum of basic fuel mass correction after injection configuration selection during IS/PL" SWORD _CNV_A_R_LINEAR_____38_CM 1 0. -131.072 131.068 DISPLAY_IDENTIFIER MF_BAS_COR_SUM_RGL ECU_ADDRESS 0x7f9d72 BYTE_ORDER MSB_LAST /end MEASUREMENT
/begin CHARACTERISTIC ip_fac_mf_bas_cor_tgas_0_0 "MF: tgas correction factor of mf_bas at inj conf 0" CURVE 0x85276e _REC_CUR_20_u2_u1 0.9999847412109381 _CNV_A_R_LINEAR_____14_CM 0. 0.9999847412109381 DISPLAY_IDENTIFIER IP_FAC_MF_BAS_COR_TGAS_0_0 FORMAT "%6.5"
 /begin AXIS_DESCR COM_AXIS tgas _CNV_A_R_LINEAR_____18_CM 8 -50. 205. FORMAT "%3.0" AXIS_PTS_REF ldp_tgas_ip_fac_mf_bas_cor_0_0 /end AXIS_DESCR
/end CHARACTERISTIC
/begin AXIS_PTS ldp_tgas_ip_fac_mf_bas_cor_0_0 "" 0x8424f4 tgas _REC_AXS_20_u1 255. _CNV_A_R_LINEAR_____18_CM 8 -50. 205. FORMAT "%3.0" /end AXIS_PTS
/begin CHARACTERISTIC ip_fac_mf_bas_cor_tgas_1_0 "MF: tgas correction factor of mf_bas at inj conf 1" CURVE 0x85277e _REC_CUR_20_u2_u1 0.9999847412109381 _CNV_A_R_LINEAR_____14_CM 0. 0.9999847412109381 DISPLAY_IDENTIFIER IP_FAC_MF_BAS_COR_TGAS_1_0 FORMAT "%6.5"
 /begin AXIS_DESCR COM_AXIS tgas _CNV_A_R_LINEAR_____18_CM 8 -50. 205. FORMAT "%3.0" AXIS_PTS_REF ldp_tgas_ip_fac_mf_bas_cor_1_0 /end AXIS_DESCR
/end CHARACTERISTIC
/begin AXIS_PTS ldp_tgas_ip_fac_mf_bas_cor_1_0 "" 0x8424fd tgas _REC_AXS_20_u1 255. _CNV_A_R_LINEAR_____18_CM 8 -50. 205. FORMAT "%3.0" /end AXIS_PTS
/begin CHARACTERISTIC ip_fac_mf_bas_cor_tgas_2_0 "MF: tgas correction factor of mf_bas at inj conf 2" CURVE 0x85278e _REC_CUR_20_u2_u1 0.9999847412109381 _CNV_A_R_LINEAR_____14_CM 0. 0.9999847412109381 DISPLAY_IDENTIFIER IP_FAC_MF_BAS_COR_TGAS_2_0 FORMAT "%6.5"
 /begin AXIS_DESCR COM_AXIS tgas _CNV_A_R_LINEAR_____18_CM 1 -50. 205. FORMAT "%3.0" AXIS_PTS_REF ldp_tgas_ip_fac_mf_bas_cor_2_0 /end AXIS_DESCR
/end CHARACTERISTIC
/begin AXIS_PTS ldp_tgas_ip_fac_mf_bas_cor_2_0 "" 0x842506 tgas _REC_AXS_20_u1 255. _CNV_A_R_LINEAR_____18_CM 1 -50. 205. FORMAT "%3.0" /end AXIS_PTS
/begin CHARACTERISTIC ip_fac_mf_bas_cor_tgas_3_0 "MF: tgas correction factor of mf_bas at inj conf 3" CURVE 0x852790 _REC_CUR_20_u2_u1 0.9999847412109381 _CNV_A_R_LINEAR_____14_CM 0. 0.9999847412109381 DISPLAY_IDENTIFIER IP_FAC_MF_BAS_COR_TGAS_3_0 FORMAT "%6.5"
 /begin AXIS_DESCR COM_AXIS tgas _CNV_A_R_LINEAR_____18_CM 1 -50. 205. FORMAT "%3.0" AXIS_PTS_REF ldp_tgas_ip_fac_mf_bas_cor_3_0 /end AXIS_DESCR
/end CHARACTERISTIC
/begin AXIS_PTS ldp_tgas_ip_fac_mf_bas_cor_3_0 "" 0x842508 tgas _REC_AXS_20_u1 255. _CNV_A_R_LINEAR_____18_CM 1 -50. 205. FORMAT "%3.0" /end AXIS_PTS
/begin CHARACTERISTIC ip_fac_mf_bas_cor_tgas_4_0 "MF: tgas correction factor of mf_bas at inj conf 4" CURVE 0x852792 _REC_CUR_20_u2_u1 0.9999847412109381 _CNV_A_R_LINEAR_____14_CM 0. 0.9999847412109381 DISPLAY_IDENTIFIER IP_FAC_MF_BAS_COR_TGAS_4_0 FORMAT "%6.5"
 /begin AXIS_DESCR COM_AXIS tgas _CNV_A_R_LINEAR_____18_CM 1 -50. 205. FORMAT "%3.0" AXIS_PTS_REF ldp_tgas_ip_fac_mf_bas_cor_4_0 /end AXIS_DESCR
/end CHARACTERISTIC
/begin AXIS_PTS ldp_tgas_ip_fac_mf_bas_cor_4_0 "" 0x84250a tgas _REC_AXS_20_u1 255. _CNV_A_R_LINEAR_____18_CM 1 -50. 205. FORMAT "%3.0" /end AXIS_PTS
/begin CHARACTERISTIC ip_fac_mf_bas_cor_amp_0_0 "MF: amp correction factor of mf_bas at inj conf 0" CURVE 0x852722 _REC_CUR_20_u2_u2 0.9999847412109381 _CNV_A_R_LINEAR_____14_CM 0. 0.9999847412109381 DISPLAY_IDENTIFIER IP_FAC_MF_BAS_COR_AMP_0_0 FORMAT "%6.5"
 /begin AXIS_DESCR COM_AXIS amp _CNV_A_R_LINEAR_____45_CM 8 0. 5434. FORMAT "%6.2" AXIS_PTS_REF ldp_amp_ip_fac_mf_cor_0_0 /end AXIS_DESCR
/end CHARACTERISTIC
/begin AXIS_PTS ldp_amp_ip_fac_mf_cor_0_0 "" 0x8411b2 amp _REC_AXS_20_u2 5434. _CNV_A_R_LINEAR_____45_CM 8 0. 5434. FORMAT "%6.2" /end AXIS_PTS
/begin CHARACTERISTIC ip_fac_mf_bas_cor_amp_1_0 "MF: amp correction factor of mf_bas at inj conf 1" CURVE 0x852732 _REC_CUR_20_u2_u2 0.9999847412109381 _CNV_A_R_LINEAR_____14_CM 0. 0.9999847412109381 DISPLAY_IDENTIFIER IP_FAC_MF_BAS_COR_AMP_1_0 FORMAT "%6.5"
 /begin AXIS_DESCR COM_AXIS amp _CNV_A_R_LINEAR_____45_CM 8 0. 5434. FORMAT "%6.2" AXIS_PTS_REF ldp_amp_ip_fac_mf_cor_1_0 /end AXIS_DESCR
/end CHARACTERISTIC
/begin AXIS_PTS ldp_amp_ip_fac_mf_cor_1_0 "" 0x8411c4 amp _REC_AXS_20_u2 5434. _CNV_A_R_LINEAR_____45_CM 8 0. 5434. FORMAT "%6.2" /end AXIS_PTS
/begin CHARACTERISTIC ip_fac_mf_bas_cor_amp_2_0 "MF: amp correction factor of mf_bas at inj conf 2" CURVE 0x852742 _REC_CUR_20_u2_u2 0.9999847412109381 _CNV_A_R_LINEAR_____14_CM 0. 0.9999847412109381 DISPLAY_IDENTIFIER IP_FAC_MF_BAS_COR_AMP_2_0 FORMAT "%6.5"
 /begin AXIS_DESCR COM_AXIS amp _CNV_A_R_LINEAR_____45_CM 1 0. 5434. FORMAT "%6.2" AXIS_PTS_REF ldp_amp_ip_fac_mf_cor_2_0 /end AXIS_DESCR
/end CHARACTERISTIC
/begin AXIS_PTS ldp_amp_ip_fac_mf_cor_2_0 "" 0x8411d6 amp _REC_AXS_20_u2 5434. _CNV_A_R_LINEAR_____45_CM 1 0. 5434. FORMAT "%6.2" /end AXIS_PTS
/begin CHARACTERISTIC ip_fac_mf_bas_cor_amp_3_0 "MF: amp correction factor of mf_bas at inj conf 3" CURVE 0x852744 _REC_CUR_20_u2_u2 0.9999847412109381 _CNV_A_R_LINEAR_____14_CM 0. 0.9999847412109381 DISPLAY_IDENTIFIER IP_FAC_MF_BAS_COR_AMP_3_0 FORMAT "%6.5"
 /begin AXIS_DESCR COM_AXIS amp _CNV_A_R_LINEAR_____45_CM 1 0. 5434. FORMAT "%6.2" AXIS_PTS_REF ldp_amp_ip_fac_mf_cor_3_0 /end AXIS_DESCR
/end CHARACTERISTIC
/begin AXIS_PTS ldp_amp_ip_fac_mf_cor_3_0 "" 0x8411da amp _REC_AXS_20_u2 5434. _CNV_A_R_LINEAR_____45_CM 1 0. 5434. FORMAT "%6.2" /end AXIS_PTS
/begin CHARACTERISTIC ip_fac_mf_bas_cor_amp_4_0 "MF: amp correction factor of mf_bas at inj conf 4" CURVE 0x852746 _REC_CUR_20_u2_u2 0.9999847412109381 _CNV_A_R_LINEAR_____14_CM 0. 0.9999847412109381 DISPLAY_IDENTIFIER IP_FAC_MF_BAS_COR_AMP_4_0 FORMAT "%6.5"
 /begin AXIS_DESCR COM_AXIS amp _CNV_A_R_LINEAR_____45_CM 1 0. 5434. FORMAT "%6.2" AXIS_PTS_REF ldp_amp_ip_fac_mf_cor_4_0 /end AXIS_DESCR
/end CHARACTERISTIC
/begin AXIS_PTS ldp_amp_ip_fac_mf_cor_4_0 "" 0x8411de amp _REC_AXS_20_u2 5434. _CNV_A_R_LINEAR_____45_CM 1 0. 5434. FORMAT "%6.2" /end AXIS_PTS
/begin CHARACTERISTIC ip_fac_mf_bas_cor_tco_0_0 "MF: mf_bas interpolation dependent on TCO for inj conf 0" CURVE 0x852748 _REC_CUR_20_u2_u1 1.9999696 _CNV_A_R_LINEAR_____48_CM 0. 1.9999696 DISPLAY_IDENTIFIER IP_FAC_MF_BAS_COR_TCO_0_0 FORMAT "%6.5"
 /begin AXIS_DESCR COM_AXIS tco _CNV_A_R_LINEAR_____18_CM 8 -50. 205. FORMAT "%3.0" AXIS_PTS_REF ldp_tco_ip_fac_mf_cor_tco_0_0 /end AXIS_DESCR
/end CHARACTERISTIC
/begin AXIS_PTS ldp_tco_ip_fac_mf_cor_tco_0_0 "" 0x8422ac tco _REC_AXS_20_u1 255. _CNV_A_R_LINEAR_____18_CM 8 -50. 205. FORMAT "%3.0" /end AXIS_PTS
/begin CHARACTERISTIC ip_fac_mf_bas_cor_tco_1_0 "MF: mf_bas interpolation dependent on TCO for inj conf 1" CURVE 0x852758 _REC_CUR_20_u2_u1 1.9999696 _CNV_A_R_LINEAR_____48_CM 0. 1.9999696 DISPLAY_IDENTIFIER IP_FAC_MF_BAS_COR_TCO_1_0 FORMAT "%6.5"
 /begin AXIS_DESCR COM_AXIS tco _CNV_A_R_LINEAR_____18_CM 8 -50. 205. FORMAT "%3.0" AXIS_PTS_REF ldp_tco_ip_fac_mf_cor_tco_1_0 /end AXIS_DESCR
/end CHARACTERISTIC
/begin AXIS_PTS ldp_tco_ip_fac_mf_cor_tco_1_0 "" 0x8422b5 tco _REC_AXS_20_u1 255. _CNV_A_R_LINEAR_____18_CM 8 -50. 205. FORMAT "%3.0" /end AXIS_PTS
/begin CHARACTERISTIC ip_fac_mf_bas_cor_tco_2_0 "MF: mf_bas interpolation dependent on TCO for inj conf 2" CURVE 0x852768 _REC_CUR_20_u2_u1 1.9999696 _CNV_A_R_LINEAR_____48_CM 0. 1.9999696 DISPLAY_IDENTIFIER IP_FAC_MF_BAS_COR_TCO_2_0 FORMAT "%6.5"
 /begin AXIS_DESCR COM_AXIS tco _CNV_A_R_LINEAR_____18_CM 1 -50. 205. FORMAT "%3.0" AXIS_PTS_REF ldp_tco_ip_fac_mf_cor_tco_2_0 /end AXIS_DESCR
/end CHARACTERISTIC
/begin AXIS_PTS ldp_tco_ip_fac_mf_cor_tco_2_0 "" 0x8422be tco _REC_AXS_20_u1 255. _CNV_A_R_LINEAR_____18_CM 1 -50. 205. FORMAT "%3.0" /end AXIS_PTS
/begin CHARACTERISTIC ip_fac_mf_bas_cor_tco_3_0 "MF: mf_bas interpolation dependent on TCO for inj conf 3" CURVE 0x85276a _REC_CUR_20_u2_u1 1.9999696 _CNV_A_R_LINEAR_____48_CM 0. 1.9999696 DISPLAY_IDENTIFIER IP_FAC_MF_BAS_COR_TCO_3_0 FORMAT "%6.5"
 /begin AXIS_DESCR COM_AXIS tco _CNV_A_R_LINEAR_____18_CM 1 -50. 205. FORMAT "%3.0" AXIS_PTS_REF ldp_tco_ip_fac_mf_cor_tco_3_0 /end AXIS_DESCR
/end CHARACTERISTIC
/begin AXIS_PTS ldp_tco_ip_fac_mf_cor_tco_3_0 "" 0x8422c0 tco _REC_AXS_20_u1 255. _CNV_A_R_LINEAR_____18_CM 1 -50. 205. FORMAT "%3.0" /end AXIS_PTS
/begin CHARACTERISTIC ip_fac_mf_bas_cor_tco_4_0 "MF: mf_bas interpolation dependent on TCO for inj conf 4" CURVE 0x85276c _REC_CUR_20_u2_u1 1.9999696 _CNV_A_R_LINEAR_____48_CM 0. 1.9999696 DISPLAY_IDENTIFIER IP_FAC_MF_BAS_COR_TCO_4_0 FORMAT "%6.5"
 /begin AXIS_DESCR COM_AXIS tco _CNV_A_R_LINEAR_____18_CM 1 -50. 205. FORMAT "%3.0" AXIS_PTS_REF ldp_tco_ip_fac_mf_cor_tco_4_0 /end AXIS_DESCR
/end CHARACTERISTIC
/begin AXIS_PTS ldp_tco_ip_fac_mf_cor_tco_4_0 "" 0x8422c2 tco _REC_AXS_20_u1 255. _CNV_A_R_LINEAR_____18_CM 1 -50. 205. FORMAT "%3.0" /end AXIS_PTS
/begin CHARACTERISTIC ip_mf_bas_tgas_0_0 "MF: tgas correction of mf_bas at inj conf 0" MAP 0x856ac6 _REC_MAP_20_u2_u2_u2 262.14 _CNV_A_R_LINEAR_____131_CM -131.072 131.068 DISPLAY_IDENTIFIER IP_MF_BAS_TGAS_0_0
 /begin AXIS_DESCR COM_AXIS n _CNV_A_R_LINEAR_____5_CM 8 0. 6375. FORMAT "%4.0" AXIS_PTS_REF ldp_n_ip_mf_bas_tgas_0_0 /end AXIS_DESCR
 /begin AXIS_DESCR COM_AXIS tqi_sp _CNV_A_R_LINEAR_____86_CM 8 -1024. 1023.96875 FORMAT "%6.2" AXIS_PTS_REF ldp_tqi_sp_ip_mf_tgas_0_0 /end AXIS_DESCR
/end CHARACTERISTIC
/begin AXIS_PTS ldp_n_ip_mf_bas_tgas_0_0 "" 0x841c20 n _REC_AXS_20_u2 6375. _CNV_A_R_LINEAR_____5_CM 8 0. 6375. FORMAT "%4.0" /end AXIS_PTS
/begin AXIS_PTS ldp_tqi_sp_ip_mf_tgas_0_0 "" 0x84288c tqi_sp _REC_AXS_20_u2 2047.96875 _CNV_A_R_LINEAR_____86_CM 8 -1024. 1023.96875 FORMAT "%6.2" /end AXIS_PTS
/begin CHARACTERISTIC ip_mf_bas_tgas_1_0 "MF: tgas correction of mf_bas at inj conf 1" MAP 0x856b46 _REC_MAP_20_u2_u2_u2 262.14 _CNV_A_R_LINEAR_____131_CM -131.072 131.068 DISPLAY_IDENTIFIER IP_MF_BAS_TGAS_1_0
 /begin AXIS_DESCR COM_AXIS n _CNV_A_R_LINEAR_____5_CM 8 0. 6375. FORMAT "%4.0" AXIS_PTS_REF ldp_n_ip_mf_bas_tgas_1_0 /end AXIS_DESCR
 /begin AXIS_DESCR COM_AXIS tqi_sp _CNV_A_R_LINEAR_____86_CM 8 -1024. 1023.96875 FORMAT "%6.2" AXIS_PTS_REF ldp_tqi_sp_ip_mf_tgas_1_0 /end AXIS_DESCR
/end CHARACTERISTIC
/begin AXIS_PTS ldp_n_ip_mf_bas_tgas_1_0 "" 0x841c32 n _REC_AXS_20_u2 6375. _CNV_A_R_LINEAR_____5_CM 8 0. 6375. FORMAT "%4.0" /end AXIS_PTS
/begin AXIS_PTS ldp_tqi_sp_ip_mf_tgas_1_0 "" 0x84289e tqi_sp _REC_AXS_20_u2 2047.96875 _CNV_A_R_LINEAR_____86_CM 8 -1024. 1023.96875 FORMAT "%6.2" /end AXIS_PTS
/begin CHARACTERISTIC ip_mf_bas_tgas_2_0 "MF: tgas correction of mf_bas at inj conf 2" MAP 0x856bc6 _REC_MAP_20_u2_u2_u2 262.14 _CNV_A_R_LINEAR_____131_CM -131.072 131.068 DISPLAY_IDENTIFIER IP_MF_BAS_TGAS_2_0
 /begin AXIS_DESCR COM_AXIS n _CNV_A_R_LINEAR_____5_CM 1 0. 6375. FORMAT "%4.0" AXIS_PTS_REF ldp_n_ip_mf_bas_tgas_2_0 /end AXIS_DESCR
 /begin AXIS_DESCR COM_AXIS tqi_sp _CNV_A_R_LINEAR_____86_CM 1 -1024. 1023.96875 FORMAT "%6.2" AXIS_PTS_REF ldp_tqi_sp_ip_mf_tgas_2_0 /end AXIS_DESCR
/end CHARACTERISTIC
/begin AXIS_PTS ldp_n_ip_mf_bas_tgas_2_0 "" 0x841c44 n _REC_AXS_20_u2 6375. _CNV_A_R_LINEAR_____5_CM 1 0. 6375. FORMAT "%4.0" /end AXIS_PTS
/begin AXIS_PTS ldp_tqi_sp_ip_mf_tgas_2_0 "" 0x8428b0 tqi_sp _REC_AXS_20_u2 2047.96875 _CNV_A_R_LINEAR_____86_CM 1 -1024. 1023.96875 FORMAT "%6.2" /end AXIS_PTS
/begin CHARACTERISTIC ip_mf_bas_tgas_3_0 "MF: tgas correction of mf_bas at inj conf 3" MAP 0x856bc8 _REC_MAP_20_u2_u2_u2 262.14 _CNV_A_R_LINEAR_____131_CM -131.072 131.068 DISPLAY_IDENTIFIER IP_MF_BAS_TGAS_3_0
 /begin AXIS_DESCR COM_AXIS n _CNV_A_R_LINEAR_____5_CM 1 0. 6375. FORMAT "%4.0" AXIS_PTS_REF ldp_n_ip_mf_bas_tgas_3_0 /end AXIS_DESCR
 /begin AXIS_DESCR COM_AXIS tqi_sp _CNV_A_R_LINEAR_____86_CM 1 -1024. 1023.96875 FORMAT "%6.2" AXIS_PTS_REF ldp_tqi_sp_ip_mf_tgas_3_0 /end AXIS_DESCR
/end CHARACTERISTIC
/begin AXIS_PTS ldp_n_ip_mf_bas_tgas_3_0 "" 0x841c48 n _REC_AXS_20_u2 6375. _CNV_A_R_LINEAR_____5_CM 1 0. 6375. FORMAT "%4.0" /end AXIS_PTS
/begin AXIS_PTS ldp_tqi_sp_ip_mf_tgas_3_0 "" 0x8428b4 tqi_sp _REC_AXS_20_u2 2047.96875 _CNV_A_R_LINEAR_____86_CM 1 -1024. 1023.96875 FORMAT "%6.2" /end AXIS_PTS
/begin CHARACTERISTIC ip_mf_bas_tgas_4_0 "MF: tgas correction of mf_bas at inj conf 4" MAP 0x856bca _REC_MAP_20_u2_u2_u2 262.14 _CNV_A_R_LINEAR_____131_CM -131.072 131.068 DISPLAY_IDENTIFIER IP_MF_BAS_TGAS_4_0
 /begin AXIS_DESCR COM_AXIS n _CNV_A_R_LINEAR_____5_CM 1 0. 6375. FORMAT "%4.0" AXIS_PTS_REF ldp_n_ip_mf_bas_tgas_4_0 /end AXIS_DESCR
 /begin AXIS_DESCR COM_AXIS tqi_sp _CNV_A_R_LINEAR_____86_CM 1 -1024. 1023.96875 FORMAT "%6.2" AXIS_PTS_REF ldp_tqi_sp_ip_mf_tgas_4_0 /end AXIS_DESCR
/end CHARACTERISTIC
/begin AXIS_PTS ldp_n_ip_mf_bas_tgas_4_0 "" 0x841c4c n _REC_AXS_20_u2 6375. _CNV_A_R_LINEAR_____5_CM 1 0. 6375. FORMAT "%4.0" /end AXIS_PTS
/begin AXIS_PTS ldp_tqi_sp_ip_mf_tgas_4_0 "" 0x8428b8 tqi_sp _REC_AXS_20_u2 2047.96875 _CNV_A_R_LINEAR_____86_CM 1 -1024. 1023.96875 FORMAT "%6.2" /end AXIS_PTS
/begin CHARACTERISTIC ip_mf_bas_amp_0_0 "MF: amp correction of mf_bas at inj conf 0" MAP 0x8568c0 _REC_MAP_20_u2_u2_u2 262.14 _CNV_A_R_LINEAR_____131_CM -131.072 131.068 DISPLAY_IDENTIFIER IP_MF_BAS_AMP_0_0
 /begin AXIS_DESCR COM_AXIS n _CNV_A_R_LINEAR_____5_CM 8 0. 6375. FORMAT "%4.0" AXIS_PTS_REF ldp_n_ip_mf_bas_amp_0_0 /end AXIS_DESCR
 /begin AXIS_DESCR COM_AXIS tqi_sp _CNV_A_R_LINEAR_____86_CM 16 -1024. 1023.96875 FORMAT "%6.2" AXIS_PTS_REF ldp_tqi_sp_ip_mf_bas_amp_0_0 /end AXIS_DESCR
/end CHARACTERISTIC
/begin AXIS_PTS ldp_n_ip_mf_bas_amp_0_0 "" 0x841bf0 n _REC_AXS_20_u2 6375. _CNV_A_R_LINEAR_____5_CM 8 0. 6375. FORMAT "%4.0" /end AXIS_PTS
/begin AXIS_PTS ldp_tqi_sp_ip_mf_bas_amp_0_0 "" 0x8427c2 tqi_sp _REC_AXS_20_u2 2047.96875 _CNV_A_R_LINEAR_____86_CM 16 -1024. 1023.96875 FORMAT "%6.2" /end AXIS_PTS
/begin CHARACTERISTIC ip_mf_bas_amp_1_0 "MF: amp correction of mf_bas at inj conf 1" MAP 0x8569c0 _REC_MAP_20_u2_u2_u2 262.14 _CNV_A_R_LINEAR_____131_CM -131.072 131.068 DISPLAY_IDENTIFIER IP_MF_BAS_AMP_1_0
 /begin AXIS_DESCR COM_AXIS n _CNV_A_R_LINEAR_____5_CM 8 0. 6375. FORMAT "%4.0" AXIS_PTS_REF ldp_n_ip_mf_bas_amp_1_0 /end AXIS_DESCR
 /begin AXIS_DESCR COM_AXIS tqi_sp _CNV_A_R_LINEAR_____86_CM 16 -1024. 1023.96875 FORMAT "%6.2" AXIS_PTS_REF ldp_tqi_sp_ip_mf_bas_amp_1_0 /end AXIS_DESCR
/end CHARACTERISTIC
/begin AXIS_PTS ldp_n_ip_mf_bas_amp_1_0 "" 0x841c02 n _REC_AXS_20_u2 6375. _CNV_A_R_LINEAR_____5_CM 8 0. 6375. FORMAT "%4.0" /end AXIS_PTS
/begin AXIS_PTS ldp_tqi_sp_ip_mf_bas_amp_1_0 "" 0x8427e4 tqi_sp _REC_AXS_20_u2 2047.96875 _CNV_A_R_LINEAR_____86_CM 16 -1024. 1023.96875 FORMAT "%6.2" /end AXIS_PTS
/begin CHARACTERISTIC ip_mf_bas_amp_2_0 "MF: amp correction of mf_bas at inj conf 2" MAP 0x856ac0 _REC_MAP_20_u2_u2_u2 262.14 _CNV_A_R_LINEAR_____131_CM -131.072 131.068 DISPLAY_IDENTIFIER IP_MF_BAS_AMP_2_0
 /begin AXIS_DESCR COM_AXIS n _CNV_A_R_LINEAR_____5_CM 1 0. 6375. FORMAT "%4.0" AXIS_PTS_REF ldp_n_ip_mf_bas_amp_2_0 /end AXIS_DESCR
 /begin AXIS_DESCR COM_AXIS tqi_sp _CNV_A_R_LINEAR_____86_CM 1 -1024. 1023.96875 FORMAT "%6.2" AXIS_PTS_REF ldp_tqi_sp_ip_mf_bas_amp_2_0 /end AXIS_DESCR
/end CHARACTERISTIC
/begin AXIS_PTS ldp_n_ip_mf_bas_amp_2_0 "" 0x841c14 n _REC_AXS_20_u2 6375. _CNV_A_R_LINEAR_____5_CM 1 0. 6375. FORMAT "%4.0" /end AXIS_PTS
/begin AXIS_PTS ldp_tqi_sp_ip_mf_bas_amp_2_0 "" 0x842806 tqi_sp _REC_AXS_20_u2 2047.96875 _CNV_A_R_LINEAR_____86_CM 1 -1024. 1023.96875 FORMAT "%6.2" /end AXIS_PTS
/begin CHARACTERISTIC ip_mf_bas_amp_3_0 "MF: amp correction of mf_bas at inj conf 3" MAP 0x856ac2 _REC_MAP_20_u2_u2_u2 262.14 _CNV_A_R_LINEAR_____131_CM -131.072 131.068 DISPLAY_IDENTIFIER IP_MF_BAS_AMP_3_0
 /begin AXIS_DESCR COM_AXIS n _CNV_A_R_LINEAR_____5_CM 1 0. 6375. FORMAT "%4.0" AXIS_PTS_REF ldp_n_ip_mf_bas_amp_3_0 /end AXIS_DESCR
 /begin AXIS_DESCR COM_AXIS tqi_sp _CNV_A_R_LINEAR_____86_CM 1 -1024. 1023.96875 FORMAT "%6.2" AXIS_PTS_REF ldp_tqi_sp_ip_mf_bas_amp_3_0 /end AXIS_DESCR
/end CHARACTERISTIC
/begin AXIS_PTS ldp_n_ip_mf_bas_amp_3_0 "" 0x841c18 n _REC_AXS_20_u2 6375. _CNV_A_R_LINEAR_____5_CM 1 0. 6375. FORMAT "%4.0" /end AXIS_PTS
/begin AXIS_PTS ldp_tqi_sp_ip_mf_bas_amp_3_0 "" 0x84280a tqi_sp _REC_AXS_20_u2 2047.96875 _CNV_A_R_LINEAR_____86_CM 1 -1024. 1023.96875 FORMAT "%6.2" /end AXIS_PTS
/begin CHARACTERISTIC ip_mf_bas_amp_4_0 "MF: amp correction of mf_bas at inj conf 4" MAP 0x856ac4 _REC_MAP_20_u2_u2_u2 262.14 _CNV_A_R_LINEAR_____131_CM -131.072 131.068 DISPLAY_IDENTIFIER IP_MF_BAS_AMP_4_0
 /begin AXIS_DESCR COM_AXIS n _CNV_A_R_LINEAR_____5_CM 1 0. 6375. FORMAT "%4.0" AXIS_PTS_REF ldp_n_ip_mf_bas_amp_4_0 /end AXIS_DESCR
 /begin AXIS_DESCR COM_AXIS tqi_sp _CNV_A_R_LINEAR_____86_CM 1 -1024. 1023.96875 FORMAT "%6.2" AXIS_PTS_REF ldp_tqi_sp_ip_mf_bas_amp_4_0 /end AXIS_DESCR
/end CHARACTERISTIC
/begin AXIS_PTS ldp_n_ip_mf_bas_amp_4_0 "" 0x841c1c n _REC_AXS_20_u2 6375. _CNV_A_R_LINEAR_____5_CM 1 0. 6375. FORMAT "%4.0" /end AXIS_PTS
/begin AXIS_PTS ldp_tqi_sp_ip_mf_bas_amp_4_0 "" 0x84280e tqi_sp _REC_AXS_20_u2 2047.96875 _CNV_A_R_LINEAR_____86_CM 1 -1024. 1023.96875 FORMAT "%6.2" /end AXIS_PTS
/begin CHARACTERISTIC ip_mf_bas_0_0 "MF: mf_bas at inj conf 0 and temp level 0" MAP 0x8550ba _REC_MAP_20_u2_u2_u2 262.14 _CNV_A_R_LINEAR_____399_CM -20. 242.14 DISPLAY_IDENTIFIER IP_MF_BAS_0_0
 /begin AXIS_DESCR COM_AXIS n _CNV_A_R_LINEAR_____5_CM 16 0. 6375. FORMAT "%4.0" AXIS_PTS_REF ldpm_n_1_ip_mf_bas_0_0 /end AXIS_DESCR
 /begin AXIS_DESCR COM_AXIS tqi_sp _CNV_A_R_LINEAR_____86_CM 16 -1024. 1023.96875 FORMAT "%6.2" AXIS_PTS_REF ldpm_tqi_sp_1_ip_mf_bas_0_0 /end AXIS_DESCR
/end CHARACTERISTIC
/begin CHARACTERISTIC ip_mf_bas_0_1 "MF: mf_bas at inj conf 0 and temp level 1" MAP 0x8552ba _REC_MAP_20_u2_u2_u2 262.14 _CNV_A_R_LINEAR_____399_CM -20. 242.14 DISPLAY_IDENTIFIER IP_MF_BAS_0_1
 /begin AXIS_DESCR COM_AXIS n _CNV_A_R_LINEAR_____5_CM 16 0. 6375. FORMAT "%4.0" AXIS_PTS_REF ldpm_n_1_ip_mf_bas_0_0 /end AXIS_DESCR
 /begin AXIS_DESCR COM_AXIS tqi_sp _CNV_A_R_LINEAR_____86_CM 16 -1024. 1023.96875 FORMAT "%6.2" AXIS_PTS_REF ldpm_tqi_sp_1_ip_mf_bas_0_0 /end AXIS_DESCR
/end CHARACTERISTIC
/begin CHARACTERISTIC ip_mf_bas_0_2 "MF: mf_bas at inj conf 0 and temp level 2" MAP 0x8554ba _REC_MAP_20_u2_u2_u2 262.14 _CNV_A_R_LINEAR_____399_CM -20. 242.14 DISPLAY_IDENTIFIER IP_MF_BAS_0_2
 /begin AXIS_DESCR COM_AXIS n _CNV_A_R_LINEAR_____5_CM 16 0. 6375. FORMAT "%4.0" AXIS_PTS_REF ldpm_n_1_ip_mf_bas_0_0 /end AXIS_DESCR
 /begin AXIS_DESCR COM_AXIS tqi_sp _CNV_A_R_LINEAR_____86_CM 16 -1024. 1023.96875 FORMAT "%6.2" AXIS_PTS_REF ldpm_tqi_sp_1_ip_mf_bas_0_0 /end AXIS_DESCR
/end CHARACTERISTIC
/begin CHARACTERISTIC ip_mf_bas_1_0 "MF: mf_bas at inj conf 1 and temp level 0" MAP 0x8556ba _REC_MAP_20_u2_u2_u2 262.14 _CNV_A_R_LINEAR_____399_CM -20. 242.14 DISPLAY_IDENTIFIER IP_MF_BAS_1_0
 /begin AXIS_DESCR COM_AXIS n _CNV_A_R_LINEAR_____5_CM 16 0. 6375. FORMAT "%4.0" AXIS_PTS_REF ldpm_n_1_ip_mf_bas_1_0 /end AXIS_DESCR
 /begin AXIS_DESCR COM_AXIS tqi_sp _CNV_A_R_LINEAR_____86_CM 16 -1024. 1023.96875 FORMAT "%6.2" AXIS_PTS_REF ldpm_tqi_sp_1_ip_mf_bas_1_0 /end AXIS_DESCR
/end CHARACTERISTIC
/begin CHARACTERISTIC ip_mf_bas_1_1 "MF: mf_bas at inj conf 1 and temp level 1" MAP 0x8558ba _REC_MAP_20_u2_u2_u2 262.14 _CNV_A_R_LINEAR_____399_CM -20. 242.14 DISPLAY_IDENTIFIER IP_MF_BAS_1_1
 /begin AXIS_DESCR COM_AXIS n _CNV_A_R_LINEAR_____5_CM 16 0. 6375. FORMAT "%4.0" AXIS_PTS_REF ldpm_n_1_ip_mf_bas_1_0 /end AXIS_DESCR
 /begin AXIS_DESCR COM_AXIS tqi_sp _CNV_A_R_LINEAR_____86_CM 16 -1024. 1023.96875 FORMAT "%6.2" AXIS_PTS_REF ldpm_tqi_sp_1_ip_mf_bas_1_0 /end AXIS_DESCR
/end CHARACTERISTIC
/begin CHARACTERISTIC ip_mf_bas_1_2 "MF: mf_bas at inj conf 1 and temp level 2" MAP 0x855aba _REC_MAP_20_u2_u2_u2 262.14 _CNV_A_R_LINEAR_____399_CM -20. 242.14 DISPLAY_IDENTIFIER IP_MF_BAS_1_2
 /begin AXIS_DESCR COM_AXIS n _CNV_A_R_LINEAR_____5_CM 16 0. 6375. FORMAT "%4.0" AXIS_PTS_REF ldpm_n_1_ip_mf_bas_1_0 /end AXIS_DESCR
 /begin AXIS_DESCR COM_AXIS tqi_sp _CNV_A_R_LINEAR_____86_CM 16 -1024. 1023.96875 FORMAT "%6.2" AXIS_PTS_REF ldpm_tqi_sp_1_ip_mf_bas_1_0 /end AXIS_DESCR
/end CHARACTERISTIC
/begin CHARACTERISTIC ip_mf_bas_2_0 "MF: mf_bas at inj conf 2 and temp level 0" MAP 0x855cba _REC_MAP_20_u2_u2_u2 262.14 _CNV_A_R_LINEAR_____399_CM -20. 242.14 DISPLAY_IDENTIFIER IP_MF_BAS_2_0
 /begin AXIS_DESCR COM_AXIS n _CNV_A_R_LINEAR_____5_CM 16 0. 6375. FORMAT "%4.0" AXIS_PTS_REF ldpm_n_1_ip_mf_bas_2_0 /end AXIS_DESCR
 /begin AXIS_DESCR COM_AXIS tqi_sp _CNV_A_R_LINEAR_____86_CM 16 -1024. 1023.96875 FORMAT "%6.2" AXIS_PTS_REF ldpm_tqi_sp_1_ip_mf_bas_2_0 /end AXIS_DESCR
/end CHARACTERISTIC
/begin CHARACTERISTIC ip_mf_bas_2_1 "MF: mf_bas at inj conf 2 and temp level 1" MAP 0x855eba _REC_MAP_20_u2_u2_u2 262.14 _CNV_A_R_LINEAR_____399_CM -20. 242.14 DISPLAY_IDENTIFIER IP_MF_BAS_2_1
 /begin AXIS_DESCR COM_AXIS n _CNV_A_R_LINEAR_____5_CM 16 0. 6375. FORMAT "%4.0" AXIS_PTS_REF ldpm_n_1_ip_mf_bas_2_0 /end AXIS_DESCR
 /begin AXIS_DESCR COM_AXIS tqi_sp _CNV_A_R_LINEAR_____86_CM 16 -1024. 1023.96875 FORMAT "%6.2" AXIS_PTS_REF ldpm_tqi_sp_1_ip_mf_bas_2_0 /end AXIS_DESCR
/end CHARACTERISTIC
/begin CHARACTERISTIC ip_mf_bas_2_2 "MF: mf_bas at inj conf 2 and temp level 2" MAP 0x8560ba _REC_MAP_20_u2_u2_u2 262.14 _CNV_A_R_LINEAR_____399_CM -20. 242.14 DISPLAY_IDENTIFIER IP_MF_BAS_2_2
 /begin AXIS_DESCR COM_AXIS n _CNV_A_R_LINEAR_____5_CM 1 0. 6375. FORMAT "%4.0" AXIS_PTS_REF ldp_n_1_ip_mf_bas_2_0_x /end AXIS_DESCR
 /begin AXIS_DESCR COM_AXIS tqi_sp _CNV_A_R_LINEAR_____86_CM 1 -1024. 1023.96875 FORMAT "%6.2" AXIS_PTS_REF ldp_tqi_sp_1_ip_mf_bas_2_0_x /end AXIS_DESCR
/end CHARACTERISTIC
/begin CHARACTERISTIC ip_mf_bas_3_0 "MF: mf_bas at inj conf 3 and temp level 0" MAP 0x8560bc _REC_MAP_20_u2_u2_u2 262.14 _CNV_A_R_LINEAR_____399_CM -20. 242.14 DISPLAY_IDENTIFIER IP_MF_BAS_3_0
 /begin AXIS_DESCR COM_AXIS n _CNV_A_R_LINEAR_____5_CM 16 0. 6375. FORMAT "%4.0" AXIS_PTS_REF ldpm_n_1_ip_mf_bas_3_0 /end AXIS_DESCR
 /begin AXIS_DESCR COM_AXIS tqi_sp _CNV_A_R_LINEAR_____86_CM 16 -1024. 1023.96875 FORMAT "%6.2" AXIS_PTS_REF ldpm_tqi_sp_1_ip_mf_bas_3_0 /end AXIS_DESCR
/end CHARACTERISTIC
/begin CHARACTERISTIC ip_mf_bas_3_1 "MF: mf_bas at inj conf 3 and temp level 1" MAP 0x8562bc _REC_MAP_20_u2_u2_u2 262.14 _CNV_A_R_LINEAR_____399_CM -20. 242.14 DISPLAY_IDENTIFIER IP_MF_BAS_3_1
 /begin AXIS_DESCR COM_AXIS n _CNV_A_R_LINEAR_____5_CM 16 0. 6375. FORMAT "%4.0" AXIS_PTS_REF ldpm_n_1_ip_mf_bas_3_0 /end AXIS_DESCR
 /begin AXIS_DESCR COM_AXIS tqi_sp _CNV_A_R_LINEAR_____86_CM 16 -1024. 1023.96875 FORMAT "%6.2" AXIS_PTS_REF ldpm_tqi_sp_1_ip_mf_bas_3_0 /end AXIS_DESCR
/end CHARACTERISTIC
/begin CHARACTERISTIC ip_mf_bas_3_2 "MF: mf_bas at inj conf 3 and temp level 2" MAP 0x8564bc _REC_MAP_20_u2_u2_u2 262.14 _CNV_A_R_LINEAR_____399_CM -20. 242.14 DISPLAY_IDENTIFIER IP_MF_BAS_3_2
 /begin AXIS_DESCR COM_AXIS n _CNV_A_R_LINEAR_____5_CM 1 0. 6375. FORMAT "%4.0" AXIS_PTS_REF ldp_n_1_ip_mf_bas_3_0_x /end AXIS_DESCR
 /begin AXIS_DESCR COM_AXIS tqi_sp _CNV_A_R_LINEAR_____86_CM 1 -1024. 1023.96875 FORMAT "%6.2" AXIS_PTS_REF ldp_tqi_sp_1_ip_mf_bas_3_0_x /end AXIS_DESCR
/end CHARACTERISTIC
/begin CHARACTERISTIC ip_mf_bas_4_0 "MF: mf_bas at inj conf 4 and temp level 0" MAP 0x8564be _REC_MAP_20_u2_u2_u2 262.14 _CNV_A_R_LINEAR_____399_CM -20. 242.14 DISPLAY_IDENTIFIER IP_MF_BAS_4_0
 /begin AXIS_DESCR COM_AXIS n _CNV_A_R_LINEAR_____5_CM 16 0. 6375. FORMAT "%4.0" AXIS_PTS_REF ldpm_n_1_ip_mf_bas_4_0 /end AXIS_DESCR
 /begin AXIS_DESCR COM_AXIS tqi_sp _CNV_A_R_LINEAR_____86_CM 16 -1024. 1023.96875 FORMAT "%6.2" AXIS_PTS_REF ldpm_tqi_sp_1_ip_mf_bas_4_0 /end AXIS_DESCR
/end CHARACTERISTIC
/begin CHARACTERISTIC ip_mf_bas_4_1 "MF: mf_bas at inj conf 4 and temp level 1" MAP 0x8566be _REC_MAP_20_u2_u2_u2 262.14 _CNV_A_R_LINEAR_____399_CM -20. 242.14 DISPLAY_IDENTIFIER IP_MF_BAS_4_1
 /begin AXIS_DESCR COM_AXIS n _CNV_A_R_LINEAR_____5_CM 16 0. 6375. FORMAT "%4.0" AXIS_PTS_REF ldpm_n_1_ip_mf_bas_4_0 /end AXIS_DESCR
 /begin AXIS_DESCR COM_AXIS tqi_sp _CNV_A_R_LINEAR_____86_CM 16 -1024. 1023.96875 FORMAT "%6.2" AXIS_PTS_REF ldpm_tqi_sp_1_ip_mf_bas_4_0 /end AXIS_DESCR
/end CHARACTERISTIC
/begin CHARACTERISTIC ip_mf_bas_4_2 "MF: mf_bas at inj conf 4 and temp level 2" MAP 0x8568be _REC_MAP_20_u2_u2_u2 262.14 _CNV_A_R_LINEAR_____399_CM -20. 242.14 DISPLAY_IDENTIFIER IP_MF_BAS_4_2
 /begin AXIS_DESCR COM_AXIS n _CNV_A_R_LINEAR_____5_CM 1 0. 6375. FORMAT "%4.0" AXIS_PTS_REF ldp_n_1_ip_mf_bas_4_0_x /end AXIS_DESCR
 /begin AXIS_DESCR COM_AXIS tqi_sp _CNV_A_R_LINEAR_____86_CM 1 -1024. 1023.96875 FORMAT "%6.2" AXIS_PTS_REF ldp_tqi_sp_1_ip_mf_bas_4_0_x /end AXIS_DESCR
/end CHARACTERISTIC
/begin AXIS_PTS ldpm_n_1_ip_mf_bas_0_0 "" 0x842cd4 n _REC_AXS_20_u2 6375. _CNV_A_R_LINEAR_____5_CM 16 0. 6375. FORMAT "%4.0" /end AXIS_PTS
/begin AXIS_PTS ldpm_tqi_sp_1_ip_mf_bas_0_0 "" 0x843ac4 tqi_sp _REC_AXS_20_u2 2047.96875 _CNV_A_R_LINEAR_____86_CM 16 -1024. 1023.96875 FORMAT "%6.2" /end AXIS_PTS
/begin AXIS_PTS ldpm_n_1_ip_mf_bas_1_0 "" 0x842cf6 n _REC_AXS_20_u2 6375. _CNV_A_R_LINEAR_____5_CM 16 0. 6375. FORMAT "%4.0" /end AXIS_PTS
/begin AXIS_PTS ldpm_tqi_sp_1_ip_mf_bas_1_0 "" 0x843ae6 tqi_sp _REC_AXS_20_u2 2047.96875 _CNV_A_R_LINEAR_____86_CM 16 -1024. 1023.96875 FORMAT "%6.2" /end AXIS_PTS
/begin AXIS_PTS ldpm_n_1_ip_mf_bas_2_0 "" 0x842d18 n _REC_AXS_20_u2 6375. _CNV_A_R_LINEAR_____5_CM 16 0. 6375. FORMAT "%4.0" /end AXIS_PTS
/begin AXIS_PTS ldp_n_1_ip_mf_bas_2_0_x "" 0x8418f0 n _REC_AXS_20_u2 6375. _CNV_A_R_LINEAR_____5_CM 1 0. 6375. FORMAT "%4.0" /end AXIS_PTS
/begin AXIS_PTS ldpm_tqi_sp_1_ip_mf_bas_2_0 "" 0x843b08 tqi_sp _REC_AXS_20_u2 2047.96875 _CNV_A_R_LINEAR_____86_CM 16 -1024. 1023.96875 FORMAT "%6.2" /end AXIS_PTS
/begin AXIS_PTS ldp_tqi_sp_1_ip_mf_bas_2_0_x "" 0x842798 tqi_sp _REC_AXS_20_u2 2047.96875 _CNV_A_R_LINEAR_____86_CM 1 -1024. 1023.96875 FORMAT "%6.2" /end AXIS_PTS
/begin AXIS_PTS ldpm_n_1_ip_mf_bas_3_0 "" 0x842d3a n _REC_AXS_20_u2 6375. _CNV_A_R_LINEAR_____5_CM 16 0. 6375. FORMAT "%4.0" /end AXIS_PTS
/begin AXIS_PTS ldp_n_1_ip_mf_bas_3_0_x "" 0x8418f4 n _REC_AXS_20_u2 6375. _CNV_A_R_LINEAR_____5_CM 1 0. 6375. FORMAT "%4.0" /end AXIS_PTS
/begin AXIS_PTS ldpm_tqi_sp_1_ip_mf_bas_3_0 "" 0x843b2a tqi_sp _REC_AXS_20_u2 2047.96875 _CNV_A_R_LINEAR_____86_CM 16 -1024. 1023.96875 FORMAT "%6.2" /end AXIS_PTS
/begin AXIS_PTS ldp_tqi_sp_1_ip_mf_bas_3_0_x "" 0x84279c tqi_sp _REC_AXS_20_u2 2047.96875 _CNV_A_R_LINEAR_____86_CM 1 -1024. 1023.96875 FORMAT "%6.2" /end AXIS_PTS
/begin AXIS_PTS ldpm_n_1_ip_mf_bas_4_0 "" 0x842d5c n _REC_AXS_20_u2 6375. _CNV_A_R_LINEAR_____5_CM 16 0. 6375. FORMAT "%4.0" /end AXIS_PTS
/begin AXIS_PTS ldp_n_1_ip_mf_bas_4_0_x "" 0x8418f8 n _REC_AXS_20_u2 6375. _CNV_A_R_LINEAR_____5_CM 1 0. 6375. FORMAT "%4.0" /end AXIS_PTS
/begin AXIS_PTS ldpm_tqi_sp_1_ip_mf_bas_4_0 "" 0x843b4c tqi_sp _REC_AXS_20_u2 2047.96875 _CNV_A_R_LINEAR_____86_CM 16 -1024. 1023.96875 FORMAT "%6.2" /end AXIS_PTS
/begin AXIS_PTS ldp_tqi_sp_1_ip_mf_bas_4_0_x "" 0x8427a0 tqi_sp _REC_AXS_20_u2 2047.96875 _CNV_A_R_LINEAR_____86_CM 1 -1024. 1023.96875 FORMAT "%6.2" /end AXIS_PTS
/begin MEASUREMENT mf_bas_is_pl_rgn_2 "Fuel Mass of Main injection at IS/PL durin rgn level2" UWORD _CNV_A_R_LINEAR_____399_CM 1 0. -20. 242.14 DISPLAY_IDENTIFIER MF_BAS_IS_PL_RGN_2 ECU_ADDRESS 0x7f9d76 BYTE_ORDER MSB_LAST /end MEASUREMENT
/begin MEASUREMENT mf_bas_is_pl_rgn_1 "Fuel Mass of Main Injection at IS/PL durin rgn level 1" UWORD _CNV_A_R_LINEAR_____399_CM 1 0. -20. 242.14 DISPLAY_IDENTIFIER MF_BAS_IS_PL_RGN_1 ECU_ADDRESS 0x7f9d74 BYTE_ORDER MSB_LAST /end MEASUREMENT
/begin CHARACTERISTIC ip_fac_mf_bas_cor_amp_rgn_2 "Mf Rgn calibrations: Amp correction factor for mf major injection during regeneration 2" CURVE 0x84821a _REC_CUR_20_u2_u2 0.9999874 _CNV_A_R_LINEAR_____87_CM 0. 0.9999874 DISPLAY_IDENTIFIER IP_FAC_MF_BAS_COR_AMP_RGN_2 FORMAT "%6.5"
 /begin AXIS_DESCR COM_AXIS amp _CNV_A_R_LINEAR_____45_CM 2 0. 5434. FORMAT "%6.2" AXIS_PTS_REF ldp_amp_ip_fac_mf_bas_cor_rgn_2 /end AXIS_DESCR
/end CHARACTERISTIC
/begin AXIS_PTS ldp_amp_ip_fac_mf_bas_cor_rgn_2 "" 0x8411ac amp _REC_AXS_20_u2 5434. _CNV_A_R_LINEAR_____45_CM 2 0. 5434. FORMAT "%6.2" /end AXIS_PTS
/begin CHARACTERISTIC ip_fac_mf_bas_cor_amp_rgn_1 "Mf Rgn calibrations: Amp correction factor for mf major injection during regeneration 1" CURVE 0x848216 _REC_CUR_20_u2_u2 0.9999874 _CNV_A_R_LINEAR_____87_CM 0. 0.9999874 DISPLAY_IDENTIFIER IP_FAC_MF_BAS_COR_AMP_RGN_1 FORMAT "%6.5"
 /begin AXIS_DESCR COM_AXIS amp _CNV_A_R_LINEAR_____45_CM 2 0. 5434. FORMAT "%6.2" AXIS_PTS_REF ldp_amp_ip_fac_mf_bas_cor_rgn_1 /end AXIS_DESCR
/end CHARACTERISTIC
/begin AXIS_PTS ldp_amp_ip_fac_mf_bas_cor_rgn_1 "" 0x8411a6 amp _REC_AXS_20_u2 5434. _CNV_A_R_LINEAR_____45_CM 2 0. 5434. FORMAT "%6.2" /end AXIS_PTS
/begin CHARACTERISTIC ip_mf_bas_amp_h_rgn_2 "Mf Rgn calibrations: AMP correction (= 1) of main injection MF during regeneration 2" MAP 0x84b904 _REC_MAP_20_u2_u2_u2 262.14 _CNV_A_R_LINEAR_____399_CM -20. 242.14 DISPLAY_IDENTIFIER IP_MF_BAS_AMP_H_RGN_2
 /begin AXIS_DESCR COM_AXIS n _CNV_A_R_LINEAR_____5_CM 12 0. 8160. FORMAT "%4.0" AXIS_PTS_REF ldpm_n_ip_mf_bas_amp_rgn_2 /end AXIS_DESCR
 /begin AXIS_DESCR COM_AXIS tqi_sp _CNV_A_R_LINEAR_____86_CM 12 -1024. 1023.96875 FORMAT "%6.2" AXIS_PTS_REF ldpm_tqi_sp_ip_mf_amp_rgn_2 /end AXIS_DESCR
/end CHARACTERISTIC
/begin AXIS_PTS ldpm_n_ip_mf_bas_amp_rgn_2 "" 0x8432d0 n _REC_AXS_20_u2 8160. _CNV_A_R_LINEAR_____5_CM 12 0. 8160. FORMAT "%4.0" /end AXIS_PTS
/begin AXIS_PTS ldpm_tqi_sp_ip_mf_amp_rgn_2 "" 0x843cd6 tqi_sp _REC_AXS_20_u2 2047.96875 _CNV_A_R_LINEAR_____86_CM 12 -1024. 1023.96875 FORMAT "%6.2" /end AXIS_PTS
/begin CHARACTERISTIC ip_mf_bas_amp_l_rgn_2 "Mf Rgn calibrations: AMP correction (= 0) of main injection MF during regeneration 2" MAP 0x84bb44 _REC_MAP_20_u2_u2_u2 262.14 _CNV_A_R_LINEAR_____399_CM -20. 242.14 DISPLAY_IDENTIFIER IP_MF_BAS_AMP_L_RGN_2
 /begin AXIS_DESCR COM_AXIS n _CNV_A_R_LINEAR_____5_CM 12 0. 8160. FORMAT "%4.0" AXIS_PTS_REF ldpm_n_ip_mf_bas_amp_rgn_2 /end AXIS_DESCR
 /begin AXIS_DESCR COM_AXIS tqi_sp _CNV_A_R_LINEAR_____86_CM 12 -1024. 1023.96875 FORMAT "%6.2" AXIS_PTS_REF ldpm_tqi_sp_ip_mf_amp_rgn_2 /end AXIS_DESCR
/end CHARACTERISTIC
/begin CHARACTERISTIC ip_mf_bas_amp_h_rgn_1 "Mf Rgn calibrations: AMP correction (= 1) of main injection MF during regeneration 1" MAP 0x84b7e4 _REC_MAP_20_u2_u2_u2 262.14 _CNV_A_R_LINEAR_____399_CM -20. 242.14 DISPLAY_IDENTIFIER IP_MF_BAS_AMP_H_RGN_1
 /begin AXIS_DESCR COM_AXIS n _CNV_A_R_LINEAR_____5_CM 12 0. 8160. FORMAT "%4.0" AXIS_PTS_REF ldpm_n_ip_mf_bas_amp_rgn_1 /end AXIS_DESCR
 /begin AXIS_DESCR COM_AXIS tqi_sp _CNV_A_R_LINEAR_____86_CM 12 -1024. 1023.96875 FORMAT "%6.2" AXIS_PTS_REF ldpm_tqi_sp_ip_mf_amp_rgn_1 /end AXIS_DESCR
/end CHARACTERISTIC
/begin AXIS_PTS ldpm_n_ip_mf_bas_amp_rgn_1 "" 0x8432b6 n _REC_AXS_20_u2 8160. _CNV_A_R_LINEAR_____5_CM 12 0. 8160. FORMAT "%4.0" /end AXIS_PTS
/begin AXIS_PTS ldpm_tqi_sp_ip_mf_amp_rgn_1 "" 0x843cbc tqi_sp _REC_AXS_20_u2 2047.96875 _CNV_A_R_LINEAR_____86_CM 12 -1024. 1023.96875 FORMAT "%6.2" /end AXIS_PTS
/begin CHARACTERISTIC ip_mf_bas_amp_l_rgn_1 "Mf Rgn calibrations: AMP correction (= 0) of main injection MF during regeneration 1" MAP 0x84ba24 _REC_MAP_20_u2_u2_u2 262.14 _CNV_A_R_LINEAR_____399_CM -20. 242.14 DISPLAY_IDENTIFIER IP_MF_BAS_AMP_L_RGN_1
 /begin AXIS_DESCR COM_AXIS n _CNV_A_R_LINEAR_____5_CM 12 0. 8160. FORMAT "%4.0" AXIS_PTS_REF ldpm_n_ip_mf_bas_amp_rgn_1 /end AXIS_DESCR
 /begin AXIS_DESCR COM_AXIS tqi_sp _CNV_A_R_LINEAR_____86_CM 12 -1024. 1023.96875 FORMAT "%6.2" AXIS_PTS_REF ldpm_tqi_sp_ip_mf_amp_rgn_1 /end AXIS_DESCR
/end CHARACTERISTIC
/begin MEASUREMENT mf_bas_sel_conf_0 "basic fuel mass at injection configuration 0 after temperature selection" UWORD _CNV_A_R_LINEAR_____38_CM 1 0. 0. 262.14 DISPLAY_IDENTIFIER MF_BAS_SEL_CONF_0 ECU_ADDRESS 0x7f9d66 BYTE_ORDER MSB_LAST /end MEASUREMENT
/begin MEASUREMENT mf_bas_sel_conf_1 "basic fuel mass at injection configuration 1 after temperature selection" UWORD _CNV_A_R_LINEAR_____38_CM 1 0. 0. 262.14 DISPLAY_IDENTIFIER MF_BAS_SEL_CONF_1 ECU_ADDRESS 0x7f9d68 BYTE_ORDER MSB_LAST /end MEASUREMENT
/begin MEASUREMENT mf_bas_sel_conf_2 "basic fuel mass at injection configuration 2 after temperature selection" UWORD _CNV_A_R_LINEAR_____38_CM 1 0. 0. 262.14 DISPLAY_IDENTIFIER MF_BAS_SEL_CONF_2 ECU_ADDRESS 0x7f9d6a BYTE_ORDER MSB_LAST /end MEASUREMENT
/begin MEASUREMENT mf_bas_sel_conf_3 "basic fuel mass at injection configuration 3 after temperature selection" UWORD _CNV_A_R_LINEAR_____38_CM 1 0. 0. 262.14 DISPLAY_IDENTIFIER MF_BAS_SEL_CONF_3 ECU_ADDRESS 0x7f9d6c BYTE_ORDER MSB_LAST /end MEASUREMENT
/begin MEASUREMENT mf_bas_sel_conf_4 "basic fuel mass at injection configuration 4 after temperature selection" UWORD _CNV_A_R_LINEAR_____38_CM 1 0. 0. 262.14 DISPLAY_IDENTIFIER MF_BAS_SEL_CONF_4 ECU_ADDRESS 0x7f9d6e BYTE_ORDER MSB_LAST /end MEASUREMENT
/begin MEASUREMENT mf_bas_conf "basic fuel mass, after injection configuration selection" UWORD _CNV_A_R_LINEAR_____399_CM 1 0. -20. 242.14 DISPLAY_IDENTIFIER MF_BAS_CONF ECU_ADDRESS 0x7f9d78 BYTE_ORDER MSB_LAST /end MEASUREMENT
/begin CHARACTERISTIC c_t_rgn_trn_mf_bas "time constant of rgn transition of mf_bas" VALUE 0x85cc84 _REC_VAL_20_u2 4.19424 _CNV_A_R_LINEAR_____64_CM 0. 4.19424 DISPLAY_IDENTIFIER C_T_RGN_TRN_MF_BAS FORMAT "%6.5" /end CHARACTERISTIC
/begin MEASUREMENT sf_inj_psn_move "flag that indicates regeneration during fuel cutoff" UBYTE _CNV_A_R_LINEAR_____0_CM 1 0. 0. 3. DISPLAY_IDENTIFIER SF_INJ_PSN_MOVE ECU_ADDRESS 0x7fba45 FORMAT "%1.0" /end MEASUREMENT
/begin MEASUREMENT lv_act_post_puc "active post injection in PUC" UBYTE _CNV_S_2_RANGE______11_CM 1 0. 0. 1. DISPLAY_IDENTIFIER LV_ACT_POST_PUC ECU_ADDRESS 0x7fba46 /end MEASUREMENT
/begin MEASUREMENT mf_main1 "" UWORD _CNV_A_R_LINEAR_____38_CM 1 0. 0. 262.14 DISPLAY_IDENTIFIER MF_MAIN1 ECU_ADDRESS 0x7f9d86 BYTE_ORDER MSB_LAST FORMAT "%4.1" /end MEASUREMENT
/begin MEASUREMENT mf_main2 "" UWORD _CNV_A_R_LINEAR_____38_CM 1 0. 0. 262.14 DISPLAY_IDENTIFIER MF_MAIN2 ECU_ADDRESS 0x7f9d90 BYTE_ORDER MSB_LAST FORMAT "%4.1" /end MEASUREMENT
/begin MEASUREMENT mf_post1 "" UWORD _CNV_A_R_LINEAR_____38_CM 1 0. 0. 262.14 DISPLAY_IDENTIFIER MF_POST1 ECU_ADDRESS 0x7f9d88 BYTE_ORDER MSB_LAST FORMAT "%4.1" /end MEASUREMENT
/begin MEASUREMENT mf_post2 "" UWORD _CNV_A_R_LINEAR_____38_CM 1 0. 0. 262.14 DISPLAY_IDENTIFIER MF_POST2 ECU_ADDRESS 0x7f9d8a BYTE_ORDER MSB_LAST FORMAT "%4.1" /end MEASUREMENT
/begin MEASUREMENT mf_prev1 "" UWORD _CNV_A_R_LINEAR_____38_CM 1 0. 0. 262.14 DISPLAY_IDENTIFIER MF_PREV1 ECU_ADDRESS 0x7f9d8c BYTE_ORDER MSB_LAST FORMAT "%4.1" /end MEASUREMENT
/begin MEASUREMENT mf_prev2 "" UWORD _CNV_A_R_LINEAR_____38_CM 1 0. 0. 262.14 DISPLAY_IDENTIFIER MF_PREV2 ECU_ADDRESS 0x7f9d8e BYTE_ORDER MSB_LAST FORMAT "%4.1" /end MEASUREMENT
/begin MEASUREMENT mf_main1_chk "fuel mass of injection MAIN1 after check" UWORD _CNV_A_R_LINEAR_____38_CM 1 0. 0. 262.14 DISPLAY_IDENTIFIER MF_MAIN1_CHK ECU_ADDRESS 0x7f9d7e BYTE_ORDER MSB_LAST /end MEASUREMENT
/begin MEASUREMENT mf_prev1_chk "fuel mass of injection PREV1 after check" UWORD _CNV_A_R_LINEAR_____38_CM 1 0. 0. 262.14 DISPLAY_IDENTIFIER MF_PREV1_CHK ECU_ADDRESS 0x7f9d7a BYTE_ORDER MSB_LAST /end MEASUREMENT
/begin MEASUREMENT mf_main2_chk "fuel mass of injection MAIN2 after check" UWORD _CNV_A_R_LINEAR_____38_CM 1 0. 0. 262.14 DISPLAY_IDENTIFIER MF_MAIN2_CHK ECU_ADDRESS 0x7f9d80 BYTE_ORDER MSB_LAST /end MEASUREMENT
/begin MEASUREMENT mf_prev2_chk "fuel mass of injection PREV2 after check" UWORD _CNV_A_R_LINEAR_____38_CM 1 0. 0. 262.14 DISPLAY_IDENTIFIER MF_PREV2_CHK ECU_ADDRESS 0x7f9d7c BYTE_ORDER MSB_LAST /end MEASUREMENT
/begin MEASUREMENT mf_post1_chk "fuel mass of injection POST1 after check" UWORD _CNV_A_R_LINEAR_____38_CM 1 0. 0. 262.14 DISPLAY_IDENTIFIER MF_POST1_CHK ECU_ADDRESS 0x7f9d82 BYTE_ORDER MSB_LAST /end MEASUREMENT
/begin MEASUREMENT mf_post2_chk "fuel mass of injection POST2 after check" UWORD _CNV_A_R_LINEAR_____38_CM 1 0. 0. 262.14 DISPLAY_IDENTIFIER MF_POST2_CHK ECU_ADDRESS 0x7f9d84 BYTE_ORDER MSB_LAST /end MEASUREMENT
/begin MEASUREMENT lv_tooth_per_pred "Flag to calculation of TOOTH_PER_PRED" UBYTE _CNV_S_2_RANGE______11_CM 1 0. 0. 1. DISPLAY_IDENTIFIER LV_TOOTH_PER_PRED ECU_ADDRESS 0x7fbbcf /end MEASUREMENT
/begin CHARACTERISTIC lc_tooth_per_pred "Manuel Button for calculation of TOOTH_PER_PRED" VALUE 0x850174 _REC_VAL_20_u1 1. _CNV_A_R_LINEAR_____0_CM 0. 1. DISPLAY_IDENTIFIER LC_TOOTH_PER_PRED FORMAT "%1.0" /end CHARACTERISTIC
/begin COMPU_METHOD _CNV_A_R_LINEAR_____0_CM "" RAT_FUNC "%6.3" "[-]" COEFFS 0 1. 0. 0 0 1 /end COMPU_METHOD
/begin COMPU_METHOD _CNV_A_R_LINEAR_____5_CM "" RAT_FUNC "%6.3" "[rpm]" COEFFS 0 1. 0. 0 0 1 /end COMPU_METHOD
/begin COMPU_METHOD _CNV_S_2_RANGE______11_CM "" TAB_VERB "%6.3" "[-]" COMPU_TAB_REF _CNV_S_2_RANGE______11 /end COMPU_METHOD
/begin COMPU_VTAB _CNV_S_2_RANGE______11 "" TAB_VERB 2 0 "0" 1 "1" /end COMPU_VTAB
/begin COMPU_METHOD _CNV_A_R_LINEAR_____14_CM "" RAT_FUNC "%6.3" "[-]" COEFFS 0 65535.99999999996 0. 0 0 1 /end COMPU_METHOD
/begin COMPU_METHOD _CNV_A_R_LINEAR_____18_CM "" RAT_FUNC "%6.3" "[°C]" COEFFS 0 1. 50. 0 0 1 /end COMPU_METHOD
/begin COMPU_METHOD _CNV_A_R_LINEAR_____29_CM "" RAT_FUNC "%6.3" "[-]" COEFFS 0 256. 0. 0 0 1 /end COMPU_METHOD
/begin COMPU_METHOD _CNV_A_R_LINEAR_____34_CM "" RAT_FUNC "%6.3" "[km/h]" COEFFS 0 1. 0. 0 0 1 /end COMPU_METHOD
/begin COMPU_METHOD _CNV_A_R_LINEAR_____38_CM "" RAT_FUNC "%6.3" "[mg/stk]" COEFFS 0 250. 0. 0 0 1 /end COMPU_METHOD
/begin COMPU_METHOD _CNV_A_R_LINEAR_____45_CM "" RAT_FUNC "%6.3" "[hPa]" COEFFS 0 12.06017666543982 0. 0 0 1 /end COMPU_METHOD
/begin COMPU_METHOD _CNV_A_R_LINEAR_____48_CM "" RAT_FUNC "%6.3" "[-]" COEFFS 0 32767.99807357072 0. 0 0 1 /end COMPU_METHOD
/begin COMPU_METHOD _CNV_A_R_LINEAR_____52_CM "" RAT_FUNC "%6.3" "[Nm]" COEFFS 0 32. 0. 0 0 1 /end COMPU_METHOD
/begin COMPU_METHOD _CNV_A_R_LINEAR_____55_CM "" RAT_FUNC "%6.3" "[rpm]" COEFFS 0 3.125e-002 0. 0 0 1 /end COMPU_METHOD
/begin COMPU_METHOD _CNV_A_R_LINEAR_____59_CM "" RAT_FUNC "%6.3" "[-]" COEFFS 0 16383.81262712377 0. 0 0 1 /end COMPU_METHOD
/begin COMPU_METHOD _CNV_A_R_LINEAR_____60_CM "" RAT_FUNC "%6.3" "[mg/stk]" COEFFS 0 47.18142548596112 0. 0 0 1 /end COMPU_METHOD
/begin COMPU_METHOD _CNV_A_R_LINEAR_____64_CM "" RAT_FUNC "%6.3" "[s]" COEFFS 0 15625. 0. 0 0 1 /end COMPU_METHOD
/begin COMPU_METHOD _CNV_A_R_LINEAR_____86_CM "" RAT_FUNC "%6.3" "[Nm]" COEFFS 0 32. 32768. 0 0 1 /end COMPU_METHOD
/begin COMPU_METHOD _CNV_A_R_LINEAR_____87_CM "" RAT_FUNC "%6.3" "[-]" COEFFS 0 65535.82575140447 0. 0 0 1 /end COMPU_METHOD
/begin COMPU_METHOD _CNV_A_R_LINEAR_____95_CM "" RAT_FUNC "%6.3" "[-]" COEFFS 0 64. 0. 0 0 1 /end COMPU_METHOD
/begin COMPU_METHOD _CNV_A_R_LINEAR_____117_CM "" RAT_FUNC "%6.3" "[MPa]" COEFFS 0 327.680000069121 32768.0000069121 0 0 1 /end COMPU_METHOD
/begin COMPU_METHOD _CNV_A_R_LINEAR_____119_CM "" RAT_FUNC "%6.3" "[°CRK]" COEFFS 0 42.66666666666666 0. 0 0 1 /end COMPU_METHOD
/begin COMPU_METHOD _CNV_A_R_LINEAR_____131_CM "" RAT_FUNC "%6.3" "[mg/stk]" COEFFS 0 250. 32768. 0 0 1 /end COMPU_METHOD
/begin COMPU_METHOD _CNV_A_R_LINEAR_____211_CM "" RAT_FUNC "%6.3" "[ms]" COEFFS 0 999.9999999999999 0. 0 0 1 /end COMPU_METHOD
/begin COMPU_METHOD _CNV_A_R_LINEAR_____223_CM "" RAT_FUNC "%6.3" "[ms]" COEFFS 0 100. 0. 0 0 1 /end COMPU_METHOD
/begin COMPU_METHOD _CNV_S_9_CONV_INJ_S_224_CM "" TAB_VERB "%6.3" "[-]" COMPU_TAB_REF _CNV_S_9_CONV_INJ_S_224 /end COMPU_METHOD
/begin COMPU_VTAB _CNV_S_9_CONV_INJ_S_224 "" TAB_VERB 9 0 "NO INJECTION" 1 "PREV" 2 "MAIN" 3 "PREV/MAIN" 4 "POST" 5 "PREV/POST" 6 "MAIN/POST" 7 "PREV/MAIN/POST" 8 "INJECTION DISABLED" /end COMPU_VTAB
/begin COMPU_METHOD _CNV_A_R_LINEAR_____343_CM "" RAT_FUNC "%6.3" "[Nm]" COEFFS 0 31.99998046846389 32767.97999970703 0 0 1 /end COMPU_METHOD
/begin COMPU_METHOD _CNV_A_R_LINEAR_____399_CM "" RAT_FUNC "%6.3" "[mg/stk]" COEFFS 0 250. 5000. 0 0 1 /end COMPU_METHOD
/begin RECORD_LAYOUT _REC_VAL_20_u1 FNC_VALUES 1 UBYTE COLUMN_DIR DIRECT /end RECORD_LAYOUT
/begin RECORD_LAYOUT _REC_AXS_20_u2 NO_AXIS_PTS_X 1 UWORD AXIS_PTS_X 2 UWORD INDEX_INCR DIRECT /end RECORD_LAYOUT
/begin RECORD_LAYOUT _REC_MAP_20_u2_u2_u2 FNC_VALUES 1 UWORD COLUMN_DIR DIRECT /end RECORD_LAYOUT
/begin RECORD_LAYOUT _REC_VAL_20_u2 FNC_VALUES 1 UWORD COLUMN_DIR DIRECT /end RECORD_LAYOUT
/begin RECORD_LAYOUT _REC_VAL_20_s2 FNC_VALUES 1 SWORD COLUMN_DIR DIRECT /end RECORD_LAYOUT
/begin RECORD_LAYOUT _REC_AXS_20_u1 NO_AXIS_PTS_X 1 UBYTE AXIS_PTS_X 2 UBYTE INDEX_INCR DIRECT /end RECORD_LAYOUT
/begin RECORD_LAYOUT _REC_CUR_20_u2_u2 FNC_VALUES 1 UWORD COLUMN_DIR DIRECT /end RECORD_LAYOUT
/begin RECORD_LAYOUT _REC_CUR_20_u2_u1 FNC_VALUES 1 UWORD COLUMN_DIR DIRECT /end RECORD_LAYOUT
/begin RECORD_LAYOUT _REC_MAP_20_u2_u2_u1 FNC_VALUES 1 UWORD COLUMN_DIR DIRECT /end RECORD_LAYOUT
/begin RECORD_LAYOUT _REC_CUR_20_u1_u1 FNC_VALUES 1 UBYTE COLUMN_DIR DIRECT /end RECORD_LAYOUT
/begin RECORD_LAYOUT _REC_MAP_20_u2_u1_u2 FNC_VALUES 1 UWORD COLUMN_DIR DIRECT /end RECORD_LAYOUT
/begin FUNCTION TI_TUN "Injection Timing Tuning"
 /begin DEF_CHARACTERISTIC lc_tun_pui_man c_soi_frze_prev1_man c_t_cha_frze_prev1_man c_soi_prev1_man c_t_cha_prev1_man c_eoi_prev1_man c_t_dcha_prev1_man c_t_hld_toze_prev1_man c_t_dcha_toze_prev1_man c_doi_prev1_man c_soi_frze_main1_man c_t_cha_frze_main1_man c_soi_main1_man c_t_cha_main1_man c_eoi_main1_man c_t_dcha_main1_man c_t_hld_toze_main1_man c_t_dcha_toze_main1_man c_doi_main1_man c_soi_frze_post1_man c_t_cha_frze_post1_man c_soi_post1_man c_t_cha_post1_man c_eoi_post1_man c_t_dcha_post1_man c_t_hld_toze_post1_man c_t_dcha_toze_post1_man c_doi_post1_man c_sf_pls_state_man c_t_cha_tot_min c_ctr_t_cha_tot_vld_hys_on /end DEF_CHARACTERISTIC
 /begin OUT_MEASUREMENT soi_frze_prev1_pwr_on_tu t_cha_frze_prev1_tu soi_prev1_pwr_on_tu t_cha_prev1_tu eoi_prev1_pwr_on_tu t_dcha_prev1_tu t_hld_toze_prev1_tu t_dcha_toze_prev1_tu soi_frze_main1_pwr_on_tu t_cha_frze_main1_tu soi_main1_pwr_on_tu t_cha_main1_tu eoi_main1_pwr_on_tu t_dcha_main1_tu t_hld_toze_main1_tu t_dcha_toze_main1_tu soi_frze_post1_pwr_on_tu t_cha_frze_post1_tu soi_post1_pwr_on_tu t_cha_post1_tu eoi_post1_pwr_on_tu t_dcha_post1_tu t_hld_toze_post1_tu t_dcha_toze_post1_tu sf_inj_state_tu.word sf_inj_state_tu.bf.unused sf_inj_state_tu.bf.lv_inj_di sf_inj_state_tu.bf.lv_post1_inj_act sf_inj_state_tu.bf.lv_main2_inj_act sf_inj_state_tu.bf.lv_main1_inj_act sf_inj_state_tu.bf.lv_prev2_inj_act sf_inj_state_tu.bf.lv_prev1_inj_act sf_pls_state_tu nr_inj_seg_tu ti_prev1 ti_main1 ti_post1 ti_prev1_tu ti_main1_tu ti_post1_tu lv_t_cha_prev1_vld lv_t_cha_main1_vld lv_t_cha_post1_vld lv_t_cha_tot_vld sf_t_cha_tot_vld_hys t_cha_seq1 doi_prev1_pwr_on_tu doi_main1_pwr_on_tu doi_post1_pwr_on_tu /end OUT_MEASUREMENT
/end FUNCTION
/begin FUNCTION TI_COL "Injection Timing Collision Check"
 /begin DEF_CHARACTERISTIC c_t_dist_prev1_main1_min c_dur_dist_prev1_main1_min c_swi_dist c_n_level_swi lc_dir_chg_n_level lc_case_clc_on c_t_swi_1_2_ofs c_t_swi_2_3_ofs /end DEF_CHARACTERISTIC
 /begin OUT_MEASUREMENT soi_frze_prev1_pwr_on t_cha_frze_prev1 soi_prev1_pwr_on t_cha_prev1 eoi_prev1_pwr_on t_dcha_prev1 t_hld_toze_prev1 t_dcha_toze_prev1 lv_frze_prev1_act lv_prev1_act lv_toze_prev1_act soi_frze_main1_pwr_on t_cha_frze_main1 soi_main1_pwr_on t_cha_main1 lv_frze_main1_act lv_main1_act lv_toze_main1_act lv_toze_prev1_req4 dur_move_prev1 case_nr doi_main1_pwr_on /end OUT_MEASUREMENT
/end FUNCTION
/begin FUNCTION TI_SUPP "Predictive Crankshaft Tooth Period" /begin DEF_CHARACTERISTIC lc_tooth_per_pred /end DEF_CHARACTERISTIC /begin OUT_MEASUREMENT lv_tooth_per_pred /end OUT_MEASUREMENT /end FUNCTION
/begin FUNCTION C_X_ASTCTL ""
 /begin SUB_FUNCTION ASTCTL_ENME ASTCTL_AQSI ASTCTL_THCL ASTCTL_ENCL ASTCTL_PUICTL ASTCTL_PUIPFSP ASTCTL_NRMPLS ARCHA_CTL /end SUB_FUNCTION
/end FUNCTION
/begin FUNCTION ASTCTL_ENME "" /end FUNCTION
/begin FUNCTION ASTCTL_AQSI "" /end FUNCTION
/begin FUNCTION ASTCTL_THCL "" /end FUNCTION
/begin FUNCTION ASTCTL_ENCL "" /end FUNCTION
/begin FUNCTION ASTCTL_PUICTL "PECO PUI Controller" /end FUNCTION
/begin FUNCTION ASTCTL_PUIPFSP "PECO PUI Acquisition of Piezo Signals" /end FUNCTION
/begin FUNCTION ASTCTL_NRMPLS "PUI Normalisation Pulse General" /end FUNCTION
/begin FUNCTION ARCHA_CTL ""
 /begin DEF_CHARACTERISTIC c_tco_rcha_lim c_ti_rcha_lim c_t_rcha_pulse_dur_[0] c_t_rcha_pulse_dur_[1] c_t_rcha_pulse_dur_[2] c_t_rcha_pulse_dur_[3] /end DEF_CHARACTERISTIC
 /begin OUT_MEASUREMENT lf_rcha_prev1_act lf_rcha_main1_act lf_rcha_post1_act t_rcha_pulse_[0] t_rcha_pulse_[1] t_rcha_pulse_[2] t_rcha_pulse_[3] /end OUT_MEASUREMENT
/end FUNCTION
/begin FUNCTION C_Y_MF ""
 /begin SUB_FUNCTION MF_AMFBPRT MF_AMFCORD MF_ATQISLM MF_AMFBOL MF_AMFSLM MF_AMF_INJCOR MF_AMF_MINOR_TEMP MF_AMF_TEMP_LEVEL MF_AMF_MINOR_ACT MF_AMF_MINOR_ST MF_AMF_MINOR MF_AMF_INJMIN MF_AMFSTBAS MF_AMF_MINOR_RGN MF_AMF_MINOR_TRAN MF_AMF_MAIN MF_AMF_MAIN_RGN MF_AMF_MAIN_TEMP MF_AMF_MAIN_TRAN MF_AMF_TRAN MF_AMFSPLIT /end SUB_FUNCTION
/end FUNCTION
/begin FUNCTION MF_AMFBPRT ""
 /begin DEF_CHARACTERISTIC c_tfu_thd_tqi_tql_tfu_prot ldp_vs_ip_fac_tqi_tql_tfu_prot ldp_n_ip_tqi_tql_tfu_prot ldp_tfu_ip_tqi_tql_tfu_prot ip_fac_tqi_tql_tfu_prot ip_tqi_tql_tfu_prot /end DEF_CHARACTERISTIC
 /begin OUT_MEASUREMENT tqi_tql_tfu_prot /end OUT_MEASUREMENT
/end FUNCTION
/begin FUNCTION MF_AMFCORD "Fuel Mass Tuning"
 /begin DEF_CHARACTERISTIC lc_mf_prev1_tu_on lc_mf_prev2_tu_on lc_mf_main1_tu_on lc_mf_main2_tu_on lc_mf_post2_tu_on lc_mf_post1_tu_on c_mf_main1_add_tu c_mf_main2_add_tu c_fac_mf_prev1_tu c_fac_mf_prev2_tu c_mf_post1_add_tu c_mf_post2_add_tu c_mf_main1_test_add_tu[0] c_mf_main1_test_add_tu[1] c_mf_main1_test_add_tu[2] c_mf_main1_test_add_tu[3] c_mf_main2_test_add_tu[0] c_mf_main2_test_add_tu[1] c_mf_main2_test_add_tu[2] c_mf_main2_test_add_tu[3] c_mf_prev1_test_add_tu[0] c_mf_prev1_test_add_tu[1] c_mf_prev1_test_add_tu[2] c_mf_prev1_test_add_tu[3] c_mf_prev2_test_add_tu[0] c_mf_prev2_test_add_tu[1] c_mf_prev2_test_add_tu[2] c_mf_prev2_test_add_tu[3] c_mf_post2_test_add_tu[0] c_mf_post2_test_add_tu[1] c_mf_post2_test_add_tu[2] c_mf_post2_test_add_tu[3] c_mf_post1_test_add_tu[0] c_mf_post1_test_add_tu[1] c_mf_post1_test_add_tu[2] c_mf_post1_test_add_tu[3] c_mf_main1_add_tu_cyl[0] c_mf_main1_add_tu_cyl[1] c_mf_main1_add_tu_cyl[2] c_mf_main1_add_tu_cyl[3] c_mf_main2_add_tu_cyl[0] c_mf_main2_add_tu_cyl[1] c_mf_main2_add_tu_cyl[2] c_mf_main2_add_tu_cyl[3] c_mf_prev1_add_tu_cyl[0] c_mf_prev1_add_tu_cyl[1] c_mf_prev1_add_tu_cyl[2] c_mf_prev1_add_tu_cyl[3] c_mf_prev2_add_tu_cyl[0] c_mf_prev2_add_tu_cyl[1] c_mf_prev2_add_tu_cyl[2] c_mf_prev2_add_tu_cyl[3] c_mf_post1_add_tu_cyl[0] c_mf_post1_add_tu_cyl[1] c_mf_post1_add_tu_cyl[2] c_mf_post1_add_tu_cyl[3] c_mf_post2_add_tu_cyl[0] c_mf_post2_add_tu_cyl[1] c_mf_post2_add_tu_cyl[2] c_mf_post2_add_tu_cyl[3] c_fac_mf_main1_tu c_fac_mf_main2_tu c_fac_mf_post1_tu c_fac_mf_post2_tu ip_mf_main1_inj_test_ad ldp_n_ip_mf_main1_inj_test_ad ldp_tqi_sp_ip_mf_main1_inj_test_ad /end DEF_CHARACTERISTIC
 /begin OUT_MEASUREMENT mf_prev1_tu mf_prev2_tu mf_main1_tu mf_main2_tu mf_post1_tu mf_post2_tu mf_inj_sum /end OUT_MEASUREMENT
/end FUNCTION
/begin FUNCTION MF_ATQISLM "Indicated Torque for Smoke Limitation" /end FUNCTION
/begin FUNCTION MF_AMFBOL "Indicated torque for blue smoke limitation"
 /begin DEF_CHARACTERISTIC c_dri_tqi_bol c_lgrd_tqi_dec_tq_bol c_lgrd_tqi_inc_tq_bol ip_tqi_bol_amp_tco ldpm_tco_ip_mf ldp_amp_ip_mf /end DEF_CHARACTERISTIC
 /begin OUT_MEASUREMENT lv_tqi_slm_bol_plaus tqi_slm_bol /end OUT_MEASUREMENT
/end FUNCTION
/begin FUNCTION MF_AMFSLM "Smoke limitation (fuel mass)"
 /begin DEF_CHARACTERISTIC lc_mf_slm_is_act c_crlc_maf_slm lc_swi_temp_slm ip_fac_mf_slm__tco ldp_tco_ip_fac_mf_slm ip_fac_mf_slm__amp ldp_amp_ip_fac_mf_slm ip_fac_mf_slm__temp_slm ldp_temp_slm_ip_fac_mf_slm ip_mf_slm_bas__n__maf_fil ldpm_n_ip_mf_slm_bas ldpm_maf_fil_ip_mf_slm_bas ip_mf_slm_cor_amp__n__amp ldpm_n_ip_mf_slm ldp_amp_ip_mf_slm_cor_amp ip_mf_slm_tfu_lim__n__tfu ldp_tfu_ip_mf_slm_tfu_lim ip_mf_slm_cor_tco__n__maf ldp_maf_ip_mf_slm_cor_tco ip_mf_slm_cor_fup__n__fup_tra_d ldp_fup_tra_d_ip_mf_slm_cor_fup ip_mf_slm_cor_temp_slm__n__maf ldp_maf_ip_mf_slm_cor_temp_slm ip_mf_slm_bas_rgn__n__maf_fil /end DEF_CHARACTERISTIC
 /begin OUT_MEASUREMENT lv_mf_slm_act mf_slm maf_fil_slm mf_slm_cor_fup mf_slm_cor_tco mf_slm_cor_temp_slm temp_slm /end OUT_MEASUREMENT
/end FUNCTION
/begin FUNCTION MF_AMF_INJCOR ""
 /begin DEF_CHARACTERISTIC c_sf_prev2_cor_rgn_1 c_sf_prev2_cor_rgn_2 c_sf_main2_cor_rgn_1 c_sf_main2_cor_rgn_2 c_sf_post1_cor_rgn_1 c_sf_post1_cor_rgn_2 c_sf_bas_cor_rgn_1 c_sf_bas_cor_rgn_2 c_sf_prev1_cor_rgn_1 c_sf_prev1_cor_rgn_2 /end DEF_CHARACTERISTIC
 /begin OUT_MEASUREMENT mf_prev1_cor mf_prev2_cor mf_main2_cor mf_post1_cor mf_bas_cor_conf_0 mf_bas_cor_conf_1 mf_bas_cor_conf_2 mf_bas_cor_conf_3 mf_bas_cor_conf_4 sf_bas_cor_rgn_1 sf_bas_cor_rgn_2 sf_prev1_cor_rgn_1 sf_prev2_cor_rgn_1 sf_main2_cor_rgn_1 sf_post1_cor_rgn_1 sf_prev2_cor_rgn_2 sf_prev1_cor_rgn_2 sf_main2_cor_rgn_2 sf_post1_cor_rgn_2 /end OUT_MEASUREMENT
/end FUNCTION
/begin FUNCTION MF_AMF_MINOR_TEMP ""
 /begin OUT_MEASUREMENT mf_prev1_bas_sel mf_prev2_bas_sel mf_main2_bas_sel mf_post1_bas_sel /end OUT_MEASUREMENT
/end FUNCTION
/begin FUNCTION MF_AMF_TEMP_LEVEL "" /begin OUT_MEASUREMENT lv_temp_inter_sel /end OUT_MEASUREMENT /end FUNCTION
/begin FUNCTION MF_AMF_MINOR_ACT ""
 /begin DEF_CHARACTERISTIC lc_inj_prev1_on c_n_32_max_inj_prev1 lc_inj_prev2_on c_n_32_max_inj_prev2 lc_inj_main2_on c_n_32_max_inj_main2 lc_inj_post1_on c_n_32_max_inj_post1 /end DEF_CHARACTERISTIC
 /begin OUT_MEASUREMENT lv_act_prev1_inj_bas lv_act_prev2_inj_bas lv_act_main2_inj_bas lv_act_post1_inj_bas lv_mf_prev1_bas_clc lv_mf_prev2_bas_clc lv_mf_main2_bas_clc lv_mf_post1_bas_clc /end OUT_MEASUREMENT
/end FUNCTION
/begin FUNCTION MF_AMF_MINOR_ST "Fuel Mass of Minor Injections at ST"
 /begin DEF_CHARACTERISTIC ldpm_amp_2_inj ldpm_n_3_inj ldpm_tco_2_inj ldpm_n_4_inj ldpm_tco_3_inj ip_fac_mf_prev1_st_cor_amp ip_fac_mf_prev1_st_cor_tia ldpm_tia_2_inj ip_mf_prev1_st ip_mf_prev1_st_cor_amp ip_mf_prev1_st_cor_tia ip_fac_mf_prev2_st_cor_amp ip_fac_mf_prev2_st_cor_tia ip_mf_prev2_st ip_mf_prev2_st_cor_amp ip_mf_prev2_st_cor_tia ip_fac_mf_main2_st_cor_amp ip_fac_mf_main2_st_cor_tia ip_mf_main2_st ip_mf_main2_st_cor_amp ip_mf_main2_st_cor_tia ip_fac_mf_post1_st_cor_amp ip_fac_mf_post1_st_cor_tia ip_mf_post1_st ip_mf_post1_st_cor_amp ip_mf_post1_st_cor_tia ldp_tia_2_inj_x /end DEF_CHARACTERISTIC
 /begin OUT_MEASUREMENT mf_prev1_st mf_prev2_st mf_main2_st mf_post1_st /end OUT_MEASUREMENT
/end FUNCTION
/begin FUNCTION MF_AMF_MINOR ""
 /begin DEF_CHARACTERISTIC c_mf_prev1_max ip_fac_mf_prev1_cor_tco ldp_tco_ip_fac_mf_prev1_cor ip_fac_mf_prev1_cor_amp ldp_amp_ip_fac_mf_prev1_cor ip_fac_mf_prev1_cor_tgas ldp_tgas_ip_fac_mf_prev1_cor ip_mf_prev1_0_0 ldpm_n_1_ip_mf_prev1 ldpm_tqi_sp_1_ip_mf_prev1 ip_mf_prev1_0_1 ip_mf_prev1_0_2 ip_mf_prev1_amp ldp_n_ip_mf_prev1_amp ldp_tqi_sp_ip_mf_prev1_amp ip_mf_prev1_tgas ldp_n_ip_mf_prev1_tgas ldp_tqi_sp_ip_mf_prev1_tgas c_mf_prev2_max ip_fac_mf_prev2_cor_tco ldp_tco_ip_fac_mf_prev2_cor ip_fac_mf_prev2_cor_amp ldp_amp_ip_fac_mf_prev2_cor ip_fac_mf_prev2_cor_tgas ldp_tgas_ip_fac_mf_prev2_cor ip_mf_prev2_0_0 ldpm_n_1_ip_mf_prev2 ldpm_tqi_sp_1_ip_mf_prev2 ip_mf_prev2_0_1 ip_mf_prev2_0_2 ip_mf_prev2_amp ldp_n_ip_mf_prev2_amp ldp_tqi_sp_ip_mf_prev2_amp ip_mf_prev2_tgas ldp_n_ip_mf_prev2_tgas ldp_tqi_sp_ip_mf_prev2_tgas c_mf_main2_max ip_fac_mf_main2_cor_tco ldp_tco_ip_fac_mf_main2_cor ip_fac_mf_main2_cor_amp ldp_amp_ip_fac_mf_main2_cor ip_fac_mf_main2_cor_tgas ldp_tgas_ip_fac_mf_main2_cor ip_mf_main2_0_0 ldpm_n_1_ip_mf_main2 ldpm_tqi_sp_1_ip_mf_main2 ip_mf_main2_0_1 ip_mf_main2_0_2 ip_mf_main2_amp ldp_n_ip_mf_main2_amp ldp_tqi_sp_ip_mf_main2_amp ip_mf_main2_tgas ldp_n_ip_mf_main2_tgas ldp_tqi_sp_ip_mf_main2_tgas c_mf_post1_max ip_fac_mf_post1_cor_tco ldp_tco_ip_fac_mf_post1_cor ip_fac_mf_post1_cor_amp ldp_amp_ip_fac_mf_post1_cor ip_fac_mf_post1_cor_tgas ldp_tgas_ip_fac_mf_post1_cor ip_mf_post1_0_0 ldpm_n_1_ip_mf_post1 ldpm_tqi_sp_1_ip_mf_post1 ip_mf_post1_0_1 ip_mf_post1_0_2 ip_mf_post1_amp ldp_n_ip_mf_post1_amp ldp_tqi_sp_ip_mf_post1_amp ip_mf_post1_tgas ldp_n_ip_mf_post1_tgas ldp_tqi_sp_ip_mf_post1_tgas /end DEF_CHARACTERISTIC
 /begin OUT_MEASUREMENT mf_prev1_is_pl_rgl mf_prev2_is_pl_rgl mf_main2_is_pl_rgl mf_post1_is_pl_rgl mf_prev1_cor_rgl mf_prev2_cor_rgl mf_main2_cor_rgl mf_post1_cor_rgl /end OUT_MEASUREMENT
/end FUNCTION
/begin FUNCTION MF_AMF_INJMIN "Minimal Injection Fuel Mass" /begin DEF_CHARACTERISTIC c_mf_inj_min /end DEF_CHARACTERISTIC /begin OUT_MEASUREMENT mf_inj_min /end OUT_MEASUREMENT /end FUNCTION
/begin FUNCTION MF_AMFSTBAS "" /begin DEF_CHARACTERISTIC c_max_thd_hys c_min_thd_hys /end DEF_CHARACTERISTIC
 /begin OUT_MEASUREMENT mf_prev1_req mf_prev2_req mf_main2_req mf_post1_req ctr_tran_st_is_inter lv_act_prev1_inj lv_act_prev2_inj lv_act_main2_inj lv_act_post1_inj mf_post2_hys mf_prev1_hys mf_prev2_hys mf_main2_hys mf_post1_hys lv_act_prev_inj /end OUT_MEASUREMENT
/end FUNCTION
/begin FUNCTION MF_AMF_MINOR_RGN ""
 /begin DEF_CHARACTERISTIC ip_fac_mf_prev1_cor_amp_rgn_1 ip_fac_mf_prev2_cor_amp_rgn_1 ip_fac_mf_main2_cor_amp_rgn_1 ip_fac_mf_post1_cor_amp_rgn_1 ldp_amp_ip_fac_mf_prev1_cor_rgn_1 ldp_amp_ip_fac_mf_prev2_cor_rgn_1 ldp_amp_ip_fac_mf_main2_cor_rgn_1 ldp_amp_ip_fac_mf_post1_cor_rgn_1 ip_fac_mf_prev1_cor_amp_rgn_2 ip_fac_mf_prev2_cor_amp_rgn_2 ip_fac_mf_main2_cor_amp_rgn_2 ip_fac_mf_post1_cor_amp_rgn_2 ldp_amp_ip_fac_mf_prev1_cor_rgn_2 ldp_amp_ip_fac_mf_prev2_cor_rgn_2 ldp_amp_ip_fac_mf_main2_cor_rgn_2 ldp_amp_ip_fac_mf_post1_cor_rgn_2 ip_mf_prev1_amp_h_rgn_1 ip_mf_prev2_amp_h_rgn_1 ip_mf_main2_amp_h_rgn_1 ip_mf_post1_amp_h_rgn_1 ldpm_n_ip_mf_prev1_amp_rgn_1 ldpm_n_ip_mf_prev2_amp_rgn_1 ldpm_n_ip_mf_main2_amp_rgn_1 ldpm_n_ip_mf_post1_amp_rgn_1 ldpm_tqi_sp_ip_mf_prev1_amp_rgn_1 ldpm_tqi_sp_ip_mf_prev2_amp_rgn_1 ldpm_tqi_sp_ip_mf_main2_amp_rgn_1 ldpm_tqi_sp_ip_mf_post1_amp_rgn_1 ip_mf_prev1_amp_l_rgn_1 ip_mf_prev2_amp_l_rgn_1 ip_mf_main2_amp_l_rgn_1 ip_mf_post1_amp_l_rgn_1 ip_mf_prev1_amp_h_rgn_2 ip_mf_prev2_amp_h_rgn_2 ip_mf_main2_amp_h_rgn_2 ip_mf_post1_amp_h_rgn_2 ldpm_n_ip_mf_prev1_amp_rgn_2 ldpm_n_ip_mf_prev2_amp_rgn_2 ldpm_n_ip_mf_main2_amp_rgn_2 ldpm_n_ip_mf_post1_amp_rgn_2 ldpm_tqi_sp_ip_mf_prev1_amp_rgn_2 ldpm_tqi_sp_ip_mf_prev2_amp_rgn_2 ldpm_tqi_sp_ip_mf_main2_amp_rgn_2 ldpm_tqi_sp_ip_mf_post1_amp_rgn_2 ip_mf_prev1_amp_l_rgn_2 ip_mf_prev2_amp_l_rgn_2 ip_mf_main2_amp_l_rgn_2 ip_mf_post1_amp_l_rgn_2 /end DEF_CHARACTERISTIC
 /begin OUT_MEASUREMENT mf_prev1_is_pl_rgn_1 mf_prev2_is_pl_rgn_1 mf_main2_is_pl_rgn_1 mf_post1_is_pl_rgn_1 mf_main2_is_pl_rgn_2 mf_post1_is_pl_rgn_2 mf_prev2_is_pl_rgn_2 mf_prev1_is_pl_rgn_2 /end OUT_MEASUREMENT
/end FUNCTION
/begin FUNCTION MF_AMF_MINOR_TRAN ""
 /begin DEF_CHARACTERISTIC c_t_rgn_trn_mf_prev1 c_t_rgn_trn_mf_prev2 c_t_rgn_trn_mf_main2 c_t_rgn_trn_mf_post1 /end DEF_CHARACTERISTIC
 /begin OUT_MEASUREMENT mf_prev1_is_pl mf_prev2_is_pl mf_main2_is_pl mf_post1_is_pl /end OUT_MEASUREMENT
/end FUNCTION
/begin FUNCTION MF_AMF_MAIN ""
 /begin DEF_CHARACTERISTIC ip_fac_mf_bas_cor_tgas_0_0 ldp_tgas_ip_fac_mf_bas_cor_0_0 ip_fac_mf_bas_cor_tgas_1_0 ldp_tgas_ip_fac_mf_bas_cor_1_0 ip_fac_mf_bas_cor_tgas_2_0 ldp_tgas_ip_fac_mf_bas_cor_2_0 ip_fac_mf_bas_cor_tgas_3_0 ldp_tgas_ip_fac_mf_bas_cor_3_0 ip_fac_mf_bas_cor_tgas_4_0 ldp_tgas_ip_fac_mf_bas_cor_4_0 ip_fac_mf_bas_cor_amp_0_0 ldp_amp_ip_fac_mf_cor_0_0 ip_fac_mf_bas_cor_amp_1_0 ldp_amp_ip_fac_mf_cor_1_0 ip_fac_mf_bas_cor_amp_2_0 ldp_amp_ip_fac_mf_cor_2_0 ip_fac_mf_bas_cor_amp_3_0 ldp_amp_ip_fac_mf_cor_3_0 ip_fac_mf_bas_cor_amp_4_0 ldp_amp_ip_fac_mf_cor_4_0 ip_fac_mf_bas_cor_tco_0_0 ldp_tco_ip_fac_mf_cor_tco_0_0 ip_fac_mf_bas_cor_tco_1_0 ldp_tco_ip_fac_mf_cor_tco_1_0 ip_fac_mf_bas_cor_tco_2_0 ldp_tco_ip_fac_mf_cor_tco_2_0 ip_fac_mf_bas_cor_tco_3_0 ldp_tco_ip_fac_mf_cor_tco_3_0 ip_fac_mf_bas_cor_tco_4_0 ldp_tco_ip_fac_mf_cor_tco_4_0 ip_mf_bas_tgas_0_0 ldp_n_ip_mf_bas_tgas_0_0 ldp_tqi_sp_ip_mf_tgas_0_0 ip_mf_bas_tgas_1_0 ldp_n_ip_mf_bas_tgas_1_0 ldp_tqi_sp_ip_mf_tgas_1_0 ip_mf_bas_tgas_2_0 ldp_n_ip_mf_bas_tgas_2_0 ldp_tqi_sp_ip_mf_tgas_2_0 ip_mf_bas_tgas_3_0 ldp_n_ip_mf_bas_tgas_3_0 ldp_tqi_sp_ip_mf_tgas_3_0 ip_mf_bas_tgas_4_0 ldp_n_ip_mf_bas_tgas_4_0 ldp_tqi_sp_ip_mf_tgas_4_0 ip_mf_bas_amp_0_0 ldp_n_ip_mf_bas_amp_0_0 ldp_tqi_sp_ip_mf_bas_amp_0_0 ip_mf_bas_amp_1_0 ldp_n_ip_mf_bas_amp_1_0 ldp_tqi_sp_ip_mf_bas_amp_1_0 ip_mf_bas_amp_2_0 ldp_n_ip_mf_bas_amp_2_0 ldp_tqi_sp_ip_mf_bas_amp_2_0 ip_mf_bas_amp_3_0 ldp_n_ip_mf_bas_amp_3_0 ldp_tqi_sp_ip_mf_bas_amp_3_0 ip_mf_bas_amp_4_0 ldp_n_ip_mf_bas_amp_4_0 ldp_tqi_sp_ip_mf_bas_amp_4_0 ip_mf_bas_0_0 ip_mf_bas_0_1 ip_mf_bas_0_2 ip_mf_bas_1_0 ip_mf_bas_1_1 ip_mf_bas_1_2 ip_mf_bas_2_0 ip_mf_bas_2_1 ip_mf_bas_2_2 ip_mf_bas_3_0 ip_mf_bas_3_1 ip_mf_bas_3_2 ip_mf_bas_4_0 ip_mf_bas_4_1 ip_mf_bas_4_2 ldpm_n_1_ip_mf_bas_0_0 ldpm_tqi_sp_1_ip_mf_bas_0_0 ldpm_n_1_ip_mf_bas_1_0 ldpm_tqi_sp_1_ip_mf_bas_1_0 ldpm_n_1_ip_mf_bas_2_0 ldp_n_1_ip_mf_bas_2_0_x ldpm_tqi_sp_1_ip_mf_bas_2_0 ldp_tqi_sp_1_ip_mf_bas_2_0_x ldpm_n_1_ip_mf_bas_3_0 ldp_n_1_ip_mf_bas_3_0_x ldpm_tqi_sp_1_ip_mf_bas_3_0 ldp_tqi_sp_1_ip_mf_bas_3_0_x ldpm_n_1_ip_mf_bas_4_0 ldp_n_1_ip_mf_bas_4_0_x ldpm_tqi_sp_1_ip_mf_bas_4_0 ldp_tqi_sp_1_ip_mf_bas_4_0_x /end DEF_CHARACTERISTIC
 /begin OUT_MEASUREMENT mf_bas_rgl mf_bas_cor_sum_rgl /end OUT_MEASUREMENT
/end FUNCTION
/begin FUNCTION MF_AMF_MAIN_RGN ""
 /begin DEF_CHARACTERISTIC ip_fac_mf_bas_cor_amp_rgn_2 ldp_amp_ip_fac_mf_bas_cor_rgn_2 ip_fac_mf_bas_cor_amp_rgn_1 ldp_amp_ip_fac_mf_bas_cor_rgn_1 ip_mf_bas_amp_h_rgn_2 ldpm_n_ip_mf_bas_amp_rgn_2 ldpm_tqi_sp_ip_mf_amp_rgn_2 ip_mf_bas_amp_l_rgn_2 ip_mf_bas_amp_h_rgn_1 ldpm_n_ip_mf_bas_amp_rgn_1 ldpm_tqi_sp_ip_mf_amp_rgn_1 ip_mf_bas_amp_l_rgn_1 /end DEF_CHARACTERISTIC
 /begin OUT_MEASUREMENT mf_bas_is_pl_rgn_2 mf_bas_is_pl_rgn_1 /end OUT_MEASUREMENT
/end FUNCTION
/begin FUNCTION MF_AMF_MAIN_TEMP ""
 /begin OUT_MEASUREMENT mf_bas_sel_conf_0 mf_bas_sel_conf_1 mf_bas_sel_conf_2 mf_bas_sel_conf_3 mf_bas_sel_conf_4 /end OUT_MEASUREMENT
/end FUNCTION
/begin FUNCTION MF_AMF_MAIN_TRAN "" /begin DEF_CHARACTERISTIC c_t_rgn_trn_mf_bas /end DEF_CHARACTERISTIC /begin OUT_MEASUREMENT mf_bas_conf /end OUT_MEASUREMENT /end FUNCTION
/begin FUNCTION MF_AMF_TRAN ""
 /begin OUT_MEASUREMENT sf_inj_psn_move lv_act_post_puc mf_main1 mf_main2 mf_post1 mf_post2 mf_prev1 mf_prev2 /end OUT_MEASUREMENT
/end FUNCTION
/begin FUNCTION MF_AMFSPLIT ""
 /begin OUT_MEASUREMENT mf_main1_chk mf_prev1_chk mf_main2_chk mf_prev2_chk mf_post1_chk mf_post2_chk /end OUT_MEASUREMENT
/end FUNCTION
/begin FUNCTION C_Y_Byp_Sim "C_Y_Byp_Sim" /begin SUB_FUNCTION Bypass_Simulation /end SUB_FUNCTION /end FUNCTION
/end MODULE
/end PROJECT
